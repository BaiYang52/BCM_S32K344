AUTOSAR XML (schema 00046)
package /Resource
  module config Resource
    CommonPublishedInformation:
      ArReleaseMajorVersion = 4
      ArReleaseMinorVersion = 4
      ArReleaseRevisionVersion = 0
      ModuleId = 0
      SwMajorVersion = 2
      SwMinorVersion = 0
      SwPatchVersion = 1
      VendorId = 43
    ResourceGeneral: ResourceSubderivative=s32k344_mqfp172
package /ActiveEcuC
  module config Mcu: implementation-config-variant=VARIANT-POST-BUILD
    CommonPublishedInformation:
      ArReleaseMajorVersion = 4
      ArReleaseMinorVersion = 4
      ArReleaseRevisionVersion = 0
      ModuleId = 101
      SwMajorVersion = 2
      SwMinorVersion = 0
      SwPatchVersion = 1
      VendorApiInfix = 
      VendorId = 43
    McuCoreControlConfiguration: McuCoreBootAddressControl=0
    McuDebugConfiguration:
      McuDisableCmuApi = 1
      McuDisableDemReportErrorStatus = 1
      McuEmiosConfigureGprenApi = 0
      McuGetClockFrequencyApi = 0
      McuGetMidrStructureApi = 0
      McuGetPowerDomainApi = 0
      McuGetPowerModeStateApi = 0
      McuGetSystemStateApi = 0
      McuSscmGetMemConfigApi = 0
      McuSscmGetStatusApi = 0
      McuSscmGetUoptApi = 0
    McuGeneralConfiguration:
      McuAlternateResetIsrUsed = 0
      McuCalloutBeforePerformReset = 0
      McuCmuErrorIsrUsed = 0
      McuDevErrorDetect = 0
      McuDisableFlashWaitStatesConfig = 1
      McuDisablePmcInit = 0
      McuDisableRamWaitStatesConfig = 1
      McuDisableRgmInit = 0
      McuEnableUserModeSupport = 0
      McuEnterLowPowerMode = 0
      McuGetRamStateApi = 0
      McuInitClock = 1
      McuNoPll = 0
      McuPerformResetApi = 1
      McuPerformResetCallout = NULL_PTR
      McuRegisterValuesOptimization = DISABLED
      McuTimeout = 50000
      McuTimeoutMethod = OSIF_COUNTER_DUMMY
      McuVersionInfoApi = 0
      McuVoltageErrorIsrUsed = 0
      McuControlledClocksConfiguration: McuFircUnderMcuControl=1, McuFxoscUnderMcuControl=1, McuPll0UnderMcuControl=1, McuSircUnderMcuControl=1, McuSxoscUnderMcuControl=1
    McuModuleConfiguration:
      McuClockSrcFailureNotification = DISABLED
      McuCrystalFrequencyHz = 1.6E7
      McuEMAC_MII_RMII_TX_CLKFrequencyHz = 5.0E7
      McuEMAC_MII_RX_CLKFrequencyHz = 2.5E7
      McuLFAST_REF_EXT_CLKFrequencyHz = 1.6E8
      McuNumberOfMcuModes = 1
      McuRamSectors = 0
      McuSWG_PAD_CLKFrequencyHz = 1.6E8
      McuSlowCrystalFrequencyHz = 32768.0
      McuClockSettingConfig_0 (McuClockSettingConfig): McuClockSettingId=0
        McuCgm0SettingConfig: McuPCSStepDuration=1, McuPCSSwitchDuration=48
          McuCgm0ClockMux0:
            McuClkMux0Div0Trigger = COMMON_TRIGGER_DIVIDER_UPDATE
            McuClkMux0Div0_Divisor = 0
            McuClkMux0Div0_En = 1
            McuClkMux0Div1Trigger = COMMON_TRIGGER_DIVIDER_UPDATE
            McuClkMux0Div1_Divisor = 1
            McuClkMux0Div1_En = 1
            McuClkMux0Div2Trigger = COMMON_TRIGGER_DIVIDER_UPDATE
            McuClkMux0Div2_Divisor = 3
            McuClkMux0Div2_En = 1
            McuClkMux0Div3Trigger = COMMON_TRIGGER_DIVIDER_UPDATE
            McuClkMux0Div3_Divisor = 1
            McuClkMux0Div3_En = 1
            McuClkMux0Div4Trigger = COMMON_TRIGGER_DIVIDER_UPDATE
            McuClkMux0Div4_Divisor = 3
            McuClkMux0Div4_En = 1
            McuClkMux0Div5Trigger = COMMON_TRIGGER_DIVIDER_UPDATE
            McuClkMux0Div5_Divisor = 3
            McuClkMux0Div5_En = 1
            McuClkMux0Div6Trigger = COMMON_TRIGGER_DIVIDER_UPDATE
            McuClkMux0Div6_Divisor = 0
            McuClkMux0Div6_En = 1
            McuClkMux0Div7Trigger = COMMON_TRIGGER_DIVIDER_UPDATE
            McuClkMux0Div7_Divisor = 0
            McuClkMux0Div7_En = 0
            McuClkMux0_Source = PLL_PHI0_CLK
            McuClockMux0Divider0_Frequency = 1.6E8
            McuClockMux0Divider1_Frequency = 8.0E7
            McuClockMux0Divider2_Frequency = 4.0E7
            McuClockMux0Divider3_Frequency = 8.0E7
            McuClockMux0Divider4_Frequency = 4.0E7
            McuClockMux0Divider5_Frequency = 4.0E7
            McuClockMux0Divider6_Frequency = 1.6E8
            McuClockMux0Divider7_Frequency = 0.0
            McuClockMuxUnderMcuControl = 1
          McuCgm0ClockMux1: McuClkMux1Div0_Divisor=0, McuClkMux1Div0_En=0, McuClkMux1_Source=FIRC_CLK, McuClockMux1Divider0_Frequency=0.0, McuClockMuxUnderMcuControl=1
          McuCgm0ClockMux10: McuClkMux10Div0_Divisor=0, McuClkMux10Div0_En=0, McuClkMux10_Source=FIRC_CLK, McuClockMux10Divider0_Frequency=0.0, McuClockMuxUnderMcuControl=1
          McuCgm0ClockMux{11..13}: McuClkMux{11..13}Div0_Divisor=0, McuClkMux{11..13}Div0_En=1, McuClkMux{11..13}_Source=FIRC_CLK, McuClockMux{11..13}Divider0_Frequency=4.8E7, McuClockMuxUnderMcuControl=1
          McuCgm0ClockMux15: McuClkMux15Div0_Divisor=2, McuClkMux15Div0_En=1, McuClkMux15_Source=FIRC_CLK, McuClockMux15Divider0_Frequency=1.6E7, McuClockMuxUnderMcuControl=1
          McuCgm0ClockMux16: McuClkMux16Div0_Divisor=2, McuClkMux16Div0_En=0, McuClkMux16_Source=FIRC_CLK, McuClockMux16Divider0_Frequency=0.0, McuClockMuxUnderMcuControl=1
          McuCgm0ClockMux{2..4}: McuClkMux{2..4}Div0_Divisor=0, McuClkMux{2..4}Div0_En=0, McuClkMux{2..4}_Source=FIRC_CLK, McuClockMux{2..4}Divider0_Frequency=0.0, McuClockMuxUnderMcuControl=1
          McuCgm0ClockMux5: McuClkMux5Div0_Divisor=1, McuClkMux5Div0_En=1, McuClkMux5_Source=FIRC_CLK, McuClockMux5Divider0_Frequency=2.4E7, McuClockMuxUnderMcuControl=1
          McuCgm0ClockMux6: McuClkMux6Div0_Divisor=1, McuClkMux6Div0_En=1, McuClkMux6_Source=FIRC_CLK, McuClockMux6Divider0_Frequency=2.4E7, McuClockMuxUnderMcuControl=1
          McuCgm0ClockMux{7..9}: McuClkMux{7..9}Div0_Divisor=0, McuClkMux{7..9}Div0_En=0, McuClkMux{7..9}_Source=FIRC_CLK, McuClockMux{7..9}Divider0_Frequency=0.0, McuClockMuxUnderMcuControl=1
          McuCgm0PcsConfig_0 (McuCgm0PcsConfig): McuClockPcfsUnderMcuControl=0, McuPCS_MaxAllowableDynamicIDD=0.0, McuPCS_Name=PCFS_8, McuPCS_SourceFrequency=1.6E8
        4 x McuClkMonitor, all with McuClkMonitorEn=0, McuClockMonitorUnderMcuControl=1, McuFHHAsyncEventEn=0, McuFHHInterruptEn=0, McuFLLAsyncEventEn=0, McuFLLInterruptEn=0:
          McuClkMonitor_0: McuCmuName=CMU_FC_0_FXOSC_CLK
          McuClkMonitor_1: McuCmuName=CMU_FC_3_CORE_CLK
          McuClkMonitor_2: McuCmuName=CMU_FC_4_AIPS_PLAT_CLK
          McuClkMonitor_3: McuCmuName=CMU_FC_5_HSE_CLK
        McuClockReferencePoint_0 (McuClockReferencePoint): McuClockFrequencySelect=CORE_CLK, McuClockReferencePointFrequency=1.6E8
        McuFIRC: McuFIRC_Frequency=4.8E7, McuFircDivSel=Div_by_1, McuFircStandbyEnable=0, McuFircUnderMcuControl=1
        McuFXOSC:
          McuFXOSC_Frequency = 1.6E7
          McuFxoscBypass = 0
          McuFxoscCounter = 49
          McuFxoscMainComparator = 1
          McuFxoscOverdriveProtection = 12
          McuFxoscPowerDownCtr = 1
          McuFxoscUnderMcuControl = 1
        McuPll_0: McuPLLEnabled=1, McuPLLUnderMcuControl=1
          McuPll_Configuration:
            McuPllDvMfi = 120
            McuPllDvOdiv2 = 2
            McuPllDvRdiv = 2
            McuPllFdFmod = 0.0
            McuPllFdMdp = 0.0
            McuPllFdMfn = 0
            McuPllFdSdm2 = 0
            McuPllFdSdm3 = 0
            McuPllFdSdmen = 0
            McuPllFmSpreadctl = Center_Spread
            McuPllFmSscgbyp = 1
            McuPllFmStepNo = 1
            McuPllFmStepSize = 0
            McuPllOdiv0_Div = 2
            McuPllOdiv0_En = 1
            McuPllOdiv1_Div = 2
            McuPllOdiv1_En = 1
          McuPll_Parameter: PLL_PHI0_Frequency=1.6E8, PLL_PHI1_Frequency=1.6E8, PLL_VCO_Frequency=9.6E8
        McuRtcClockSelect: McuClockMuxUnderMcuControl=1, McuRtc_Frequency=4.8E7, McuRtc_Source=FIRC_CLK
        McuSIRC: McuSIRC_Frequency=32000.0, McuSircStandbyEnable=0, McuSircUnderMcuControl=1
        McuSXOSC: McuSXOSC_Frequency=0.0, McuSxoscCounter=125, McuSxoscPowerDownCtr=0, McuSxoscUnderMcuControl=1
      McuClockSettingConfig_1 (McuClockSettingConfig): McuClockSettingId=1
        McuCgm0SettingConfig: McuPCSStepDuration=1, McuPCSSwitchDuration=48
          McuCgm0ClockMux0:
            McuClkMux0Div0Trigger = COMMON_TRIGGER_DIVIDER_UPDATE
            McuClkMux0Div0_Divisor = 0
            McuClkMux0Div0_En = 1
            McuClkMux0Div1Trigger = COMMON_TRIGGER_DIVIDER_UPDATE
            McuClkMux0Div1_Divisor = 0
            McuClkMux0Div1_En = 1
            McuClkMux0Div2Trigger = COMMON_TRIGGER_DIVIDER_UPDATE
            McuClkMux0Div2_Divisor = 1
            McuClkMux0Div2_En = 1
            McuClkMux0Div3Trigger = COMMON_TRIGGER_DIVIDER_UPDATE
            McuClkMux0Div3_Divisor = 0
            McuClkMux0Div3_En = 1
            McuClkMux0Div4Trigger = COMMON_TRIGGER_DIVIDER_UPDATE
            McuClkMux0Div4_Divisor = 0
            McuClkMux0Div4_En = 1
            McuClkMux0Div5Trigger = COMMON_TRIGGER_DIVIDER_UPDATE
            McuClkMux0Div5_Divisor = 3
            McuClkMux0Div5_En = 1
            McuClkMux0Div6Trigger = COMMON_TRIGGER_DIVIDER_UPDATE
            McuClkMux0Div6_Divisor = 0
            McuClkMux0Div6_En = 1
            McuClkMux0Div7Trigger = COMMON_TRIGGER_DIVIDER_UPDATE
            McuClkMux0Div7_Divisor = 0
            McuClkMux0Div7_En = 0
            McuClkMux0_Source = FIRC_CLK
            McuClockMux0Divider0_Frequency = 4.8E7
            McuClockMux0Divider1_Frequency = 4.8E7
            McuClockMux0Divider2_Frequency = 2.4E7
            McuClockMux0Divider3_Frequency = 4.8E7
            McuClockMux0Divider4_Frequency = 4.8E7
            McuClockMux0Divider5_Frequency = 1.2E7
            McuClockMux0Divider6_Frequency = 4.8E7
            McuClockMux0Divider7_Frequency = 0.0
            McuClockMuxUnderMcuControl = 1
          McuCgm0ClockMux1: McuClkMux1Div0_Divisor=0, McuClkMux1Div0_En=0, McuClkMux1_Source=FIRC_CLK, McuClockMux1Divider0_Frequency=0.0, McuClockMuxUnderMcuControl=1
          McuCgm0ClockMux10: McuClkMux10Div0_Divisor=0, McuClkMux10Div0_En=0, McuClkMux10_Source=FIRC_CLK, McuClockMux10Divider0_Frequency=0.0, McuClockMuxUnderMcuControl=1
          McuCgm0ClockMux{11..13}: McuClkMux{11..13}Div0_Divisor=0, McuClkMux{11..13}Div0_En=1, McuClkMux{11..13}_Source=FIRC_CLK, McuClockMux{11..13}Divider0_Frequency=4.8E7, McuClockMuxUnderMcuControl=1
          McuCgm0ClockMux15: McuClkMux15Div0_Divisor=2, McuClkMux15Div0_En=1, McuClkMux15_Source=FIRC_CLK, McuClockMux15Divider0_Frequency=1.6E7, McuClockMuxUnderMcuControl=1
          McuCgm0ClockMux16: McuClkMux16Div0_Divisor=2, McuClkMux16Div0_En=0, McuClkMux16_Source=FIRC_CLK, McuClockMux16Divider0_Frequency=0.0, McuClockMuxUnderMcuControl=1
          McuCgm0ClockMux{2..4}: McuClkMux{2..4}Div0_Divisor=0, McuClkMux{2..4}Div0_En=0, McuClkMux{2..4}_Source=FIRC_CLK, McuClockMux{2..4}Divider0_Frequency=0.0, McuClockMuxUnderMcuControl=1
          McuCgm0ClockMux5: McuClkMux5Div0_Divisor=1, McuClkMux5Div0_En=1, McuClkMux5_Source=FIRC_CLK, McuClockMux5Divider0_Frequency=2.4E7, McuClockMuxUnderMcuControl=1
          McuCgm0ClockMux6: McuClkMux6Div0_Divisor=1, McuClkMux6Div0_En=1, McuClkMux6_Source=FIRC_CLK, McuClockMux6Divider0_Frequency=2.4E7, McuClockMuxUnderMcuControl=1
          McuCgm0ClockMux{7..9}: McuClkMux{7..9}Div0_Divisor=0, McuClkMux{7..9}Div0_En=0, McuClkMux{7..9}_Source=FIRC_CLK, McuClockMux{7..9}Divider0_Frequency=0.0, McuClockMuxUnderMcuControl=1
          McuCgm0PcsConfig_0 (McuCgm0PcsConfig): McuClockPcfsUnderMcuControl=0, McuPCS_MaxAllowableDynamicIDD=0.0, McuPCS_Name=PCFS_8, McuPCS_SourceFrequency=0.0
        4 x McuClkMonitor, all with McuClkMonitorEn=0, McuClockMonitorUnderMcuControl=1, McuFHHAsyncEventEn=0, McuFHHInterruptEn=0, McuFLLAsyncEventEn=0, McuFLLInterruptEn=0:
          McuClkMonitor_0: McuCmuName=CMU_FC_0_FXOSC_CLK
          McuClkMonitor_1: McuCmuName=CMU_FC_3_CORE_CLK
          McuClkMonitor_2: McuCmuName=CMU_FC_4_AIPS_PLAT_CLK
          McuClkMonitor_3: McuCmuName=CMU_FC_5_HSE_CLK
        McuClockReferencePoint_0 (McuClockReferencePoint): McuClockFrequencySelect=CORE_CLK, McuClockReferencePointFrequency=4.8E7
        McuFIRC: McuFIRC_Frequency=4.8E7, McuFircDivSel=Div_by_1, McuFircStandbyEnable=0, McuFircUnderMcuControl=1
        McuFXOSC:
          McuFXOSC_Frequency = 0.0
          McuFxoscBypass = 0
          McuFxoscCounter = 49
          McuFxoscMainComparator = 1
          McuFxoscOverdriveProtection = 12
          McuFxoscPowerDownCtr = 0
          McuFxoscUnderMcuControl = 1
        McuPll_0: McuPLLEnabled=0, McuPLLUnderMcuControl=1
          McuPll_Configuration:
            McuPllDvMfi = 120
            McuPllDvOdiv2 = 2
            McuPllDvRdiv = 2
            McuPllFdFmod = 0.0
            McuPllFdMdp = 0.0
            McuPllFdMfn = 0
            McuPllFdSdm2 = 0
            McuPllFdSdm3 = 0
            McuPllFdSdmen = 0
            McuPllFmSpreadctl = Center_Spread
            McuPllFmSscgbyp = 1
            McuPllFmStepNo = 1
            McuPllFmStepSize = 0
            McuPllOdiv0_Div = 2
            McuPllOdiv0_En = 0
            McuPllOdiv1_Div = 2
            McuPllOdiv1_En = 0
          McuPll_Parameter: PLL_PHI0_Frequency=0.0, PLL_PHI1_Frequency=0.0, PLL_VCO_Frequency=0.0
        McuRtcClockSelect: McuClockMuxUnderMcuControl=1, McuRtc_Frequency=4.8E7, McuRtc_Source=FIRC_CLK
        McuSIRC: McuSIRC_Frequency=32000.0, McuSircStandbyEnable=0, McuSircUnderMcuControl=1
        McuSXOSC: McuSXOSC_Frequency=0.0, McuSxoscCounter=125, McuSxoscPowerDownCtr=0, McuSxoscUnderMcuControl=1
      McuModeSettingConf_0 (McuModeSettingConf): McuEnableSleepOnExit=0, McuMainCoreSelect=CM7_0, McuMode=0, McuPowerMode=RUN
        McuDcmGprConfiguration:
          McuBootBaseAddress = 0
          McuDCM_SCAN_BYP_STDBY_EXTControl = 0
          McuDcmGprUnderMcuControl = 1
          McuFIRC_TRIM_BYP_STDBY_EXTControl = 0
          McuGlobalPadkeepingEnable = 0
          McuPMC_TRIM_RGM_DCF_BYP_STDBY_EXTControl = 0
          McuSIRC_TRIM_BYP_STDBY_EXTControl = 0
        McuPartitionConfiguration
          McuPartition0Config:
            McuPartitionClockEnable = 1
            McuPartitionPowerUnderMcuControl = 1
            McuPartitionUnderMcuControl = 1
            McuPrtnCofb0UnderMcuControl = 1
            McuPrtnCofb1UnderMcuControl = 1
            McuCore0Configuration: McuCoreBootAddress=0, McuCoreBootAddressLinkerSym=, McuCoreClockEnable=0, McuCoreUnderMcuControl=1
            McuCore1Configuration: McuCoreBootAddress=0, McuCoreBootAddressLinkerSym=, McuCoreClockEnable=0, McuCoreUnderMcuControl=1
            McuCore4Configuration: McuCoreBootAddress=0, McuCoreBootAddressLinkerSym=, McuCoreClockEnable=0, McuCoreUnderMcuControl=1
          McuPartition1Config:
            McuPartitionClockEnable = 1
            McuPartitionPowerUnderMcuControl = 1
            McuPartitionUnderMcuControl = 1
            McuPrtnCofb{0..3}UnderMcuControl = 1
          McuPartition2Config:
            McuPartitionClockEnable = 1
            McuPartitionPowerUnderMcuControl = 1
            McuPartitionUnderMcuControl = 1
            McuPrtnCofb{0..2}UnderMcuControl = 1
          McuPartition3Config:
            McuPartitionClockEnable = 1
            McuPartitionPowerUnderMcuControl = 1
            McuPartitionUnderMcuControl = 1
            McuPrtnCofb{0..2}UnderMcuControl = 1
          107 x McuPeripheral, all with McuPeripheralResetEnable=0, McuResetGenerationSlot=NONE:
            McuPeripheral_0: index=0, McuModeEntrySlot=PRTN0_COFB1_REQ32, McuPeripheralClockEnable=0, McuPeripheralName=TRGMUX
            McuPeripheral_1: index=1, McuModeEntrySlot=PRTN0_COFB1_REQ33, McuPeripheralClockEnable=0, McuPeripheralName=BCTU
            McuPeripheral_2: index=2, McuModeEntrySlot=PRTN0_COFB1_REQ34, McuPeripheralClockEnable=0, McuPeripheralName=EMIOS_0
            McuPeripheral_3: index=3, McuModeEntrySlot=PRTN0_COFB1_REQ35, McuPeripheralClockEnable=0, McuPeripheralName=EMIOS_1
            McuPeripheral_4: index=4, McuModeEntrySlot=PRTN0_COFB1_REQ36, McuPeripheralClockEnable=0, McuPeripheralName=EMIOS_2
            McuPeripheral_5: index=5, McuModeEntrySlot=PRTN0_COFB1_REQ38, McuPeripheralClockEnable=0, McuPeripheralName=LCU_0
            McuPeripheral_6: index=6, McuModeEntrySlot=PRTN0_COFB1_REQ39, McuPeripheralClockEnable=0, McuPeripheralName=LCU_1
            McuPeripheral_7: index=7, McuModeEntrySlot=PRTN0_COFB1_REQ40, McuPeripheralClockEnable=0, McuPeripheralName=ADC_0
            McuPeripheral_8: index=8, McuModeEntrySlot=PRTN0_COFB1_REQ41, McuPeripheralClockEnable=0, McuPeripheralName=ADC_1
            McuPeripheral_9: index=9, McuModeEntrySlot=PRTN0_COFB1_REQ42, McuPeripheralClockEnable=0, McuPeripheralName=ADC_2
            McuPeripheral_10: index=10, McuModeEntrySlot=PRTN0_COFB1_REQ44, McuPeripheralClockEnable=1, McuPeripheralName=PIT_0
            McuPeripheral_11: index=11, McuModeEntrySlot=PRTN0_COFB1_REQ45, McuPeripheralClockEnable=0, McuPeripheralName=PIT_1
            McuPeripheral_12: index=12, McuModeEntrySlot=PRTN1_COFB0_REQ3, McuPeripheralClockEnable=0, McuPeripheralName=EDMA
            McuPeripheral_13: index=13, McuModeEntrySlot=PRTN1_COFB0_REQ4, McuPeripheralClockEnable=0, McuPeripheralName=EDMA_TCD_0
            McuPeripheral_14: index=14, McuModeEntrySlot=PRTN1_COFB0_REQ5, McuPeripheralClockEnable=0, McuPeripheralName=EDMA_TCD_1
            McuPeripheral_15: index=15, McuModeEntrySlot=PRTN1_COFB0_REQ6, McuPeripheralClockEnable=0, McuPeripheralName=EDMA_TCD_2
            McuPeripheral_16: index=16, McuModeEntrySlot=PRTN1_COFB0_REQ7, McuPeripheralClockEnable=0, McuPeripheralName=EDMA_TCD_3
            McuPeripheral_17: index=17, McuModeEntrySlot=PRTN1_COFB0_REQ8, McuPeripheralClockEnable=0, McuPeripheralName=EDMA_TCD_4
            McuPeripheral_18: index=18, McuModeEntrySlot=PRTN1_COFB0_REQ9, McuPeripheralClockEnable=0, McuPeripheralName=EDMA_TCD_5
            McuPeripheral_19: index=19, McuModeEntrySlot=PRTN1_COFB0_REQ10, McuPeripheralClockEnable=0, McuPeripheralName=EDMA_TCD_6
            McuPeripheral_20: index=20, McuModeEntrySlot=PRTN1_COFB0_REQ11, McuPeripheralClockEnable=0, McuPeripheralName=EDMA_TCD_7
            McuPeripheral_21: index=21, McuModeEntrySlot=PRTN1_COFB0_REQ12, McuPeripheralClockEnable=0, McuPeripheralName=EDMA_TCD_8
            McuPeripheral_22: index=22, McuModeEntrySlot=PRTN1_COFB0_REQ13, McuPeripheralClockEnable=0, McuPeripheralName=EDMA_TCD_9
            McuPeripheral_23: index=23, McuModeEntrySlot=PRTN1_COFB0_REQ14, McuPeripheralClockEnable=0, McuPeripheralName=EDMA_TCD_10
            McuPeripheral_24: index=24, McuModeEntrySlot=PRTN1_COFB0_REQ15, McuPeripheralClockEnable=0, McuPeripheralName=EDMA_TCD_11
            McuPeripheral_25: index=25, McuModeEntrySlot=PRTN1_COFB0_REQ21, McuPeripheralClockEnable=1, McuPeripheralName=SDA_AP
            McuPeripheral_26: index=26, McuModeEntrySlot=PRTN1_COFB0_REQ22, McuPeripheralClockEnable=0, McuPeripheralName=EIM
            McuPeripheral_27: index=27, McuModeEntrySlot=PRTN1_COFB0_REQ23, McuPeripheralClockEnable=0, McuPeripheralName=ERM
            McuPeripheral_28: index=28, McuModeEntrySlot=PRTN1_COFB0_REQ24, McuPeripheralClockEnable=1, McuPeripheralName=MSCM
            McuPeripheral_29: index=29, McuModeEntrySlot=PRTN1_COFB0_REQ28, McuPeripheralClockEnable=1, McuPeripheralName=SWT_0
            McuPeripheral_30: index=30, McuModeEntrySlot=PRTN1_COFB0_REQ29, McuPeripheralClockEnable=0, McuPeripheralName=STM_0
            McuPeripheral_31: index=31, McuModeEntrySlot=PRTN1_COFB0_REQ31, McuPeripheralClockEnable=0, McuPeripheralName=INTM
            McuPeripheral_32: index=32, McuModeEntrySlot=PRTN1_COFB1_REQ32, McuPeripheralClockEnable=0, McuPeripheralName=DMAMUX_0
            McuPeripheral_33: index=33, McuModeEntrySlot=PRTN1_COFB1_REQ33, McuPeripheralClockEnable=0, McuPeripheralName=DMAMUX_1
            McuPeripheral_34: index=34, McuModeEntrySlot=PRTN1_COFB1_REQ34, McuPeripheralClockEnable=1, McuPeripheralName=RTC
            McuPeripheral_35: index=35, McuModeEntrySlot=PRTN1_COFB1_REQ42, McuPeripheralClockEnable=1, McuPeripheralName=SIUL2_VIRTWRAPPER_PDAC3
            McuPeripheral_36: index=36, McuModeEntrySlot=PRTN1_COFB1_REQ45, McuPeripheralClockEnable=1, McuPeripheralName=WKPU
            McuPeripheral_37: index=37, McuModeEntrySlot=PRTN1_COFB1_REQ47, McuPeripheralClockEnable=0, McuPeripheralName=CMU_0_5
            McuPeripheral_38: index=38, McuModeEntrySlot=PRTN1_COFB1_REQ49, McuPeripheralClockEnable=1, McuPeripheralName=TSPC
            McuPeripheral_39: index=39, McuModeEntrySlot=PRTN1_COFB1_REQ51, McuPeripheralClockEnable=1, McuPeripheralName=SXOSC
            McuPeripheral_40: index=40, McuModeEntrySlot=PRTN1_COFB1_REQ53, McuPeripheralClockEnable=1, McuPeripheralName=FXOSC
            McuPeripheral_41: index=41, McuModeEntrySlot=PRTN1_COFB1_REQ56, McuPeripheralClockEnable=0, McuPeripheralName=PLL
            McuPeripheral_42: index=42, McuModeEntrySlot=PRTN1_COFB1_REQ63, McuPeripheralClockEnable=0, McuPeripheralName=PIT_2
            McuPeripheral_43: index=43, McuModeEntrySlot=PRTN1_COFB2_REQ65, McuPeripheralClockEnable=0, McuPeripheralName=FlexCAN_0
            McuPeripheral_44: index=44, McuModeEntrySlot=PRTN1_COFB2_REQ66, McuPeripheralClockEnable=0, McuPeripheralName=FlexCAN_1
            McuPeripheral_45: index=45, McuModeEntrySlot=PRTN1_COFB2_REQ67, McuPeripheralClockEnable=0, McuPeripheralName=FlexCAN_2
            McuPeripheral_46: index=46, McuModeEntrySlot=PRTN1_COFB2_REQ68, McuPeripheralClockEnable=0, McuPeripheralName=FlexCAN_3
            McuPeripheral_47: index=47, McuModeEntrySlot=PRTN1_COFB2_REQ69, McuPeripheralClockEnable=0, McuPeripheralName=FlexCAN_4
            McuPeripheral_48: index=48, McuModeEntrySlot=PRTN1_COFB2_REQ70, McuPeripheralClockEnable=0, McuPeripheralName=FlexCAN_5
            McuPeripheral_49: index=49, McuModeEntrySlot=PRTN1_COFB2_REQ73, McuPeripheralClockEnable=0, McuPeripheralName=FlexIO
            McuPeripheral_50: index=50, McuModeEntrySlot=PRTN1_COFB2_REQ74, McuPeripheralClockEnable=0, McuPeripheralName=LPUART_0
            McuPeripheral_51: index=51, McuModeEntrySlot=PRTN1_COFB2_REQ75, McuPeripheralClockEnable=0, McuPeripheralName=LPUART_1
            McuPeripheral_52: index=52, McuModeEntrySlot=PRTN1_COFB2_REQ76, McuPeripheralClockEnable=0, McuPeripheralName=LPUART_2
            McuPeripheral_53: index=53, McuModeEntrySlot=PRTN1_COFB2_REQ77, McuPeripheralClockEnable=0, McuPeripheralName=LPUART_3
            McuPeripheral_54: index=54, McuModeEntrySlot=PRTN1_COFB2_REQ78, McuPeripheralClockEnable=0, McuPeripheralName=LPUART_4
            McuPeripheral_55: index=55, McuModeEntrySlot=PRTN1_COFB2_REQ79, McuPeripheralClockEnable=0, McuPeripheralName=LPUART_5
            McuPeripheral_56: index=56, McuModeEntrySlot=PRTN1_COFB2_REQ80, McuPeripheralClockEnable=0, McuPeripheralName=LPUART_6
            McuPeripheral_57: index=57, McuModeEntrySlot=PRTN1_COFB2_REQ81, McuPeripheralClockEnable=0, McuPeripheralName=LPUART_7
            McuPeripheral_58: index=58, McuModeEntrySlot=PRTN1_COFB2_REQ84, McuPeripheralClockEnable=0, McuPeripheralName=LPI2C_0
            McuPeripheral_59: index=59, McuModeEntrySlot=PRTN1_COFB2_REQ85, McuPeripheralClockEnable=0, McuPeripheralName=LPI2C_1
            McuPeripheral_60: index=60, McuModeEntrySlot=PRTN1_COFB2_REQ86, McuPeripheralClockEnable=0, McuPeripheralName=LPSPI_0
            McuPeripheral_61: index=61, McuModeEntrySlot=PRTN1_COFB2_REQ87, McuPeripheralClockEnable=0, McuPeripheralName=LPSPI_1
            McuPeripheral_62: index=62, McuModeEntrySlot=PRTN1_COFB2_REQ88, McuPeripheralClockEnable=0, McuPeripheralName=LPSPI_2
            McuPeripheral_63: index=63, McuModeEntrySlot=PRTN1_COFB2_REQ89, McuPeripheralClockEnable=0, McuPeripheralName=LPSPI_3
            McuPeripheral_64: index=64, McuModeEntrySlot=PRTN1_COFB2_REQ91, McuPeripheralClockEnable=0, McuPeripheralName=SAI_0
            McuPeripheral_65: index=65, McuModeEntrySlot=PRTN1_COFB2_REQ92, McuPeripheralClockEnable=1, McuPeripheralName=LPCMP_0
            McuPeripheral_66: index=66, McuModeEntrySlot=PRTN1_COFB2_REQ93, McuPeripheralClockEnable=1, McuPeripheralName=LPCMP_1
            McuPeripheral_67: index=67, McuModeEntrySlot=PRTN1_COFB2_REQ95, McuPeripheralClockEnable=0, McuPeripheralName=TEMPSENSE
            McuPeripheral_68: index=68, McuModeEntrySlot=PRTN1_COFB3_REQ96, McuPeripheralClockEnable=0, McuPeripheralName=CRC
            McuPeripheral_69: index=69, McuModeEntrySlot=PRTN1_COFB3_REQ104, McuPeripheralClockEnable=1, McuPeripheralName=STCU_2
            McuPeripheral_70: index=70, McuModeEntrySlot=PRTN2_COFB0_REQ4, McuPeripheralClockEnable=0, McuPeripheralName=EDMA_TCD_12
            McuPeripheral_71: index=71, McuModeEntrySlot=PRTN2_COFB0_REQ5, McuPeripheralClockEnable=0, McuPeripheralName=EDMA_TCD_13
            McuPeripheral_72: index=72, McuModeEntrySlot=PRTN2_COFB0_REQ6, McuPeripheralClockEnable=0, McuPeripheralName=EDMA_TCD_14
            McuPeripheral_73: index=73, McuModeEntrySlot=PRTN2_COFB0_REQ7, McuPeripheralClockEnable=0, McuPeripheralName=EDMA_TCD_15
            McuPeripheral_74: index=74, McuModeEntrySlot=PRTN2_COFB0_REQ8, McuPeripheralClockEnable=0, McuPeripheralName=EDMA_TCD_16
            McuPeripheral_75: index=75, McuModeEntrySlot=PRTN2_COFB0_REQ9, McuPeripheralClockEnable=0, McuPeripheralName=EDMA_TCD_17
            McuPeripheral_76: index=76, McuModeEntrySlot=PRTN2_COFB0_REQ10, McuPeripheralClockEnable=0, McuPeripheralName=EDMA_TCD_18
            McuPeripheral_77: index=77, McuModeEntrySlot=PRTN2_COFB0_REQ11, McuPeripheralClockEnable=0, McuPeripheralName=EDMA_TCD_19
            McuPeripheral_78: index=78, McuModeEntrySlot=PRTN2_COFB0_REQ12, McuPeripheralClockEnable=0, McuPeripheralName=EDMA_TCD_20
            McuPeripheral_79: index=79, McuModeEntrySlot=PRTN2_COFB0_REQ13, McuPeripheralClockEnable=0, McuPeripheralName=EDMA_TCD_21
            McuPeripheral_80: index=80, McuModeEntrySlot=PRTN2_COFB0_REQ14, McuPeripheralClockEnable=0, McuPeripheralName=EDMA_TCD_22
            McuPeripheral_81: index=81, McuModeEntrySlot=PRTN2_COFB0_REQ15, McuPeripheralClockEnable=0, McuPeripheralName=EDMA_TCD_23
            McuPeripheral_82: index=82, McuModeEntrySlot=PRTN2_COFB0_REQ16, McuPeripheralClockEnable=0, McuPeripheralName=EDMA_TCD_24
            McuPeripheral_83: index=83, McuModeEntrySlot=PRTN2_COFB0_REQ17, McuPeripheralClockEnable=0, McuPeripheralName=EDMA_TCD_25
            McuPeripheral_84: index=84, McuModeEntrySlot=PRTN2_COFB0_REQ18, McuPeripheralClockEnable=0, McuPeripheralName=EDMA_TCD_26
            McuPeripheral_85: index=85, McuModeEntrySlot=PRTN2_COFB0_REQ19, McuPeripheralClockEnable=0, McuPeripheralName=EDMA_TCD_27
            McuPeripheral_86: index=86, McuModeEntrySlot=PRTN2_COFB0_REQ20, McuPeripheralClockEnable=0, McuPeripheralName=EDMA_TCD_28
            McuPeripheral_87: index=87, McuModeEntrySlot=PRTN2_COFB0_REQ21, McuPeripheralClockEnable=0, McuPeripheralName=EDMA_TCD_29
            McuPeripheral_88: index=88, McuModeEntrySlot=PRTN2_COFB0_REQ22, McuPeripheralClockEnable=0, McuPeripheralName=EDMA_TCD_30
            McuPeripheral_89: index=89, McuModeEntrySlot=PRTN2_COFB0_REQ23, McuPeripheralClockEnable=0, McuPeripheralName=EDMA_TCD_31
            McuPeripheral_90: index=90, McuModeEntrySlot=PRTN2_COFB0_REQ24, McuPeripheralClockEnable=0, McuPeripheralName=SEMA_42
            McuPeripheral_91: index=91, McuModeEntrySlot=PRTN2_COFB0_REQ29, McuPeripheralClockEnable=0, McuPeripheralName=STM_1
            McuPeripheral_92: index=92, McuModeEntrySlot=PRTN2_COFB1_REQ32, McuPeripheralClockEnable=0, McuPeripheralName=EMAC
            McuPeripheral_93: index=93, McuModeEntrySlot=PRTN2_COFB1_REQ35, McuPeripheralClockEnable=0, McuPeripheralName=LPUART_8
            McuPeripheral_94: index=94, McuModeEntrySlot=PRTN2_COFB1_REQ36, McuPeripheralClockEnable=0, McuPeripheralName=LPUART_9
            McuPeripheral_95: index=95, McuModeEntrySlot=PRTN2_COFB1_REQ37, McuPeripheralClockEnable=0, McuPeripheralName=LPUART_10
            McuPeripheral_96: index=96, McuModeEntrySlot=PRTN2_COFB1_REQ38, McuPeripheralClockEnable=0, McuPeripheralName=LPUART_11
            McuPeripheral_97: index=97, McuModeEntrySlot=PRTN2_COFB1_REQ39, McuPeripheralClockEnable=0, McuPeripheralName=LPUART_12
            McuPeripheral_98: index=98, McuModeEntrySlot=PRTN2_COFB1_REQ40, McuPeripheralClockEnable=0, McuPeripheralName=LPUART_13
            McuPeripheral_99: index=99, McuModeEntrySlot=PRTN2_COFB1_REQ41, McuPeripheralClockEnable=0, McuPeripheralName=LPUART_14
            McuPeripheral_100: index=100, McuModeEntrySlot=PRTN2_COFB1_REQ42, McuPeripheralClockEnable=0, McuPeripheralName=LPUART_15
            McuPeripheral_101: index=101, McuModeEntrySlot=PRTN2_COFB1_REQ47, McuPeripheralClockEnable=0, McuPeripheralName=LPSPI_4
            McuPeripheral_102: index=102, McuModeEntrySlot=PRTN2_COFB1_REQ48, McuPeripheralClockEnable=0, McuPeripheralName=LPSPI_5
            McuPeripheral_103: index=103, McuModeEntrySlot=PRTN2_COFB1_REQ51, McuPeripheralClockEnable=0, McuPeripheralName=QuadSPI
            McuPeripheral_104: index=104, McuModeEntrySlot=PRTN2_COFB1_REQ55, McuPeripheralClockEnable=0, McuPeripheralName=SAI_1
            McuPeripheral_105: index=105, McuModeEntrySlot=PRTN2_COFB1_REQ58, McuPeripheralClockEnable=1, McuPeripheralName=LPCMP_2
            McuPeripheral_106: index=106, McuModeEntrySlot=PRTN2_COFB1_REQ62, McuPeripheralClockEnable=1, McuPeripheralName=CM7_0_TCM
      McuPowerControl
        McuPMC_Config:
          McuFASTRECEnable = 0
          McuHVDIEEnable = 0
          McuLMAUTOENEnable = 0
          McuLMBCTLENEnable = 0
          McuLMENEnable = 0
          McuLMSMPSENEnable = 0
          McuLPM25ENEnable = 0
          McuLVDIEEnable = 0
          McuLVRBLPENEnable = 0
      McuResetConfig: McuDestResetEscThreshold=0, McuFuncResetEscThreshold=15, McuResetType=FunctionalReset
        McuResetSourcesConfig
          McuDEBUG_FUNC_ResetSource: McuDisableReset=0
          McuFCCU_RST_ResetSource: McuDisableReset=0
          McuJTAG_RST_ResetSource: McuDisableReset=0
          McuSWT0_RST_ResetSource: McuDisableReset=0
          McuSWT1_RST_ResetSource: McuDisableReset=0
    McuPublishedInformation
      28 x McuResetReasonConf:
        MCU_POWER_ON_RESET: index=0, McuResetReason=0
        MCU_FCCU_FTR_RESET: index=1, McuResetReason=1
        MCU_STCU_URF_RESET: index=2, McuResetReason=2
        MCU_MC_RGM_FRE_RESET: index=3, McuResetReason=3
        MCU_FXOSC_FAIL_RESET: index=4, McuResetReason=4
        MCU_PLL_LOL_RESET: index=5, McuResetReason=5
        MCU_CORE_CLK_FAIL_RESET: index=6, McuResetReason=6
        MCU_AIPS_PLAT_CLK_FAIL_RESET: index=7, McuResetReason=7
        MCU_HSE_CLK_FAIL_RESET: index=8, McuResetReason=8
        MCU_SYS_DIV_FAIL_RESET: index=9, McuResetReason=9
        MCU_HSE_TMPR_RST_RESET: index=10, McuResetReason=10
        MCU_HSE_SNVS_RST_RESET: index=11, McuResetReason=11
        MCU_SW_DEST_RESET: index=12, McuResetReason=12
        MCU_DEBUG_DEST_RESET: index=13, McuResetReason=13
        MCU_F_EXR_RESET: index=14, McuResetReason=14
        MCU_FCCU_RST_RESET: index=15, McuResetReason=15
        MCU_ST_DONE_RESET: index=16, McuResetReason=16
        MCU_SWT0_RST_RESET: index=17, McuResetReason=17
        MCU_SWT1_RST_RESET: index=18, McuResetReason=18
        MCU_JTAG_RST_RESET: index=19, McuResetReason=19
        MCU_HSE_SWT_RST_RESET: index=20, McuResetReason=20
        MCU_HSE_BOOT_RST_RESET: index=21, McuResetReason=21
        MCU_SW_FUNC_RESET: index=22, McuResetReason=22
        MCU_DEBUG_FUNC_RESET: index=23, McuResetReason=23
        MCU_WAKEUP_REASON: index=24, McuResetReason=24
        MCU_NO_RESET_REASON: index=25, McuResetReason=25
        MCU_MULTIPLE_RESET_REASON: index=26, McuResetReason=26
        MCU_RESET_UNDEFINED: index=27, McuResetReason=27
