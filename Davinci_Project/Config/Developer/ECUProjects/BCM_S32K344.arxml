AUTOSAR XML (schema 00048)
package /ECUCompositionTypes
  composition sw component type ECU_Composition
    component CtAppSwc: type=CtAppSwc
package /EndToEndProtections
  end to end protection set EndToEndProtectionSet
package /Systems
  system BCM_S32K344
    root-software-compositions:
      root sw composition prototype EcuSwComposition: software-composition=ECU_Composition
