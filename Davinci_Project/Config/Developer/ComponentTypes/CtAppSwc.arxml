AUTOSAR XML (schema 4-3-0)
package /ComponentTypes
  application sw component type CtAppSwc
    behavior CtAppSwc_InternalBehavior
      init event CtAppSwc_InitEvent: start-on-event=RCtAppSwc_Init
      timing event TMT_RCtAppSwc_10ms: start-on-event=RCtAppSwc_10ms, period=0.01
      timing event TMT_RCtAppSwc_1000ms: start-on-event=RCtAppSwc_1000ms, period=1
      runnable RCtAppSwc_Init
      runnable RCtAppSwc_10ms
      runnable RCtAppSwc_1000ms
  swc implementation CtAppSwc_Implementation: behavior=CtAppSwc_InternalBehavior
