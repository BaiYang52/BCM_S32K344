AUTOSAR XML (schema 00050)
package /InitialEcuC
  ecuc value collection InitialEcuC
