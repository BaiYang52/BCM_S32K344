AUTOSAR XML (schema 00050)
package /ActiveEcuC
  module config Mcu: implementation-config-variant=VARIANT-POST-BUILD, module-description=Mcu_Impl
    CommonPublishedInformation:
      ArReleaseMajorVersion = 4
      ArReleaseMinorVersion = 4
      ArReleaseRevisionVersion = 0
      ModuleId = 101
      SwMajorVersion = 2
      SwMinorVersion = 0
      SwPatchVersion = 1
      VendorApiInfix = 
      VendorId = 43
    McuCoreControlConfiguration: McuCoreBootAddressControl=false
    McuDebugConfiguration:
      McuDisableCmuApi = true
      McuDisableDemReportErrorStatus = true
      McuEmiosConfigureGprenApi = false
      McuGetClockFrequencyApi = false
      McuGetMidrStructureApi = false
      McuGetPowerDomainApi = false
      McuGetPowerModeStateApi = false
      McuGetSystemStateApi = false
      McuSscmGetMemConfigApi = false
      McuSscmGetStatusApi = false
      McuSscmGetUoptApi = false
    McuGeneralConfiguration:
      McuAlternateResetIsrUsed = false
      McuCalloutBeforePerformReset = false
      McuCmuErrorIsrUsed = false
      McuDevErrorDetect = false
      McuDisableFlashWaitStatesConfig = true
      McuDisablePmcInit = false
      McuDisableRamWaitStatesConfig = true
      McuDisableRgmInit = false
      McuEnableUserModeSupport = false
      McuEnterLowPowerMode = false
      McuGetRamStateApi = false
      McuInitClock = true
      McuNoPll = false
      McuPerformResetApi = true
      McuPerformResetCallout = NULL_PTR
      McuRegisterValuesOptimization = DISABLED
      McuTimeout = 50000
      McuTimeoutMethod = OSIF_COUNTER_DUMMY
      McuVersionInfoApi = false
      McuVoltageErrorIsrUsed = false
      McuControlledClocksConfiguration: McuFircUnderMcuControl=true, McuFxoscUnderMcuControl=true, McuPll0UnderMcuControl=true, McuSircUnderMcuControl=true, McuSxoscUnderMcuControl=true
    McuModuleConfiguration:
      McuClockSrcFailureNotification = DISABLED
      McuCrystalFrequencyHz = 16000000
      McuEMAC_MII_RMII_TX_CLKFrequencyHz = 50000000
      McuEMAC_MII_RX_CLKFrequencyHz = 25000000
      McuLFAST_REF_EXT_CLKFrequencyHz = 160000000
      McuNumberOfMcuModes = 1
      McuRamSectors = 0
      McuSWG_PAD_CLKFrequencyHz = 160000000
      McuSlowCrystalFrequencyHz = 32768
      McuClockSettingConfig_0 (McuClockSettingConfig): McuClockSettingId=0
        McuCgm0SettingConfig: McuPCSStepDuration=1, McuPCSSwitchDuration=48
          McuCgm0ClockMux0:
            McuClkMux0Div0Trigger = COMMON_TRIGGER_DIVIDER_UPDATE
            McuClkMux0Div0_Divisor = 0
            McuClkMux0Div0_En = true
            McuClkMux0Div1Trigger = COMMON_TRIGGER_DIVIDER_UPDATE
            McuClkMux0Div1_Divisor = 1
            McuClkMux0Div1_En = true
            McuClkMux0Div2Trigger = COMMON_TRIGGER_DIVIDER_UPDATE
            McuClkMux0Div2_Divisor = 3
            McuClkMux0Div2_En = true
            McuClkMux0Div3Trigger = COMMON_TRIGGER_DIVIDER_UPDATE
            McuClkMux0Div3_Divisor = 1
            McuClkMux0Div3_En = true
            McuClkMux0Div4Trigger = COMMON_TRIGGER_DIVIDER_UPDATE
            McuClkMux0Div4_Divisor = 3
            McuClkMux0Div4_En = true
            McuClkMux0Div5Trigger = COMMON_TRIGGER_DIVIDER_UPDATE
            McuClkMux0Div5_Divisor = 3
            McuClkMux0Div5_En = true
            McuClkMux0Div6Trigger = COMMON_TRIGGER_DIVIDER_UPDATE
            McuClkMux0Div6_Divisor = 0
            McuClkMux0Div6_En = true
            McuClkMux0Div7Trigger = COMMON_TRIGGER_DIVIDER_UPDATE
            McuClkMux0Div7_Divisor = 0
            McuClkMux0Div7_En = false
            McuClkMux0_Source = PLL_PHI0_CLK
            McuClockMux0Divider0_Frequency = 160000000
            McuClockMux0Divider1_Frequency = 80000000
            McuClockMux0Divider2_Frequency = 40000000
            McuClockMux0Divider3_Frequency = 80000000
            McuClockMux0Divider4_Frequency = 40000000
            McuClockMux0Divider5_Frequency = 40000000
            McuClockMux0Divider6_Frequency = 160000000
            McuClockMux0Divider7_Frequency = 0
            McuClockMuxUnderMcuControl = true
          McuCgm0ClockMux1: McuClkMux1Div0_Divisor=0, McuClkMux1Div0_En=false, McuClkMux1_Source=FIRC_CLK, McuClockMux1Divider0_Frequency=0, McuClockMuxUnderMcuControl=true
          McuCgm0ClockMux10: McuClkMux10Div0_Divisor=0, McuClkMux10Div0_En=false, McuClkMux10_Source=FIRC_CLK, McuClockMux10Divider0_Frequency=0, McuClockMuxUnderMcuControl=true
          McuCgm0ClockMux11:
            McuClkMux11Div0_Divisor = 0
            McuClkMux11Div0_En = true
            McuClkMux11_Source = FIRC_CLK
            McuClockMux11Divider0_Frequency = 48000000
            McuClockMuxUnderMcuControl = true
          McuCgm0ClockMux12:
            McuClkMux12Div0_Divisor = 0
            McuClkMux12Div0_En = true
            McuClkMux12_Source = FIRC_CLK
            McuClockMux12Divider0_Frequency = 48000000
            McuClockMuxUnderMcuControl = true
          McuCgm0ClockMux13:
            McuClkMux13Div0_Divisor = 0
            McuClkMux13Div0_En = true
            McuClkMux13_Source = FIRC_CLK
            McuClockMux13Divider0_Frequency = 48000000
            McuClockMuxUnderMcuControl = true
          McuCgm0ClockMux15:
            McuClkMux15Div0_Divisor = 2
            McuClkMux15Div0_En = true
            McuClkMux15_Source = FIRC_CLK
            McuClockMux15Divider0_Frequency = 16000000
            McuClockMuxUnderMcuControl = true
          McuCgm0ClockMux16: McuClkMux16Div0_Divisor=2, McuClkMux16Div0_En=false, McuClkMux16_Source=FIRC_CLK, McuClockMux16Divider0_Frequency=0, McuClockMuxUnderMcuControl=true
          McuCgm0ClockMux{2..4}: McuClkMux{2..4}Div0_Divisor=0, McuClkMux{2..4}Div0_En=false, McuClkMux{2..4}_Source=FIRC_CLK, McuClockMux{2..4}Divider0_Frequency=0, McuClockMuxUnderMcuControl=true
          McuCgm0ClockMux5:
            McuClkMux5Div0_Divisor = 1
            McuClkMux5Div0_En = true
            McuClkMux5_Source = FIRC_CLK
            McuClockMux5Divider0_Frequency = 24000000
            McuClockMuxUnderMcuControl = true
          McuCgm0ClockMux6:
            McuClkMux6Div0_Divisor = 1
            McuClkMux6Div0_En = true
            McuClkMux6_Source = FIRC_CLK
            McuClockMux6Divider0_Frequency = 24000000
            McuClockMuxUnderMcuControl = true
          McuCgm0ClockMux{7..9}: McuClkMux{7..9}Div0_Divisor=0, McuClkMux{7..9}Div0_En=false, McuClkMux{7..9}_Source=FIRC_CLK, McuClockMux{7..9}Divider0_Frequency=0, McuClockMuxUnderMcuControl=true
          McuCgm0PcsConfig_0 (McuCgm0PcsConfig): McuClockPcfsUnderMcuControl=false, McuPCS_MaxAllowableDynamicIDD=0, McuPCS_Name=PCFS_8, McuPCS_SourceFrequency=160000000
        4 x McuClkMonitor, all with McuClkMonitorEn=false, McuClockMonitorUnderMcuControl=true, McuFHHAsyncEventEn=false, McuFHHInterruptEn=false, McuFLLAsyncEventEn=false, McuFLLInterruptEn=false:
          McuClkMonitor_0: McuCmuName=CMU_FC_0_FXOSC_CLK
          McuClkMonitor_1: McuCmuName=CMU_FC_3_CORE_CLK
          McuClkMonitor_2: McuCmuName=CMU_FC_4_AIPS_PLAT_CLK
          McuClkMonitor_3: McuCmuName=CMU_FC_5_HSE_CLK
        McuClockReferencePoint_0 (McuClockReferencePoint): McuClockFrequencySelect=CORE_CLK, McuClockReferencePointFrequency=160000000
        McuFIRC: McuFIRC_Frequency=48000000, McuFircDivSel=Div_by_1, McuFircStandbyEnable=false, McuFircUnderMcuControl=true
        McuFXOSC:
          McuFXOSC_Frequency = 16000000
          McuFxoscBypass = false
          McuFxoscCounter = 49
          McuFxoscMainComparator = true
          McuFxoscOverdriveProtection = 12
          McuFxoscPowerDownCtr = true
          McuFxoscUnderMcuControl = true
        McuPll_0: McuPLLEnabled=true, McuPLLUnderMcuControl=true
          McuPll_Configuration:
            McuPllDvMfi = 120
            McuPllDvOdiv2 = 2
            McuPllDvRdiv = 2
            McuPllFdFmod = 0
            McuPllFdMdp = 0
            McuPllFdMfn = 0
            McuPllFdSdm2 = false
            McuPllFdSdm3 = false
            McuPllFdSdmen = false
            McuPllFmSpreadctl = Center_Spread
            McuPllFmSscgbyp = true
            McuPllFmStepNo = 1
            McuPllFmStepSize = 0
            McuPllOdiv0_Div = 2
            McuPllOdiv0_En = true
            McuPllOdiv1_Div = 2
            McuPllOdiv1_En = true
          McuPll_Parameter: PLL_PHI0_Frequency=160000000, PLL_PHI1_Frequency=160000000, PLL_VCO_Frequency=960000000
        McuRtcClockSelect: McuClockMuxUnderMcuControl=true, McuRtc_Frequency=48000000, McuRtc_Source=FIRC_CLK
        McuSIRC: McuSIRC_Frequency=32000, McuSircStandbyEnable=false, McuSircUnderMcuControl=true
        McuSXOSC: McuSXOSC_Frequency=0, McuSxoscCounter=125, McuSxoscPowerDownCtr=false, McuSxoscUnderMcuControl=true
      McuClockSettingConfig_1 (McuClockSettingConfig): McuClockSettingId=1
        McuCgm0SettingConfig: McuPCSStepDuration=1, McuPCSSwitchDuration=48
          McuCgm0ClockMux0:
            McuClkMux0Div0Trigger = COMMON_TRIGGER_DIVIDER_UPDATE
            McuClkMux0Div0_Divisor = 0
            McuClkMux0Div0_En = true
            McuClkMux0Div1Trigger = COMMON_TRIGGER_DIVIDER_UPDATE
            McuClkMux0Div1_Divisor = 0
            McuClkMux0Div1_En = true
            McuClkMux0Div2Trigger = COMMON_TRIGGER_DIVIDER_UPDATE
            McuClkMux0Div2_Divisor = 1
            McuClkMux0Div2_En = true
            McuClkMux0Div3Trigger = COMMON_TRIGGER_DIVIDER_UPDATE
            McuClkMux0Div3_Divisor = 0
            McuClkMux0Div3_En = true
            McuClkMux0Div4Trigger = COMMON_TRIGGER_DIVIDER_UPDATE
            McuClkMux0Div4_Divisor = 0
            McuClkMux0Div4_En = true
            McuClkMux0Div5Trigger = COMMON_TRIGGER_DIVIDER_UPDATE
            McuClkMux0Div5_Divisor = 3
            McuClkMux0Div5_En = true
            McuClkMux0Div6Trigger = COMMON_TRIGGER_DIVIDER_UPDATE
            McuClkMux0Div6_Divisor = 0
            McuClkMux0Div6_En = true
            McuClkMux0Div7Trigger = COMMON_TRIGGER_DIVIDER_UPDATE
            McuClkMux0Div7_Divisor = 0
            McuClkMux0Div7_En = false
            McuClkMux0_Source = FIRC_CLK
            McuClockMux0Divider0_Frequency = 48000000
            McuClockMux0Divider1_Frequency = 48000000
            McuClockMux0Divider2_Frequency = 24000000
            McuClockMux0Divider3_Frequency = 48000000
            McuClockMux0Divider4_Frequency = 48000000
            McuClockMux0Divider5_Frequency = 12000000
            McuClockMux0Divider6_Frequency = 48000000
            McuClockMux0Divider7_Frequency = 0
            McuClockMuxUnderMcuControl = true
          McuCgm0ClockMux1: McuClkMux1Div0_Divisor=0, McuClkMux1Div0_En=false, McuClkMux1_Source=FIRC_CLK, McuClockMux1Divider0_Frequency=0, McuClockMuxUnderMcuControl=true
          McuCgm0ClockMux10: McuClkMux10Div0_Divisor=0, McuClkMux10Div0_En=false, McuClkMux10_Source=FIRC_CLK, McuClockMux10Divider0_Frequency=0, McuClockMuxUnderMcuControl=true
          McuCgm0ClockMux11:
            McuClkMux11Div0_Divisor = 0
            McuClkMux11Div0_En = true
            McuClkMux11_Source = FIRC_CLK
            McuClockMux11Divider0_Frequency = 48000000
            McuClockMuxUnderMcuControl = true
          McuCgm0ClockMux12:
            McuClkMux12Div0_Divisor = 0
            McuClkMux12Div0_En = true
            McuClkMux12_Source = FIRC_CLK
            McuClockMux12Divider0_Frequency = 48000000
            McuClockMuxUnderMcuControl = true
          McuCgm0ClockMux13:
            McuClkMux13Div0_Divisor = 0
            McuClkMux13Div0_En = true
            McuClkMux13_Source = FIRC_CLK
            McuClockMux13Divider0_Frequency = 48000000
            McuClockMuxUnderMcuControl = true
          McuCgm0ClockMux15:
            McuClkMux15Div0_Divisor = 2
            McuClkMux15Div0_En = true
            McuClkMux15_Source = FIRC_CLK
            McuClockMux15Divider0_Frequency = 16000000
            McuClockMuxUnderMcuControl = true
          McuCgm0ClockMux16: McuClkMux16Div0_Divisor=2, McuClkMux16Div0_En=false, McuClkMux16_Source=FIRC_CLK, McuClockMux16Divider0_Frequency=0, McuClockMuxUnderMcuControl=true
          McuCgm0ClockMux{2..4}: McuClkMux{2..4}Div0_Divisor=0, McuClkMux{2..4}Div0_En=false, McuClkMux{2..4}_Source=FIRC_CLK, McuClockMux{2..4}Divider0_Frequency=0, McuClockMuxUnderMcuControl=true
          McuCgm0ClockMux5:
            McuClkMux5Div0_Divisor = 1
            McuClkMux5Div0_En = true
            McuClkMux5_Source = FIRC_CLK
            McuClockMux5Divider0_Frequency = 24000000
            McuClockMuxUnderMcuControl = true
          McuCgm0ClockMux6:
            McuClkMux6Div0_Divisor = 1
            McuClkMux6Div0_En = true
            McuClkMux6_Source = FIRC_CLK
            McuClockMux6Divider0_Frequency = 24000000
            McuClockMuxUnderMcuControl = true
          McuCgm0ClockMux{7..9}: McuClkMux{7..9}Div0_Divisor=0, McuClkMux{7..9}Div0_En=false, McuClkMux{7..9}_Source=FIRC_CLK, McuClockMux{7..9}Divider0_Frequency=0, McuClockMuxUnderMcuControl=true
          McuCgm0PcsConfig_0 (McuCgm0PcsConfig): McuClockPcfsUnderMcuControl=false, McuPCS_MaxAllowableDynamicIDD=0, McuPCS_Name=PCFS_8, McuPCS_SourceFrequency=0
        4 x McuClkMonitor, all with McuClkMonitorEn=false, McuClockMonitorUnderMcuControl=true, McuFHHAsyncEventEn=false, McuFHHInterruptEn=false, McuFLLAsyncEventEn=false, McuFLLInterruptEn=false:
          McuClkMonitor_0: McuCmuName=CMU_FC_0_FXOSC_CLK
          McuClkMonitor_1: McuCmuName=CMU_FC_3_CORE_CLK
          McuClkMonitor_2: McuCmuName=CMU_FC_4_AIPS_PLAT_CLK
          McuClkMonitor_3: McuCmuName=CMU_FC_5_HSE_CLK
        McuClockReferencePoint_0 (McuClockReferencePoint): McuClockFrequencySelect=CORE_CLK, McuClockReferencePointFrequency=48000000
        McuFIRC: McuFIRC_Frequency=48000000, McuFircDivSel=Div_by_1, McuFircStandbyEnable=false, McuFircUnderMcuControl=true
        McuFXOSC:
          McuFXOSC_Frequency = 0
          McuFxoscBypass = false
          McuFxoscCounter = 49
          McuFxoscMainComparator = true
          McuFxoscOverdriveProtection = 12
          McuFxoscPowerDownCtr = false
          McuFxoscUnderMcuControl = true
        McuPll_0: McuPLLEnabled=false, McuPLLUnderMcuControl=true
          McuPll_Configuration:
            McuPllDvMfi = 120
            McuPllDvOdiv2 = 2
            McuPllDvRdiv = 2
            McuPllFdFmod = 0
            McuPllFdMdp = 0
            McuPllFdMfn = 0
            McuPllFdSdm2 = false
            McuPllFdSdm3 = false
            McuPllFdSdmen = false
            McuPllFmSpreadctl = Center_Spread
            McuPllFmSscgbyp = true
            McuPllFmStepNo = 1
            McuPllFmStepSize = 0
            McuPllOdiv0_Div = 2
            McuPllOdiv0_En = false
            McuPllOdiv1_Div = 2
            McuPllOdiv1_En = false
          McuPll_Parameter: PLL_PHI0_Frequency=0, PLL_PHI1_Frequency=0, PLL_VCO_Frequency=0
        McuRtcClockSelect: McuClockMuxUnderMcuControl=true, McuRtc_Frequency=48000000, McuRtc_Source=FIRC_CLK
        McuSIRC: McuSIRC_Frequency=32000, McuSircStandbyEnable=false, McuSircUnderMcuControl=true
        McuSXOSC: McuSXOSC_Frequency=0, McuSxoscCounter=125, McuSxoscPowerDownCtr=false, McuSxoscUnderMcuControl=true
      McuModeSettingConf_0 (McuModeSettingConf): McuEnableSleepOnExit=false, McuMainCoreSelect=CM7_0, McuMode=0, McuPowerMode=RUN
        McuDcmGprConfiguration:
          McuBootBaseAddress = 0
          McuDCM_SCAN_BYP_STDBY_EXTControl = false
          McuDcmGprUnderMcuControl = true
          McuFIRC_TRIM_BYP_STDBY_EXTControl = false
          McuGlobalPadkeepingEnable = false
          McuPMC_TRIM_RGM_DCF_BYP_STDBY_EXTControl = false
          McuSIRC_TRIM_BYP_STDBY_EXTControl = false
        McuPartitionConfiguration
          McuPartition0Config:
            McuPartitionClockEnable = true
            McuPartitionPowerUnderMcuControl = true
            McuPartitionUnderMcuControl = true
            McuPrtnCofb0UnderMcuControl = true
            McuPrtnCofb1UnderMcuControl = true
            McuCore0Configuration: McuCoreBootAddress=0, McuCoreBootAddressLinkerSym=, McuCoreClockEnable=false, McuCoreUnderMcuControl=true
            McuCore1Configuration: McuCoreBootAddress=0, McuCoreBootAddressLinkerSym=, McuCoreClockEnable=false, McuCoreUnderMcuControl=true
            McuCore4Configuration: McuCoreBootAddress=0, McuCoreBootAddressLinkerSym=, McuCoreClockEnable=false, McuCoreUnderMcuControl=true
          McuPartition1Config:
            McuPartitionClockEnable = true
            McuPartitionPowerUnderMcuControl = true
            McuPartitionUnderMcuControl = true
            McuPrtnCofb{0..3}UnderMcuControl = true
          McuPartition2Config:
            McuPartitionClockEnable = true
            McuPartitionPowerUnderMcuControl = true
            McuPartitionUnderMcuControl = true
            McuPrtnCofb{0..2}UnderMcuControl = true
          McuPartition3Config:
            McuPartitionClockEnable = true
            McuPartitionPowerUnderMcuControl = true
            McuPartitionUnderMcuControl = true
            McuPrtnCofb{0..2}UnderMcuControl = true
          107 x McuPeripheral, all with McuPeripheralResetEnable=false, McuResetGenerationSlot=NONE:
            McuPeripheral_0: index=0, McuModeEntrySlot=PRTN0_COFB1_REQ32, McuPeripheralClockEnable=false, McuPeripheralName=TRGMUX
            McuPeripheral_1: index=1, McuModeEntrySlot=PRTN0_COFB1_REQ33, McuPeripheralClockEnable=false, McuPeripheralName=BCTU
            McuPeripheral_2: index=2, McuModeEntrySlot=PRTN0_COFB1_REQ34, McuPeripheralClockEnable=false, McuPeripheralName=EMIOS_0
            McuPeripheral_3: index=3, McuModeEntrySlot=PRTN0_COFB1_REQ35, McuPeripheralClockEnable=false, McuPeripheralName=EMIOS_1
            McuPeripheral_4: index=4, McuModeEntrySlot=PRTN0_COFB1_REQ36, McuPeripheralClockEnable=false, McuPeripheralName=EMIOS_2
            McuPeripheral_5: index=5, McuModeEntrySlot=PRTN0_COFB1_REQ38, McuPeripheralClockEnable=false, McuPeripheralName=LCU_0
            McuPeripheral_6: index=6, McuModeEntrySlot=PRTN0_COFB1_REQ39, McuPeripheralClockEnable=false, McuPeripheralName=LCU_1
            McuPeripheral_7: index=7, McuModeEntrySlot=PRTN0_COFB1_REQ40, McuPeripheralClockEnable=false, McuPeripheralName=ADC_0
            McuPeripheral_8: index=8, McuModeEntrySlot=PRTN0_COFB1_REQ41, McuPeripheralClockEnable=false, McuPeripheralName=ADC_1
            McuPeripheral_9: index=9, McuModeEntrySlot=PRTN0_COFB1_REQ42, McuPeripheralClockEnable=false, McuPeripheralName=ADC_2
            McuPeripheral_10: index=10, McuModeEntrySlot=PRTN0_COFB1_REQ44, McuPeripheralClockEnable=true, McuPeripheralName=PIT_0
            McuPeripheral_11: index=11, McuModeEntrySlot=PRTN0_COFB1_REQ45, McuPeripheralClockEnable=false, McuPeripheralName=PIT_1
            McuPeripheral_12: index=12, McuModeEntrySlot=PRTN1_COFB0_REQ3, McuPeripheralClockEnable=false, McuPeripheralName=EDMA
            McuPeripheral_13: index=13, McuModeEntrySlot=PRTN1_COFB0_REQ4, McuPeripheralClockEnable=false, McuPeripheralName=EDMA_TCD_0
            McuPeripheral_14: index=14, McuModeEntrySlot=PRTN1_COFB0_REQ5, McuPeripheralClockEnable=false, McuPeripheralName=EDMA_TCD_1
            McuPeripheral_15: index=15, McuModeEntrySlot=PRTN1_COFB0_REQ6, McuPeripheralClockEnable=false, McuPeripheralName=EDMA_TCD_2
            McuPeripheral_16: index=16, McuModeEntrySlot=PRTN1_COFB0_REQ7, McuPeripheralClockEnable=false, McuPeripheralName=EDMA_TCD_3
            McuPeripheral_17: index=17, McuModeEntrySlot=PRTN1_COFB0_REQ8, McuPeripheralClockEnable=false, McuPeripheralName=EDMA_TCD_4
            McuPeripheral_18: index=18, McuModeEntrySlot=PRTN1_COFB0_REQ9, McuPeripheralClockEnable=false, McuPeripheralName=EDMA_TCD_5
            McuPeripheral_19: index=19, McuModeEntrySlot=PRTN1_COFB0_REQ10, McuPeripheralClockEnable=false, McuPeripheralName=EDMA_TCD_6
            McuPeripheral_20: index=20, McuModeEntrySlot=PRTN1_COFB0_REQ11, McuPeripheralClockEnable=false, McuPeripheralName=EDMA_TCD_7
            McuPeripheral_21: index=21, McuModeEntrySlot=PRTN1_COFB0_REQ12, McuPeripheralClockEnable=false, McuPeripheralName=EDMA_TCD_8
            McuPeripheral_22: index=22, McuModeEntrySlot=PRTN1_COFB0_REQ13, McuPeripheralClockEnable=false, McuPeripheralName=EDMA_TCD_9
            McuPeripheral_23: index=23, McuModeEntrySlot=PRTN1_COFB0_REQ14, McuPeripheralClockEnable=false, McuPeripheralName=EDMA_TCD_10
            McuPeripheral_24: index=24, McuModeEntrySlot=PRTN1_COFB0_REQ15, McuPeripheralClockEnable=false, McuPeripheralName=EDMA_TCD_11
            McuPeripheral_25: index=25, McuModeEntrySlot=PRTN1_COFB0_REQ21, McuPeripheralClockEnable=true, McuPeripheralName=SDA_AP
            McuPeripheral_26: index=26, McuModeEntrySlot=PRTN1_COFB0_REQ22, McuPeripheralClockEnable=false, McuPeripheralName=EIM
            McuPeripheral_27: index=27, McuModeEntrySlot=PRTN1_COFB0_REQ23, McuPeripheralClockEnable=false, McuPeripheralName=ERM
            McuPeripheral_28: index=28, McuModeEntrySlot=PRTN1_COFB0_REQ24, McuPeripheralClockEnable=true, McuPeripheralName=MSCM
            McuPeripheral_29: index=29, McuModeEntrySlot=PRTN1_COFB0_REQ28, McuPeripheralClockEnable=true, McuPeripheralName=SWT_0
            McuPeripheral_30: index=30, McuModeEntrySlot=PRTN1_COFB0_REQ29, McuPeripheralClockEnable=false, McuPeripheralName=STM_0
            McuPeripheral_31: index=31, McuModeEntrySlot=PRTN1_COFB0_REQ31, McuPeripheralClockEnable=false, McuPeripheralName=INTM
            McuPeripheral_32: index=32, McuModeEntrySlot=PRTN1_COFB1_REQ32, McuPeripheralClockEnable=false, McuPeripheralName=DMAMUX_0
            McuPeripheral_33: index=33, McuModeEntrySlot=PRTN1_COFB1_REQ33, McuPeripheralClockEnable=false, McuPeripheralName=DMAMUX_1
            McuPeripheral_34: index=34, McuModeEntrySlot=PRTN1_COFB1_REQ34, McuPeripheralClockEnable=true, McuPeripheralName=RTC
            McuPeripheral_35: index=35, McuModeEntrySlot=PRTN1_COFB1_REQ42, McuPeripheralClockEnable=true, McuPeripheralName=SIUL2_VIRTWRAPPER_PDAC3
            McuPeripheral_36: index=36, McuModeEntrySlot=PRTN1_COFB1_REQ45, McuPeripheralClockEnable=true, McuPeripheralName=WKPU
            McuPeripheral_37: index=37, McuModeEntrySlot=PRTN1_COFB1_REQ47, McuPeripheralClockEnable=false, McuPeripheralName=CMU_0_5
            McuPeripheral_38: index=38, McuModeEntrySlot=PRTN1_COFB1_REQ49, McuPeripheralClockEnable=true, McuPeripheralName=TSPC
            McuPeripheral_39: index=39, McuModeEntrySlot=PRTN1_COFB1_REQ51, McuPeripheralClockEnable=true, McuPeripheralName=SXOSC
            McuPeripheral_40: index=40, McuModeEntrySlot=PRTN1_COFB1_REQ53, McuPeripheralClockEnable=true, McuPeripheralName=FXOSC
            McuPeripheral_41: index=41, McuModeEntrySlot=PRTN1_COFB1_REQ56, McuPeripheralClockEnable=false, McuPeripheralName=PLL
            McuPeripheral_42: index=42, McuModeEntrySlot=PRTN1_COFB1_REQ63, McuPeripheralClockEnable=false, McuPeripheralName=PIT_2
            McuPeripheral_43: index=43, McuModeEntrySlot=PRTN1_COFB2_REQ65, McuPeripheralClockEnable=false, McuPeripheralName=FlexCAN_0
            McuPeripheral_44: index=44, McuModeEntrySlot=PRTN1_COFB2_REQ66, McuPeripheralClockEnable=false, McuPeripheralName=FlexCAN_1
            McuPeripheral_45: index=45, McuModeEntrySlot=PRTN1_COFB2_REQ67, McuPeripheralClockEnable=false, McuPeripheralName=FlexCAN_2
            McuPeripheral_46: index=46, McuModeEntrySlot=PRTN1_COFB2_REQ68, McuPeripheralClockEnable=false, McuPeripheralName=FlexCAN_3
            McuPeripheral_47: index=47, McuModeEntrySlot=PRTN1_COFB2_REQ69, McuPeripheralClockEnable=false, McuPeripheralName=FlexCAN_4
            McuPeripheral_48: index=48, McuModeEntrySlot=PRTN1_COFB2_REQ70, McuPeripheralClockEnable=false, McuPeripheralName=FlexCAN_5
            McuPeripheral_49: index=49, McuModeEntrySlot=PRTN1_COFB2_REQ73, McuPeripheralClockEnable=false, McuPeripheralName=FlexIO
            McuPeripheral_50: index=50, McuModeEntrySlot=PRTN1_COFB2_REQ74, McuPeripheralClockEnable=false, McuPeripheralName=LPUART_0
            McuPeripheral_51: index=51, McuModeEntrySlot=PRTN1_COFB2_REQ75, McuPeripheralClockEnable=false, McuPeripheralName=LPUART_1
            McuPeripheral_52: index=52, McuModeEntrySlot=PRTN1_COFB2_REQ76, McuPeripheralClockEnable=false, McuPeripheralName=LPUART_2
            McuPeripheral_53: index=53, McuModeEntrySlot=PRTN1_COFB2_REQ77, McuPeripheralClockEnable=false, McuPeripheralName=LPUART_3
            McuPeripheral_54: index=54, McuModeEntrySlot=PRTN1_COFB2_REQ78, McuPeripheralClockEnable=false, McuPeripheralName=LPUART_4
            McuPeripheral_55: index=55, McuModeEntrySlot=PRTN1_COFB2_REQ79, McuPeripheralClockEnable=false, McuPeripheralName=LPUART_5
            McuPeripheral_56: index=56, McuModeEntrySlot=PRTN1_COFB2_REQ80, McuPeripheralClockEnable=false, McuPeripheralName=LPUART_6
            McuPeripheral_57: index=57, McuModeEntrySlot=PRTN1_COFB2_REQ81, McuPeripheralClockEnable=false, McuPeripheralName=LPUART_7
            McuPeripheral_58: index=58, McuModeEntrySlot=PRTN1_COFB2_REQ84, McuPeripheralClockEnable=false, McuPeripheralName=LPI2C_0
            McuPeripheral_59: index=59, McuModeEntrySlot=PRTN1_COFB2_REQ85, McuPeripheralClockEnable=false, McuPeripheralName=LPI2C_1
            McuPeripheral_60: index=60, McuModeEntrySlot=PRTN1_COFB2_REQ86, McuPeripheralClockEnable=false, McuPeripheralName=LPSPI_0
            McuPeripheral_61: index=61, McuModeEntrySlot=PRTN1_COFB2_REQ87, McuPeripheralClockEnable=false, McuPeripheralName=LPSPI_1
            McuPeripheral_62: index=62, McuModeEntrySlot=PRTN1_COFB2_REQ88, McuPeripheralClockEnable=false, McuPeripheralName=LPSPI_2
            McuPeripheral_63: index=63, McuModeEntrySlot=PRTN1_COFB2_REQ89, McuPeripheralClockEnable=false, McuPeripheralName=LPSPI_3
            McuPeripheral_64: index=64, McuModeEntrySlot=PRTN1_COFB2_REQ91, McuPeripheralClockEnable=false, McuPeripheralName=SAI_0
            McuPeripheral_65: index=65, McuModeEntrySlot=PRTN1_COFB2_REQ92, McuPeripheralClockEnable=true, McuPeripheralName=LPCMP_0
            McuPeripheral_66: index=66, McuModeEntrySlot=PRTN1_COFB2_REQ93, McuPeripheralClockEnable=true, McuPeripheralName=LPCMP_1
            McuPeripheral_67: index=67, McuModeEntrySlot=PRTN1_COFB2_REQ95, McuPeripheralClockEnable=false, McuPeripheralName=TEMPSENSE
            McuPeripheral_68: index=68, McuModeEntrySlot=PRTN1_COFB3_REQ96, McuPeripheralClockEnable=false, McuPeripheralName=CRC
            McuPeripheral_69: index=69, McuModeEntrySlot=PRTN1_COFB3_REQ104, McuPeripheralClockEnable=true, McuPeripheralName=STCU_2
            McuPeripheral_70: index=70, McuModeEntrySlot=PRTN2_COFB0_REQ4, McuPeripheralClockEnable=false, McuPeripheralName=EDMA_TCD_12
            McuPeripheral_71: index=71, McuModeEntrySlot=PRTN2_COFB0_REQ5, McuPeripheralClockEnable=false, McuPeripheralName=EDMA_TCD_13
            McuPeripheral_72: index=72, McuModeEntrySlot=PRTN2_COFB0_REQ6, McuPeripheralClockEnable=false, McuPeripheralName=EDMA_TCD_14
            McuPeripheral_73: index=73, McuModeEntrySlot=PRTN2_COFB0_REQ7, McuPeripheralClockEnable=false, McuPeripheralName=EDMA_TCD_15
            McuPeripheral_74: index=74, McuModeEntrySlot=PRTN2_COFB0_REQ8, McuPeripheralClockEnable=false, McuPeripheralName=EDMA_TCD_16
            McuPeripheral_75: index=75, McuModeEntrySlot=PRTN2_COFB0_REQ9, McuPeripheralClockEnable=false, McuPeripheralName=EDMA_TCD_17
            McuPeripheral_76: index=76, McuModeEntrySlot=PRTN2_COFB0_REQ10, McuPeripheralClockEnable=false, McuPeripheralName=EDMA_TCD_18
            McuPeripheral_77: index=77, McuModeEntrySlot=PRTN2_COFB0_REQ11, McuPeripheralClockEnable=false, McuPeripheralName=EDMA_TCD_19
            McuPeripheral_78: index=78, McuModeEntrySlot=PRTN2_COFB0_REQ12, McuPeripheralClockEnable=false, McuPeripheralName=EDMA_TCD_20
            McuPeripheral_79: index=79, McuModeEntrySlot=PRTN2_COFB0_REQ13, McuPeripheralClockEnable=false, McuPeripheralName=EDMA_TCD_21
            McuPeripheral_80: index=80, McuModeEntrySlot=PRTN2_COFB0_REQ14, McuPeripheralClockEnable=false, McuPeripheralName=EDMA_TCD_22
            McuPeripheral_81: index=81, McuModeEntrySlot=PRTN2_COFB0_REQ15, McuPeripheralClockEnable=false, McuPeripheralName=EDMA_TCD_23
            McuPeripheral_82: index=82, McuModeEntrySlot=PRTN2_COFB0_REQ16, McuPeripheralClockEnable=false, McuPeripheralName=EDMA_TCD_24
            McuPeripheral_83: index=83, McuModeEntrySlot=PRTN2_COFB0_REQ17, McuPeripheralClockEnable=false, McuPeripheralName=EDMA_TCD_25
            McuPeripheral_84: index=84, McuModeEntrySlot=PRTN2_COFB0_REQ18, McuPeripheralClockEnable=false, McuPeripheralName=EDMA_TCD_26
            McuPeripheral_85: index=85, McuModeEntrySlot=PRTN2_COFB0_REQ19, McuPeripheralClockEnable=false, McuPeripheralName=EDMA_TCD_27
            McuPeripheral_86: index=86, McuModeEntrySlot=PRTN2_COFB0_REQ20, McuPeripheralClockEnable=false, McuPeripheralName=EDMA_TCD_28
            McuPeripheral_87: index=87, McuModeEntrySlot=PRTN2_COFB0_REQ21, McuPeripheralClockEnable=false, McuPeripheralName=EDMA_TCD_29
            McuPeripheral_88: index=88, McuModeEntrySlot=PRTN2_COFB0_REQ22, McuPeripheralClockEnable=false, McuPeripheralName=EDMA_TCD_30
            McuPeripheral_89: index=89, McuModeEntrySlot=PRTN2_COFB0_REQ23, McuPeripheralClockEnable=false, McuPeripheralName=EDMA_TCD_31
            McuPeripheral_90: index=90, McuModeEntrySlot=PRTN2_COFB0_REQ24, McuPeripheralClockEnable=false, McuPeripheralName=SEMA_42
            McuPeripheral_91: index=91, McuModeEntrySlot=PRTN2_COFB0_REQ29, McuPeripheralClockEnable=false, McuPeripheralName=STM_1
            McuPeripheral_92: index=92, McuModeEntrySlot=PRTN2_COFB1_REQ32, McuPeripheralClockEnable=false, McuPeripheralName=EMAC
            McuPeripheral_93: index=93, McuModeEntrySlot=PRTN2_COFB1_REQ35, McuPeripheralClockEnable=false, McuPeripheralName=LPUART_8
            McuPeripheral_94: index=94, McuModeEntrySlot=PRTN2_COFB1_REQ36, McuPeripheralClockEnable=false, McuPeripheralName=LPUART_9
            McuPeripheral_95: index=95, McuModeEntrySlot=PRTN2_COFB1_REQ37, McuPeripheralClockEnable=false, McuPeripheralName=LPUART_10
            McuPeripheral_96: index=96, McuModeEntrySlot=PRTN2_COFB1_REQ38, McuPeripheralClockEnable=false, McuPeripheralName=LPUART_11
            McuPeripheral_97: index=97, McuModeEntrySlot=PRTN2_COFB1_REQ39, McuPeripheralClockEnable=false, McuPeripheralName=LPUART_12
            McuPeripheral_98: index=98, McuModeEntrySlot=PRTN2_COFB1_REQ40, McuPeripheralClockEnable=false, McuPeripheralName=LPUART_13
            McuPeripheral_99: index=99, McuModeEntrySlot=PRTN2_COFB1_REQ41, McuPeripheralClockEnable=false, McuPeripheralName=LPUART_14
            McuPeripheral_100: index=100, McuModeEntrySlot=PRTN2_COFB1_REQ42, McuPeripheralClockEnable=false, McuPeripheralName=LPUART_15
            McuPeripheral_101: index=101, McuModeEntrySlot=PRTN2_COFB1_REQ47, McuPeripheralClockEnable=false, McuPeripheralName=LPSPI_4
            McuPeripheral_102: index=102, McuModeEntrySlot=PRTN2_COFB1_REQ48, McuPeripheralClockEnable=false, McuPeripheralName=LPSPI_5
            McuPeripheral_103: index=103, McuModeEntrySlot=PRTN2_COFB1_REQ51, McuPeripheralClockEnable=false, McuPeripheralName=QuadSPI
            McuPeripheral_104: index=104, McuModeEntrySlot=PRTN2_COFB1_REQ55, McuPeripheralClockEnable=false, McuPeripheralName=SAI_1
            McuPeripheral_105: index=105, McuModeEntrySlot=PRTN2_COFB1_REQ58, McuPeripheralClockEnable=true, McuPeripheralName=LPCMP_2
            McuPeripheral_106: index=106, McuModeEntrySlot=PRTN2_COFB1_REQ62, McuPeripheralClockEnable=true, McuPeripheralName=CM7_0_TCM
      McuPowerControl
        McuPMC_Config:
          McuFASTRECEnable = false
          McuHVDIEEnable = false
          McuLMAUTOENEnable = false
          McuLMBCTLENEnable = false
          McuLMENEnable = false
          McuLMSMPSENEnable = false
          McuLPM25ENEnable = false
          McuLVDIEEnable = false
          McuLVRBLPENEnable = false
      McuResetConfig: McuDestResetEscThreshold=0, McuFuncResetEscThreshold=15, McuResetType=FunctionalReset
        McuResetSourcesConfig
          McuDEBUG_FUNC_ResetSource: McuDisableReset=false
          McuFCCU_RST_ResetSource: McuDisableReset=false
          McuJTAG_RST_ResetSource: McuDisableReset=false
          McuSWT0_RST_ResetSource: McuDisableReset=false
          McuSWT1_RST_ResetSource: McuDisableReset=false
    McuPublishedInformation
      28 x McuResetReasonConf:
        MCU_POWER_ON_RESET: index=0, McuResetReason=0
        MCU_FCCU_FTR_RESET: index=1, McuResetReason=1
        MCU_STCU_URF_RESET: index=2, McuResetReason=2
        MCU_MC_RGM_FRE_RESET: index=3, McuResetReason=3
        MCU_FXOSC_FAIL_RESET: index=4, McuResetReason=4
        MCU_PLL_LOL_RESET: index=5, McuResetReason=5
        MCU_CORE_CLK_FAIL_RESET: index=6, McuResetReason=6
        MCU_AIPS_PLAT_CLK_FAIL_RESET: index=7, McuResetReason=7
        MCU_HSE_CLK_FAIL_RESET: index=8, McuResetReason=8
        MCU_SYS_DIV_FAIL_RESET: index=9, McuResetReason=9
        MCU_HSE_TMPR_RST_RESET: index=10, McuResetReason=10
        MCU_HSE_SNVS_RST_RESET: index=11, McuResetReason=11
        MCU_SW_DEST_RESET: index=12, McuResetReason=12
        MCU_DEBUG_DEST_RESET: index=13, McuResetReason=13
        MCU_F_EXR_RESET: index=14, McuResetReason=14
        MCU_FCCU_RST_RESET: index=15, McuResetReason=15
        MCU_ST_DONE_RESET: index=16, McuResetReason=16
        MCU_SWT0_RST_RESET: index=17, McuResetReason=17
        MCU_SWT1_RST_RESET: index=18, McuResetReason=18
        MCU_JTAG_RST_RESET: index=19, McuResetReason=19
        MCU_HSE_SWT_RST_RESET: index=20, McuResetReason=20
        MCU_HSE_BOOT_RST_RESET: index=21, McuResetReason=21
        MCU_SW_FUNC_RESET: index=22, McuResetReason=22
        MCU_DEBUG_FUNC_RESET: index=23, McuResetReason=23
        MCU_WAKEUP_REASON: index=24, McuResetReason=24
        MCU_NO_RESET_REASON: index=25, McuResetReason=25
        MCU_MULTIPLE_RESET_REASON: index=26, McuResetReason=26
        MCU_RESET_UNDEFINED: index=27, McuResetReason=27
