AUTOSAR XML (schema 00050)
package /ActiveEcuC
  module config Port: implementation-config-variant=VARIANT-PRE-COMPILE, module-description=Port_Impl
    PortConfigSet
      NotUsedPortPin: PortPinPue=false, PortPinPus=false, PortPinDirection=PORT_PIN_IN, PortPinLevelValue=PORT_PIN_LEVEL_LOW
      PortContainerA (PortContainer): PortNumberOfPortPins=5
        5 x PortPin, all with PortPinPue=false, PortPinPus=false, PortPinSafeMode=false, PortPinDse=false, PortPinWithReadBack=true, PortPinPke=false, PortPinIfe=false, PortPinDirectionChangeable=true, PortPinModeChangeable=true, PortPinInvertControl=false, PortPinSiul2Instance=SIUL2_0, PortPinInitialMode=PORT_GPIO_MODE, PortPinMode=GPIO, PortPinLevelValue=PORT_PIN_LEVEL_LOW, PortPinSlewRate=FASTEST_SETTING, OBEGroupSelect=NO_OBE_GROUP, MscrPdacSlot=VIRTUAL_WRAPPER_PDAC0, ImcrPdacSlot=VIRTUAL_WRAPPER_PDAC0:
          PortPinPTA29_LED1_RED: PortPinId=24, PortPinPcr=29, PortPinDirection=PORT_PIN_OUT
          PortPinPTA30_LED2_GREEN: PortPinId=25, PortPinPcr=30, PortPinDirection=PORT_PIN_OUT
          PortPinPTA31_LED3_BLUE: PortPinId=26, PortPinPcr=31, PortPinDirection=PORT_PIN_OUT
          PortPinPTA24: PortPinId=20, PortPinPcr=24, PortPinDirection=PORT_PIN_IN
          PortPinPTA25: PortPinId=21, PortPinPcr=25, PortPinDirection=PORT_PIN_IN
      4 x UnTouchedPortPin, all with PortPinSiul2Instance=SIUL2_0:
        JTAGC_TCK: PortPinPcr=68
        JTAGC_TDI: PortPinPcr=4
        JTAGC_TDO: PortPinPcr=10
        JTAGC_TMS: PortPinPcr=69
      PortContainerB (PortContainer): PortNumberOfPortPins=4
        4 x PortPin, all with PortPinPue=false, PortPinPus=false, PortPinSafeMode=false, PortPinDse=false, PortPinWithReadBack=true, PortPinPke=false, PortPinIfe=false, PortPinDirectionChangeable=true, PortPinModeChangeable=true, PortPinInvertControl=false, PortPinSiul2Instance=SIUL2_0, PortPinInitialMode=PORT_GPIO_MODE, PortPinMode=GPIO, PortPinLevelValue=PORT_PIN_LEVEL_LOW, PortPinSlewRate=FASTEST_SETTING, OBEGroupSelect=NO_OBE_GROUP, MscrPdacSlot=VIRTUAL_WRAPPER_PDAC0, ImcrPdacSlot=VIRTUAL_WRAPPER_PDAC0:
          PortPinPTB18_LED4_YELLOW: PortPinId=43, PortPinPcr=18, PortPinDirection=PORT_PIN_OUT
          PortPinPTB19_KEY2: PortPinId=44, PortPinPcr=19, PortPinDirection=PORT_PIN_IN
          PortPinPTB26_KEY1: PortPinId=51, PortPinPcr=26, PortPinDirection=PORT_PIN_IN
          PortPinPTB20_KEY3: PortPinId=45, PortPinPcr=20, PortPinDirection=PORT_PIN_IN
      PortContainerC (PortContainer): PortNumberOfPortPins=2
        PortPinPTC8_CAN1_TX (PortPin):
          PortPinPue = false
          PortPinPus = false
          PortPinSafeMode = false
          PortPinDse = false
          PortPinWithReadBack = false
          PortPinPke = false
          PortPinIfe = false
          PortPinDirectionChangeable = true
          PortPinModeChangeable = true
          PortPinInvertControl = false
          PortPinSiul2Instance = SIUL2_0
          PortPinId = 63
          PortPinPcr = 72
          PortPinDirection = PORT_PIN_HIGH_Z
          PortPinInitialMode = PORT_GPIO_MODE
          PortPinMode = CAN1_CAN1_TX
          PortPinLevelValue = PORT_PIN_LEVEL_LOW
          PortPinSlewRate = FASTEST_SETTING
          OBEGroupSelect = NO_OBE_GROUP
          MscrPdacSlot = VIRTUAL_WRAPPER_PDAC0
          ImcrPdacSlot = VIRTUAL_WRAPPER_PDAC0
        PortPinPTC9_CAN1_RX (PortPin):
          PortPinPue = false
          PortPinPus = false
          PortPinSafeMode = false
          PortPinDse = false
          PortPinWithReadBack = false
          PortPinPke = false
          PortPinIfe = false
          PortPinDirectionChangeable = true
          PortPinModeChangeable = true
          PortPinInvertControl = false
          PortPinSiul2Instance = SIUL2_0
          PortPinId = 64
          PortPinPcr = 73
          PortPinDirection = PORT_PIN_HIGH_Z
          PortPinInitialMode = PORT_GPIO_MODE
          PortPinMode = CAN1_CAN1_RX
          PortPinLevelValue = PORT_PIN_LEVEL_LOW
          PortPinSlewRate = FASTEST_SETTING
          OBEGroupSelect = NO_OBE_GROUP
          MscrPdacSlot = VIRTUAL_WRAPPER_PDAC0
          ImcrPdacSlot = VIRTUAL_WRAPPER_PDAC0
    PortGeneral:
      PortDevErrorDetect = true
      SIUL2PortIPDevErrorDetect = false
      PortSetPinDirectionApi = true
      PortSetPinModeApi = true
      PortVersionInfoApi = true
      PortSetPinModeDoesNotTouchGpioLevel = false
      PortSetAsUnusedPinApi = false
      PortResetPinModeApi = false
      PortEnableUserModeSupport = false
      PortMulticoreSupport = false
      PortTspcSupport = false
      SignalInversionConfigEnable = false
      VirtWrapperSupport = false
    CommonPublishedInformation:
      ArReleaseMajorVersion = 4
      ArReleaseMinorVersion = 4
      ArReleaseRevisionVersion = 0
      ModuleId = 124
      SwMajorVersion = 2
      SwMinorVersion = 0
      SwPatchVersion = 1
      VendorId = 43
