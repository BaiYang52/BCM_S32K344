AUTOSAR XML (schema 00050)
package /ActiveEcuC
  module config Os: implementation-config-variant=VARIANT-PRE-COMPILE, module-description=Os_Impl
    SystemTimer (OsCounter):
      OsCounterMaxAllowedValue = 2147483647
      OsCounterMinCycle = 1
      OsCounterType = HARDWARE
      OsSecondsPerTick = 0.001
      OsCounterTicksPerBase = 160000
      OsCounterAlgorithm = HEAP
      OsCounterAccessingApplication = SystemApplication_OsCore0
      OsDriver: OsDriverHighResolution=false, OsDriverHardwareTimerChannelRef=SysTick_Core0_Ch0, OsDriverIsrRef=CounterIsr_SystemTimer
    OsMemoryProtection
    OsOS:
      OsScalabilityClass = SC1
      OsGenerateMemMapForNearAddressing = false
      OsStackMonitoring = true
      OsStatus = EXTENDED
      OsUseArti = false
      OsUseGetServiceId = false
      OsUseParameterAccess = false
      OsUseResScheduler = false
      OsForcibleTermination = false
      OsGenerateCalloutStubs = true
      OsGenerateMemMap = COMPLETE
      OsGenerateMemMapForThreads = false
      OsServiceProtection = false
      OsStackUsageMeasurement = false
      OsUseXSignalAsyncApiCalls = false
      OsFpuUsage = NONE
      OsUseCase = STANDARD
      OsNumberOfCores = 1
      OsSystemTimer = SystemTimer
      OsMasterCore = OsCore0
      OsHooks: OsErrorHook=true, OsPostTaskHook=false, OsPreTaskHook=false, OsShutdownHook=false, OsStartupHook=false
      OsStackSummary
        9 x OsStack, all with OsStackSize=1024, OsStackCore=OsCore0:
          OsCore0_Kernel: OsStackType=CORE_KERNEL_STACK, OsStackUser=OsCore0
          OsCore0_Init: OsStackType=CORE_INIT_STACK, OsStackUser=OsCore0
          OsCore0_Error: OsStackType=CORE_ERROR_STACK, OsStackUser=OsCore0
          OsCore0_Isr_Core: OsStackType=ISR_SHARED_CORE_STACK, OsStackUser=CounterIsr_SystemTimer
          OsCore0_Task_Prio4294967295: OsStackType=TASK_SHARED_PRIORITY_STACK, OsStackUser=IdleTask_OsCore0
          OsCore0_Task_Prio49: OsStackType=TASK_SHARED_PRIORITY_STACK, OsStackUser=Default_Init_Task_Trusted
          OsCore0_Task_Prio50: OsStackType=TASK_SHARED_PRIORITY_STACK, OsStackUser=Default_Init_Task
          OsCore0_Task_Prio30: OsStackType=TASK_SHARED_PRIORITY_STACK, OsStackUser=SwcInitTask
          AppRunTask: OsStackType=TASK_EXTENDED_STACK, OsStackUser=Os/AppRunTask
    CounterIsr_SystemTimer (OsIsr):
      OsIsrInterruptPriority = 64
      OsIsrInterruptSource = 15
      OsIsrInitialEnableInterruptSource = false
      OsIsrCategory = CATEGORY_2
      OsIsrInterruptType = EXTERNAL
      OsIsrStackSize = 1024
      OsIsrEnableNesting = false
      OsIsrUsesFpu = false
      OsIsrSpecialFunctionName = Os_TimerPitIsr
    OsPublishedInformation: OsKernelVersion=7, OsPlatformName=Arm
      S32K3xx (OsDerivativeInformation):
        OsHardwareManuals = ARMv7-M Architecture Reference Manual edition: ARM DDI 0403E.b (ID120114), 02 December 2014 Document identifier: S32K3xxRM Reference Manual Rev. 5, 09/2022 Document identifier: S32K396RM Reference Manual Rev. 1.1, 09/2022
        OsStackAlignment = 0
        OsExceptionVectorTableAlignment = 0
        OsInterruptVectorTableAlignment = 1024
        OsMpuAlignment = SIZE
        OsMpuEndAddressAccessible = true
        OsMpuPrivilegedRegionsConfigurable = false
        3 x OsPhysicalCore, all with OsPhysicalCoreExceptionSources=8, OsPhysicalCorePrivelegedHwAccess=true, OsPhysicalCoreType=Cortex-M:
          Core0: OsPhysicalCoreId=0, OsPhysicalCoreIsAutostart=true, OsPhysicalCoreMasterStartAllowed=true, OsPhysicalCoreDefaultEntrySymbol=_start
            Core0_MPU (OsPhysicalCoreMpu): OsPhysicalCoreMpuId=0, OsPhysicalCoreMpuMaxRegions=16, OsPhysicalCoreMpuType=Cortex-M
            Core0_INTC (OsPhysicalCoreIntCtrl): OsPhysicalCoreIntCtrlMaxPrios=240, OsPhysicalCoreIntCtrlPrioOrder=DESC, OsPhysicalCoreIntCtrlMaxSources=255, OsPhysicalCoreIntCtrlType=NVIC_S32
              OsPhysicalCoreIntCtrlAddress: OsPhysicalCoreIntCtrlAddressValue=3758153728
            MC_ME_PRTN0_CORE0 (OsPhysicalCoreAddress): OsPhysicalCoreAddressValue=1076740416
          Core1: OsPhysicalCoreId=1, OsPhysicalCoreIsAutostart=false, OsPhysicalCoreMasterStartAllowed=false, OsPhysicalCoreDefaultEntrySymbol=_start_c1
            Core1_MPU (OsPhysicalCoreMpu): OsPhysicalCoreMpuId=1, OsPhysicalCoreMpuType=Cortex-M, OsPhysicalCoreMpuMaxRegions=16
            Core1_INTC (OsPhysicalCoreIntCtrl): OsPhysicalCoreIntCtrlMaxPrios=240, OsPhysicalCoreIntCtrlMaxSources=255, OsPhysicalCoreIntCtrlPrioOrder=DESC, OsPhysicalCoreIntCtrlType=NVIC_S32
              OsPhysicalCoreIntCtrlAddress: OsPhysicalCoreIntCtrlAddressValue=3758153728
            MC_ME_PRTN0_CORE1 (OsPhysicalCoreAddress): OsPhysicalCoreAddressValue=1076740448
          Core2: OsPhysicalCoreId=2, OsPhysicalCoreIsAutostart=false, OsPhysicalCoreMasterStartAllowed=false, OsPhysicalCoreDefaultEntrySymbol=_start_c2
            Core2_MPU (OsPhysicalCoreMpu): OsPhysicalCoreMpuId=2, OsPhysicalCoreMpuType=Cortex-M, OsPhysicalCoreMpuMaxRegions=16
            Core2_INTC (OsPhysicalCoreIntCtrl): OsPhysicalCoreIntCtrlMaxPrios=240, OsPhysicalCoreIntCtrlMaxSources=255, OsPhysicalCoreIntCtrlPrioOrder=DESC, OsPhysicalCoreIntCtrlType=NVIC_S32
              OsPhysicalCoreIntCtrlAddress: OsPhysicalCoreIntCtrlAddressValue=3758153728
            MC_ME_PRTN0_CORE2 (OsPhysicalCoreAddress): OsPhysicalCoreAddressValue=1076740544
        3 x OsHardwareTimer, all with OsHardwareTimerBaseAddress=0, OsHardwareTimerSize=24, OsHardwareTimerUnit=PIT, OsHardwareTimerType=SysTick:
          SysTick_Core0: OsHardwareTimerId=0
            SysTick_Core0_Ch0 (OsHardwareTimerChannel): OsHardwareTimerChannelId=0, OsHardwareTimerChannelIntSource=15, OsHardwareTimerChannelOffset=0
          SysTick_Core1: OsHardwareTimerId=1
            SysTick_Core1_Ch0 (OsHardwareTimerChannel): OsHardwareTimerChannelId=0, OsHardwareTimerChannelIntSource=15, OsHardwareTimerChannelOffset=0
          SysTick_Core2: OsHardwareTimerId=2
            SysTick_Core2_Ch0 (OsHardwareTimerChannel): OsHardwareTimerChannelId=0, OsHardwareTimerChannelIntSource=15, OsHardwareTimerChannelOffset=0
        OsMemoryRegionSpecifics
          10 x OsMemoryRegionAccess:
            SUPERVISOR_R: OsMemoryRegionAccessRights=R, OsMemoryRegionAccessType=SUPERVISOR
            SUPERVISOR_RW: OsMemoryRegionAccessRights=RW, OsMemoryRegionAccessType=SUPERVISOR
            USER_R: OsMemoryRegionAccessRights=R, OsMemoryRegionAccessType=USER
            USER_RW: OsMemoryRegionAccessRights=RW, OsMemoryRegionAccessType=USER
            SUPERVISOR_NONE: OsMemoryRegionAccessRights=NONE, OsMemoryRegionAccessType=SUPERVISOR
            USER_NONE: OsMemoryRegionAccessRights=NONE, OsMemoryRegionAccessType=USER
            SUPERVISOR_RX: OsMemoryRegionAccessRights=RX, OsMemoryRegionAccessType=SUPERVISOR
            SUPERVISOR_RWX: OsMemoryRegionAccessRights=RWX, OsMemoryRegionAccessType=SUPERVISOR
            USER_RX: OsMemoryRegionAccessRights=RX, OsMemoryRegionAccessType=USER
            USER_RWX: OsMemoryRegionAccessRights=RWX, OsMemoryRegionAccessType=USER
          8 x OsMemoryRegionFlag:
            SHAREABLE
            TYPE_STRONGLY_ORDERED
            TYPE_NON_CACHEABLE
            TYPE_CACHEABLE_WRITEBACK_ALLOCATE
            TYPE_SHARED_DEVICE
            TYPE_NON_SHARED_DEVICE
            TYPE_CACHEABLE_WRITETHROUGH_NO_ALLOCATE
            TYPE_CACHEABLE_WRITEBACK_NO_ALLOCATE
        OsMemoryRegionDefaults_AppNT (OsMemoryRegionDefaults):
          OsMemoryRegionDefIdentifier = 1
          OsMemoryRegionDefType = APPLICATION_NONPRIVILEGED
          OsMemoryRegionDefProtectionUnitSlot = 14
          OsMemoryRegionDefAccessRights = SUPERVISOR_RW
          OsMemoryRegionDefAccessRights = USER_RW
          OsMemoryRegionDefFlags = TYPE_CACHEABLE_WRITEBACK_ALLOCATE
        MSCM (OsSystemIntCtrl):
          OsSystemIntCtrlBaseAddress = 1076232192
          OsSystemIntCtrlMaxPrios = 240
          OsSystemIntCtrlMaxSources = 255
          OsSystemIntCtrlPrioOrder = DESC
          OsSystemIntCtrlType = NVIC_S32
          MSCM_IRSPRC (OsSystemIntCtrlAddress): OsSystemIntCtrlAddressValue=1076234370
        OsInterruptRouting: OsInterruptRoutingCore0Offset=0
        3 x OsHardwareTimer, all with OsHardwareTimerSize=32, OsHardwareTimerType=STM, OsHardwareTimerUnit=FRT:
          STM0: OsHardwareTimerId=0, OsHardwareTimerBaseAddress=1076314112
            STM0 (OsHardwareTimerChannel): OsHardwareTimerChannelId=0, OsHardwareTimerChannelIntSource=55, OsHardwareTimerChannelOffset=0
          STM1: OsHardwareTimerId=1, OsHardwareTimerBaseAddress=1078411264
            STM1 (OsHardwareTimerChannel): OsHardwareTimerChannelId=0, OsHardwareTimerChannelIntSource=56, OsHardwareTimerChannelOffset=0
          STM2: OsHardwareTimerId=2, OsHardwareTimerBaseAddress=1078427648
            STM2 (OsHardwareTimerChannel): OsHardwareTimerChannelId=0, OsHardwareTimerChannelIntSource=57, OsHardwareTimerChannelOffset=0
    OSDEFAULTAPPMODE (OsAppMode)
    OS_APPMODE_ANY (OsAppMode)
    OsCore0 (OsCore):
      OsCoreIsAutostart = true
      OsCoreIsAutosar = true
      OsCoreEntrySymbol = _start
      OsCorePhysicalCoreRef = Core0
      OsCoreIdleTask = IdleTask_OsCore0
      OsCoreSystemApplication = SystemApplication_OsCore0
      OsCoreEcucCoreRef = EcucCoreDefinition
      OsCoreStacks:
        OsCoreKernelStackSize = 1024
        OsCoreStartupStackSize = 1024
        OsCoreShutdownStackSize = 1024
        OsCoreErrorStackSize = 1024
        OsCoreProtectionStackSize = 1024
        OsCoreInitStackSize = 1024
    IdleTask_OsCore0 (OsTask):
      OsTaskActivation = 1
      OsTaskPriority = 4294967295
      OsTaskSchedule = FULL
      OsTaskStackSharing = false
      OsTaskStackSize = 1024
      OsTaskType = AUTO
      OsTaskUsesFpu = false
      OsTaskAccessingApplication = SystemApplication_OsCore0
      OsTaskAutostart: OsTaskAppModeRef=OS_APPMODE_ANY
    SystemApplication_OsCore0 (OsApplication):
      OsTrusted = true
      OsTrustedApplicationDelayTimingViolationCall = false
      OsTrustedApplicationWithProtection = false
      OsApplicationIsPrivileged = true
      OsAppUseTrustedFunctionStubs = false
      OsAppTaskRef = IdleTask_OsCore0
      OsAppCounterRef = SystemTimer
      OsAppIsrRef = CounterIsr_SystemTimer
      OsApplicationCoreRef = EcucCoreDefinition
      OsAppTaskRef = Os/AppRunTask
      OsAppTaskRef = Default_Init_Task
      OsAppTaskRef = Default_Init_Task_Trusted
      OsAppAlarmRef = Rte_Al_TE2_AppRunTask_0_10ms
      OsAppTaskRef = SwcInitTask
      OsAppAlarmRef = Rte_Al_TE_CtAppSwc_RCtAppSwc_1000ms
      OsAppAlarmRef = Rte_Al_TE_CtAppSwc_RCtAppSwc_10ms
      OsApplicationHooks: OsAppErrorHook=false, OsAppShutdownHook=false, OsAppStartupHook=false
    OsResource: OsResourceProperty=STANDARD, OsResourceAccessingApplication=SystemApplication_OsCore0
    3 x OsTask, all with OsTaskActivation=1, OsTaskSchedule=FULL, OsTaskStackSharing=false, OsTaskStackSize=1024, OsTaskUsesFpu=false, OsTaskAccessingApplication=SystemApplication_OsCore0:
      AppRunTask: OsTaskPriority=15, OsTaskType=AUTO, OsTaskResourceRef=OsResource, OsTaskEventRef=Rte_Ev_Cyclic2_AppRunTask_0_10ms, OsTaskEventRef=Rte_Ev_Run_CtAppSwc_RCtAppSwc_1000ms, OsTaskEventRef=Rte_Ev_Run_CtAppSwc_RCtAppSwc_10ms
      Default_Init_Task: OsTaskPriority=50, OsTaskType=BASIC
        OsTaskAutostart: OsTaskAppModeRef=OSDEFAULTAPPMODE
      Default_Init_Task_Trusted: OsTaskPriority=49, OsTaskType=BASIC
        OsTaskAutostart: OsTaskAppModeRef=OSDEFAULTAPPMODE
    Rte_Al_TE2_AppRunTask_0_10ms (OsAlarm): OsAlarmCounterRef=SystemTimer, OsAlarmAccessingApplication=SystemApplication_OsCore0
      OsAlarmAction
        OsAlarmSetEvent: OsAlarmSetEventRef=Rte_Ev_Cyclic2_AppRunTask_0_10ms, OsAlarmSetEventTaskRef=Os/AppRunTask
    SwcInitTask (OsTask):
      OsTaskActivation = 1
      OsTaskPriority = 30
      OsTaskSchedule = FULL
      OsTaskStackSharing = false
      OsTaskStackSize = 1024
      OsTaskType = AUTO
      OsTaskUsesFpu = false
      OsTaskAccessingApplication = SystemApplication_OsCore0
    Rte_Al_TE_CtAppSwc_RCtAppSwc_1000ms (OsAlarm): OsAlarmCounterRef=SystemTimer, OsAlarmAccessingApplication=SystemApplication_OsCore0
      OsAlarmAction
        OsAlarmSetEvent: OsAlarmSetEventRef=Rte_Ev_Run_CtAppSwc_RCtAppSwc_1000ms, OsAlarmSetEventTaskRef=Os/AppRunTask
    Rte_Al_TE_CtAppSwc_RCtAppSwc_10ms (OsAlarm): OsAlarmCounterRef=SystemTimer, OsAlarmAccessingApplication=SystemApplication_OsCore0
      OsAlarmAction
        OsAlarmSetEvent: OsAlarmSetEventRef=Rte_Ev_Run_CtAppSwc_RCtAppSwc_10ms, OsAlarmSetEventTaskRef=Os/AppRunTask
    3 x OsEvent:
      Rte_Ev_Cyclic2_AppRunTask_0_10ms
      Rte_Ev_Run_CtAppSwc_RCtAppSwc_1000ms
      Rte_Ev_Run_CtAppSwc_RCtAppSwc_10ms
