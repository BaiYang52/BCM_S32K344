AUTOSAR XML (schema 00050)
package /ActiveEcuC
  module config VTTMemMap: implementation-config-variant=VARIANT-PRE-COMPILE, module-description=VTTMemMap_Impl
    MemMapGeneral:
      MemMapGeneration = FULL
      MemMapCompatibilityGeneration = FULL
      MemMapTypedPragmas = true
      MemMapGeneratePragmas = true
      MemMapErrorChecks = ALL
      MemMapGeneratePragmasForNearAddressing = true
    8 x MemMapAddressingModeSet, all with MemMapCompilerMemClassSymbolImpl=:
      MSR_PBCFG_VAR
        MSR_PBCFG_VAR (MemMapAddressingMode):
          MemMapAlignmentSelector = UNSPECIFIED
          MemMapAlignmentSelector = 8
          MemMapAlignmentSelector = 16
          MemMapAlignmentSelector = 32
          MemMapAlignmentSelector = 64
          MemMapAlignmentSelector = BOOLEAN
      MSR_VAR_NO_INIT
        MSR_VAR_NO_INIT (MemMapAddressingMode):
          MemMapAlignmentSelector = UNSPECIFIED
          MemMapAlignmentSelector = 8
          MemMapAlignmentSelector = 16
          MemMapAlignmentSelector = 32
          MemMapAlignmentSelector = 64
          MemMapAlignmentSelector = BOOLEAN
      MSR_PBCFG_CONST
        MSR_PBCFG_CONST (MemMapAddressingMode):
          MemMapAlignmentSelector = UNSPECIFIED
          MemMapAlignmentSelector = 8
          MemMapAlignmentSelector = 16
          MemMapAlignmentSelector = 32
          MemMapAlignmentSelector = 64
          MemMapAlignmentSelector = BOOLEAN
      MSR_VAR_SAVED_ZONE
        MSR_VAR_SAVED_ZONE (MemMapAddressingMode):
          MemMapAlignmentSelector = UNSPECIFIED
          MemMapAlignmentSelector = 8
          MemMapAlignmentSelector = 16
          MemMapAlignmentSelector = 32
          MemMapAlignmentSelector = 64
          MemMapAlignmentSelector = BOOLEAN
      MSR_VAR_CLEARED
        MSR_VAR_CLEARED (MemMapAddressingMode):
          MemMapAlignmentSelector = UNSPECIFIED
          MemMapAlignmentSelector = 8
          MemMapAlignmentSelector = 16
          MemMapAlignmentSelector = 32
          MemMapAlignmentSelector = 64
          MemMapAlignmentSelector = BOOLEAN
      MSR_CONST
        MSR_CONST (MemMapAddressingMode):
          MemMapAlignmentSelector = UNSPECIFIED
          MemMapAlignmentSelector = 8
          MemMapAlignmentSelector = 16
          MemMapAlignmentSelector = 32
          MemMapAlignmentSelector = 64
          MemMapAlignmentSelector = BOOLEAN
      MSR_VAR_INIT
        MSR_VAR_INIT (MemMapAddressingMode):
          MemMapAlignmentSelector = UNSPECIFIED
          MemMapAlignmentSelector = 8
          MemMapAlignmentSelector = 16
          MemMapAlignmentSelector = 32
          MemMapAlignmentSelector = 64
          MemMapAlignmentSelector = BOOLEAN
      MSR_CODE
        MSR_CODE (MemMapAddressingMode):
          MemMapAlignmentSelector = UNSPECIFIED
          MemMapAlignmentSelector = 8
          MemMapAlignmentSelector = 16
          MemMapAlignmentSelector = 32
          MemMapAlignmentSelector = 64
          MemMapAlignmentSelector = BOOLEAN
    MemMap_Common (MemMapModule): MemMapGenerateAdditionalMemorySections=true
      113 x MemMapAdditionalMemorySection, all with MemMapMemorySectionPrefix=, MemMapMemorySectionFileName=MemMap_Common.h:
        CONST_16: MemMapMemorySectionAlignment=16, MemMapMemorySectionSymbol=CONST_16, MemMapMemorySectionSwAddrMethodRef=CONST
        VAR_NO_INIT_16: MemMapMemorySectionAlignment=16, MemMapMemorySectionSymbol=VAR_NO_INIT_16, MemMapMemorySectionSwAddrMethodRef=VAR_NO_INIT
        CONST: MemMapMemorySectionAlignment=UNSPECIFIED, MemMapMemorySectionSymbol=CONST, MemMapMemorySectionSwAddrMethodRef=CONST
        CODE_FAST: MemMapMemorySectionSymbol=CODE_FAST, MemMapMemorySectionSwAddrMethodRef=CODE_FAST
        VAR_FAST_INIT_64BIT: MemMapMemorySectionAlignment=64, MemMapMemorySectionSymbol=VAR_FAST_INIT_64BIT, MemMapMemorySectionSwAddrMethodRef=VAR_FAST_INIT
        VAR_NOCACHE_ZERO_INIT_16BIT: MemMapMemorySectionAlignment=16, MemMapMemorySectionSymbol=VAR_NOCACHE_ZERO_INIT_16BIT, MemMapMemorySectionSwAddrMethodRef=VAR_NOCACHE_CLEARED
        VAR_FAST_INIT_8: MemMapMemorySectionAlignment=8, MemMapMemorySectionSymbol=VAR_FAST_INIT_8, MemMapMemorySectionSwAddrMethodRef=VAR_FAST_INIT
        CONST_32: MemMapMemorySectionSymbol=CONST_32, MemMapMemorySectionAlignment=32, MemMapMemorySectionSwAddrMethodRef=CONST
        VAR_NOCACHE_CLEARED_32: MemMapMemorySectionSymbol=VAR_NOCACHE_CLEARED_32, MemMapMemorySectionAlignment=32, MemMapMemorySectionSwAddrMethodRef=VAR_NOCACHE_CLEARED
        VAR_NOINIT_UNSPECIFIED: MemMapMemorySectionAlignment=UNSPECIFIED, MemMapMemorySectionSymbol=VAR_NOINIT_UNSPECIFIED, MemMapMemorySectionSwAddrMethodRef=VAR_NO_INIT
        VAR_INIT_64: MemMapMemorySectionSymbol=VAR_INIT_64, MemMapMemorySectionAlignment=64, MemMapMemorySectionSwAddrMethodRef=VAR_INIT
        VAR_ZERO_INIT_8BIT: MemMapMemorySectionSymbol=VAR_ZERO_INIT_8BIT, MemMapMemorySectionAlignment=8, MemMapMemorySectionSwAddrMethodRef=VAR_CLEARED
        VAR_INIT_16BIT: MemMapMemorySectionSymbol=VAR_INIT_16BIT, MemMapMemorySectionAlignment=16, MemMapMemorySectionSwAddrMethodRef=VAR_INIT
        VAR_INIT_32BIT: MemMapMemorySectionAlignment=32, MemMapMemorySectionSymbol=VAR_INIT_32BIT, MemMapMemorySectionSwAddrMethodRef=VAR_INIT
        CONST_UNSPECIFIED: MemMapMemorySectionAlignment=UNSPECIFIED, MemMapMemorySectionSymbol=CONST_UNSPECIFIED, MemMapMemorySectionSwAddrMethodRef=CONST
        VAR_NOCACHE_NOINIT_32BIT: MemMapMemorySectionSymbol=VAR_NOCACHE_NOINIT_32BIT, MemMapMemorySectionAlignment=32, MemMapMemorySectionSwAddrMethodRef=VAR_NOCACHE_NO_INIT
        VAR_FAST_NO_INIT_32: MemMapMemorySectionAlignment=32, MemMapMemorySectionSymbol=VAR_FAST_NO_INIT_32, MemMapMemorySectionSwAddrMethodRef=VAR_FAST_NO_INIT
        VAR_FAST_ZERO_INIT_64BIT: MemMapMemorySectionAlignment=64, MemMapMemorySectionSymbol=VAR_FAST_ZERO_INIT_64BIT, MemMapMemorySectionSwAddrMethodRef=VAR_FAST_CLEARED
        PBCFG_GLOBALROOT: MemMapMemorySectionSymbol=PBCFG_GLOBALROOT, MemMapMemorySectionSwAddrMethodRef=PBCFG_GLOBALROOT
        VAR_FAST_CLEARED_UNSPECIFIED: MemMapMemorySectionAlignment=UNSPECIFIED, MemMapMemorySectionSymbol=VAR_FAST_CLEARED_UNSPECIFIED, MemMapMemorySectionSwAddrMethodRef=VAR_FAST_CLEARED
        VAR_CLEARED_64: MemMapMemorySectionSymbol=VAR_CLEARED_64, MemMapMemorySectionAlignment=64, MemMapMemorySectionSwAddrMethodRef=VAR_CLEARED
        VAR_NOCACHE_CLEARED_64: MemMapMemorySectionAlignment=64, MemMapMemorySectionSymbol=VAR_NOCACHE_CLEARED_64, MemMapMemorySectionSwAddrMethodRef=VAR_NOCACHE_CLEARED
        CONST_FAST_UNSPECIFIED: MemMapMemorySectionAlignment=UNSPECIFIED, MemMapMemorySectionSymbol=CONST_FAST_UNSPECIFIED, MemMapMemorySectionSwAddrMethodRef=CONST_FAST
        CONST_FAST_64: MemMapMemorySectionAlignment=64, MemMapMemorySectionSymbol=CONST_FAST_64, MemMapMemorySectionSwAddrMethodRef=CONST_FAST
        VAR_NOINIT_8BIT: MemMapMemorySectionAlignment=8, MemMapMemorySectionSymbol=VAR_NOINIT_8BIT, MemMapMemorySectionSwAddrMethodRef=VAR_NO_INIT
        CONST_8: MemMapMemorySectionAlignment=8, MemMapMemorySectionSymbol=CONST_8, MemMapMemorySectionSwAddrMethodRef=CONST
        VAR_NOCACHE_INIT_32BIT: MemMapMemorySectionSymbol=VAR_NOCACHE_INIT_32BIT, MemMapMemorySectionAlignment=32, MemMapMemorySectionSwAddrMethodRef=VAR_NOCACHE_INIT
        VAR_NOCACHE_NOINIT_UNSPECIFIED: MemMapMemorySectionSymbol=VAR_NOCACHE_NOINIT_UNSPECIFIED, MemMapMemorySectionAlignment=UNSPECIFIED, MemMapMemorySectionSwAddrMethodRef=VAR_NOCACHE_NO_INIT
        VAR_CLEARED_16: MemMapMemorySectionAlignment=16, MemMapMemorySectionSymbol=VAR_CLEARED_16, MemMapMemorySectionSwAddrMethodRef=VAR_CLEARED
        VAR_ZERO_INIT_UNSPECIFIED: MemMapMemorySectionAlignment=UNSPECIFIED, MemMapMemorySectionSymbol=VAR_ZERO_INIT_UNSPECIFIED, MemMapMemorySectionSwAddrMethodRef=VAR_CLEARED
        VAR_NOCACHE_CLEARED_8: MemMapMemorySectionSymbol=VAR_NOCACHE_CLEARED_8, MemMapMemorySectionAlignment=8, MemMapMemorySectionSwAddrMethodRef=VAR_NOCACHE_CLEARED
        VAR: MemMapMemorySectionSymbol=VAR, MemMapMemorySectionAlignment=UNSPECIFIED, MemMapMemorySectionSwAddrMethodRef=VAR_INIT
        VAR_NOINIT_32BIT: MemMapMemorySectionAlignment=32, MemMapMemorySectionSymbol=VAR_NOINIT_32BIT, MemMapMemorySectionSwAddrMethodRef=VAR_NO_INIT
        VAR_INIT_UNSPECIFIED: MemMapMemorySectionAlignment=UNSPECIFIED, MemMapMemorySectionSymbol=VAR_INIT_UNSPECIFIED, MemMapMemorySectionSwAddrMethodRef=VAR_INIT
        CONST_FAST_8: MemMapMemorySectionSymbol=CONST_FAST_8, MemMapMemorySectionAlignment=8, MemMapMemorySectionSwAddrMethodRef=CONST_FAST
        VAR_FAST_INIT_64: MemMapMemorySectionAlignment=64, MemMapMemorySectionSymbol=VAR_FAST_INIT_64, MemMapMemorySectionSwAddrMethodRef=VAR_FAST_INIT
        VAR_NOCACHE_ZERO_INIT_32BIT: MemMapMemorySectionSymbol=VAR_NOCACHE_ZERO_INIT_32BIT, MemMapMemorySectionAlignment=32, MemMapMemorySectionSwAddrMethodRef=VAR_NOCACHE_CLEARED
        VAR_FAST_ZERO_INIT_32BIT: MemMapMemorySectionAlignment=32, MemMapMemorySectionSymbol=VAR_FAST_ZERO_INIT_32BIT, MemMapMemorySectionSwAddrMethodRef=VAR_FAST_CLEARED
        CONST_64BIT: MemMapMemorySectionSymbol=CONST_64BIT, MemMapMemorySectionAlignment=64, MemMapMemorySectionSwAddrMethodRef=CONST
        VAR_NO_INIT_8: MemMapMemorySectionAlignment=8, MemMapMemorySectionSymbol=VAR_NO_INIT_8, MemMapMemorySectionSwAddrMethodRef=VAR_NO_INIT
        VAR_CLEARED_8: MemMapMemorySectionAlignment=8, MemMapMemorySectionSymbol=VAR_CLEARED_8, MemMapMemorySectionSwAddrMethodRef=VAR_CLEARED
        CONST_16BIT: MemMapMemorySectionSymbol=CONST_16BIT, MemMapMemorySectionAlignment=16, MemMapMemorySectionSwAddrMethodRef=CONST
        VAR_FAST_NO_INIT_64: MemMapMemorySectionSymbol=VAR_FAST_NO_INIT_64, MemMapMemorySectionAlignment=64, MemMapMemorySectionSwAddrMethodRef=VAR_FAST_NO_INIT
        VAR_INIT_16: MemMapMemorySectionAlignment=16, MemMapMemorySectionSymbol=VAR_INIT_16, MemMapMemorySectionSwAddrMethodRef=VAR_INIT
        VAR_FAST_CLEARED_64: MemMapMemorySectionAlignment=64, MemMapMemorySectionSymbol=VAR_FAST_CLEARED_64, MemMapMemorySectionSwAddrMethodRef=VAR_FAST_CLEARED
        VAR_FAST_NO_INIT_16: MemMapMemorySectionSymbol=VAR_FAST_NO_INIT_16, MemMapMemorySectionAlignment=16, MemMapMemorySectionSwAddrMethodRef=VAR_FAST_NO_INIT
        CODE_ISR: MemMapMemorySectionSymbol=CODE_ISR, MemMapMemorySectionSwAddrMethodRef=CODE_ISR
        VAR_NOCACHE_INIT_UNSPECIFIED: MemMapMemorySectionSymbol=VAR_NOCACHE_INIT_UNSPECIFIED, MemMapMemorySectionAlignment=UNSPECIFIED, MemMapMemorySectionSwAddrMethodRef=VAR_NOCACHE_INIT
        VAR_NOCACHE_INIT_16BIT: MemMapMemorySectionAlignment=16, MemMapMemorySectionSymbol=VAR_NOCACHE_INIT_16BIT, MemMapMemorySectionSwAddrMethodRef=VAR_NOCACHE_INIT
        CONST_PBCFG: MemMapMemorySectionSymbol=CONST_PBCFG, MemMapMemorySectionSwAddrMethodRef=CONST_PBCFG
        VAR_INIT_32: MemMapMemorySectionAlignment=32, MemMapMemorySectionSymbol=VAR_INIT_32, MemMapMemorySectionSwAddrMethodRef=VAR_INIT
        CONST_FAST_64BIT: MemMapMemorySectionAlignment=64, MemMapMemorySectionSymbol=CONST_FAST_64BIT, MemMapMemorySectionSwAddrMethodRef=CONST_FAST
        VAR_CLEARED_UNSPECIFIED: MemMapMemorySectionAlignment=UNSPECIFIED, MemMapMemorySectionSymbol=VAR_CLEARED_UNSPECIFIED, MemMapMemorySectionSwAddrMethodRef=VAR_CLEARED
        VAR_CLEARED_32: MemMapMemorySectionSymbol=VAR_CLEARED_32, MemMapMemorySectionAlignment=32, MemMapMemorySectionSwAddrMethodRef=VAR_CLEARED
        VAR_NOCACHE_INIT_8BIT: MemMapMemorySectionSymbol=VAR_NOCACHE_INIT_8BIT, MemMapMemorySectionAlignment=8, MemMapMemorySectionSwAddrMethodRef=VAR_NOCACHE_INIT
        VAR_NOCACHE_NO_INIT_8: MemMapMemorySectionAlignment=8, MemMapMemorySectionSymbol=VAR_NOCACHE_NO_INIT_8, MemMapMemorySectionSwAddrMethodRef=VAR_NOCACHE_NO_INIT
        VAR_NOCACHE_CLEARED_UNSPECIFIED: MemMapMemorySectionSymbol=VAR_NOCACHE_CLEARED_UNSPECIFIED, MemMapMemorySectionAlignment=UNSPECIFIED, MemMapMemorySectionSwAddrMethodRef=VAR_NOCACHE_CLEARED
        VAR_NOCACHE_NOINIT_64BIT: MemMapMemorySectionSymbol=VAR_NOCACHE_NOINIT_64BIT, MemMapMemorySectionAlignment=64, MemMapMemorySectionSwAddrMethodRef=VAR_NOCACHE_NO_INIT
        VAR_NOCACHE_NO_INIT_16: MemMapMemorySectionSymbol=VAR_NOCACHE_NO_INIT_16, MemMapMemorySectionAlignment=16, MemMapMemorySectionSwAddrMethodRef=VAR_NOCACHE_NO_INIT
        VAR_NO_INIT_64: MemMapMemorySectionAlignment=64, MemMapMemorySectionSymbol=VAR_NO_INIT_64, MemMapMemorySectionSwAddrMethodRef=VAR_NO_INIT
        CODE: MemMapMemorySectionSymbol=CODE, MemMapMemorySectionSwAddrMethodRef=CODE
        VAR_FAST_CLEARED_8: MemMapMemorySectionSymbol=VAR_FAST_CLEARED_8, MemMapMemorySectionAlignment=8, MemMapMemorySectionSwAddrMethodRef=VAR_FAST_CLEARED
        CONST_FAST_32: MemMapMemorySectionSymbol=CONST_FAST_32, MemMapMemorySectionAlignment=32, MemMapMemorySectionSwAddrMethodRef=CONST_FAST
        CONST_32BIT: MemMapMemorySectionSymbol=CONST_32BIT, MemMapMemorySectionAlignment=32, MemMapMemorySectionSwAddrMethodRef=CONST
        VAR_NOCACHE_INIT_16: MemMapMemorySectionSymbol=VAR_NOCACHE_INIT_16, MemMapMemorySectionAlignment=16, MemMapMemorySectionSwAddrMethodRef=VAR_NOCACHE_INIT
        VAR_FAST_NOINIT_8BIT: MemMapMemorySectionAlignment=8, MemMapMemorySectionSymbol=VAR_FAST_NOINIT_8BIT, MemMapMemorySectionSwAddrMethodRef=VAR_FAST_NO_INIT
        CONST_FAST_32BIT: MemMapMemorySectionAlignment=32, MemMapMemorySectionSymbol=CONST_FAST_32BIT, MemMapMemorySectionSwAddrMethodRef=CONST_FAST
        VAR_FAST_INIT_16BIT: MemMapMemorySectionAlignment=16, MemMapMemorySectionSymbol=VAR_FAST_INIT_16BIT, MemMapMemorySectionSwAddrMethodRef=VAR_FAST_INIT
        VAR_NOCACHE_ZERO_INIT_UNSPECIFIED: MemMapMemorySectionSymbol=VAR_NOCACHE_ZERO_INIT_UNSPECIFIED, MemMapMemorySectionAlignment=UNSPECIFIED, MemMapMemorySectionSwAddrMethodRef=VAR_NOCACHE_CLEARED
        CONST_FAST_8BIT: MemMapMemorySectionAlignment=8, MemMapMemorySectionSymbol=CONST_FAST_8BIT, MemMapMemorySectionSwAddrMethodRef=CONST_FAST
        VAR_INIT_8BIT: MemMapMemorySectionAlignment=8, MemMapMemorySectionSymbol=VAR_INIT_8BIT, MemMapMemorySectionSwAddrMethodRef=VAR_INIT
        VAR_INIT_8: MemMapMemorySectionSymbol=VAR_INIT_8, MemMapMemorySectionAlignment=8, MemMapMemorySectionSwAddrMethodRef=VAR_INIT
        VAR_NOCACHE_INIT_64BIT: MemMapMemorySectionSymbol=VAR_NOCACHE_INIT_64BIT, MemMapMemorySectionAlignment=64, MemMapMemorySectionSwAddrMethodRef=VAR_NOCACHE_INIT
        VAR_NOCACHE_INIT_32: MemMapMemorySectionSymbol=VAR_NOCACHE_INIT_32, MemMapMemorySectionAlignment=32, MemMapMemorySectionSwAddrMethodRef=VAR_NOCACHE_INIT
        VAR_INIT_64BIT: MemMapMemorySectionSymbol=VAR_INIT_64BIT, MemMapMemorySectionAlignment=64, MemMapMemorySectionSwAddrMethodRef=VAR_INIT
        VAR_NO_INIT_UNSPECIFIED: MemMapMemorySectionSymbol=VAR_NO_INIT_UNSPECIFIED, MemMapMemorySectionAlignment=UNSPECIFIED, MemMapMemorySectionSwAddrMethodRef=VAR_NO_INIT
        VAR_FAST_NOINIT_UNSPECIFIED: MemMapMemorySectionSymbol=VAR_FAST_NOINIT_UNSPECIFIED, MemMapMemorySectionAlignment=UNSPECIFIED, MemMapMemorySectionSwAddrMethodRef=VAR_FAST_NO_INIT
        VAR_FAST_INIT_16: MemMapMemorySectionAlignment=16, MemMapMemorySectionSymbol=VAR_FAST_INIT_16, MemMapMemorySectionSwAddrMethodRef=VAR_FAST_INIT
        VAR_FAST_INIT_UNSPECIFIED: MemMapMemorySectionAlignment=UNSPECIFIED, MemMapMemorySectionSymbol=VAR_FAST_INIT_UNSPECIFIED, MemMapMemorySectionSwAddrMethodRef=VAR_FAST_INIT
        VAR_FAST_ZERO_INIT_8BIT: MemMapMemorySectionAlignment=8, MemMapMemorySectionSymbol=VAR_FAST_ZERO_INIT_8BIT, MemMapMemorySectionSwAddrMethodRef=VAR_FAST_CLEARED
        VAR_NOCACHE_NO_INIT_32: MemMapMemorySectionAlignment=32, MemMapMemorySectionSymbol=VAR_NOCACHE_NO_INIT_32, MemMapMemorySectionSwAddrMethodRef=VAR_NOCACHE_NO_INIT
        VAR_FAST_INIT_8BIT: MemMapMemorySectionAlignment=8, MemMapMemorySectionSymbol=VAR_FAST_INIT_8BIT, MemMapMemorySectionSwAddrMethodRef=VAR_FAST_INIT
        VAR_NOCACHE_ZERO_INIT_8BIT: MemMapMemorySectionAlignment=8, MemMapMemorySectionSymbol=VAR_NOCACHE_ZERO_INIT_8BIT, MemMapMemorySectionSwAddrMethodRef=VAR_NOCACHE_CLEARED
        VAR_NO_INIT_32: MemMapMemorySectionAlignment=32, MemMapMemorySectionSymbol=VAR_NO_INIT_32, MemMapMemorySectionSwAddrMethodRef=VAR_NO_INIT
        VAR_PBCFG: MemMapMemorySectionAlignment=UNSPECIFIED, MemMapMemorySectionSymbol=VAR_PBCFG, MemMapMemorySectionSwAddrMethodRef=VAR_PBCFG
        VAR_NOINIT_64BIT: MemMapMemorySectionSymbol=VAR_NOINIT_64BIT, MemMapMemorySectionAlignment=64, MemMapMemorySectionSwAddrMethodRef=VAR_NO_INIT
        VAR_ZERO_INIT_32BIT: MemMapMemorySectionAlignment=32, MemMapMemorySectionSymbol=VAR_ZERO_INIT_32BIT, MemMapMemorySectionSwAddrMethodRef=VAR_CLEARED
        VAR_ZERO_INIT_64BIT: MemMapMemorySectionSymbol=VAR_ZERO_INIT_64BIT, MemMapMemorySectionAlignment=64, MemMapMemorySectionSwAddrMethodRef=VAR_CLEARED
        CONST_FAST_16: MemMapMemorySectionAlignment=16, MemMapMemorySectionSymbol=CONST_FAST_16, MemMapMemorySectionSwAddrMethodRef=CONST_FAST
        VAR_NOCACHE_NO_INIT_64: MemMapMemorySectionSymbol=VAR_NOCACHE_NO_INIT_64, MemMapMemorySectionAlignment=64, MemMapMemorySectionSwAddrMethodRef=VAR_NOCACHE_NO_INIT
        VAR_NOCACHE_ZERO_INIT_64BIT: MemMapMemorySectionAlignment=64, MemMapMemorySectionSymbol=VAR_NOCACHE_ZERO_INIT_64BIT, MemMapMemorySectionSwAddrMethodRef=VAR_NOCACHE_CLEARED
        VAR_FAST_INIT_32: MemMapMemorySectionSymbol=VAR_FAST_INIT_32, MemMapMemorySectionAlignment=32, MemMapMemorySectionSwAddrMethodRef=VAR_FAST_INIT
        VAR_FAST_NOINIT_16BIT: MemMapMemorySectionAlignment=16, MemMapMemorySectionSymbol=VAR_FAST_NOINIT_16BIT, MemMapMemorySectionSwAddrMethodRef=VAR_FAST_NO_INIT
        VAR_FAST_NO_INIT_8: MemMapMemorySectionSymbol=VAR_FAST_NO_INIT_8, MemMapMemorySectionAlignment=8, MemMapMemorySectionSwAddrMethodRef=VAR_FAST_NO_INIT
        CONST_FAST_16BIT: MemMapMemorySectionAlignment=16, MemMapMemorySectionSymbol=CONST_FAST_16BIT, MemMapMemorySectionSwAddrMethodRef=CONST_FAST
        VAR_NOCACHE_INIT_64: MemMapMemorySectionSymbol=VAR_NOCACHE_INIT_64, MemMapMemorySectionAlignment=64, MemMapMemorySectionSwAddrMethodRef=VAR_NOCACHE_INIT
        CONST_64: MemMapMemorySectionSymbol=CONST_64, MemMapMemorySectionAlignment=64, MemMapMemorySectionSwAddrMethodRef=CONST
        VAR_NOINIT_16BIT: MemMapMemorySectionAlignment=16, MemMapMemorySectionSymbol=VAR_NOINIT_16BIT, MemMapMemorySectionSwAddrMethodRef=VAR_NO_INIT
        VAR_FAST_ZERO_INIT_UNSPECIFIED: MemMapMemorySectionSymbol=VAR_FAST_ZERO_INIT_UNSPECIFIED, MemMapMemorySectionAlignment=UNSPECIFIED, MemMapMemorySectionSwAddrMethodRef=VAR_FAST_CLEARED
        CONST_8BIT: MemMapMemorySectionAlignment=8, MemMapMemorySectionSymbol=CONST_8BIT, MemMapMemorySectionSwAddrMethodRef=CONST
        VAR_NOCACHE_CLEARED_16: MemMapMemorySectionSymbol=VAR_NOCACHE_CLEARED_16, MemMapMemorySectionAlignment=16, MemMapMemorySectionSwAddrMethodRef=VAR_NOCACHE_CLEARED
        VAR_FAST_NOINIT_32BIT: MemMapMemorySectionAlignment=32, MemMapMemorySectionSymbol=VAR_FAST_NOINIT_32BIT, MemMapMemorySectionSwAddrMethodRef=VAR_FAST_NO_INIT
        VAR_ZERO_INIT_16BIT: MemMapMemorySectionSymbol=VAR_ZERO_INIT_16BIT, MemMapMemorySectionAlignment=16, MemMapMemorySectionSwAddrMethodRef=VAR_CLEARED
        VAR_NOCACHE_INIT_8: MemMapMemorySectionSymbol=VAR_NOCACHE_INIT_8, MemMapMemorySectionAlignment=8, MemMapMemorySectionSwAddrMethodRef=VAR_NOCACHE_INIT
        VAR_FAST_INIT_32BIT: MemMapMemorySectionSymbol=VAR_FAST_INIT_32BIT, MemMapMemorySectionAlignment=32, MemMapMemorySectionSwAddrMethodRef=VAR_FAST_INIT
        VAR_FAST_NOINIT_64BIT: MemMapMemorySectionAlignment=64, MemMapMemorySectionSymbol=VAR_FAST_NOINIT_64BIT, MemMapMemorySectionSwAddrMethodRef=VAR_FAST_NO_INIT
        VAR_FAST_ZERO_INIT_16BIT: MemMapMemorySectionSymbol=VAR_FAST_ZERO_INIT_16BIT, MemMapMemorySectionAlignment=16, MemMapMemorySectionSwAddrMethodRef=VAR_FAST_CLEARED
        VAR_NOCACHE_NOINIT_16BIT: MemMapMemorySectionAlignment=16, MemMapMemorySectionSymbol=VAR_NOCACHE_NOINIT_16BIT, MemMapMemorySectionSwAddrMethodRef=VAR_NOCACHE_NO_INIT
        VAR_FAST_CLEARED_16: MemMapMemorySectionSymbol=VAR_FAST_CLEARED_16, MemMapMemorySectionAlignment=16, MemMapMemorySectionSwAddrMethodRef=VAR_FAST_CLEARED
        VAR_FAST_CLEARED_32: MemMapMemorySectionAlignment=32, MemMapMemorySectionSymbol=VAR_FAST_CLEARED_32, MemMapMemorySectionSwAddrMethodRef=VAR_FAST_CLEARED
        VAR_NOCACHE_NO_INIT_UNSPECIFIED: MemMapMemorySectionSymbol=VAR_NOCACHE_NO_INIT_UNSPECIFIED, MemMapMemorySectionAlignment=UNSPECIFIED, MemMapMemorySectionSwAddrMethodRef=VAR_NOCACHE_NO_INIT
        VAR_NOCACHE_NOINIT_8BIT: MemMapMemorySectionSymbol=VAR_NOCACHE_NOINIT_8BIT, MemMapMemorySectionAlignment=8, MemMapMemorySectionSwAddrMethodRef=VAR_NOCACHE_NO_INIT
        VAR_FAST_NO_INIT_UNSPECIFIED: MemMapMemorySectionAlignment=UNSPECIFIED, MemMapMemorySectionSymbol=VAR_FAST_NO_INIT_UNSPECIFIED, MemMapMemorySectionSwAddrMethodRef=VAR_FAST_NO_INIT
    MSR_Generic (MemMapAllocation)
      8 x MemMapGenericMapping:
        MSR_CODE: MemMapAddressingModeSetRef=VTTMemMap/MSR_CODE, MemMapSwAddressMethodRef=CODE, MemMapSwAddressMethodRef=CALLOUT_CODE, MemMapSwAddressMethodRef=CODE_FAST, MemMapSwAddressMethodRef=CODE_ISR
        MSR_PBCFG_CONST: MemMapAddressingModeSetRef=VTTMemMap/MSR_PBCFG_CONST, MemMapSwAddressMethodRef=CONST_PBCFG, MemMapSwAddressMethodRef=PBCFG_GLOBALROOT
        MSR_VAR_INIT: MemMapAddressingModeSetRef=VTTMemMap/MSR_VAR_INIT, MemMapSwAddressMethodRef=VAR_FAST_INIT_8, MemMapSwAddressMethodRef=VAR_FAST_INIT_16, MemMapSwAddressMethodRef=VAR_FAST_INIT_32, MemMapSwAddressMethodRef=VAR_FAST_INIT_64, MemMapSwAddressMethodRef=VAR_FAST_INIT_UNSPECIFIED, MemMapSwAddressMethodRef=VAR_INIT_8, MemMapSwAddressMethodRef=VAR_INIT_16, MemMapSwAddressMethodRef=VAR_INIT_32, MemMapSwAddressMethodRef=VAR_INIT_64, MemMapSwAddressMethodRef=VAR_INIT_BOOLEAN, MemMapSwAddressMethodRef=VAR_INIT_UNSPECIFIED, MemMapSwAddressMethodRef=VAR_FAST_INIT_BOOLEAN, MemMapSwAddressMethodRef=VAR_NOCACHE_INIT_8, MemMapSwAddressMethodRef=VAR_NOCACHE_INIT_16, MemMapSwAddressMethodRef=VAR_NOCACHE_INIT_32, MemMapSwAddressMethodRef=VAR_NOCACHE_INIT_64, MemMapSwAddressMethodRef=VAR_NOCACHE_INIT_BOOLEAN, MemMapSwAddressMethodRef=VAR_NOCACHE_INIT_UNSPECIFIED, MemMapSwAddressMethodRef=VAR_INIT, MemMapSwAddressMethodRef=VAR_FAST_INIT, MemMapSwAddressMethodRef=VAR_NOCACHE_INIT
        MSR_VAR_SAVED_ZONE: MemMapAddressingModeSetRef=VTTMemMap/MSR_VAR_SAVED_ZONE, MemMapSwAddressMethodRef=VAR_SAVED_ZONE_BOOLEAN, MemMapSwAddressMethodRef=VAR_SAVED_ZONE_8, MemMapSwAddressMethodRef=VAR_SAVED_ZONE_16, MemMapSwAddressMethodRef=VAR_SAVED_ZONE_32, MemMapSwAddressMethodRef=VAR_SAVED_ZONE_64, MemMapSwAddressMethodRef=VAR_SAVED_ZONE_UNSPECIFIED, MemMapSwAddressMethodRef=VAR_SAVED_ZONE
        MSR_CONST: MemMapAddressingModeSetRef=VTTMemMap/MSR_CONST, MemMapSwAddressMethodRef=CONST_8, MemMapSwAddressMethodRef=CONST_16, MemMapSwAddressMethodRef=CONST_32, MemMapSwAddressMethodRef=CONST_64, MemMapSwAddressMethodRef=CONST_BOOLEAN, MemMapSwAddressMethodRef=CONST_FAST_8, MemMapSwAddressMethodRef=CONST_FAST_16, MemMapSwAddressMethodRef=CONST_FAST_32, MemMapSwAddressMethodRef=CONST_FAST_64, MemMapSwAddressMethodRef=CONST_FAST_BOOLEAN, MemMapSwAddressMethodRef=CONST_FAST_UNSPECIFIED, MemMapSwAddressMethodRef=CONST_UNSPECIFIED, MemMapSwAddressMethodRef=CONFIG_DATA, MemMapSwAddressMethodRef=CONST, MemMapSwAddressMethodRef=CONST_FAST
        MSR_PBCFG_VAR: MemMapAddressingModeSetRef=VTTMemMap/MSR_PBCFG_VAR, MemMapSwAddressMethodRef=VAR_PBCFG
        MSR_VAR_CLEARED: MemMapAddressingModeSetRef=VTTMemMap/MSR_VAR_CLEARED, MemMapSwAddressMethodRef=VAR_ZERO_INIT_8, MemMapSwAddressMethodRef=VAR_ZERO_INIT_16, MemMapSwAddressMethodRef=VAR_ZERO_INIT_32, MemMapSwAddressMethodRef=VAR_ZERO_INIT_64, MemMapSwAddressMethodRef=VAR_ZERO_INIT_UNSPECIFIED, MemMapSwAddressMethodRef=VAR_ZERO_INIT_BOOLEAN, MemMapSwAddressMethodRef=VAR_FAST_ZERO_INIT_8, MemMapSwAddressMethodRef=VAR_FAST_ZERO_INIT_16, MemMapSwAddressMethodRef=VAR_FAST_ZERO_INIT_32, MemMapSwAddressMethodRef=VAR_FAST_ZERO_INIT_64, MemMapSwAddressMethodRef=VAR_FAST_ZERO_INIT_BOOLEAN, MemMapSwAddressMethodRef=VAR_FAST_ZERO_INIT_UNSPECIFIED, MemMapSwAddressMethodRef=VAR_NOCACHE_ZERO_INIT_8, MemMapSwAddressMethodRef=VAR_NOCACHE_ZERO_INIT_16, MemMapSwAddressMethodRef=VAR_NOCACHE_ZERO_INIT_32, MemMapSwAddressMethodRef=VAR_NOCACHE_ZERO_INIT_64, MemMapSwAddressMethodRef=VAR_NOCACHE_ZERO_INIT_BOOLEAN, MemMapSwAddressMethodRef=VAR_NOCACHE_ZERO_INIT_UNSPECIFIED, MemMapSwAddressMethodRef=VAR_CLEARED_BOOLEAN, MemMapSwAddressMethodRef=VAR_CLEARED_8, MemMapSwAddressMethodRef=VAR_CLEARED_16, MemMapSwAddressMethodRef=VAR_CLEARED_32, MemMapSwAddressMethodRef=VAR_CLEARED_64, MemMapSwAddressMethodRef=VAR_CLEARED_UNSPECIFIED, MemMapSwAddressMethodRef=VAR_FAST_CLEARED_BOOLEAN, MemMapSwAddressMethodRef=VAR_FAST_CLEARED_8, MemMapSwAddressMethodRef=VAR_FAST_CLEARED_16, MemMapSwAddressMethodRef=VAR_FAST_CLEARED_32, MemMapSwAddressMethodRef=VAR_FAST_CLEARED_64, MemMapSwAddressMethodRef=VAR_FAST_CLEARED_UNSPECIFIED, MemMapSwAddressMethodRef=VAR_NOCACHE_CLEARED_BOOLEAN, MemMapSwAddressMethodRef=VAR_NOCACHE_CLEARED_8, MemMapSwAddressMethodRef=VAR_NOCACHE_CLEARED_16, MemMapSwAddressMethodRef=VAR_NOCACHE_CLEARED_32, MemMapSwAddressMethodRef=VAR_NOCACHE_CLEARED_64, MemMapSwAddressMethodRef=VAR_NOCACHE_CLEARED_UNSPECIFIED, MemMapSwAddressMethodRef=VAR_CLEARED, MemMapSwAddressMethodRef=VAR_FAST_CLEARED, MemMapSwAddressMethodRef=VAR_NOCACHE_CLEARED, MemMapSwAddressMethodRef=VAR_ZERO_INIT
        MSR_VAR_NO_INIT: MemMapAddressingModeSetRef=VTTMemMap/MSR_VAR_NO_INIT, MemMapSwAddressMethodRef=VAR_FAST_NO_INIT_8, MemMapSwAddressMethodRef=VAR_FAST_NO_INIT_16, MemMapSwAddressMethodRef=VAR_FAST_NO_INIT_32, MemMapSwAddressMethodRef=VAR_FAST_NO_INIT_64, MemMapSwAddressMethodRef=VAR_FAST_NO_INIT_UNSPECIFIED, MemMapSwAddressMethodRef=VAR_NO_INIT_8, MemMapSwAddressMethodRef=VAR_NO_INIT_16, MemMapSwAddressMethodRef=VAR_NO_INIT_32, MemMapSwAddressMethodRef=VAR_NO_INIT_64, MemMapSwAddressMethodRef=VAR_NO_INIT_UNSPECIFIED, MemMapSwAddressMethodRef=VAR_NO_INIT_BOOLEAN, MemMapSwAddressMethodRef=VAR_FAST_NO_INIT_BOOLEAN, MemMapSwAddressMethodRef=VAR_NOCACHE_NO_INIT_8, MemMapSwAddressMethodRef=VAR_NOCACHE_NO_INIT_16, MemMapSwAddressMethodRef=VAR_NOCACHE_NO_INIT_32, MemMapSwAddressMethodRef=VAR_NOCACHE_NO_INIT_64, MemMapSwAddressMethodRef=VAR_NOCACHE_NO_INIT_BOOLEAN, MemMapSwAddressMethodRef=VAR_NOCACHE_NO_INIT_UNSPECIFIED, MemMapSwAddressMethodRef=VAR_FAST_NOINIT_8, MemMapSwAddressMethodRef=VAR_FAST_NOINIT_16, MemMapSwAddressMethodRef=VAR_FAST_NOINIT_32, MemMapSwAddressMethodRef=VAR_FAST_NOINIT_64, MemMapSwAddressMethodRef=VAR_FAST_NOINIT_UNSPECIFIED, MemMapSwAddressMethodRef=VAR_NOINIT_8, MemMapSwAddressMethodRef=VAR_NOINIT_16, MemMapSwAddressMethodRef=VAR_NOINIT_32, MemMapSwAddressMethodRef=VAR_NOINIT_64, MemMapSwAddressMethodRef=VAR_NOINIT_UNSPECIFIED, MemMapSwAddressMethodRef=VAR_NOINIT_BOOLEAN, MemMapSwAddressMethodRef=VAR_FAST_NOINIT_BOOLEAN, MemMapSwAddressMethodRef=VAR_NOCACHE_NOINIT_8, MemMapSwAddressMethodRef=VAR_NOCACHE_NOINIT_16, MemMapSwAddressMethodRef=VAR_NOCACHE_NOINIT_32, MemMapSwAddressMethodRef=VAR_NOCACHE_NOINIT_64, MemMapSwAddressMethodRef=VAR_NOCACHE_NOINIT_BOOLEAN, MemMapSwAddressMethodRef=VAR_NOCACHE_NOINIT_UNSPECIFIED, MemMapSwAddressMethodRef=VAR_NO_INIT, MemMapSwAddressMethodRef=VAR_FAST_NO_INIT, MemMapSwAddressMethodRef=VAR_NOCACHE_NO_INIT
    8 x MemMapAddressingModeSet, all with MemMapCompilerMemClassSymbolImpl=:
      OS_GLOBALSHARED_VAR_NOINIT
        OS_GLOBALSHARED_VAR_NOINIT (MemMapAddressingMode):
          MemMapAlignmentSelector = BOOLEAN
          MemMapAlignmentSelector = 8
          MemMapAlignmentSelector = 16
          MemMapAlignmentSelector = 32
          MemMapAlignmentSelector = 64
          MemMapAlignmentSelector = UNSPECIFIED
      OS_GLOBALSHARED_VAR_INIT
        OS_GLOBALSHARED_VAR_INIT (MemMapAddressingMode):
          MemMapAlignmentSelector = BOOLEAN
          MemMapAlignmentSelector = 8
          MemMapAlignmentSelector = 16
          MemMapAlignmentSelector = 32
          MemMapAlignmentSelector = 64
          MemMapAlignmentSelector = UNSPECIFIED
      OS_GLOBALSHARED_VAR_SAVED_ZONE
        OS_GLOBALSHARED_VAR_SAVED_ZONE (MemMapAddressingMode):
          MemMapAlignmentSelector = BOOLEAN
          MemMapAlignmentSelector = 8
          MemMapAlignmentSelector = 16
          MemMapAlignmentSelector = 32
          MemMapAlignmentSelector = 64
          MemMapAlignmentSelector = UNSPECIFIED
      OS_GLOBALSHARED_VAR_ZERO_INIT
        OS_GLOBALSHARED_VAR_ZERO_INIT (MemMapAddressingMode):
          MemMapAlignmentSelector = BOOLEAN
          MemMapAlignmentSelector = 8
          MemMapAlignmentSelector = 16
          MemMapAlignmentSelector = 32
          MemMapAlignmentSelector = 64
          MemMapAlignmentSelector = UNSPECIFIED
      OS_SystemApplication_OsCore0_VAR_ZERO_INIT
        OS_SystemApplication_OsCore0_VAR_ZERO_INIT (MemMapAddressingMode):
          MemMapAlignmentSelector = BOOLEAN
          MemMapAlignmentSelector = 8
          MemMapAlignmentSelector = 16
          MemMapAlignmentSelector = 32
          MemMapAlignmentSelector = 64
          MemMapAlignmentSelector = UNSPECIFIED
      OS_SystemApplication_OsCore0_VAR_SAVED_ZONE
        OS_SystemApplication_OsCore0_VAR_SAVED_ZONE (MemMapAddressingMode):
          MemMapAlignmentSelector = BOOLEAN
          MemMapAlignmentSelector = 8
          MemMapAlignmentSelector = 16
          MemMapAlignmentSelector = 32
          MemMapAlignmentSelector = 64
          MemMapAlignmentSelector = UNSPECIFIED
      OS_SystemApplication_OsCore0_VAR_INIT
        OS_SystemApplication_OsCore0_VAR_INIT (MemMapAddressingMode):
          MemMapAlignmentSelector = BOOLEAN
          MemMapAlignmentSelector = 8
          MemMapAlignmentSelector = 16
          MemMapAlignmentSelector = 32
          MemMapAlignmentSelector = 64
          MemMapAlignmentSelector = UNSPECIFIED
      OS_SystemApplication_OsCore0_VAR_NOINIT
        OS_SystemApplication_OsCore0_VAR_NOINIT (MemMapAddressingMode):
          MemMapAlignmentSelector = BOOLEAN
          MemMapAlignmentSelector = 8
          MemMapAlignmentSelector = 16
          MemMapAlignmentSelector = 32
          MemMapAlignmentSelector = 64
          MemMapAlignmentSelector = UNSPECIFIED
    OS_Generic (MemMapAllocation)
      10 x MemMapGenericMapping:
        OS_SystemApplication_OsCore0_VAR_SAVED_ZONE: MemMapAddressingModeSetRef=VTTMemMap/OS_SystemApplication_OsCore0_VAR_SAVED_ZONE, MemMapSwAddressMethodRef=SystemApplication_OsCore0_VAR_SAVED_ZONE
        OS_GLOBALSHARED_VAR_SAVED_ZONE: MemMapAddressingModeSetRef=VTTMemMap/OS_GLOBALSHARED_VAR_SAVED_ZONE, MemMapSwAddressMethodRef=GLOBALSHARED_VAR_SAVED_ZONE
        OS_GLOBALSHARED_VAR_NOINIT: MemMapAddressingModeSetRef=VTTMemMap/OS_GLOBALSHARED_VAR_NOINIT, MemMapSwAddressMethodRef=GLOBALSHARED_VAR_NO_INIT, MemMapSwAddressMethodRef=GLOBALSHARED_VAR_FAST_NO_INIT, MemMapSwAddressMethodRef=GLOBALSHARED_VAR_NOCACHE_NO_INIT
        OS_GLOBALSHARED_VAR_ZERO_INIT: MemMapAddressingModeSetRef=VTTMemMap/OS_GLOBALSHARED_VAR_ZERO_INIT, MemMapSwAddressMethodRef=GLOBALSHARED_VAR_CLEARED, MemMapSwAddressMethodRef=GLOBALSHARED_VAR_FAST_CLEARED, MemMapSwAddressMethodRef=GLOBALSHARED_VAR_NOCACHE_CLEARED
        OS_GLOBALSHARED_CONST: MemMapAddressingModeSetRef=VTTMemMap/MSR_CONST, MemMapSwAddressMethodRef=GLOBALSHARED_CONST, MemMapSwAddressMethodRef=GLOBALSHARED_CONST_FAST
        OS_SystemApplication_OsCore0_CONST: MemMapAddressingModeSetRef=VTTMemMap/MSR_CONST, MemMapSwAddressMethodRef=SystemApplication_OsCore0_CONST, MemMapSwAddressMethodRef=SystemApplication_OsCore0_CONST_FAST
        OS_SystemApplication_OsCore0_VAR_NOINIT: MemMapAddressingModeSetRef=VTTMemMap/OS_SystemApplication_OsCore0_VAR_NOINIT, MemMapSwAddressMethodRef=SystemApplication_OsCore0_VAR_NO_INIT, MemMapSwAddressMethodRef=SystemApplication_OsCore0_VAR_FAST_NO_INIT, MemMapSwAddressMethodRef=SystemApplication_OsCore0_VAR_NOCACHE_NO_INIT
        OS_SystemApplication_OsCore0_VAR_ZERO_INIT: MemMapAddressingModeSetRef=VTTMemMap/OS_SystemApplication_OsCore0_VAR_ZERO_INIT, MemMapSwAddressMethodRef=SystemApplication_OsCore0_VAR_CLEARED, MemMapSwAddressMethodRef=SystemApplication_OsCore0_VAR_FAST_CLEARED, MemMapSwAddressMethodRef=SystemApplication_OsCore0_VAR_NOCACHE_CLEARED
        OS_GLOBALSHARED_VAR_INIT: MemMapAddressingModeSetRef=VTTMemMap/OS_GLOBALSHARED_VAR_INIT, MemMapSwAddressMethodRef=GLOBALSHARED_VAR_INIT, MemMapSwAddressMethodRef=GLOBALSHARED_VAR_FAST_INIT, MemMapSwAddressMethodRef=GLOBALSHARED_VAR_NOCACHE_INIT
        OS_SystemApplication_OsCore0_VAR_INIT: MemMapAddressingModeSetRef=VTTMemMap/OS_SystemApplication_OsCore0_VAR_INIT, MemMapSwAddressMethodRef=SystemApplication_OsCore0_VAR_INIT, MemMapSwAddressMethodRef=SystemApplication_OsCore0_VAR_FAST_INIT, MemMapSwAddressMethodRef=SystemApplication_OsCore0_VAR_NOCACHE_INIT
