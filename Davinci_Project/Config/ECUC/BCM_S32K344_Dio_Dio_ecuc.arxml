AUTOSAR XML (schema 00050)
package /ActiveEcuC
  module config Dio: implementation-config-variant=VARIANT-PRE-COMPILE, module-description=Dio_Impl
    DioConfig
      DioPortAH (DioPort): DioPortId=1
        3 x DioChannel, all with PDACSlot=VIRTUAL_WRAPPER_PDAC0:
          DioChannelPTA29_LED1_RED: DioChannelId=13
          DioChannelPTA30_LED2_GREEN: DioChannelId=14
          DioChannelPTA31_LED3_BLUE: DioChannelId=15
      DioPortBH (DioPort): DioPortId=3
    DioGeneral:
      DioDevErrorDetect = false
      SIUL2DioIPDevErrorDetect = false
      DioVersionInfoApi = false
      DioReversePortBits = false
      DioFlipChannelApi = true
      DioReadZeroForUndefinedPortPins = false
      DioMaskedWritePortApi = false
      DioEnableUserModeSupport = false
      DioVirtWrapperSupport = false
      DioMulticoreSupport = false
    CommonPublishedInformation:
      ArReleaseMajorVersion = 4
      ArReleaseMinorVersion = 4
      ArReleaseRevisionVersion = 0
      ModuleId = 120
      SwMajorVersion = 2
      SwMinorVersion = 0
      SwPatchVersion = 1
      VendorId = 43
