AUTOSAR XML (schema 00050)
package /ActiveEcuC
  module config vLinkGen: implementation-config-variant=VARIANT-PRE-COMPILE, module-description=vLinkGen_Impl
    vLinkGenMemLayout
      vLinkGenLinkerSections
        MSR_CODE (vLinkGenLinkerCodeSection): vLinkGenLinkerCodeSectionName=MSR_CODE, vLinkGenLinkerCodeSectionFast=false
        MSR_CONST (vLinkGenLinkerConstSection): vLinkGenLinkerConstSectionName=MSR_CONST, vLinkGenLinkerConstSectionFast=false
        MSR_PBCFG_CONST (vLinkGenLinkerConstSection): vLinkGenLinkerConstSectionName=MSR_PBCFG_CONST, vLinkGenLinkerConstSectionFast=false
        4 x vLinkGenLinkerVarSection, all with vLinkGenLinkerVarSectionFast=false:
          MSR_PBCFG_VAR: vLinkGenLinkerVarSectionName=MSR_PBCFG_VAR
          MSR_VAR_CLEARED: vLinkGenLinkerVarSectionName=MSR_VAR_CLEARED
          MSR_VAR_INIT: vLinkGenLinkerVarSectionName=MSR_VAR_INIT
          MSR_VAR_NO_INIT: vLinkGenLinkerVarSectionName=MSR_VAR_NO_INIT
        MSR_CONST_FAST (vLinkGenLinkerConstSection): vLinkGenLinkerConstSectionFast=true, vLinkGenLinkerConstSectionName=MSR_CONST_FAST
        3 x vLinkGenLinkerVarSection, all with vLinkGenLinkerVarSectionFast=true:
          MSR_VAR_FAST_CLEARED: vLinkGenLinkerVarSectionName=MSR_VAR_FAST_CLEARED
          MSR_VAR_FAST_INIT: vLinkGenLinkerVarSectionName=MSR_VAR_FAST_INIT
          MSR_VAR_FAST_NO_INIT: vLinkGenLinkerVarSectionName=MSR_VAR_FAST_NO_INIT
        MSR_PBCFG_CONST_FAST (vLinkGenLinkerConstSection): vLinkGenLinkerConstSectionFast=true, vLinkGenLinkerConstSectionName=MSR_PBCFG_CONST_FAST
        9 x vLinkGenLinkerVarSection:
          MSR_PBCFG_VAR_FAST: vLinkGenLinkerVarSectionFast=true, vLinkGenLinkerVarSectionName=MSR_PBCFG_VAR_FAST
          MSR_PBCFG_VAR_FAST_NO_INIT: vLinkGenLinkerVarSectionFast=true, vLinkGenLinkerVarSectionName=MSR_PBCFG_VAR_FAST_NO_INIT
          MSR_PBCFG_VAR_NO_INIT: vLinkGenLinkerVarSectionName=MSR_PBCFG_VAR_NO_INIT, vLinkGenLinkerVarSectionFast=false
          MSR_VAR_SAVED_ZONE_INIT: vLinkGenLinkerVarSectionName=MSR_VAR_SAVED_ZONE_INIT, vLinkGenLinkerVarSectionFast=false
          MSR_VAR_SAVED_ZONE_NO_INIT: vLinkGenLinkerVarSectionName=MSR_VAR_SAVED_ZONE_NO_INIT, vLinkGenLinkerVarSectionFast=false
          MSR_VAR_SAVED_ZONE_FAST_INIT: vLinkGenLinkerVarSectionFast=true, vLinkGenLinkerVarSectionName=MSR_VAR_SAVED_ZONE_FAST_INIT
          MSR_VAR_SAVED_ZONE_FAST_NO_INIT: vLinkGenLinkerVarSectionFast=true, vLinkGenLinkerVarSectionName=MSR_VAR_SAVED_ZONE_FAST_NO_INIT
          MSR_PBCFG_VAR_CLEARED: vLinkGenLinkerVarSectionName=MSR_PBCFG_VAR_CLEARED, vLinkGenLinkerVarSectionFast=false
          MSR_PBCFG_VAR_FAST_CLEARED: vLinkGenLinkerVarSectionName=MSR_PBCFG_VAR_FAST_CLEARED, vLinkGenLinkerVarSectionFast=true
        IVTField (vLinkGenLinkerConstSection): vLinkGenLinkerConstSectionName=IVTField, vLinkGenLinkerConstSectionFast=false
        5 x vLinkGenLinkerCodeSection, all with vLinkGenLinkerCodeSectionFast=false:
          brsExcVect: vLinkGenLinkerCodeSectionName=brsExcVect
          brsStartup: vLinkGenLinkerCodeSectionName=brsStartup
          brsMainStartup: vLinkGenLinkerCodeSectionName=brsMainStartup
          brsSharedConst: vLinkGenLinkerCodeSectionName=brsSharedConst
          brsApplicationEntry: vLinkGenLinkerCodeSectionName=brsApplicationEntry
        brsExcVectConst (vLinkGenLinkerConstSection): vLinkGenLinkerConstSectionName=brsExcVectConst, vLinkGenLinkerConstSectionFast=false
        brsSharedVar (vLinkGenLinkerVarSection): vLinkGenLinkerVarSectionName=brsSharedVar, vLinkGenLinkerVarSectionFast=false
        text (vLinkGenLinkerCodeSection): vLinkGenLinkerCodeSectionName=text, vLinkGenLinkerCodeSectionFast=false
        text_vle (vLinkGenLinkerCodeSection): vLinkGenLinkerCodeSectionName=vletext, vLinkGenLinkerCodeSectionFast=false
        6 x vLinkGenLinkerSpecSection, all with vLinkGenLinkerSpecSectionPad=0:
          secinfo: vLinkGenLinkerSpecSectionValue=.secinfo
          syscall: vLinkGenLinkerSpecSectionValue=.syscall
          fixaddr: vLinkGenLinkerSpecSectionValue=.fixaddr
          fixtype: vLinkGenLinkerSpecSectionValue=.fixtype
          picbase: vLinkGenLinkerSpecSectionValue=.picbase
          pidbase: vLinkGenLinkerSpecSectionValue=.pidbase
        6 x vLinkGenLinkerConstSection:
          rodata: vLinkGenLinkerConstSectionName=rodata, vLinkGenLinkerConstSectionFast=false
          rosdata: vLinkGenLinkerConstSectionName=rosdata, vLinkGenLinkerConstSectionFast=true
          ldata: vLinkGenLinkerConstSectionName=ldata, vLinkGenLinkerConstSectionFast=true
          sdata2: vLinkGenLinkerConstSectionName=sdata2, vLinkGenLinkerConstSectionFast=true
          rozdata: vLinkGenLinkerConstSectionName=rozdata, vLinkGenLinkerConstSectionFast=true
          zrodata: vLinkGenLinkerConstSectionName=zrodata, vLinkGenLinkerConstSectionFast=true
        data (vLinkGenLinkerVarSection): vLinkGenLinkerVarSectionName=data, vLinkGenLinkerVarSectionFast=false
        sdabase (vLinkGenLinkerSpecSection): vLinkGenLinkerSpecSectionValue=.sdabase, vLinkGenLinkerSpecSectionPad=0
        sdata (vLinkGenLinkerVarSection): vLinkGenLinkerVarSectionName=sdata, vLinkGenLinkerVarSectionFast=true
        tdata (vLinkGenLinkerSpecSection): vLinkGenLinkerSpecSectionValue=.tdata, vLinkGenLinkerSpecSectionPad=0
        zdata (vLinkGenLinkerVarSection): vLinkGenLinkerVarSectionName=zdata, vLinkGenLinkerVarSectionFast=true
        PPC_EMB_SDATA0 (vLinkGenLinkerSpecSection): vLinkGenLinkerSpecSectionValue=.PPC.EMB.sdata0, vLinkGenLinkerSpecSectionPad=0
        bss (vLinkGenLinkerVarSection): vLinkGenLinkerVarSectionName=bss, vLinkGenLinkerVarSectionFast=false
        COMMON (vLinkGenLinkerSpecSection): vLinkGenLinkerSpecSectionValue=COMMON, vLinkGenLinkerSpecSectionPad=0
        sbss (vLinkGenLinkerVarSection): vLinkGenLinkerVarSectionName=sbss, vLinkGenLinkerVarSectionFast=true
        SMALLCOMMON (vLinkGenLinkerSpecSection): vLinkGenLinkerSpecSectionValue=SMALLCOMMON, vLinkGenLinkerSpecSectionPad=0
        zbss (vLinkGenLinkerVarSection): vLinkGenLinkerVarSectionName=zbss, vLinkGenLinkerVarSectionFast=true
        PPC_EMB_SBSS0 (vLinkGenLinkerSpecSection): vLinkGenLinkerSpecSectionValue=.PPC.EMB.sbss0, vLinkGenLinkerSpecSectionPad=0
        ZEROCOMMON (vLinkGenLinkerSpecSection): vLinkGenLinkerSpecSectionValue=ZEROCOMMON, vLinkGenLinkerSpecSectionPad=0
        stack (vLinkGenLinkerVarSection): vLinkGenLinkerVarSectionName=stack, vLinkGenLinkerVarSectionFast=false
        4 x vLinkGenLinkerCodeSection, all with vLinkGenLinkerCodeSectionFast=false, vLinkGenLinkerCodeSectionModule=Os:
          OS_CODE: vLinkGenLinkerCodeSectionName=OS_CODE
          OS_OS_COREINITHOOK_CODE: vLinkGenLinkerCodeSectionName=OS_OS_COREINITHOOK_CODE
          OS_INTVEC_CODE: vLinkGenLinkerCodeSectionName=OS_INTVEC_CODE, vLinkGenLinkerCodeSectionAlignment=1024
          OS_ERRORHOOK_CODE: vLinkGenLinkerCodeSectionName=OS_ERRORHOOK_CODE
        3 x vLinkGenLinkerConstSection, all with vLinkGenLinkerConstSectionFast=false, vLinkGenLinkerConstSectionModule=Os:
          OS_CONST: vLinkGenLinkerConstSectionName=OS_CONST
          OS_INTVEC_CONST: vLinkGenLinkerConstSectionName=OS_INTVEC_CONST
          OS_GLOBALSHARED_CONST: vLinkGenLinkerConstSectionName=OS_GLOBALSHARED_CONST
        10 x vLinkGenLinkerVarSection, all with vLinkGenLinkerVarSectionFast=false, vLinkGenLinkerVarSectionModule=Os:
          OS_VAR_NOCACHE: vLinkGenLinkerVarSectionName=OS_VAR_NOCACHE
          OS_VAR_NOCACHE_NOINIT: vLinkGenLinkerVarSectionName=OS_VAR_NOCACHE_NOINIT
          OS_GLOBALSHARED_VAR_NOINIT: vLinkGenLinkerVarSectionName=OS_GLOBALSHARED_VAR_NOINIT
          OS_GLOBALSHARED_VAR: vLinkGenLinkerVarSectionName=OS_GLOBALSHARED_VAR
          OS_GLOBALSHARED_VAR_ZERO_INIT: vLinkGenLinkerVarSectionName=OS_GLOBALSHARED_VAR_ZERO_INIT
          OS_GLOBALSHARED_VAR_NOCACHE_NOINIT: vLinkGenLinkerVarSectionName=OS_GLOBALSHARED_VAR_NOCACHE_NOINIT
          OS_GLOBALSHARED_VAR_NOCACHE: vLinkGenLinkerVarSectionName=OS_GLOBALSHARED_VAR_NOCACHE
          OS_GLOBALSHARED_VAR_NOCACHE_ZERO_INIT: vLinkGenLinkerVarSectionName=OS_GLOBALSHARED_VAR_NOCACHE_ZERO_INIT
          OS_GLOBALSHARED_VAR_SAVED_ZONE: vLinkGenLinkerVarSectionName=OS_GLOBALSHARED_VAR_SAVED_ZONE
          OS_GLOBALSHARED_VAR_SAVED_ZONE_NOINIT: vLinkGenLinkerVarSectionName=OS_GLOBALSHARED_VAR_SAVED_ZONE_NOINIT
        OS_SystemApplication_OsCore0_CONST (vLinkGenLinkerConstSection): vLinkGenLinkerConstSectionName=OS_SystemApplication_OsCore0_CONST, vLinkGenLinkerConstSectionFast=false, vLinkGenLinkerConstSectionModule=Os
        OS_EXCVEC_CORE0_CODE (vLinkGenLinkerCodeSection):
          vLinkGenLinkerCodeSectionName = OS_EXCVEC_CORE0_CODE
          vLinkGenLinkerCodeSectionFast = false
          vLinkGenLinkerCodeSectionAlignment = 0
          vLinkGenLinkerCodeSectionModule = Os
        OS_INTVEC_CORE0_CODE (vLinkGenLinkerCodeSection):
          vLinkGenLinkerCodeSectionName = OS_INTVEC_CORE0_CODE
          vLinkGenLinkerCodeSectionFast = false
          vLinkGenLinkerCodeSectionAlignment = 1024
          vLinkGenLinkerCodeSectionModule = Os
        3 x vLinkGenLinkerConstSection, all with vLinkGenLinkerConstSectionFast=false, vLinkGenLinkerConstSectionModule=Os:
          OS_CORE0_CONST: vLinkGenLinkerConstSectionName=OS_CORE0_CONST
          OS_EXCVEC_CORE0_CONST: vLinkGenLinkerConstSectionName=OS_EXCVEC_CORE0_CONST, vLinkGenLinkerConstSectionAlignment=0
          OS_INTVEC_CORE0_CONST: vLinkGenLinkerConstSectionName=OS_INTVEC_CORE0_CONST, vLinkGenLinkerConstSectionAlignment=1024
        5 x vLinkGenLinkerStackSection, all with vLinkGenLinkerStackSectionModule=Os:
          OS_STACK_OSCORE0_KERNEL_VAR_NOINIT: vLinkGenLinkerStackSectionName=OS_STACK_OSCORE0_KERNEL_VAR_NOINIT
          OS_STACK_OSCORE0_INIT_VAR_NOINIT: vLinkGenLinkerStackSectionName=OS_STACK_OSCORE0_INIT_VAR_NOINIT
          OS_STACK_OSCORE0_ERROR_VAR_NOINIT: vLinkGenLinkerStackSectionName=OS_STACK_OSCORE0_ERROR_VAR_NOINIT
          OS_STACK_OSCORE0_ISR_CORE_VAR_NOINIT: vLinkGenLinkerStackSectionName=OS_STACK_OSCORE0_ISR_CORE_VAR_NOINIT
          OS_STACK_OSCORE0_TASK_PRIO4294967295_VAR_NOINIT: vLinkGenLinkerStackSectionName=OS_STACK_OSCORE0_TASK_PRIO4294967295_VAR_NOINIT
        15 x vLinkGenLinkerVarSection, all with vLinkGenLinkerVarSectionFast=false, vLinkGenLinkerVarSectionModule=Os:
          OS_CORESTATUS_CORE0_VAR_NOCACHE_NOINIT: vLinkGenLinkerVarSectionName=OS_CORESTATUS_CORE0_VAR_NOCACHE_NOINIT
          OS_CORE0_VAR: vLinkGenLinkerVarSectionName=OS_CORE0_VAR
          OS_CORE0_VAR_NOCACHE: vLinkGenLinkerVarSectionName=OS_CORE0_VAR_NOCACHE
          OS_CORE0_VAR_NOINIT: vLinkGenLinkerVarSectionName=OS_CORE0_VAR_NOINIT
          OS_CORE0_VAR_NOCACHE_NOINIT: vLinkGenLinkerVarSectionName=OS_CORE0_VAR_NOCACHE_NOINIT
          OS_PUBLIC_CORE0_VAR_NOINIT: vLinkGenLinkerVarSectionName=OS_PUBLIC_CORE0_VAR_NOINIT
          OS_BARRIER_CORE0_VAR_NOCACHE_NOINIT: vLinkGenLinkerVarSectionName=OS_BARRIER_CORE0_VAR_NOCACHE_NOINIT
          OS_SystemApplication_OsCore0_VAR_NOINIT: vLinkGenLinkerVarSectionName=OS_SystemApplication_OsCore0_VAR_NOINIT
          OS_SystemApplication_OsCore0_VAR: vLinkGenLinkerVarSectionName=OS_SystemApplication_OsCore0_VAR
          OS_SystemApplication_OsCore0_VAR_ZERO_INIT: vLinkGenLinkerVarSectionName=OS_SystemApplication_OsCore0_VAR_ZERO_INIT
          OS_SystemApplication_OsCore0_VAR_NOCACHE_NOINIT: vLinkGenLinkerVarSectionName=OS_SystemApplication_OsCore0_VAR_NOCACHE_NOINIT
          OS_SystemApplication_OsCore0_VAR_NOCACHE: vLinkGenLinkerVarSectionName=OS_SystemApplication_OsCore0_VAR_NOCACHE
          OS_SystemApplication_OsCore0_VAR_NOCACHE_ZERO_INIT: vLinkGenLinkerVarSectionName=OS_SystemApplication_OsCore0_VAR_NOCACHE_ZERO_INIT
          OS_SystemApplication_OsCore0_VAR_SAVED_ZONE: vLinkGenLinkerVarSectionName=OS_SystemApplication_OsCore0_VAR_SAVED_ZONE
          OS_SystemApplication_OsCore0_VAR_SAVED_ZONE_NOINIT: vLinkGenLinkerVarSectionName=OS_SystemApplication_OsCore0_VAR_SAVED_ZONE_NOINIT
        3 x vLinkGenLinkerCodeSection, all with vLinkGenLinkerCodeSectionFast=false, vLinkGenLinkerCodeSectionModule=Os:
          OS_AppRunTask_CODE: vLinkGenLinkerCodeSectionName=OS_AppRunTask_CODE
          OS_Default_Init_Task_CODE: vLinkGenLinkerCodeSectionName=OS_Default_Init_Task_CODE
          OS_Default_Init_Task_Trusted_CODE: vLinkGenLinkerCodeSectionName=OS_Default_Init_Task_Trusted_CODE
        OS_STACK_OSCORE0_TASK_PRIO49_VAR_NOINIT (vLinkGenLinkerStackSection): vLinkGenLinkerStackSectionName=OS_STACK_OSCORE0_TASK_PRIO49_VAR_NOINIT, vLinkGenLinkerStackSectionModule=Os
        OS_STACK_OSCORE0_TASK_PRIO50_VAR_NOINIT (vLinkGenLinkerStackSection): vLinkGenLinkerStackSectionName=OS_STACK_OSCORE0_TASK_PRIO50_VAR_NOINIT, vLinkGenLinkerStackSectionModule=Os
        OS_SwcInitTask_CODE (vLinkGenLinkerCodeSection): vLinkGenLinkerCodeSectionName=OS_SwcInitTask_CODE, vLinkGenLinkerCodeSectionFast=false, vLinkGenLinkerCodeSectionModule=Os
        OS_STACK_OSCORE0_TASK_PRIO30_VAR_NOINIT (vLinkGenLinkerStackSection): vLinkGenLinkerStackSectionName=OS_STACK_OSCORE0_TASK_PRIO30_VAR_NOINIT, vLinkGenLinkerStackSectionModule=Os
        OS_STACK_APPRUNTASK_VAR_NOINIT (vLinkGenLinkerStackSection): vLinkGenLinkerStackSectionName=OS_STACK_APPRUNTASK_VAR_NOINIT, vLinkGenLinkerStackSectionModule=Os
      3 x vLinkGenLogicalConstGroup, all with vLinkGenConstGroupPosition=5, vLinkGenConstGroupRegion=FLASH/FLASH:
        MSR_CODE: vLinkGenConstGroupContentType=GLOBAL_CODE
          MSR_CODE (vLinkGenConstSectionGroup):
            vLinkGenConstSectionGroupPosition = 0
            vLinkGenConstSectionGroupInit = NONE
            vLinkGenConstSectionGroupInitStage = ONE
            vLinkGenConstSectionGroupRef = vLinkGenLinkerSections/MSR_CODE
        MSR_CONST: vLinkGenConstGroupContentType=GLOBAL_CONST
          MSR_CONST (vLinkGenConstSectionGroup):
            vLinkGenConstSectionGroupPosition = 0
            vLinkGenConstSectionGroupInit = NONE
            vLinkGenConstSectionGroupInitStage = ONE
            vLinkGenConstSectionGroupRef = vLinkGenLinkerSections/MSR_CONST
            vLinkGenConstSectionGroupRef = MSR_CONST_FAST
        MSR_PBCFG_CONST: vLinkGenConstGroupContentType=GLOBAL_CONST
          MSR_PBCFG_CONST (vLinkGenConstSectionGroup):
            vLinkGenConstSectionGroupPosition = 0
            vLinkGenConstSectionGroupInit = NONE
            vLinkGenConstSectionGroupInitStage = ONE
            vLinkGenConstSectionGroupRef = vLinkGenLinkerSections/MSR_PBCFG_CONST
            vLinkGenConstSectionGroupRef = MSR_PBCFG_CONST_FAST
      3 x vLinkGenLogicalVarGroup, all with vLinkGenVarGroupPosition=5, vLinkGenVarGroupInitCore=0, vLinkGenVarGroupRegion=RAM/RAM, vLinkGenVarGroupRomRegion=FLASH/FLASH:
        MSR_VAR: vLinkGenVarGroupContentType=GLOBAL_DATA
          3 x vLinkGenVarSectionGroup, all with vLinkGenVarSectionGroupPosition=0, vLinkGenVarSectionGroupInitStage=ONE:
            MSR_VAR_CLEARED: vLinkGenVarSectionGroupInit=ZERO_INIT, vLinkGenVarSectionGroupAlignment=4, vLinkGenVarSectionGroupEndAlignment=4, vLinkGenVarSectionGroupRef=vLinkGenLinkerSections/MSR_VAR_CLEARED, vLinkGenVarSectionGroupRef=MSR_VAR_FAST_CLEARED
            MSR_VAR_INIT: vLinkGenVarSectionGroupInit=INIT, vLinkGenVarSectionGroupAlignment=4, vLinkGenVarSectionGroupEndAlignment=4, vLinkGenVarSectionGroupRef=vLinkGenLinkerSections/MSR_VAR_INIT, vLinkGenVarSectionGroupRef=MSR_VAR_FAST_INIT
            MSR_VAR_NO_INIT: vLinkGenVarSectionGroupInit=NONE, vLinkGenVarSectionGroupRef=vLinkGenLinkerSections/MSR_VAR_NO_INIT, vLinkGenVarSectionGroupRef=MSR_VAR_FAST_NO_INIT
        MSR_PBCFG_VAR: vLinkGenVarGroupContentType=GLOBAL_DATA
          3 x vLinkGenVarSectionGroup, all with vLinkGenVarSectionGroupPosition=0, vLinkGenVarSectionGroupInitStage=ONE:
            MSR_PBCFG_VAR_INIT: vLinkGenVarSectionGroupInit=INIT, vLinkGenVarSectionGroupAlignment=4, vLinkGenVarSectionGroupEndAlignment=4, vLinkGenVarSectionGroupRef=vLinkGenLinkerSections/MSR_PBCFG_VAR, vLinkGenVarSectionGroupRef=MSR_PBCFG_VAR_FAST
            MSR_PBCFG_VAR_NO_INIT: vLinkGenVarSectionGroupInit=NONE, vLinkGenVarSectionGroupRef=vLinkGenLinkerSections/MSR_PBCFG_VAR_NO_INIT, vLinkGenVarSectionGroupRef=MSR_PBCFG_VAR_FAST_NO_INIT
            MSR_PBCFG_VAR_CLEARED: vLinkGenVarSectionGroupInit=ZERO_INIT, vLinkGenVarSectionGroupAlignment=4, vLinkGenVarSectionGroupEndAlignment=4, vLinkGenVarSectionGroupRef=vLinkGenLinkerSections/MSR_PBCFG_VAR_CLEARED, vLinkGenVarSectionGroupRef=MSR_PBCFG_VAR_FAST_CLEARED
        MSR_VAR_SAVED_ZONE: vLinkGenVarGroupContentType=RETENTION_DATA
          MSR_VAR_SAVED_ZONE_INIT (vLinkGenVarSectionGroup):
            vLinkGenVarSectionGroupInit = INIT
            vLinkGenVarSectionGroupPosition = 0
            vLinkGenVarSectionGroupInitStage = ONE
            vLinkGenVarSectionGroupAlignment = 4
            vLinkGenVarSectionGroupEndAlignment = 4
            vLinkGenVarSectionGroupRef = vLinkGenLinkerSections/MSR_VAR_SAVED_ZONE_INIT
            vLinkGenVarSectionGroupRef = MSR_VAR_SAVED_ZONE_FAST_INIT
          MSR_VAR_SAVED_ZONE_NO_INIT (vLinkGenVarSectionGroup):
            vLinkGenVarSectionGroupInit = NONE
            vLinkGenVarSectionGroupPosition = 0
            vLinkGenVarSectionGroupInitStage = ONE
            vLinkGenVarSectionGroupRef = vLinkGenLinkerSections/MSR_VAR_SAVED_ZONE_NO_INIT
            vLinkGenVarSectionGroupRef = MSR_VAR_SAVED_ZONE_FAST_NO_INIT
      Startup_Labels (vLinkGenLogicalSymbolGroup): vLinkGenSymbolGroupPosition=5
        Startup_Labels1 (vLinkGenLinkerSymbol): vLinkGenLinkerSymbolName=_start, vLinkGenLinkerSymbolValue=brsStartupEntry +1, vLinkGenLinkerSymbolPosition=0
      RAM (vLinkGenMemoryRegion):
        vLinkGenMemoryRegionAddrOffset = 0
        vLinkGenMemoryRegionSize = 163840
        vLinkGenMemoryRegionAddress = 541065216
        vLinkGenMemoryRegionAvailable = true
        vLinkGenMemoryRegionHwRegion = PRAM0
        3 x vLinkGenMemoryRegionBlock, all with vLinkGenMemoryRegionBlockInitCore=0, vLinkGenMemoryRegionBlockInitStage=EARLY:
          RAM: vLinkGenMemoryRegionBlockPosition=0, vLinkGenMemoryRegionBlockSize=162800, vLinkGenMemoryRegionBlockAddress=541065216, vLinkGenMemoryRegionBlockBoundary=LOWER, vLinkGenMemoryRegionBlockContentType=GLOBAL_DATA, vLinkGenMemoryRegionBlockContentType=LOCAL_DATA, vLinkGenMemoryRegionBlockContentType=RAM_CODE_COPY, vLinkGenMemoryRegionBlockContentType=RAM_CONST_COPY, vLinkGenMemoryRegionBlockContentType=RETENTION_DATA, vLinkGenMemoryRegionBlockContentType=STACKS
          Variables_Shared: vLinkGenMemoryRegionBlockSize=16, vLinkGenMemoryRegionBlockBoundary=UPPER, vLinkGenMemoryRegionBlockPosition=0, vLinkGenMemoryRegionBlockAddress=541228016, vLinkGenMemoryRegionBlockContentType=SHARED_DATA
          StartupStack_Shared: vLinkGenMemoryRegionBlockPosition=1, vLinkGenMemoryRegionBlockSize=1024, vLinkGenMemoryRegionBlockBoundary=UPPER, vLinkGenMemoryRegionBlockAddress=541228032, vLinkGenMemoryRegionBlockContentType=STARTUP_STACK
      FLASH (vLinkGenMemoryRegion):
        vLinkGenMemoryRegionAddrOffset = 0
        vLinkGenMemoryRegionSize = 4194304
        vLinkGenMemoryRegionAddress = 4194304
        vLinkGenMemoryRegionAvailable = true
        vLinkGenMemoryRegionHwRegion = Program_Flash
        5 x vLinkGenMemoryRegionBlock, all with vLinkGenMemoryRegionBlockBoundary=LOWER, vLinkGenMemoryRegionBlockInitStage=NONE:
          IVT_Block: vLinkGenMemoryRegionBlockSize=1024, vLinkGenMemoryRegionBlockPosition=0, vLinkGenMemoryRegionBlockAddress=4194304
          CoreExceptions_FirstExecInst: vLinkGenMemoryRegionBlockPosition=1, vLinkGenMemoryRegionBlockSize=960, vLinkGenMemoryRegionBlockAddress=4195328, vLinkGenMemoryRegionBlockContentType=GLOBAL_EXCVEC_CODE, vLinkGenMemoryRegionBlockContentType=GLOBAL_EXCVEC_CONST
          StartupCode_FirstExecInst: vLinkGenMemoryRegionBlockPosition=2, vLinkGenMemoryRegionBlockSize=1024, vLinkGenMemoryRegionBlockAddress=4196288, vLinkGenMemoryRegionBlockContentType=STARTUP_CODE
          ApplicationEntry: vLinkGenMemoryRegionBlockPosition=3, vLinkGenMemoryRegionBlockSize=256, vLinkGenMemoryRegionBlockCore=0, vLinkGenMemoryRegionBlockAddress=4197312, vLinkGenMemoryRegionBlockContentType=APPLICATION_ENTRY
          FLASH: vLinkGenMemoryRegionBlockPosition=4, vLinkGenMemoryRegionBlockSize=4191040, vLinkGenMemoryRegionBlockAddress=4197568, vLinkGenMemoryRegionBlockContentType=LOCAL_INTVEC_CONST, vLinkGenMemoryRegionBlockContentType=LOCAL_INTVEC_CODE, vLinkGenMemoryRegionBlockContentType=LOCAL_EXCVEC_CONST, vLinkGenMemoryRegionBlockContentType=LOCAL_EXCVEC_CODE, vLinkGenMemoryRegionBlockContentType=GLOBAL_INTVEC_CODE, vLinkGenMemoryRegionBlockContentType=GLOBAL_INTVEC_CONST, vLinkGenMemoryRegionBlockContentType=GLOBAL_CODE, vLinkGenMemoryRegionBlockContentType=GLOBAL_CONST, vLinkGenMemoryRegionBlockContentType=LOCAL_CODE, vLinkGenMemoryRegionBlockContentType=LOCAL_CONST, vLinkGenMemoryRegionBlockContentType=RAM_CODE, vLinkGenMemoryRegionBlockContentType=RAM_CONST
      5 x vLinkGenLogicalConstGroup:
        IVTFIELD: vLinkGenConstGroupPosition=5, vLinkGenConstGroupRegion=IVT_Block
          IVTField (vLinkGenConstSectionGroup):
            vLinkGenConstSectionGroupPosition = 0
            vLinkGenConstSectionGroupInit = NONE
            vLinkGenConstSectionGroupInitStage = ONE
            vLinkGenConstSectionGroupRef = vLinkGenLinkerSections/IVTField
        Brs_ExcVect: vLinkGenConstGroupPosition=1, vLinkGenConstGroupContentType=GLOBAL_EXCVEC_CONST, vLinkGenConstGroupRegion=CoreExceptions_FirstExecInst
          Brs_ExcVect (vLinkGenConstSectionGroup):
            vLinkGenConstSectionGroupPosition = 0
            vLinkGenConstSectionGroupInit = NONE
            vLinkGenConstSectionGroupInitStage = ONE
            vLinkGenConstSectionGroupRef = brsExcVect
            vLinkGenConstSectionGroupRef = brsExcVectConst
        Brs_Startup_Code: vLinkGenConstGroupPosition=1, vLinkGenConstGroupContentType=STARTUP_CODE, vLinkGenConstGroupRegion=StartupCode_FirstExecInst
          Brs_Startup_Code (vLinkGenConstSectionGroup):
            vLinkGenConstSectionGroupPosition = 0
            vLinkGenConstSectionGroupInit = NONE
            vLinkGenConstSectionGroupInitStage = ONE
            vLinkGenConstSectionGroupRef = brsStartup
          BrsMain_Startup_Code (vLinkGenConstSectionGroup):
            vLinkGenConstSectionGroupPosition = 0
            vLinkGenConstSectionGroupInit = NONE
            vLinkGenConstSectionGroupInitStage = ONE
            vLinkGenConstSectionGroupRef = brsMainStartup
        Brs_Shared_Const: vLinkGenConstGroupPosition=5, vLinkGenConstGroupContentType=GLOBAL_CONST, vLinkGenConstGroupRegion=FLASH/FLASH
          Brs_Shared_Const (vLinkGenConstSectionGroup):
            vLinkGenConstSectionGroupPosition = 0
            vLinkGenConstSectionGroupInit = NONE
            vLinkGenConstSectionGroupInitStage = ONE
            vLinkGenConstSectionGroupRef = brsSharedConst
        Brs_ApplicationEntry: vLinkGenConstGroupPosition=1, vLinkGenConstGroupContentType=APPLICATION_ENTRY, vLinkGenConstGroupRegion=ApplicationEntry
          Brs_ApplicationEntry (vLinkGenConstSectionGroup):
            vLinkGenConstSectionGroupPosition = 0
            vLinkGenConstSectionGroupInit = NONE
            vLinkGenConstSectionGroupInitStage = ONE
            vLinkGenConstSectionGroupRef = brsApplicationEntry
      Brs_Shared_Var (vLinkGenLogicalVarGroup): vLinkGenVarGroupPosition=5, vLinkGenVarGroupContentType=SHARED_DATA, vLinkGenVarGroupRegion=Variables_Shared
        Brs_Shared_Var (vLinkGenVarSectionGroup): vLinkGenVarSectionGroupPosition=0, vLinkGenVarSectionGroupInit=NONE, vLinkGenVarSectionGroupInitStage=ONE, vLinkGenVarSectionGroupRef=brsSharedVar
      Const_Default (vLinkGenLogicalConstGroup): vLinkGenConstGroupPosition=1000, vLinkGenConstGroupContentType=GLOBAL_CONST, vLinkGenConstGroupRegion=FLASH/FLASH
        7 x vLinkGenConstSectionGroup, all with vLinkGenConstSectionGroupPosition=0, vLinkGenConstSectionGroupInit=NONE, vLinkGenConstSectionGroupInitStage=ONE:
          text: vLinkGenConstSectionGroupRef=vLinkGenLinkerSections/text, vLinkGenConstSectionGroupRef=text_vle, vLinkGenConstSectionGroupRef=syscall, vLinkGenConstSectionGroupRef=fixaddr, vLinkGenConstSectionGroupRef=fixtype, vLinkGenConstSectionGroupRef=picbase, vLinkGenConstSectionGroupRef=pidbase
          secinfo: vLinkGenConstSectionGroupRef=vLinkGenLinkerSections/secinfo
          rodata: vLinkGenConstSectionGroupRef=vLinkGenLinkerSections/rodata
          rozdata: vLinkGenConstSectionGroupRef=vLinkGenLinkerSections/rozdata, vLinkGenConstSectionGroupRef=zrodata
          tdata: vLinkGenConstSectionGroupRef=vLinkGenLinkerSections/tdata
          rosdata: vLinkGenConstSectionGroupRef=vLinkGenLinkerSections/rosdata, vLinkGenConstSectionGroupRef=ldata
          sdata2: vLinkGenConstSectionGroupRef=vLinkGenLinkerSections/sdata2
      Data_Default (vLinkGenLogicalVarGroup):
        vLinkGenVarGroupPosition = 1000
        vLinkGenVarGroupCore = 0
        vLinkGenVarGroupInitCore = 0
        vLinkGenVarGroupContentType = GLOBAL_DATA
        vLinkGenVarGroupRegion = RAM/RAM
        vLinkGenVarGroupRomRegion = FLASH/FLASH
        9 x vLinkGenVarSectionGroup, all with vLinkGenVarSectionGroupPosition=0, vLinkGenVarSectionGroupInitStage=ONE:
          data: vLinkGenVarSectionGroupInit=INIT, vLinkGenVarSectionGroupAlignment=4, vLinkGenVarSectionGroupEndAlignment=4, vLinkGenVarSectionGroupRef=vLinkGenLinkerSections/data
          sdabase: vLinkGenVarSectionGroupInit=NONE, vLinkGenVarSectionGroupRef=vLinkGenLinkerSections/sdabase
          sdata: vLinkGenVarSectionGroupInit=INIT, vLinkGenVarSectionGroupAlignment=4, vLinkGenVarSectionGroupEndAlignment=4, vLinkGenVarSectionGroupRef=vLinkGenLinkerSections/sdata
          zdata: vLinkGenVarSectionGroupInit=INIT, vLinkGenVarSectionGroupAlignment=4, vLinkGenVarSectionGroupEndAlignment=4, vLinkGenVarSectionGroupRef=vLinkGenLinkerSections/zdata, vLinkGenVarSectionGroupRef=PPC_EMB_SDATA0
          bss: vLinkGenVarSectionGroupInit=ZERO_INIT, vLinkGenVarSectionGroupAlignment=4, vLinkGenVarSectionGroupEndAlignment=4, vLinkGenVarSectionGroupRef=vLinkGenLinkerSections/bss, vLinkGenVarSectionGroupRef=COMMON, vLinkGenVarSectionGroupFlag=vLinkGenVarGroupFlags/CLEAR
          sbss: vLinkGenVarSectionGroupInit=ZERO_INIT, vLinkGenVarSectionGroupAlignment=4, vLinkGenVarSectionGroupEndAlignment=4, vLinkGenVarSectionGroupRef=vLinkGenLinkerSections/sbss, vLinkGenVarSectionGroupRef=SMALLCOMMON, vLinkGenVarSectionGroupFlag=vLinkGenVarGroupFlags/CLEAR
          zbss: vLinkGenVarSectionGroupInit=ZERO_INIT, vLinkGenVarSectionGroupAlignment=4, vLinkGenVarSectionGroupEndAlignment=4, vLinkGenVarSectionGroupRef=vLinkGenLinkerSections/zbss, vLinkGenVarSectionGroupRef=PPC_EMB_SBSS0, vLinkGenVarSectionGroupRef=ZEROCOMMON, vLinkGenVarSectionGroupFlag=vLinkGenVarGroupFlags/CLEAR
          stack: vLinkGenVarSectionGroupInit=NONE, vLinkGenVarSectionGroupRef=vLinkGenLinkerSections/stack
          heap: vLinkGenVarSectionGroupAlignment=16, vLinkGenVarSectionGroupSize=1024, vLinkGenVarSectionGroupInit=NONE, vLinkGenVarSectionGroupFlag=vLinkGenVarGroupFlags/NOCLEAR
      6 x vLinkGenLogicalConstGroup, all with vLinkGenConstGroupPosition=5, vLinkGenConstGroupRegion=FLASH/FLASH, vLinkGenConstGroupModule=Os:
        OS_CODE: vLinkGenConstGroupContentType=GLOBAL_CODE
          OS_CODE (vLinkGenConstSectionGroup):
            vLinkGenConstSectionGroupPosition = 0
            vLinkGenConstSectionGroupInit = NONE
            vLinkGenConstSectionGroupInitStage = ONE
            vLinkGenConstSectionGroupRef = vLinkGenLinkerSections/OS_CODE
            vLinkGenConstSectionGroupRef = OS_OS_COREINITHOOK_CODE
        OS_USER_CODE: vLinkGenConstGroupContentType=GLOBAL_CODE
          OS_USER_CODE (vLinkGenConstSectionGroup):
            vLinkGenConstSectionGroupPosition = 0
            vLinkGenConstSectionGroupInit = NONE
            vLinkGenConstSectionGroupInitStage = ONE
            vLinkGenConstSectionGroupRef = OS_ERRORHOOK_CODE
            vLinkGenConstSectionGroupRef = OS_AppRunTask_CODE
            vLinkGenConstSectionGroupRef = OS_Default_Init_Task_CODE
            vLinkGenConstSectionGroupRef = OS_Default_Init_Task_Trusted_CODE
            vLinkGenConstSectionGroupRef = OS_SwcInitTask_CODE
        OS_INTVEC_CODE: vLinkGenConstGroupContentType=GLOBAL_INTVEC_CODE
          OS_INTVEC_CODE (vLinkGenConstSectionGroup):
            vLinkGenConstSectionGroupPosition = 0
            vLinkGenConstSectionGroupInit = NONE
            vLinkGenConstSectionGroupInitStage = ONE
            vLinkGenConstSectionGroupAlignment = 1024
            vLinkGenConstSectionGroupRef = vLinkGenLinkerSections/OS_INTVEC_CODE
        OS_CONST: vLinkGenConstGroupContentType=GLOBAL_CONST
          OS_CONST (vLinkGenConstSectionGroup):
            vLinkGenConstSectionGroupPosition = 0
            vLinkGenConstSectionGroupInit = NONE
            vLinkGenConstSectionGroupInitStage = ONE
            vLinkGenConstSectionGroupRef = vLinkGenLinkerSections/OS_CONST
            vLinkGenConstSectionGroupRef = OS_SystemApplication_OsCore0_CONST
            vLinkGenConstSectionGroupRef = OS_CORE0_CONST
        OS_GLOBALSHARED_CONST: vLinkGenConstGroupContentType=GLOBAL_CONST
          OS_GLOBALSHARED_CONST (vLinkGenConstSectionGroup):
            vLinkGenConstSectionGroupPosition = 0
            vLinkGenConstSectionGroupInit = NONE
            vLinkGenConstSectionGroupInitStage = ONE
            vLinkGenConstSectionGroupRef = vLinkGenLinkerSections/OS_GLOBALSHARED_CONST
        OS_INTVEC_CONST: vLinkGenConstGroupContentType=GLOBAL_INTVEC_CONST
          OS_INTVEC_CONST (vLinkGenConstSectionGroup):
            vLinkGenConstSectionGroupPosition = 0
            vLinkGenConstSectionGroupInit = NONE
            vLinkGenConstSectionGroupInitStage = ONE
            vLinkGenConstSectionGroupAlignment = 1024
            vLinkGenConstSectionGroupRef = vLinkGenLinkerSections/OS_INTVEC_CONST
      3 x vLinkGenLogicalVarGroup, all with vLinkGenVarGroupPosition=5, vLinkGenVarGroupInitCore=0, vLinkGenVarGroupRegion=RAM/RAM, vLinkGenVarGroupModule=Os, vLinkGenVarGroupRomRegion=FLASH/FLASH:
        OS_GLOBALSHARED_VAR: vLinkGenVarGroupContentType=GLOBAL_DATA
          3 x vLinkGenVarSectionGroup, all with vLinkGenVarSectionGroupPosition=0, vLinkGenVarSectionGroupInitStage=ONE:
            OS_GLOBALSHARED_VAR_NOINIT: vLinkGenVarSectionGroupInit=NONE, vLinkGenVarSectionGroupRef=vLinkGenLinkerSections/OS_GLOBALSHARED_VAR_NOINIT, vLinkGenVarSectionGroupRef=OS_GLOBALSHARED_VAR_NOCACHE_NOINIT
            OS_GLOBALSHARED_VAR_INIT: vLinkGenVarSectionGroupInit=INIT, vLinkGenVarSectionGroupAlignment=4, vLinkGenVarSectionGroupEndAlignment=4, vLinkGenVarSectionGroupRef=vLinkGenLinkerSections/OS_GLOBALSHARED_VAR, vLinkGenVarSectionGroupRef=OS_GLOBALSHARED_VAR_NOCACHE
            OS_GLOBALSHARED_VAR_ZERO_INIT: vLinkGenVarSectionGroupInit=ZERO_INIT, vLinkGenVarSectionGroupAlignment=4, vLinkGenVarSectionGroupEndAlignment=4, vLinkGenVarSectionGroupRef=vLinkGenLinkerSections/OS_GLOBALSHARED_VAR_ZERO_INIT, vLinkGenVarSectionGroupRef=OS_GLOBALSHARED_VAR_NOCACHE_ZERO_INIT
        OS_GLOBALSHARED_VAR_SAVED_ZONE: vLinkGenVarGroupContentType=RETENTION_DATA
          OS_GLOBALSHARED_VAR_SAVED_ZONE_NOINIT (vLinkGenVarSectionGroup):
            vLinkGenVarSectionGroupPosition = 0
            vLinkGenVarSectionGroupInit = NONE
            vLinkGenVarSectionGroupInitStage = ONE
            vLinkGenVarSectionGroupRef = vLinkGenLinkerSections/OS_GLOBALSHARED_VAR_SAVED_ZONE_NOINIT
          OS_GLOBALSHARED_VAR_SAVED_ZONE_INIT (vLinkGenVarSectionGroup):
            vLinkGenVarSectionGroupPosition = 0
            vLinkGenVarSectionGroupInit = INIT
            vLinkGenVarSectionGroupInitStage = ONE
            vLinkGenVarSectionGroupAlignment = 4
            vLinkGenVarSectionGroupEndAlignment = 4
            vLinkGenVarSectionGroupRef = vLinkGenLinkerSections/OS_GLOBALSHARED_VAR_SAVED_ZONE
        OS_DATA_SHARED_VAR: vLinkGenVarGroupContentType=GLOBAL_DATA
          OS_DATA_SHARED_VAR_NOINIT (vLinkGenVarSectionGroup):
            vLinkGenVarSectionGroupPosition = 0
            vLinkGenVarSectionGroupInit = NONE
            vLinkGenVarSectionGroupInitStage = ONE
            vLinkGenVarSectionGroupRef = OS_VAR_NOCACHE_NOINIT
            vLinkGenVarSectionGroupRef = OS_CORESTATUS_CORE0_VAR_NOCACHE_NOINIT
            vLinkGenVarSectionGroupRef = OS_PUBLIC_CORE0_VAR_NOINIT
            vLinkGenVarSectionGroupRef = OS_BARRIER_CORE0_VAR_NOCACHE_NOINIT
          OS_DATA_SHARED_VAR_INIT (vLinkGenVarSectionGroup):
            vLinkGenVarSectionGroupPosition = 0
            vLinkGenVarSectionGroupInit = INIT
            vLinkGenVarSectionGroupInitStage = ONE
            vLinkGenVarSectionGroupAlignment = 4
            vLinkGenVarSectionGroupEndAlignment = 4
            vLinkGenVarSectionGroupRef = OS_VAR_NOCACHE
      4 x vLinkGenLogicalConstGroup, all with vLinkGenConstGroupPosition=5, vLinkGenConstGroupCore=0, vLinkGenConstGroupRegion=FLASH/FLASH, vLinkGenConstGroupModule=Os:
        OS_EXCVEC_CORE0_CODE: vLinkGenConstGroupContentType=LOCAL_EXCVEC_CODE
          OS_EXCVEC_CORE0_CODE (vLinkGenConstSectionGroup):
            vLinkGenConstSectionGroupPosition = 0
            vLinkGenConstSectionGroupInit = NONE
            vLinkGenConstSectionGroupInitStage = ONE
            vLinkGenConstSectionGroupAlignment = 0
            vLinkGenConstSectionGroupRef = vLinkGenLinkerSections/OS_EXCVEC_CORE0_CODE
        OS_INTVEC_CORE0_CODE: vLinkGenConstGroupContentType=LOCAL_INTVEC_CODE
          OS_INTVEC_CORE0_CODE (vLinkGenConstSectionGroup):
            vLinkGenConstSectionGroupPosition = 0
            vLinkGenConstSectionGroupInit = NONE
            vLinkGenConstSectionGroupInitStage = ONE
            vLinkGenConstSectionGroupAlignment = 1024
            vLinkGenConstSectionGroupRef = vLinkGenLinkerSections/OS_INTVEC_CORE0_CODE
        OS_EXCVEC_CORE0_CONST: vLinkGenConstGroupContentType=LOCAL_EXCVEC_CONST
          OS_EXCVEC_CORE0_CONST (vLinkGenConstSectionGroup):
            vLinkGenConstSectionGroupPosition = 0
            vLinkGenConstSectionGroupInit = NONE
            vLinkGenConstSectionGroupInitStage = ONE
            vLinkGenConstSectionGroupAlignment = 0
            vLinkGenConstSectionGroupRef = vLinkGenLinkerSections/OS_EXCVEC_CORE0_CONST
        OS_INTVEC_CORE0_CONST: vLinkGenConstGroupContentType=LOCAL_INTVEC_CONST
          OS_INTVEC_CORE0_CONST (vLinkGenConstSectionGroup):
            vLinkGenConstSectionGroupPosition = 0
            vLinkGenConstSectionGroupInit = NONE
            vLinkGenConstSectionGroupInitStage = ONE
            vLinkGenConstSectionGroupAlignment = 1024
            vLinkGenConstSectionGroupRef = vLinkGenLinkerSections/OS_INTVEC_CORE0_CONST
      3 x vLinkGenLogicalVarGroup, all with vLinkGenVarGroupCore=0:
        OS_STACKS_CORE0_VAR: vLinkGenVarGroupPosition=0, vLinkGenVarGroupRegion=RAM/RAM, vLinkGenVarGroupModule=Os, vLinkGenVarGroupContentType=STACKS
          OS_STACKS_CORE0_VAR_NOINIT (vLinkGenVarSectionGroup):
            vLinkGenVarSectionGroupPosition = 0
            vLinkGenVarSectionGroupInit = NONE
            vLinkGenVarSectionGroupInitStage = ONE
            vLinkGenVarSectionGroupRef = OS_STACK_OSCORE0_KERNEL_VAR_NOINIT
            vLinkGenVarSectionGroupRef = OS_STACK_OSCORE0_INIT_VAR_NOINIT
            vLinkGenVarSectionGroupRef = OS_STACK_OSCORE0_ERROR_VAR_NOINIT
            vLinkGenVarSectionGroupRef = OS_STACK_OSCORE0_ISR_CORE_VAR_NOINIT
            vLinkGenVarSectionGroupRef = OS_STACK_OSCORE0_TASK_PRIO4294967295_VAR_NOINIT
            vLinkGenVarSectionGroupRef = OS_STACK_OSCORE0_TASK_PRIO49_VAR_NOINIT
            vLinkGenVarSectionGroupRef = OS_STACK_OSCORE0_TASK_PRIO50_VAR_NOINIT
            vLinkGenVarSectionGroupRef = OS_STACK_OSCORE0_TASK_PRIO30_VAR_NOINIT
            vLinkGenVarSectionGroupRef = OS_STACK_APPRUNTASK_VAR_NOINIT
        OS_DATA_CORE0_VAR: vLinkGenVarGroupPosition=5, vLinkGenVarGroupInitCore=0, vLinkGenVarGroupRegion=RAM/RAM, vLinkGenVarGroupModule=Os, vLinkGenVarGroupContentType=LOCAL_DATA, vLinkGenVarGroupRomRegion=FLASH/FLASH
          3 x vLinkGenVarSectionGroup, all with vLinkGenVarSectionGroupPosition=0, vLinkGenVarSectionGroupInitStage=ONE:
            OS_DATA_CORE0_VAR_NOINIT: vLinkGenVarSectionGroupInit=NONE, vLinkGenVarSectionGroupRef=OS_CORE0_VAR_NOINIT, vLinkGenVarSectionGroupRef=OS_CORE0_VAR_NOCACHE_NOINIT, vLinkGenVarSectionGroupRef=OS_SystemApplication_OsCore0_VAR_NOINIT, vLinkGenVarSectionGroupRef=OS_SystemApplication_OsCore0_VAR_NOCACHE_NOINIT, vLinkGenVarSectionGroupRef=OS_SystemApplication_OsCore0_VAR_SAVED_ZONE_NOINIT
            OS_DATA_CORE0_VAR_INIT: vLinkGenVarSectionGroupInit=INIT, vLinkGenVarSectionGroupAlignment=4, vLinkGenVarSectionGroupEndAlignment=4, vLinkGenVarSectionGroupRef=OS_CORE0_VAR, vLinkGenVarSectionGroupRef=OS_CORE0_VAR_NOCACHE, vLinkGenVarSectionGroupRef=OS_SystemApplication_OsCore0_VAR, vLinkGenVarSectionGroupRef=OS_SystemApplication_OsCore0_VAR_NOCACHE, vLinkGenVarSectionGroupRef=OS_SystemApplication_OsCore0_VAR_SAVED_ZONE
            OS_DATA_CORE0_VAR_ZERO_INIT: vLinkGenVarSectionGroupInit=ZERO_INIT, vLinkGenVarSectionGroupAlignment=4, vLinkGenVarSectionGroupEndAlignment=4, vLinkGenVarSectionGroupRef=OS_SystemApplication_OsCore0_VAR_ZERO_INIT, vLinkGenVarSectionGroupRef=OS_SystemApplication_OsCore0_VAR_NOCACHE_ZERO_INIT
        STACK_C0: vLinkGenVarGroupPosition=5, vLinkGenVarGroupRegion=StartupStack_Shared, vLinkGenVarGroupContentType=STARTUP_STACK, vLinkGenVarGroupModule=vBRS
          STACK_C0 (vLinkGenVarSectionGroup):
            vLinkGenVarSectionGroupPosition = 0
            vLinkGenVarSectionGroupInit = NONE
            vLinkGenVarSectionGroupInitStage = ONE
            vLinkGenVarSectionGroupAlignment = 4
            vLinkGenVarSectionGroupEndAlignment = 4
            vLinkGenVarSectionGroupSize = 1024
    vLinkGenContentTypes
      RAM_CODE (vLinkGenConstContentType): vLinkGenConstContentTypeLocal=false, vLinkGenConstContentTypeCopyRef=RAM_CODE_COPY
      RAM_CONST (vLinkGenConstContentType): vLinkGenConstContentTypeLocal=false, vLinkGenConstContentTypeCopyRef=RAM_CONST_COPY
      3 x vLinkGenVarContentType:
        GLOBAL_DATA: vLinkGenVarContentTypeLocal=false, vLinkGenVarContentTypeCopyRef=GLOBAL_CONST
        LOCAL_DATA: vLinkGenVarContentTypeLocal=true, vLinkGenVarContentTypeCopyRef=LOCAL_CONST
        RETENTION_DATA: vLinkGenVarContentTypeLocal=false, vLinkGenVarContentTypeCopyRef=GLOBAL_CONST
      13 x vLinkGenConstContentType:
        GLOBAL_CODE: vLinkGenConstContentTypeLocal=false
        LOCAL_CODE: vLinkGenConstContentTypeLocal=true
        GLOBAL_CONST: vLinkGenConstContentTypeLocal=false
        LOCAL_CONST: vLinkGenConstContentTypeLocal=true
        GLOBAL_EXCVEC_CODE: vLinkGenConstContentTypeLocal=false
        LOCAL_EXCVEC_CODE: vLinkGenConstContentTypeLocal=true
        GLOBAL_EXCVEC_CONST: vLinkGenConstContentTypeLocal=true
        LOCAL_EXCVEC_CONST: vLinkGenConstContentTypeLocal=true
        GLOBAL_INTVEC_CODE: vLinkGenConstContentTypeLocal=false
        LOCAL_INTVEC_CODE: vLinkGenConstContentTypeLocal=true
        GLOBAL_INTVEC_CONST: vLinkGenConstContentTypeLocal=false
        LOCAL_INTVEC_CONST: vLinkGenConstContentTypeLocal=true
        STARTUP_CODE: vLinkGenConstContentTypeLocal=false
      5 x vLinkGenVarContentType:
        STARTUP_STACK: vLinkGenVarContentTypeLocal=true
        STACKS: vLinkGenVarContentTypeLocal=true
        RAM_CODE_COPY: vLinkGenVarContentTypeLocal=false
        RAM_CONST_COPY: vLinkGenVarContentTypeLocal=false
        SHARED_DATA: vLinkGenVarContentTypeLocal=false
      APPLICATION_ENTRY (vLinkGenConstContentType): vLinkGenConstContentTypeLocal=false
    vLinkGenPublishedInformation: vLinkGenGeneration=2, vLinkGenDuplicatedLabels=false
      vLinkGenConstGroupFlags
        5 x vLinkGenConstGroupFlag:
          ABS
          CLEAR
          NOCLEAR
          NOLOAD
          NOCHECKSUM
      vLinkGenVarGroupFlags
        5 x vLinkGenVarGroupFlag:
          ABS
          CLEAR
          NOCLEAR
          NOLOAD
          NOCHECKSUM
    vLinkGenGeneral: vLinkGenFileGeneration=STANDARD
