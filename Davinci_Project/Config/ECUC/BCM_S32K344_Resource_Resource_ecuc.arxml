AUTOSAR XML (schema 00050)
package /ActiveEcuC
  module config Resource: implementation-config-variant=VARIANT-PRE-COMPILE
    CommonPublishedInformation:
      ArReleaseMajorVersion = 4
      ArReleaseMinorVersion = 4
      ArReleaseRevisionVersion = 0
      ModuleId = 0
      SwMajorVersion = 2
      SwMinorVersion = 0
      SwPatchVersion = 1
      VendorId = 43
    ResourceGeneral: ResourceSubderivative=s32k344_mapbga257
