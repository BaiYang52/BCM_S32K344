AUTOSAR XML (schema 00050)
package /ActiveEcuC
  module config vBRS: implementation-config-variant=VARIANT-PRE-COMPILE, module-description=vBRS_Impl
    vBRSGeneral:
      vBRSEnableCoreSpecificVLinkGenConfig = true
      vBRSEnableSupportLEDs = false
      vBRSEnableSafeContextSupport = false
      vBRSEnableMultiCoreSupport = false
      vBRSEnableSupportToggleWdPin = false
      vBRSEnableSupportToggleCustomPin = false
      vBRSEnableEcuMStubGeneration = false
      vBRSDisableSetupSupport = false
      vBRSEnableSchmStubGeneration = false
      vBRSEnableSchmStubSupportDrvCanAN = true
      vBRSEnableSchmStubEmptyExclusiveAreaHandling = false
      vBRSExecutionInstance = Application
      vBRSFirstInstance = true
      vBRSFblSupportEcuMInit = false
      vBRSFblSupportExceptionTableInRam = true
    vBRSHwConfig:
      vBRSCompilerInstructionSet = THUMB
      vBRSPeriphClockDescription = Initial value for Peripheral Clock: 120MHz
      vBRSOscClock = 16000000
      vBRSTimebaseClock = 160000000
      vBRSPeriphClock = 160000000
      vBRSEnablePortHandling = false
      vBRSEnableWatchdogHandling = false
      vBRSEnablePLLClocksHandling = false
      vBRSPreferPLLWatchdogInit = false
      3 x vBRSEvalBoardInfo:
        S32K3XXEVB: vBRSEvalBoard=S32K3XXEVB, vBRSEvalBoardDescription=Toggle PTA31 for LED support, vBRSEvalBoardOscClock=16000000
        S32K3XXCVB: vBRSEvalBoard=S32K3XXCVB, vBRSEvalBoardDescription=No User LED available, vBRSEvalBoardOscClock=16000000
        S32K396BGA: vBRSEvalBoard=S32K396BGA, vBRSEvalBoardDescription=Toggle PTH7 for LED support, vBRSEvalBoardOscClock=40000000
    vBRSMemoryInit: vBRSInitPatternBlocks=0, vBRSInitPatternHardResetBlocks=0, vBRSInitPatternAreas=0, vBRSInitPatternHardResetAreas=0
