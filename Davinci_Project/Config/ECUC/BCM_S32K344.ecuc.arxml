AUTOSAR XML (schema 00050)
package /ActiveEcuC
  ecuc value collection ActiveEcuC: ecu-extract=SYSTEM, ecuc-values=[VTTMemMap, MemMap, vLinkGen, Base, Resource, vBRS, BswM, EcuM, vSet, vBaseEnv, Det, Os, Rte, EcuC, Mcu, Dio, Port]
