AUTOSAR XML (schema 00050)
package /ActiveEcuC
  module config vSet: implementation-config-variant=VARIANT-PRE-COMPILE, module-description=vSet_Impl
    vSetGeneral: vSetDummyStatementKind=SelfAssignment
    vSetPlatform:
      vSetByteOrder = LITTLE_ENDIAN
      vSetSizeOfEnum = Size32Bit
      vSetBitOrder = LSB_to_MSB
      vSetSizeOfInt = Size32Bit
      vSetSizeOfROMPointer = Size32Bit
      vSetCPUType = CPU32Bit
      vSetSizeOfRAMPointer = Size32Bit
    vSetCalibration
    vSetBswInitialization
      20 x vSetInitFunction:
        OsIf_Init: vSetHeader=OsIf.h, vSetConfigType=Base_ConfigType, vSetConfigPtrClass=BASE_APPL_CONST, vSetModuleRef=Base  # /ActiveEcuC/Base PLAIN_TEXT Created OsIf_Init by Extended Init XML Service
          vSetInitFunctionInstance: vSetInitPhase=INIT_ONE, vSetConfigPtrName=NULL_PTR
        BswM_Init: vSetHeader=BswM.h, vSetConfigType=BswM_ConfigType, vSetConfigPtrClass=BSWM_INIT_DATA, vSetModuleRef=BswM  # /ActiveEcuC/BswM PLAIN_TEXT Init function description of BswM in UnfilteredViewInInvariantProject (UnfilteredInvariantProjectModelView) .
          vSetInitFunctionInstance: vSetInitPhase=NO_INIT, vSetConfigPtrName=BswM_Config_Ptr
        BswM_InitMemory: vSetHeader=BswM.h, vSetModuleRef=BswM  # /ActiveEcuC/BswM PLAIN_TEXT InitMemory function description of BswM in UnfilteredViewInInvariantProject (UnfilteredInvariantProjectModelView) .
          vSetInitFunctionInstance: vSetInitPhase=INIT_MEMORY
        BswM_PreInit: vSetHeader=BswM.h, vSetConfigType=BswM_ConfigType, vSetConfigPtrClass=BSWM_INIT_DATA, vSetModuleRef=BswM  # /ActiveEcuC/BswM PLAIN_TEXT PreInit function description of BswM in UnfilteredViewInInvariantProject (UnfilteredInvariantProjectModelView) .
          vSetInitFunctionInstance: vSetInitPhase=INIT_ONE, vSetConfigPtrName=BswM_Config_Ptr
        Det_InitMemory: vSetHeader=Det.h, vSetModuleRef=Det  # /ActiveEcuC/Det PLAIN_TEXT InitMemory function description of Det in UnfilteredViewInInvariantProject (UnfilteredInvariantProjectModelView) .
          vSetInitFunctionInstance: vSetInitPhase=INIT_MEMORY
        Det_Init: vSetHeader=Det.h, vSetConfigType=Det_ConfigType, vSetConfigPtrClass=DET_INIT_DATA, vSetModuleRef=Det  # /ActiveEcuC/Det PLAIN_TEXT Init function description of Det in UnfilteredViewInInvariantProject (UnfilteredInvariantProjectModelView) .
          vSetInitFunctionInstance: vSetInitPhase=INIT_ZERO, vSetConfigPtrName=Det_Config_Ptr
        EcuM_Init: vSetHeader=EcuM.h, vSetConfigType=EcuM_PbConfigType, vSetConfigPtrClass=ECUM_INIT_DATA, vSetModuleRef=EcuM  # /ActiveEcuC/EcuM PLAIN_TEXT Init function description of EcuM in UnfilteredViewInInvariantProject (UnfilteredInvariantProjectModelView) .
          vSetInitFunctionInstance: vSetInitPhase=NO_INIT, vSetConfigPtrName=EcuM_Config_Ptr
        Mcu_Init: vSetHeader=Mcu.h, vSetConfigType=Mcu_ConfigType, vSetConfigPtrClass=MCU_APPL_CONST, vSetModuleRef=Mcu  # /ActiveEcuC/Mcu PLAIN_TEXT Created Mcu_Init by Extended Init XML Service
          vSetInitFunctionInstance:
            vSetInitPhase = INIT_ONE
            vSetConfigPtrName = &Mcu_Config
            vSetAdditionalInitCode = Mcu_InitClock(McuConf_McuClockSettingConfig_McuClockSettingConfig_0);while (MCU_PLL_LOCKED != Mcu_GetPllStatus());Mcu_DistributePllClock();Mcu_SetMode(McuConf_McuModeSettingConf_McuModeSettingConf_0);
        Resource_Init: vSetHeader=Resource.h, vSetModuleRef=Resource  # /ActiveEcuC/Resource PLAIN_TEXT Created Resource_Init by Extended Init XML Service
          vSetInitFunctionInstance: vSetInitPhase=NO_INIT
        SchM_Init: vSetHeader=Rte_Main.h, vSetModuleRef=Rte  # /ActiveEcuC/Rte PLAIN_TEXT Automatically generated by BswInitFctConfigurationService.
          vSetInitFunctionInstance: vSetInitPhase=NO_INIT
        Rte_Start: vSetHeader=Rte_Main.h, vSetModuleRef=Rte  # /ActiveEcuC/Rte PLAIN_TEXT Automatically generated by BswInitFctConfigurationService.
          vSetInitFunctionInstance: vSetInitPhase=INIT_THREE
        Rte_InitMemory: vSetHeader=Rte_Main.h, vSetModuleRef=Rte  # /ActiveEcuC/Rte PLAIN_TEXT Automatically generated by BswInitFctConfigurationService.
          vSetInitFunctionInstance: vSetInitPhase=INIT_MEMORY
        SchM_StartTiming: vSetHeader=Rte_Main.h, vSetModuleRef=Rte  # /ActiveEcuC/Rte PLAIN_TEXT Automatically generated by BswInitFctConfigurationService.
          vSetInitFunctionInstance: vSetInitPhase=NO_INIT
        SchM_Start: vSetHeader=Rte_Main.h, vSetModuleRef=Rte  # /ActiveEcuC/Rte PLAIN_TEXT Automatically generated by BswInitFctConfigurationService.
          vSetInitFunctionInstance: vSetInitPhase=NO_INIT
        Rte_StartTiming: vSetHeader=Rte_Main.h, vSetModuleRef=Rte  # /ActiveEcuC/Rte PLAIN_TEXT Automatically generated by BswInitFctConfigurationService.
          vSetInitFunctionInstance: vSetInitPhase=NO_INIT
        Brs_Init: vSetHeader=, vSetModuleRef=vBRS  # /ActiveEcuC/vBRS PLAIN_TEXT Automatically generated by BswInitFctConfigurationService.
          vSetInitFunctionInstance: vSetInitPhase=NO_INIT
        vBaseEnv_Init: vSetHeader=, vSetModuleRef=vBaseEnv  # /ActiveEcuC/vBaseEnv PLAIN_TEXT Created vBaseEnv_Init by Extended Init XML Service
          vSetInitFunctionInstance: vSetInitPhase=NO_INIT
        vLinkGen_Init: vSetHeader=vLinkGen_Lcfg.h, vSetModuleRef=vLinkGen  # /ActiveEcuC/vLinkGen PLAIN_TEXT Dummy initialization of the vLinkGen
          vSetInitFunctionInstance: vSetInitPhase=NO_INIT
        Dio_Init: vSetHeader=Dio.h, vSetModuleRef=Dio  # /ActiveEcuC/Dio PLAIN_TEXT Created Dio_Init by Extended Init XML Service
          vSetInitFunctionInstance: vSetInitPhase=NO_INIT
        Port_Init: vSetHeader=Port.h, vSetConfigType=Port_ConfigType, vSetConfigPtrClass=PORT_APPL_CONST, vSetModuleRef=Port  # /ActiveEcuC/Port PLAIN_TEXT Created Port_Init by Extended Init XML Service
          vSetInitFunctionInstance: vSetInitPhase=INIT_ONE_EARLY, vSetConfigPtrName=NULL_PTR
