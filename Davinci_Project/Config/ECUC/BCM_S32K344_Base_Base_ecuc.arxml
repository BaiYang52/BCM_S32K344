AUTOSAR XML (schema 00050)
package /ActiveEcuC
  module config Base: implementation-config-variant=VARIANT-PRE-COMPILE, module-description=Base_Impl
    OsIfGeneral:
      OsIfMulticoreSupport = false
      OsIfEnableUserModeSupport = false
      OsIfDevErrorDetect = false
      OsIfUseSystemTimer = false
      OsIfUseCustomTimer = false
      OsIfInstanceId = 0
      OsIfOperatingSystemType
        OsIfAutosarOsType
    CommonPublishedInformation:
      ArReleaseMajorVersion = 4
      ArReleaseMinorVersion = 4
      ArReleaseRevisionVersion = 0
      ModuleId = 0
      SwMajorVersion = 2
      SwMinorVersion = 0
      SwPatchVersion = 1
      VendorId = 43
