AUTOSAR XML (schema 00050)
package /ActiveEcuC
  module config vBaseEnv: implementation-config-variant=VARIANT-PRE-COMPILE, module-description=vBaseEnv_Impl
    vBaseEnvGeneral: vBaseEnvTestedDerivativeRef=S32K344
      21 x vBaseEnvDerivativeInformation, all with vBaseEnvAvailableChannels_Flexray=0, vBaseEnvCpuCore=CORTEX_M7, vBaseEnvAvailableChannels_Hyperbus=0, vBaseEnvAvailableChannels_I2c=0, vBaseEnvAvailableChannels_Spi=0:
        S32K396: vBaseEnvCpuMaxFrequency=320000000, vBaseEnvAvailableChannels_Can=6, vBaseEnvAvailableChannels_Lin=4, vBaseEnvAvailableChannels_Ethernet=1, vBaseEnvCpuCoreAmount=4, vBaseEnvTestedDerivative=S32K396, vBaseEnvTestedDerivativeDescription=NXP S32K396
          Program_Flash (vBaseEnvMemLayoutHwRegion): vBaseEnvHwRegionStartAddress=4194304, vBaseEnvHwRegionSize=6291456, vBaseEnvHwRegionEccAlignment=4, vBaseEnvHwRegionType=ROM
          Data_Flash (vBaseEnvMemLayoutHwRegion): vBaseEnvHwRegionStartAddress=268435456, vBaseEnvHwRegionSize=131072, vBaseEnvHwRegionEccAlignment=4, vBaseEnvHwRegionType=ROM
          vBaseEnvAdditionalParameters: vBaseEnvPllGroup=D, vBaseEnvPortGroup=B, vBaseEnvResetGroup=B, vBaseEnvDerivativeGroup=S32K39X
          8 x vBaseEnvMemLayoutHwRegion, all with vBaseEnvHwRegionEccAlignment=8, vBaseEnvHwRegionType=RAM:
            ITCM0: vBaseEnvHwRegionSize=32768, vBaseEnvHwRegionStartAddress=0
            DTCM0: vBaseEnvHwRegionSize=131072, vBaseEnvHwRegionStartAddress=536870912
            PRAM0: vBaseEnvHwRegionSize=262144, vBaseEnvHwRegionStartAddress=541065216
            PRAM1: vBaseEnvHwRegionSize=262144, vBaseEnvHwRegionStartAddress=541327360
            ITCM1: vBaseEnvHwRegionSize=32768, vBaseEnvHwRegionStartAddress=0
            ITCM2: vBaseEnvHwRegionSize=32768, vBaseEnvHwRegionStartAddress=0
            DTCM1: vBaseEnvHwRegionSize=131072, vBaseEnvHwRegionStartAddress=536870912
            DTCM2: vBaseEnvHwRegionSize=131072, vBaseEnvHwRegionStartAddress=536870912
          vBaseEnvClockSettings: vBaseEnvOscClock=40000000, vBaseEnvTimebaseClock=320000000, vBaseEnvPeriphClock=320000000
        S32K394: vBaseEnvCpuMaxFrequency=320000000, vBaseEnvAvailableChannels_Can=6, vBaseEnvAvailableChannels_Lin=4, vBaseEnvAvailableChannels_Ethernet=1, vBaseEnvCpuCoreAmount=4, vBaseEnvTestedDerivative=S32K394, vBaseEnvTestedDerivativeDescription=NXP S32K394
          Program_Flash (vBaseEnvMemLayoutHwRegion): vBaseEnvHwRegionStartAddress=4194304, vBaseEnvHwRegionSize=4194304, vBaseEnvHwRegionEccAlignment=4, vBaseEnvHwRegionType=ROM
          Data_Flash (vBaseEnvMemLayoutHwRegion): vBaseEnvHwRegionStartAddress=268435456, vBaseEnvHwRegionSize=131072, vBaseEnvHwRegionEccAlignment=4, vBaseEnvHwRegionType=ROM
          vBaseEnvAdditionalParameters: vBaseEnvPllGroup=D, vBaseEnvPortGroup=B, vBaseEnvResetGroup=B, vBaseEnvDerivativeGroup=S32K39X
          8 x vBaseEnvMemLayoutHwRegion, all with vBaseEnvHwRegionEccAlignment=8, vBaseEnvHwRegionType=RAM:
            ITCM0: vBaseEnvHwRegionSize=32768, vBaseEnvHwRegionStartAddress=0
            DTCM0: vBaseEnvHwRegionSize=131072, vBaseEnvHwRegionStartAddress=536870912
            PRAM0: vBaseEnvHwRegionSize=262144, vBaseEnvHwRegionStartAddress=541065216
            PRAM1: vBaseEnvHwRegionSize=262144, vBaseEnvHwRegionStartAddress=541327360
            ITCM1: vBaseEnvHwRegionSize=32768, vBaseEnvHwRegionStartAddress=0
            ITCM2: vBaseEnvHwRegionSize=32768, vBaseEnvHwRegionStartAddress=0
            DTCM1: vBaseEnvHwRegionSize=131072, vBaseEnvHwRegionStartAddress=536870912
            DTCM2: vBaseEnvHwRegionSize=131072, vBaseEnvHwRegionStartAddress=536870912
          vBaseEnvClockSettings: vBaseEnvOscClock=40000000, vBaseEnvTimebaseClock=320000000, vBaseEnvPeriphClock=320000000
        S32K376: vBaseEnvCpuMaxFrequency=320000000, vBaseEnvAvailableChannels_Can=6, vBaseEnvAvailableChannels_Lin=4, vBaseEnvAvailableChannels_Ethernet=1, vBaseEnvCpuCoreAmount=4, vBaseEnvTestedDerivative=S32K376, vBaseEnvTestedDerivativeDescription=NXP S32K376
          Program_Flash (vBaseEnvMemLayoutHwRegion): vBaseEnvHwRegionStartAddress=4194304, vBaseEnvHwRegionSize=6291456, vBaseEnvHwRegionEccAlignment=4, vBaseEnvHwRegionType=ROM
          Data_Flash (vBaseEnvMemLayoutHwRegion): vBaseEnvHwRegionStartAddress=268435456, vBaseEnvHwRegionSize=131072, vBaseEnvHwRegionEccAlignment=4, vBaseEnvHwRegionType=ROM
          vBaseEnvAdditionalParameters: vBaseEnvPllGroup=D, vBaseEnvPortGroup=B, vBaseEnvResetGroup=B, vBaseEnvDerivativeGroup=S32K38X
          8 x vBaseEnvMemLayoutHwRegion, all with vBaseEnvHwRegionEccAlignment=8, vBaseEnvHwRegionType=RAM:
            ITCM0: vBaseEnvHwRegionSize=32768, vBaseEnvHwRegionStartAddress=0
            DTCM0: vBaseEnvHwRegionSize=131072, vBaseEnvHwRegionStartAddress=536870912
            PRAM0: vBaseEnvHwRegionSize=262144, vBaseEnvHwRegionStartAddress=541065216
            PRAM1: vBaseEnvHwRegionSize=262144, vBaseEnvHwRegionStartAddress=541327360
            DTCM1: vBaseEnvHwRegionSize=131072, vBaseEnvHwRegionStartAddress=536870912
            DTCM2: vBaseEnvHwRegionSize=131072, vBaseEnvHwRegionStartAddress=536870912
            ITCM1: vBaseEnvHwRegionSize=32768, vBaseEnvHwRegionStartAddress=0
            ITCM2: vBaseEnvHwRegionSize=32768, vBaseEnvHwRegionStartAddress=0
          vBaseEnvClockSettings: vBaseEnvOscClock=40000000, vBaseEnvTimebaseClock=320000000, vBaseEnvPeriphClock=320000000
        S32K374: vBaseEnvCpuMaxFrequency=320000000, vBaseEnvAvailableChannels_Can=6, vBaseEnvAvailableChannels_Lin=4, vBaseEnvAvailableChannels_Ethernet=1, vBaseEnvCpuCoreAmount=4, vBaseEnvTestedDerivative=S32K374, vBaseEnvTestedDerivativeDescription=NXP S32K374
          Program_Flash (vBaseEnvMemLayoutHwRegion): vBaseEnvHwRegionStartAddress=4194304, vBaseEnvHwRegionSize=4194304, vBaseEnvHwRegionEccAlignment=4, vBaseEnvHwRegionType=ROM
          Data_Flash (vBaseEnvMemLayoutHwRegion): vBaseEnvHwRegionStartAddress=268435456, vBaseEnvHwRegionSize=131072, vBaseEnvHwRegionEccAlignment=4, vBaseEnvHwRegionType=ROM
          vBaseEnvAdditionalParameters: vBaseEnvPllGroup=D, vBaseEnvPortGroup=B, vBaseEnvResetGroup=B, vBaseEnvDerivativeGroup=S32K38X
          8 x vBaseEnvMemLayoutHwRegion, all with vBaseEnvHwRegionEccAlignment=8, vBaseEnvHwRegionType=RAM:
            ITCM0: vBaseEnvHwRegionSize=32768, vBaseEnvHwRegionStartAddress=0
            DTCM0: vBaseEnvHwRegionSize=65536, vBaseEnvHwRegionStartAddress=536870912
            PRAM0: vBaseEnvHwRegionSize=262144, vBaseEnvHwRegionStartAddress=541065216
            PRAM1: vBaseEnvHwRegionSize=262144, vBaseEnvHwRegionStartAddress=541327360
            ITCM1: vBaseEnvHwRegionSize=32768, vBaseEnvHwRegionStartAddress=0
            ITCM2: vBaseEnvHwRegionSize=32768, vBaseEnvHwRegionStartAddress=0
            DTCM1: vBaseEnvHwRegionSize=65536, vBaseEnvHwRegionStartAddress=536870912
            DTCM2: vBaseEnvHwRegionSize=65536, vBaseEnvHwRegionStartAddress=536870912
          vBaseEnvClockSettings: vBaseEnvOscClock=40000000, vBaseEnvTimebaseClock=320000000, vBaseEnvPeriphClock=320000000
        S32K358: vBaseEnvCpuMaxFrequency=240000000, vBaseEnvAvailableChannels_Can=8, vBaseEnvAvailableChannels_Lin=16, vBaseEnvAvailableChannels_Ethernet=1, vBaseEnvCpuCoreAmount=4, vBaseEnvTestedDerivative=S32K358, vBaseEnvTestedDerivativeDescription=NXP S32K358
          Program_Flash (vBaseEnvMemLayoutHwRegion): vBaseEnvHwRegionStartAddress=4194304, vBaseEnvHwRegionSize=8388608, vBaseEnvHwRegionEccAlignment=4, vBaseEnvHwRegionType=ROM
          Data_Flash (vBaseEnvMemLayoutHwRegion): vBaseEnvHwRegionStartAddress=268435456, vBaseEnvHwRegionSize=131072, vBaseEnvHwRegionEccAlignment=4, vBaseEnvHwRegionType=ROM
          vBaseEnvAdditionalParameters: vBaseEnvPllGroup=B, vBaseEnvPortGroup=B, vBaseEnvResetGroup=B, vBaseEnvDerivativeGroup=S32K3X8
          7 x vBaseEnvMemLayoutHwRegion, all with vBaseEnvHwRegionEccAlignment=8, vBaseEnvHwRegionType=RAM:
            ITCM0: vBaseEnvHwRegionSize=65536, vBaseEnvHwRegionStartAddress=0
            DTCM0: vBaseEnvHwRegionSize=131072, vBaseEnvHwRegionStartAddress=536870912
            PRAM0: vBaseEnvHwRegionSize=262144, vBaseEnvHwRegionStartAddress=541065216
            PRAM1: vBaseEnvHwRegionSize=262144, vBaseEnvHwRegionStartAddress=541327360
            PRAM2: vBaseEnvHwRegionSize=262144, vBaseEnvHwRegionStartAddress=541589504
            ITCM2: vBaseEnvHwRegionSize=65536, vBaseEnvHwRegionStartAddress=0
            DTCM2: vBaseEnvHwRegionSize=131072, vBaseEnvHwRegionStartAddress=536870912
          vBaseEnvClockSettings: vBaseEnvOscClock=16000000, vBaseEnvTimebaseClock=240000000, vBaseEnvPeriphClock=240000000
        S32K348: vBaseEnvCpuMaxFrequency=160000000, vBaseEnvAvailableChannels_Can=8, vBaseEnvAvailableChannels_Lin=16, vBaseEnvAvailableChannels_Ethernet=1, vBaseEnvCpuCoreAmount=2, vBaseEnvTestedDerivative=S32K348, vBaseEnvTestedDerivativeDescription=NXP S32K348
          Program_Flash (vBaseEnvMemLayoutHwRegion): vBaseEnvHwRegionStartAddress=4194304, vBaseEnvHwRegionSize=8388608, vBaseEnvHwRegionEccAlignment=4, vBaseEnvHwRegionType=ROM
          Data_Flash (vBaseEnvMemLayoutHwRegion): vBaseEnvHwRegionStartAddress=268435456, vBaseEnvHwRegionSize=131072, vBaseEnvHwRegionEccAlignment=4, vBaseEnvHwRegionType=ROM
          vBaseEnvAdditionalParameters: vBaseEnvPllGroup=B, vBaseEnvPortGroup=B, vBaseEnvResetGroup=B, vBaseEnvDerivativeGroup=S32K3X8
          7 x vBaseEnvMemLayoutHwRegion, all with vBaseEnvHwRegionEccAlignment=8, vBaseEnvHwRegionType=RAM:
            ITCM0: vBaseEnvHwRegionSize=65536, vBaseEnvHwRegionStartAddress=0
            DTCM0: vBaseEnvHwRegionSize=131072, vBaseEnvHwRegionStartAddress=536870912
            PRAM0: vBaseEnvHwRegionSize=262144, vBaseEnvHwRegionStartAddress=541065216
            PRAM1: vBaseEnvHwRegionSize=262144, vBaseEnvHwRegionStartAddress=541327360
            PRAM2: vBaseEnvHwRegionSize=262144, vBaseEnvHwRegionStartAddress=541589504
            ITCM2: vBaseEnvHwRegionSize=65536, vBaseEnvHwRegionStartAddress=293601280
            DTCM2: vBaseEnvHwRegionSize=131072, vBaseEnvHwRegionStartAddress=562036736
          vBaseEnvClockSettings: vBaseEnvOscClock=16000000, vBaseEnvTimebaseClock=240000000, vBaseEnvPeriphClock=240000000
        S32K344: vBaseEnvCpuMaxFrequency=160000000, vBaseEnvAvailableChannels_Can=6, vBaseEnvAvailableChannels_Lin=16, vBaseEnvAvailableChannels_Ethernet=1, vBaseEnvCpuCoreAmount=2, vBaseEnvTestedDerivative=S32K344, vBaseEnvTestedDerivativeDescription=NXP S32K344
          Program_Flash (vBaseEnvMemLayoutHwRegion): vBaseEnvHwRegionStartAddress=4194304, vBaseEnvHwRegionSize=4194304, vBaseEnvHwRegionEccAlignment=4, vBaseEnvHwRegionType=ROM
          Data_Flash (vBaseEnvMemLayoutHwRegion): vBaseEnvHwRegionStartAddress=268435456, vBaseEnvHwRegionSize=131072, vBaseEnvHwRegionEccAlignment=4, vBaseEnvHwRegionType=ROM
          vBaseEnvAdditionalParameters: vBaseEnvPllGroup=B, vBaseEnvPortGroup=B, vBaseEnvResetGroup=B, vBaseEnvDerivativeGroup=S32K34X
          4 x vBaseEnvMemLayoutHwRegion, all with vBaseEnvHwRegionEccAlignment=8, vBaseEnvHwRegionType=RAM:
            ITCM0: vBaseEnvHwRegionSize=65536, vBaseEnvHwRegionStartAddress=0
            DTCM0: vBaseEnvHwRegionSize=131072, vBaseEnvHwRegionStartAddress=536870912
            PRAM0: vBaseEnvHwRegionSize=163840, vBaseEnvHwRegionStartAddress=541065216
            PRAM1: vBaseEnvHwRegionSize=163840, vBaseEnvHwRegionStartAddress=541229056
          vBaseEnvClockSettings: vBaseEnvOscClock=16000000, vBaseEnvTimebaseClock=160000000, vBaseEnvPeriphClock=160000000
        S32K342: vBaseEnvCpuMaxFrequency=160000000, vBaseEnvAvailableChannels_Can=4, vBaseEnvAvailableChannels_Lin=4, vBaseEnvAvailableChannels_Ethernet=1, vBaseEnvCpuCoreAmount=2, vBaseEnvTestedDerivative=S32K342, vBaseEnvTestedDerivativeDescription=NXP S32K342
          Program_Flash (vBaseEnvMemLayoutHwRegion): vBaseEnvHwRegionStartAddress=4194304, vBaseEnvHwRegionSize=2097152, vBaseEnvHwRegionEccAlignment=4, vBaseEnvHwRegionType=ROM
          Data_Flash (vBaseEnvMemLayoutHwRegion): vBaseEnvHwRegionStartAddress=268435456, vBaseEnvHwRegionSize=131072, vBaseEnvHwRegionEccAlignment=4, vBaseEnvHwRegionType=ROM
          vBaseEnvAdditionalParameters: vBaseEnvPllGroup=B, vBaseEnvPortGroup=B, vBaseEnvResetGroup=B, vBaseEnvDerivativeGroup=S32K34X
          3 x vBaseEnvMemLayoutHwRegion, all with vBaseEnvHwRegionEccAlignment=8, vBaseEnvHwRegionType=RAM:
            ITCM0: vBaseEnvHwRegionSize=65536, vBaseEnvHwRegionStartAddress=0
            DTCM0: vBaseEnvHwRegionSize=131072, vBaseEnvHwRegionStartAddress=536870912
            PRAM0: vBaseEnvHwRegionSize=65536, vBaseEnvHwRegionStartAddress=541065216
          vBaseEnvClockSettings: vBaseEnvOscClock=16000000, vBaseEnvTimebaseClock=160000000, vBaseEnvPeriphClock=160000000
        S32K341: vBaseEnvCpuMaxFrequency=160000000, vBaseEnvAvailableChannels_Can=4, vBaseEnvAvailableChannels_Lin=4, vBaseEnvAvailableChannels_Ethernet=1, vBaseEnvCpuCoreAmount=2, vBaseEnvTestedDerivative=S32K341, vBaseEnvTestedDerivativeDescription=NXP S32K341
          Program_Flash (vBaseEnvMemLayoutHwRegion): vBaseEnvHwRegionStartAddress=4194304, vBaseEnvHwRegionSize=1048576, vBaseEnvHwRegionEccAlignment=4, vBaseEnvHwRegionType=ROM
          Data_Flash (vBaseEnvMemLayoutHwRegion): vBaseEnvHwRegionStartAddress=268435456, vBaseEnvHwRegionSize=131072, vBaseEnvHwRegionEccAlignment=4, vBaseEnvHwRegionType=ROM
          vBaseEnvAdditionalParameters: vBaseEnvPllGroup=B, vBaseEnvPortGroup=B, vBaseEnvResetGroup=B, vBaseEnvDerivativeGroup=S32K34X
          3 x vBaseEnvMemLayoutHwRegion, all with vBaseEnvHwRegionEccAlignment=8, vBaseEnvHwRegionType=RAM:
            ITCM0: vBaseEnvHwRegionSize=65536, vBaseEnvHwRegionStartAddress=0
            DTCM0: vBaseEnvHwRegionSize=131072, vBaseEnvHwRegionStartAddress=536870912
            PRAM0: vBaseEnvHwRegionSize=65536, vBaseEnvHwRegionStartAddress=541065216
          vBaseEnvClockSettings: vBaseEnvOscClock=16000000, vBaseEnvTimebaseClock=160000000, vBaseEnvPeriphClock=160000000
        S32K338: vBaseEnvCpuMaxFrequency=240000000, vBaseEnvAvailableChannels_Can=8, vBaseEnvAvailableChannels_Lin=16, vBaseEnvAvailableChannels_Ethernet=1, vBaseEnvCpuCoreAmount=3, vBaseEnvTestedDerivative=S32K338, vBaseEnvTestedDerivativeDescription=NXP S32K338
          Program_Flash (vBaseEnvMemLayoutHwRegion): vBaseEnvHwRegionStartAddress=4194304, vBaseEnvHwRegionSize=8388608, vBaseEnvHwRegionEccAlignment=4, vBaseEnvHwRegionType=ROM
          Data_Flash (vBaseEnvMemLayoutHwRegion): vBaseEnvHwRegionStartAddress=268435456, vBaseEnvHwRegionSize=131072, vBaseEnvHwRegionEccAlignment=4, vBaseEnvHwRegionType=ROM
          vBaseEnvAdditionalParameters: vBaseEnvPllGroup=B, vBaseEnvPortGroup=B, vBaseEnvResetGroup=B, vBaseEnvDerivativeGroup=S32K3X8
          9 x vBaseEnvMemLayoutHwRegion, all with vBaseEnvHwRegionEccAlignment=8, vBaseEnvHwRegionType=RAM:
            ITCM0: vBaseEnvHwRegionSize=32768, vBaseEnvHwRegionStartAddress=0
            DTCM0: vBaseEnvHwRegionSize=65536, vBaseEnvHwRegionStartAddress=536870912
            PRAM0: vBaseEnvHwRegionSize=262144, vBaseEnvHwRegionStartAddress=541065216
            PRAM1: vBaseEnvHwRegionSize=262144, vBaseEnvHwRegionStartAddress=541327360
            PRAM2: vBaseEnvHwRegionSize=262144, vBaseEnvHwRegionStartAddress=541589504
            ITCM1: vBaseEnvHwRegionSize=32768, vBaseEnvHwRegionStartAddress=0
            ITCM2: vBaseEnvHwRegionSize=65536, vBaseEnvHwRegionStartAddress=0
            DTCM1: vBaseEnvHwRegionSize=65536, vBaseEnvHwRegionStartAddress=536870912
            DTCM2: vBaseEnvHwRegionSize=131072, vBaseEnvHwRegionStartAddress=536870912
          vBaseEnvClockSettings: vBaseEnvOscClock=16000000, vBaseEnvTimebaseClock=240000000, vBaseEnvPeriphClock=240000000
        S32K328: vBaseEnvCpuMaxFrequency=160000000, vBaseEnvAvailableChannels_Can=8, vBaseEnvAvailableChannels_Lin=16, vBaseEnvAvailableChannels_Ethernet=1, vBaseEnvCpuCoreAmount=2, vBaseEnvTestedDerivative=S32K328, vBaseEnvTestedDerivativeDescription=NXP S32K328
          Program_Flash (vBaseEnvMemLayoutHwRegion): vBaseEnvHwRegionStartAddress=4194304, vBaseEnvHwRegionSize=8388608, vBaseEnvHwRegionEccAlignment=4, vBaseEnvHwRegionType=ROM
          Data_Flash (vBaseEnvMemLayoutHwRegion): vBaseEnvHwRegionStartAddress=268435456, vBaseEnvHwRegionSize=131072, vBaseEnvHwRegionEccAlignment=4, vBaseEnvHwRegionType=ROM
          vBaseEnvAdditionalParameters: vBaseEnvPllGroup=B, vBaseEnvPortGroup=B, vBaseEnvResetGroup=B, vBaseEnvDerivativeGroup=S32K3X8
          9 x vBaseEnvMemLayoutHwRegion, all with vBaseEnvHwRegionEccAlignment=8, vBaseEnvHwRegionType=RAM:
            ITCM0: vBaseEnvHwRegionSize=32768, vBaseEnvHwRegionStartAddress=0
            DTCM0: vBaseEnvHwRegionSize=65536, vBaseEnvHwRegionStartAddress=536870912
            PRAM0: vBaseEnvHwRegionSize=262144, vBaseEnvHwRegionStartAddress=541065216
            PRAM1: vBaseEnvHwRegionSize=262144, vBaseEnvHwRegionStartAddress=541327360
            ITCM1: vBaseEnvHwRegionSize=32768, vBaseEnvHwRegionStartAddress=0
            ITCM2: vBaseEnvHwRegionSize=65536, vBaseEnvHwRegionStartAddress=293601280
            PRAM2: vBaseEnvHwRegionSize=262144, vBaseEnvHwRegionStartAddress=541589504
            DTCM1: vBaseEnvHwRegionSize=65536, vBaseEnvHwRegionStartAddress=536870912
            DTCM2: vBaseEnvHwRegionSize=131072, vBaseEnvHwRegionStartAddress=562036736
          vBaseEnvClockSettings: vBaseEnvOscClock=16000000, vBaseEnvTimebaseClock=160000000, vBaseEnvPeriphClock=160000000
        S32K324: vBaseEnvCpuMaxFrequency=160000000, vBaseEnvAvailableChannels_Can=6, vBaseEnvAvailableChannels_Lin=16, vBaseEnvAvailableChannels_Ethernet=1, vBaseEnvCpuCoreAmount=2, vBaseEnvTestedDerivative=S32K324, vBaseEnvTestedDerivativeDescription=NXP S32K324
          Program_Flash (vBaseEnvMemLayoutHwRegion): vBaseEnvHwRegionStartAddress=4194304, vBaseEnvHwRegionSize=4194304, vBaseEnvHwRegionEccAlignment=4, vBaseEnvHwRegionType=ROM
          Data_Flash (vBaseEnvMemLayoutHwRegion): vBaseEnvHwRegionStartAddress=268435456, vBaseEnvHwRegionSize=131072, vBaseEnvHwRegionEccAlignment=4, vBaseEnvHwRegionType=ROM
          vBaseEnvAdditionalParameters: vBaseEnvPllGroup=B, vBaseEnvPortGroup=B, vBaseEnvResetGroup=B, vBaseEnvDerivativeGroup=S32K32X
          6 x vBaseEnvMemLayoutHwRegion, all with vBaseEnvHwRegionEccAlignment=8, vBaseEnvHwRegionType=RAM:
            ITCM0: vBaseEnvHwRegionSize=32768, vBaseEnvHwRegionStartAddress=0
            DTCM0: vBaseEnvHwRegionSize=65536, vBaseEnvHwRegionStartAddress=536870912
            PRAM0: vBaseEnvHwRegionSize=163840, vBaseEnvHwRegionStartAddress=541065216
            PRAM1: vBaseEnvHwRegionSize=163840, vBaseEnvHwRegionStartAddress=541229056
            ITCM1: vBaseEnvHwRegionSize=32768, vBaseEnvHwRegionStartAddress=0
            DTCM1: vBaseEnvHwRegionSize=65536, vBaseEnvHwRegionStartAddress=536870912
          vBaseEnvClockSettings: vBaseEnvOscClock=16000000, vBaseEnvTimebaseClock=160000000, vBaseEnvPeriphClock=160000000
        S32K322: vBaseEnvCpuMaxFrequency=160000000, vBaseEnvAvailableChannels_Can=4, vBaseEnvAvailableChannels_Lin=4, vBaseEnvAvailableChannels_Ethernet=1, vBaseEnvCpuCoreAmount=2, vBaseEnvTestedDerivative=S32K322, vBaseEnvTestedDerivativeDescription=NXP S32K322
          Program_Flash (vBaseEnvMemLayoutHwRegion): vBaseEnvHwRegionStartAddress=4194304, vBaseEnvHwRegionSize=2097152, vBaseEnvHwRegionEccAlignment=4, vBaseEnvHwRegionType=ROM
          Data_Flash (vBaseEnvMemLayoutHwRegion): vBaseEnvHwRegionStartAddress=268435456, vBaseEnvHwRegionSize=131072, vBaseEnvHwRegionEccAlignment=4, vBaseEnvHwRegionType=ROM
          vBaseEnvAdditionalParameters: vBaseEnvPllGroup=B, vBaseEnvPortGroup=B, vBaseEnvResetGroup=B, vBaseEnvDerivativeGroup=S32K32X
          5 x vBaseEnvMemLayoutHwRegion, all with vBaseEnvHwRegionEccAlignment=8, vBaseEnvHwRegionType=RAM:
            ITCM0: vBaseEnvHwRegionSize=32768, vBaseEnvHwRegionStartAddress=0
            DTCM0: vBaseEnvHwRegionSize=65536, vBaseEnvHwRegionStartAddress=536870912
            PRAM0: vBaseEnvHwRegionSize=65536, vBaseEnvHwRegionStartAddress=541065216
            DTCM1: vBaseEnvHwRegionSize=65536, vBaseEnvHwRegionStartAddress=536870912
            ITCM1: vBaseEnvHwRegionSize=32768, vBaseEnvHwRegionStartAddress=0
          vBaseEnvClockSettings: vBaseEnvOscClock=16000000, vBaseEnvTimebaseClock=160000000, vBaseEnvPeriphClock=160000000
        S32K314: vBaseEnvCpuMaxFrequency=160000000, vBaseEnvAvailableChannels_Can=6, vBaseEnvAvailableChannels_Lin=16, vBaseEnvAvailableChannels_Ethernet=1, vBaseEnvCpuCoreAmount=1, vBaseEnvTestedDerivative=S32K314, vBaseEnvTestedDerivativeDescription=NXP S32K314
          Program_Flash (vBaseEnvMemLayoutHwRegion): vBaseEnvHwRegionStartAddress=4194304, vBaseEnvHwRegionSize=4194304, vBaseEnvHwRegionEccAlignment=4, vBaseEnvHwRegionType=ROM
          Data_Flash (vBaseEnvMemLayoutHwRegion): vBaseEnvHwRegionStartAddress=268435456, vBaseEnvHwRegionSize=131072, vBaseEnvHwRegionEccAlignment=4, vBaseEnvHwRegionType=ROM
          vBaseEnvAdditionalParameters: vBaseEnvPllGroup=B, vBaseEnvPortGroup=B, vBaseEnvResetGroup=B, vBaseEnvDerivativeGroup=S32K31X
          6 x vBaseEnvMemLayoutHwRegion, all with vBaseEnvHwRegionEccAlignment=8, vBaseEnvHwRegionType=RAM:
            ITCM0: vBaseEnvHwRegionSize=32768, vBaseEnvHwRegionStartAddress=0
            DTCM0: vBaseEnvHwRegionSize=65536, vBaseEnvHwRegionStartAddress=536870912
            PRAM0: vBaseEnvHwRegionSize=163840, vBaseEnvHwRegionStartAddress=541065216
            PRAM1: vBaseEnvHwRegionSize=163840, vBaseEnvHwRegionStartAddress=541229056
            ITCM1: vBaseEnvHwRegionSize=32768, vBaseEnvHwRegionStartAddress=289406976
            DTCM1: vBaseEnvHwRegionSize=65536, vBaseEnvHwRegionStartAddress=557842432
          vBaseEnvClockSettings: vBaseEnvOscClock=16000000, vBaseEnvTimebaseClock=160000000, vBaseEnvPeriphClock=160000000
        S32K312: vBaseEnvCpuMaxFrequency=120000000, vBaseEnvAvailableChannels_Can=6, vBaseEnvAvailableChannels_Lin=8, vBaseEnvAvailableChannels_Ethernet=0, vBaseEnvCpuCoreAmount=1, vBaseEnvTestedDerivative=S32K312, vBaseEnvTestedDerivativeDescription=NXP S32K312
          Program_Flash (vBaseEnvMemLayoutHwRegion): vBaseEnvHwRegionStartAddress=4194304, vBaseEnvHwRegionSize=2097152, vBaseEnvHwRegionEccAlignment=4, vBaseEnvHwRegionType=ROM
          Data_Flash (vBaseEnvMemLayoutHwRegion): vBaseEnvHwRegionStartAddress=268435456, vBaseEnvHwRegionSize=131072, vBaseEnvHwRegionEccAlignment=4, vBaseEnvHwRegionType=ROM
          vBaseEnvAdditionalParameters: vBaseEnvPllGroup=C, vBaseEnvPortGroup=B, vBaseEnvResetGroup=B, vBaseEnvDerivativeGroup=S32K31X
          3 x vBaseEnvMemLayoutHwRegion, all with vBaseEnvHwRegionEccAlignment=8, vBaseEnvHwRegionType=RAM:
            ITCM0: vBaseEnvHwRegionSize=32768, vBaseEnvHwRegionStartAddress=0
            DTCM0: vBaseEnvHwRegionSize=65536, vBaseEnvHwRegionStartAddress=536870912
            PRAM0: vBaseEnvHwRegionSize=98304, vBaseEnvHwRegionStartAddress=541065216
          vBaseEnvClockSettings: vBaseEnvOscClock=16000000, vBaseEnvTimebaseClock=120000000, vBaseEnvPeriphClock=120000000
        S32K311: vBaseEnvCpuMaxFrequency=120000000, vBaseEnvAvailableChannels_Can=3, vBaseEnvAvailableChannels_Lin=4, vBaseEnvAvailableChannels_Ethernet=0, vBaseEnvCpuCoreAmount=1, vBaseEnvTestedDerivative=S32K311, vBaseEnvTestedDerivativeDescription=NXP S32K311
          Program_Flash (vBaseEnvMemLayoutHwRegion): vBaseEnvHwRegionStartAddress=4194304, vBaseEnvHwRegionSize=1048576, vBaseEnvHwRegionEccAlignment=4, vBaseEnvHwRegionType=ROM
          Data_Flash (vBaseEnvMemLayoutHwRegion): vBaseEnvHwRegionStartAddress=268435456, vBaseEnvHwRegionSize=65536, vBaseEnvHwRegionEccAlignment=4, vBaseEnvHwRegionType=ROM
          vBaseEnvAdditionalParameters: vBaseEnvPllGroup=C, vBaseEnvPortGroup=B, vBaseEnvResetGroup=B, vBaseEnvDerivativeGroup=S32K31X
          3 x vBaseEnvMemLayoutHwRegion, all with vBaseEnvHwRegionEccAlignment=8, vBaseEnvHwRegionType=RAM:
            ITCM0: vBaseEnvHwRegionSize=32768, vBaseEnvHwRegionStartAddress=0
            DTCM0: vBaseEnvHwRegionSize=65536, vBaseEnvHwRegionStartAddress=536870912
            PRAM0: vBaseEnvHwRegionSize=32768, vBaseEnvHwRegionStartAddress=541065216
          vBaseEnvClockSettings: vBaseEnvOscClock=16000000, vBaseEnvTimebaseClock=120000000, vBaseEnvPeriphClock=120000000
        S32K310: vBaseEnvCpuMaxFrequency=120000000, vBaseEnvAvailableChannels_Can=3, vBaseEnvAvailableChannels_Lin=4, vBaseEnvAvailableChannels_Ethernet=0, vBaseEnvCpuCoreAmount=1, vBaseEnvTestedDerivative=S32K310, vBaseEnvTestedDerivativeDescription=NXP S32K310
          Program_Flash (vBaseEnvMemLayoutHwRegion): vBaseEnvHwRegionStartAddress=4194304, vBaseEnvHwRegionSize=524288, vBaseEnvHwRegionEccAlignment=4, vBaseEnvHwRegionType=ROM
          Data_Flash (vBaseEnvMemLayoutHwRegion): vBaseEnvHwRegionStartAddress=268435456, vBaseEnvHwRegionSize=65536, vBaseEnvHwRegionEccAlignment=4, vBaseEnvHwRegionType=ROM
          vBaseEnvAdditionalParameters: vBaseEnvPllGroup=C, vBaseEnvPortGroup=B, vBaseEnvResetGroup=B, vBaseEnvDerivativeGroup=S32K31X
          3 x vBaseEnvMemLayoutHwRegion, all with vBaseEnvHwRegionEccAlignment=8, vBaseEnvHwRegionType=RAM:
            ITCM0: vBaseEnvHwRegionSize=32768, vBaseEnvHwRegionStartAddress=0
            DTCM0: vBaseEnvHwRegionSize=65536, vBaseEnvHwRegionStartAddress=536870912
            PRAM0: vBaseEnvHwRegionSize=16384, vBaseEnvHwRegionStartAddress=541065216
          vBaseEnvClockSettings: vBaseEnvOscClock=16000000, vBaseEnvTimebaseClock=120000000, vBaseEnvPeriphClock=120000000
        MWCT2015S: vBaseEnvCpuMaxFrequency=120000000, vBaseEnvAvailableChannels_Can=3, vBaseEnvAvailableChannels_Lin=4, vBaseEnvAvailableChannels_Ethernet=0, vBaseEnvCpuCoreAmount=1, vBaseEnvTestedDerivative=MWCT2015S, vBaseEnvTestedDerivativeDescription=NXP MWCT2015S
          Program_Flash (vBaseEnvMemLayoutHwRegion): vBaseEnvHwRegionStartAddress=4194304, vBaseEnvHwRegionSize=1048576, vBaseEnvHwRegionEccAlignment=4, vBaseEnvHwRegionType=ROM
          Data_Flash (vBaseEnvMemLayoutHwRegion): vBaseEnvHwRegionStartAddress=268435456, vBaseEnvHwRegionSize=65536, vBaseEnvHwRegionEccAlignment=4, vBaseEnvHwRegionType=ROM
          vBaseEnvAdditionalParameters: vBaseEnvPllGroup=C, vBaseEnvPortGroup=B, vBaseEnvResetGroup=B, vBaseEnvDerivativeGroup=MWCT201XX
          3 x vBaseEnvMemLayoutHwRegion, all with vBaseEnvHwRegionEccAlignment=8, vBaseEnvHwRegionType=RAM:
            ITCM0: vBaseEnvHwRegionSize=32768, vBaseEnvHwRegionStartAddress=0
            DTCM0: vBaseEnvHwRegionSize=65536, vBaseEnvHwRegionStartAddress=536870912
            PRAM0: vBaseEnvHwRegionSize=32768, vBaseEnvHwRegionStartAddress=541065216
          vBaseEnvClockSettings: vBaseEnvOscClock=16000000, vBaseEnvTimebaseClock=120000000, vBaseEnvPeriphClock=120000000
        MWCT2016S: vBaseEnvCpuMaxFrequency=120000000, vBaseEnvAvailableChannels_Can=6, vBaseEnvAvailableChannels_Lin=8, vBaseEnvAvailableChannels_Ethernet=0, vBaseEnvCpuCoreAmount=1, vBaseEnvTestedDerivative=MWCT2016S, vBaseEnvTestedDerivativeDescription=NXP MWCT2016S
          Program_Flash (vBaseEnvMemLayoutHwRegion): vBaseEnvHwRegionStartAddress=4194304, vBaseEnvHwRegionSize=2097152, vBaseEnvHwRegionEccAlignment=4, vBaseEnvHwRegionType=ROM
          Data_Flash (vBaseEnvMemLayoutHwRegion): vBaseEnvHwRegionStartAddress=268435456, vBaseEnvHwRegionSize=131072, vBaseEnvHwRegionEccAlignment=4, vBaseEnvHwRegionType=ROM
          vBaseEnvAdditionalParameters: vBaseEnvPllGroup=C, vBaseEnvPortGroup=B, vBaseEnvResetGroup=B, vBaseEnvDerivativeGroup=MWCT201XX
          3 x vBaseEnvMemLayoutHwRegion, all with vBaseEnvHwRegionEccAlignment=8, vBaseEnvHwRegionType=RAM:
            ITCM0: vBaseEnvHwRegionSize=32768, vBaseEnvHwRegionStartAddress=0
            DTCM0: vBaseEnvHwRegionSize=65536, vBaseEnvHwRegionStartAddress=536870912
            PRAM0: vBaseEnvHwRegionSize=98304, vBaseEnvHwRegionStartAddress=541065216
          vBaseEnvClockSettings: vBaseEnvOscClock=16000000, vBaseEnvTimebaseClock=120000000, vBaseEnvPeriphClock=120000000
        MWCT2D16S: vBaseEnvCpuMaxFrequency=160000000, vBaseEnvAvailableChannels_Can=4, vBaseEnvAvailableChannels_Lin=4, vBaseEnvAvailableChannels_Ethernet=1, vBaseEnvCpuCoreAmount=2, vBaseEnvTestedDerivative=MWCT2D16S, vBaseEnvTestedDerivativeDescription=NXP MWCT2D16S
          Program_Flash (vBaseEnvMemLayoutHwRegion): vBaseEnvHwRegionStartAddress=4194304, vBaseEnvHwRegionSize=2097152, vBaseEnvHwRegionEccAlignment=4, vBaseEnvHwRegionType=ROM
          Data_Flash (vBaseEnvMemLayoutHwRegion): vBaseEnvHwRegionStartAddress=268435456, vBaseEnvHwRegionSize=131072, vBaseEnvHwRegionEccAlignment=4, vBaseEnvHwRegionType=ROM
          vBaseEnvAdditionalParameters: vBaseEnvPllGroup=B, vBaseEnvPortGroup=B, vBaseEnvResetGroup=B, vBaseEnvDerivativeGroup=MWCT2D1XX
          5 x vBaseEnvMemLayoutHwRegion, all with vBaseEnvHwRegionEccAlignment=8, vBaseEnvHwRegionType=RAM:
            ITCM0: vBaseEnvHwRegionSize=32768, vBaseEnvHwRegionStartAddress=0
            DTCM0: vBaseEnvHwRegionSize=65536, vBaseEnvHwRegionStartAddress=536870912
            PRAM0: vBaseEnvHwRegionSize=65536, vBaseEnvHwRegionStartAddress=541065216
            ITCM1: vBaseEnvHwRegionSize=32768, vBaseEnvHwRegionStartAddress=0
            DTCM1: vBaseEnvHwRegionSize=65536, vBaseEnvHwRegionStartAddress=536870912
          vBaseEnvClockSettings: vBaseEnvOscClock=16000000, vBaseEnvTimebaseClock=160000000, vBaseEnvPeriphClock=160000000
        MWCT2D17S: vBaseEnvCpuMaxFrequency=160000000, vBaseEnvAvailableChannels_Can=6, vBaseEnvAvailableChannels_Lin=16, vBaseEnvAvailableChannels_Ethernet=1, vBaseEnvCpuCoreAmount=2, vBaseEnvTestedDerivative=MWCT2D17S, vBaseEnvTestedDerivativeDescription=NXP MWCT2D17S
          Program_Flash (vBaseEnvMemLayoutHwRegion): vBaseEnvHwRegionStartAddress=4194304, vBaseEnvHwRegionSize=4194304, vBaseEnvHwRegionEccAlignment=4, vBaseEnvHwRegionType=ROM
          Data_Flash (vBaseEnvMemLayoutHwRegion): vBaseEnvHwRegionStartAddress=268435456, vBaseEnvHwRegionSize=131072, vBaseEnvHwRegionEccAlignment=4, vBaseEnvHwRegionType=ROM
          vBaseEnvAdditionalParameters: vBaseEnvPllGroup=B, vBaseEnvPortGroup=B, vBaseEnvResetGroup=B, vBaseEnvDerivativeGroup=MWCT2D1XX
          6 x vBaseEnvMemLayoutHwRegion, all with vBaseEnvHwRegionEccAlignment=8, vBaseEnvHwRegionType=RAM:
            ITCM0: vBaseEnvHwRegionSize=32768, vBaseEnvHwRegionStartAddress=0
            DTCM0: vBaseEnvHwRegionSize=65536, vBaseEnvHwRegionStartAddress=536870912
            PRAM0: vBaseEnvHwRegionSize=163840, vBaseEnvHwRegionStartAddress=541065216
            PRAM1: vBaseEnvHwRegionSize=163840, vBaseEnvHwRegionStartAddress=541229056
            ITCM1: vBaseEnvHwRegionSize=32768, vBaseEnvHwRegionStartAddress=0
            DTCM1: vBaseEnvHwRegionSize=65536, vBaseEnvHwRegionStartAddress=536870912
          vBaseEnvClockSettings: vBaseEnvOscClock=16000000, vBaseEnvTimebaseClock=160000000, vBaseEnvPeriphClock=160000000
      11 x vBaseEnvMemLayoutHwRegion:
        Program_Flash
        Data_Flash
        ITCM{0..2}
        DTCM{0..2}
        PRAM{0..2}
