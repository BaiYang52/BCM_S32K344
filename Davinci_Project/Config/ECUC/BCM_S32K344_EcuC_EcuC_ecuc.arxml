AUTOSAR XML (schema 00050)
package /ActiveEcuC
  module config EcuC: implementation-config-variant=VARIANT-PRE-COMPILE, module-description=EcuC_Impl
    EcucGeneral:
      DummyFunction = false
      DummyStatement = true
      StructAlignment = Auto
      ArrayAlignment = Auto
      StructInArrayAlignment = Auto
      SizeOfEnum = Size32Bit
      SizeOfROMPointer = Size32Bit
      SizeOfRAMPointer = Size32Bit
      DummyStatementKind = SelfAssignment
      AtomicBitAccessInBitfield = false
      AtomicVariableAccess = Atomic32BitAccess
      CPUType = CPU32Bit
      SizeOfInt = Size32Bit
      ByteOrder = LITTLE_ENDIAN
      BitOrder = LSB_to_MSB
      BitFieldDataType = INT
      ConditionalGenerating = true
      EcucBswImplementationCodeType = EcuCSourceCode
      EcuCUseStdReturnTypeForRte = false
      BswInitialization
        20 x InitFunction:
          OsIf_Init: Header=OsIf.h, InitPhase=INIT_ONE, ConfigType=Base_ConfigType, ConfigPtrClass=BASE_APPL_CONST, ConfigPtrName=NULL_PTR, ModuleRef=Base  # /ActiveEcuC/Base PLAIN_TEXT Created OsIf_Init by Extended Init XML Service
          BswM_InitMemory: Header=BswM.h, InitPhase=INIT_MEMORY, ModuleRef=BswM  # /ActiveEcuC/BswM PLAIN_TEXT InitMemory function description of BswM in UnfilteredViewInInvariantProject (UnfilteredInvariantProjectModelView) .
          BswM_PreInit: Header=BswM.h, InitPhase=INIT_ONE, ConfigType=BswM_ConfigType, ConfigPtrClass=BSWM_INIT_DATA, ConfigPtrName=BswM_Config_Ptr, ModuleRef=BswM  # /ActiveEcuC/BswM PLAIN_TEXT PreInit function description of BswM in UnfilteredViewInInvariantProject (UnfilteredInvariantProjectModelView) .
          BswM_Init: Header=BswM.h, InitPhase=NO_INIT, ConfigType=BswM_ConfigType, ConfigPtrClass=BSWM_INIT_DATA, ConfigPtrName=BswM_Config_Ptr, ModuleRef=BswM  # /ActiveEcuC/BswM PLAIN_TEXT Init function description of BswM in UnfilteredViewInInvariantProject (UnfilteredInvariantProjectModelView) .
          Det_InitMemory: Header=Det.h, InitPhase=INIT_MEMORY, ModuleRef=Det  # /ActiveEcuC/Det PLAIN_TEXT InitMemory function description of Det in UnfilteredViewInInvariantProject (UnfilteredInvariantProjectModelView) .
          Det_Init: Header=Det.h, InitPhase=INIT_ZERO, ConfigType=Det_ConfigType, ConfigPtrClass=DET_INIT_DATA, ConfigPtrName=Det_Config_Ptr, ModuleRef=Det  # /ActiveEcuC/Det PLAIN_TEXT Init function description of Det in UnfilteredViewInInvariantProject (UnfilteredInvariantProjectModelView) .
          EcuM_Init: Header=EcuM.h, InitPhase=NO_INIT, ConfigType=EcuM_PbConfigType, ConfigPtrClass=ECUM_INIT_DATA, ConfigPtrName=EcuM_Config_Ptr, ModuleRef=EcuM  # /ActiveEcuC/EcuM PLAIN_TEXT Init function description of EcuM in UnfilteredViewInInvariantProject (UnfilteredInvariantProjectModelView) .
          Mcu_Init: Header=Mcu.h, InitPhase=INIT_ONE, ConfigType=Mcu_ConfigType, ConfigPtrClass=MCU_APPL_CONST, ConfigPtrName=&Mcu_Config, AdditionalInitCode=Mcu_InitClock(McuConf_McuClockSettingConfig_McuClockSettingConfig_0);while (MCU_PLL_LOCKED != Mcu_GetPllStatus());Mcu_DistributePllClock();Mcu_SetMode(McuConf_McuModeSettingConf_McuModeSettingConf_0);, ModuleRef=Mcu  # /ActiveEcuC/Mcu PLAIN_TEXT Created Mcu_Init by Extended Init XML Service
          Resource_Init: Header=Resource.h, InitPhase=NO_INIT, ModuleRef=Resource  # /ActiveEcuC/Resource PLAIN_TEXT Created Resource_Init by Extended Init XML Service
          SchM_Init: Header=Rte_Main.h, InitPhase=NO_INIT, ModuleRef=Rte  # /ActiveEcuC/Rte PLAIN_TEXT Automatically generated by BswInitFctConfigurationService.
          SchM_StartTiming: Header=Rte_Main.h, InitPhase=NO_INIT, ModuleRef=Rte  # /ActiveEcuC/Rte PLAIN_TEXT Automatically generated by BswInitFctConfigurationService.
          Rte_StartTiming: Header=Rte_Main.h, InitPhase=NO_INIT, ModuleRef=Rte  # /ActiveEcuC/Rte PLAIN_TEXT Automatically generated by BswInitFctConfigurationService.
          Rte_InitMemory: Header=Rte_Main.h, InitPhase=INIT_MEMORY, ModuleRef=Rte  # /ActiveEcuC/Rte PLAIN_TEXT Automatically generated by BswInitFctConfigurationService.
          SchM_Start: Header=Rte_Main.h, InitPhase=NO_INIT, ModuleRef=Rte  # /ActiveEcuC/Rte PLAIN_TEXT Automatically generated by BswInitFctConfigurationService.
          Rte_Start: Header=Rte_Main.h, InitPhase=INIT_THREE, ModuleRef=Rte  # /ActiveEcuC/Rte PLAIN_TEXT Automatically generated by BswInitFctConfigurationService.
          Brs_Init: Header=, InitPhase=NO_INIT, ModuleRef=vBRS  # /ActiveEcuC/vBRS PLAIN_TEXT Automatically generated by BswInitFctConfigurationService.
          vBaseEnv_Init: Header=, InitPhase=NO_INIT, ModuleRef=vBaseEnv  # /ActiveEcuC/vBaseEnv PLAIN_TEXT Created vBaseEnv_Init by Extended Init XML Service
          vLinkGen_Init: Header=vLinkGen_Lcfg.h, InitPhase=NO_INIT, ModuleRef=vLinkGen  # /ActiveEcuC/vLinkGen PLAIN_TEXT Dummy initialization of the vLinkGen
          Dio_Init: Header=Dio.h, InitPhase=NO_INIT, ModuleRef=Dio  # /ActiveEcuC/Dio PLAIN_TEXT Created Dio_Init by Extended Init XML Service
          Port_Init: Header=Port.h, InitPhase=INIT_ONE_EARLY, ConfigType=Port_ConfigType, ConfigPtrClass=PORT_APPL_CONST, ConfigPtrName=NULL_PTR, ModuleRef=Port  # /ActiveEcuC/Port PLAIN_TEXT Created Port_Init by Extended Init XML Service
    EcucHardware
      EcucCoreDefinition: EcucCoreId=0
