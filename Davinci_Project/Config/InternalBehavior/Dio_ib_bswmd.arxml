AUTOSAR XML (schema 00046)
package /TS_T40D34M20I1R0/Dio_ib_bswmd/BswModuleDescriptions
  bsw module description Dio: provided-entrys=Dio_Virtual
    bsw internal behavior DioBehavior
      31 x exclusive area:
        DIO_EXCLUSIVE_AREA_{00..30}
      bsw called entity Dio_Virtual: can-enter-exclusive-area=[DIO_EXCLUSIVE_AREA_00, DIO_EXCLUSIVE_AREA_01, DIO_EXCLUSIVE_AREA_02, DIO_EXCLUSIVE_AREA_03, DIO_EXCLUSIVE_AREA_04, DIO_EXCLUSIVE_AREA_05, DIO_EXCLUSIVE_AREA_06, DIO_EXCLUSIVE_AREA_07, DIO_EXCLUSIVE_AREA_08, DIO_EXCLUSIVE_AREA_09, DIO_EXCLUSIVE_AREA_10, DIO_EXCLUSIVE_AREA_11, DIO_EXCLUSIVE_AREA_12, DIO_EXCLUSIVE_AREA_13, DIO_EXCLUSIVE_AREA_14, DIO_EXCLUSIVE_AREA_15, DIO_EXCLUSIVE_AREA_16, DIO_EXCLUSIVE_AREA_17, DIO_EXCLUSIVE_AREA_18, DIO_EXCLUSIVE_AREA_19, DIO_EXCLUSIVE_AREA_20, DIO_EXCLUSIVE_AREA_21, DIO_EXCLUSIVE_AREA_22, DIO_EXCLUSIVE_AREA_23, DIO_EXCLUSIVE_AREA_24, DIO_EXCLUSIVE_AREA_25, DIO_EXCLUSIVE_AREA_26, DIO_EXCLUSIVE_AREA_27, DIO_EXCLUSIVE_AREA_28, DIO_EXCLUSIVE_AREA_29, DIO_EXCLUSIVE_AREA_30], implemented-entry=Dio_Virtual
  bsw module entry Dio_Virtual: call-type=REGULAR, execution-context=TASK
