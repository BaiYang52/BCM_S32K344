AUTOSAR XML (schema 00048)
package /MICROSAR/Det_ib_bswmd/BswModuleDescriptions
  bsw module description Det: provided-entrys=Det_Virtual
    bsw internal behavior DetBehavior
      exclusive area DET_EXCLUSIVE_AREA_0  # Critical section to guarantee atomic handling of log buffer, requires global interrupt disabling.
      bsw called entity Det_Virtual: can-enter-exclusive-area=DET_EXCLUSIVE_AREA_0, implemented-entry=Det_Virtual
  bsw module entry Det_Virtual: call-type=REGULAR, execution-context=TASK
