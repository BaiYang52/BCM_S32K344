AUTOSAR XML (schema 00046)
package /TS_T40D34M20I1R0/Port_ib_bswmd/BswModuleDescriptions
  bsw module description Port: provided-entrys=Port_Virtual
    bsw internal behavior PortBehavior
      31 x exclusive area:
        PORT_EXCLUSIVE_AREA_{00..30}
      bsw called entity Port_Virtual: can-enter-exclusive-area=[PORT_EXCLUSIVE_AREA_00, PORT_EXCLUSIVE_AREA_01, PORT_EXCLUSIVE_AREA_02, PORT_EXCLUSIVE_AREA_03, PORT_EXCLUSIVE_AREA_04, PORT_EXCLUSIVE_AREA_05, PORT_EXCLUSIVE_AREA_06, PORT_EXCLUSIVE_AREA_07, PORT_EXCLUSIVE_AREA_08, PORT_EXCLUSIVE_AREA_09, PORT_EXCLUSIVE_AREA_10, PORT_EXCLUSIVE_AREA_11, PORT_EXCLUSIVE_AREA_12, PORT_EXCLUSIVE_AREA_13, PORT_EXCLUSIVE_AREA_14, PORT_EXCLUSIVE_AREA_15, PORT_EXCLUSIVE_AREA_16, PORT_EXCLUSIVE_AREA_17, PORT_EXCLUSIVE_AREA_18, PORT_EXCLUSIVE_AREA_19, PORT_EXCLUSIVE_AREA_20, PORT_EXCLUSIVE_AREA_21, PORT_EXCLUSIVE_AREA_22, PORT_EXCLUSIVE_AREA_23, PORT_EXCLUSIVE_AREA_24, PORT_EXCLUSIVE_AREA_25, PORT_EXCLUSIVE_AREA_26, PORT_EXCLUSIVE_AREA_27, PORT_EXCLUSIVE_AREA_28, PORT_EXCLUSIVE_AREA_29, PORT_EXCLUSIVE_AREA_30], implemented-entry=Port_Virtual
  bsw module entry Port_Virtual: call-type=REGULAR, execution-context=TASK
