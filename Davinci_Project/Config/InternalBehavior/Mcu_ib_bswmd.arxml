AUTOSAR XML (schema 00046)
package /TS_T40D34M20I1R0/Mcu_ib_bswmd/BswModuleDescriptions
  bsw module description Mcu: provided-entrys=Mcu_Virtual
    bsw internal behavior McuBehavior
      31 x exclusive area:
        MCU_EXCLUSIVE_AREA_{00..30}
      bsw called entity Mcu_Virtual: can-enter-exclusive-area=[MCU_EXCLUSIVE_AREA_00, MCU_EXCLUSIVE_AREA_01, MCU_EXCLUSIVE_AREA_02, MCU_EXCLUSIVE_AREA_03, MCU_EXCLUSIVE_AREA_04, MCU_EXCLUSIVE_AREA_05, MCU_EXCLUSIVE_AREA_06, MCU_EXCLUSIVE_AREA_07, MCU_EXCLUSIVE_AREA_08, MCU_EXCLUSIVE_AREA_09, MCU_EXCLUSIVE_AREA_10, MCU_EXCLUSIVE_AREA_11, MCU_EXCLUSIVE_AREA_12, MCU_EXCLUSIVE_AREA_13, MCU_EXCLUSIVE_AREA_14, MCU_EXCLUSIVE_AREA_15, MCU_EXCLUSIVE_AREA_16, MCU_EXCLUSIVE_AREA_17, MCU_EXCLUSIVE_AREA_18, MCU_EXCLUSIVE_AREA_19, MCU_EXCLUSIVE_AREA_20, MCU_EXCLUSIVE_AREA_21, MCU_EXCLUSIVE_AREA_22, MCU_EXCLUSIVE_AREA_23, MCU_EXCLUSIVE_AREA_24, MCU_EXCLUSIVE_AREA_25, MCU_EXCLUSIVE_AREA_26, MCU_EXCLUSIVE_AREA_27, MCU_EXCLUSIVE_AREA_28, MCU_EXCLUSIVE_AREA_29, MCU_EXCLUSIVE_AREA_30], implemented-entry=Mcu_Virtual
  bsw module entry Mcu_Virtual: call-type=REGULAR, execution-context=TASK
