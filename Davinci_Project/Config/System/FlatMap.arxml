AUTOSAR XML (schema 00050)
package /COM/VECTOR/CFG/WORKFLOW/SYSDESC/SYNC
  flat map FLATMAP
    flat instance descriptor CtAppSwc: upstream-reference=EcuSwComposition.CtAppSwc, ecu-extract-reference=COMPOSITIONTYPE.CtAppSwc
