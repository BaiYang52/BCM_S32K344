AUTOSAR XML (schema 4-0-3)
package /DaVinci_Project
  module config Rte
    6 x RteBswModuleInstance:
      BswM
        BswM_MainFunctionTimingEvent0 (RteBswEventToTaskMapping): RteBswUsedOsEventRef=Rte_Ev_Cyclic2_AppRunTask_0_10ms, RteBswUsedOsAlarmRef=Os/Rte_Al_TE2_AppRunTask_0_10ms
      Det
      Dio
      EcuM
        EcuM_MainFunctionTimingEvent0 (RteBswEventToTaskMapping): RteBswUsedOsEventRef=Rte_Ev_Cyclic2_AppRunTask_0_10ms, RteBswUsedOsAlarmRef=Os/Rte_Al_TE2_AppRunTask_0_10ms
      Mcu
      Port
    5 x RteSwComponentInstance:
      BswM_EcuSwComposition
        Timer_BswM_MainFunction (RteEventToTaskMapping): RteUsedOsEventRef=Rte_Ev_Cyclic2_AppRunTask_0_10ms, RteUsedOsAlarmRef=Os/Rte_Al_TE2_AppRunTask_0_10ms
      CtAppSwc_EcuSwComposition
        TMT_RCtAppSwc_1000ms (RteEventToTaskMapping): RteUsedOsEventRef=Rte_Ev_Run_CtAppSwc_RCtAppSwc_1000ms, RteUsedOsAlarmRef=Os/Rte_Al_TE_CtAppSwc_RCtAppSwc_1000ms
        TMT_RCtAppSwc_10ms (RteEventToTaskMapping): RteUsedOsEventRef=Rte_Ev_Run_CtAppSwc_RCtAppSwc_10ms, RteUsedOsAlarmRef=Os/Rte_Al_TE_CtAppSwc_RCtAppSwc_10ms
      Det_EcuSwComposition
      EcuM_EcuSwComposition
        Timer_EcuM_MainFunction (RteEventToTaskMapping): RteUsedOsEventRef=Rte_Ev_Cyclic2_AppRunTask_0_10ms, RteUsedOsAlarmRef=Os/Rte_Al_TE2_AppRunTask_0_10ms
      Os_OsCore0_swc_EcuSwComposition
    RteOsInteraction
      3 x RteUsedOsActivation, all with RteExpectedActivationOffset=0, RteActivationOsTaskRef=AppRunTask:
        Rte_Al_TE2_AppRunTask_0_10ms: RteActivationOsAlarmRef=Os/Rte_Al_TE2_AppRunTask_0_10ms
        Rte_Al_TE_CtAppSwc_RCtAppSwc_1000ms: RteActivationOsAlarmRef=Os/Rte_Al_TE_CtAppSwc_RCtAppSwc_1000ms
        Rte_Al_TE_CtAppSwc_RCtAppSwc_10ms: RteActivationOsAlarmRef=Os/Rte_Al_TE_CtAppSwc_RCtAppSwc_10ms
  module config NvM
  module config Os
    AppRunTask (OsTask):
      OsTaskActivation = 1
      OsTaskPriority = 15
      OsTaskSchedule = FULL
      OsTaskEventRef = Rte_Ev_Cyclic2_AppRunTask_0_10ms
      OsTaskEventRef = Rte_Ev_Run_CtAppSwc_RCtAppSwc_1000ms
      OsTaskEventRef = Rte_Ev_Run_CtAppSwc_RCtAppSwc_10ms
    3 x OsAlarm, all with OsAlarmCounterRef=SystemTimer:
      Rte_Al_TE2_AppRunTask_0_10ms
        OsAlarmAction
          OsAlarmSetEvent: OsAlarmSetEventRef=Rte_Ev_Cyclic2_AppRunTask_0_10ms, OsAlarmSetEventTaskRef=AppRunTask
      Rte_Al_TE_CtAppSwc_RCtAppSwc_1000ms
        OsAlarmAction
          OsAlarmSetEvent: OsAlarmSetEventRef=Rte_Ev_Run_CtAppSwc_RCtAppSwc_1000ms, OsAlarmSetEventTaskRef=AppRunTask
      Rte_Al_TE_CtAppSwc_RCtAppSwc_10ms
        OsAlarmAction
          OsAlarmSetEvent: OsAlarmSetEventRef=Rte_Ev_Run_CtAppSwc_RCtAppSwc_10ms, OsAlarmSetEventTaskRef=AppRunTask
    SwcInitTask (OsTask): OsTaskActivation=1, OsTaskPriority=30, OsTaskSchedule=FULL
    3 x OsEvent:
      Rte_Ev_Cyclic2_AppRunTask_0_10ms
      Rte_Ev_Run_CtAppSwc_RCtAppSwc_1000ms
      Rte_Ev_Run_CtAppSwc_RCtAppSwc_10ms
  module config EcuC
  ecuc value collection DaVinci_Project: ecuc-values=[Com, Rte, Os, EcuC, NvM]
