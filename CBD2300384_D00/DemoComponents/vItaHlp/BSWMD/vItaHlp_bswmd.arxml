AUTOSAR XML (schema 4-0-3)
# COPYRIGHT
# Copyright (c) 2019 by Vector Informatik GmbH. All rights reserved.
# This software is copyright protected and proprietary to Vector Informatik GmbH.
# Vector Informatik GmbH grants to you only those rights as set out in the license conditions.
package /MICROSAR
  bsw implementation vItaHlp_Impl: programming-language=C, sw-version=6.00.00, used-code-generator=DaVinci Configurator, ar-release-version=4.00.03, behavior=vItaHlpBehavior, vendor-specific-module-def=vItaHlp
  module definition vItaHlp [0..1]: category=VENDOR_SPECIFIC_MODULE_DEFINITION, variants pre-compile  # Configuration of the vItaHlp (Vector Integration Test Application for Hardware License Package) module.
    container vItaHlpTestModules  # Test Module definitions of vItaHlp.
      container vItaHlpCanTestModule [0..*]  # Definitions of CAN test modules for vItaHlp. Add a container for each CAN Driver under test. A CAN test module may comprise several CanTestConfig containers.
        foreign reference vItaHlpCanModuleRef: set at pre-compile, origin=Vector Informatik, destination-type=ECUC-MODULE-CONFIGURATION-VALUES  # Module Ref | The reference to a CAN module (CAN Driver).
        container vItaHlpCanTestConfig [1..*]  # Definition of parameters used for the vItaHlp CAN module tests. Add a container for each CAN Controller under test.
          string vItaHlpCanCanoeChannelName: set at pre-compile, origin=Vector Informatik, min-length=1  # Canoe Channel Name | Set the name as configured in the CANoe network. Do not use CANoe keywords (CAN1...CAN32) as channel name. Generally avoid using similar constructs like CAN0, CAN00, etc. for channel names. Note: Please take care that the Canoe Channel names are consistent (e.g. use the same Canoe Channel name if TestCom and CAN Test Module references the same CAN Controller).
          boolean vItaHlpCanStandardTestCommunicationRx: set at pre-compile, origin=Vector Informatik, default-value=true  # Standard Test - Communication Rx | Enables CAN reception tests for the Unit Under Test (CAN Controller). The CAN reception test is instantiated for all referenced Standard Test Elements which represent CAN Hardware Rx objects.
          boolean vItaHlpCanStandardTestCommunicationTx: set at pre-compile, origin=Vector Informatik, default-value=true  # Standard Test - Communication Tx | Enables CAN transmission tests for the Unit Under Test (CAN Controller). The CAN transmission test is instantiated for all referenced Standard Test Elements which represent CAN Hardware Tx objects.
          reference vItaHlpCanModuleUnitUnderTestRef: set at pre-compile, origin=Vector Informatik, destination=CanController  # Module Unit Under Test Ref | The reference to the CAN Controller, for which the tests shall be executed.
          reference vItaHlpCanStandardTestTestElementRef [0..*]: set at pre-compile, origin=Vector Informatik, destination=CanHardwareObject  # Standard Test - Test Element Ref | The reference(s) to the CAN Hardware Object(s), which are considered to be used for Standard Tests. For detailed information regarding which object is used in a test refer to the description of the Standard Test parameters.
          reference vItaHlpCanSetupTestTestElementRef: set at pre-compile, origin=Vector Informatik, destination=CanHardwareObject  # Setup Test - Test Element Ref | The reference to the CAN Tx Hardware Object, over which PDUs shall be transmitted for the Setup Test.
      container vItaHlpOsTestModule [0..1]  # Definitions of the OS test module for vItaHlp. An OS test module may comprise several OsTestConfig containers.
        container vItaHlpOsTestConfig [1..*]  # Definition of parameters used for the vItaHlp OS module tests. Add a container for each OS Core under test.
          boolean vItaHlpOsStandardTestStartup: set at pre-compile, origin=Vector Informatik, default-value=true  # Standard Test - Startup | Enables OS Startup test for the Unit Under Test (OS Core). The OS Startup test is instantiated for the referenced OS Test Communication Task Ref. For detailed information regarding the demands on the referenced OsTask refer to the description of the vItaHlpOsTestCommunicationTaskRef parameter.
          boolean vItaHlpOsStandardTestCounter: set at pre-compile, origin=Vector Informatik, default-value=false  # Standard Test - Counter | Enables OS Counter test for the Unit Under Test (OS Core). The OS Counter test is instantiated for the referenced OS Counter. It checks that the configured alarm action is performed, when the corresponding counter event occurs and the alarm expires. The OS Counter must be referenced by an OS Alarm with a configured OsAlarmAction OsAlarmActivateTask. The task which is referenced by the alarm action must not be used/activated by the RTE/BRE during execution of vItaHlp. The task implementation is provided by vItaHlp.
          reference vItaHlpOsModuleUnitUnderTestRef: set at pre-compile, origin=Vector Informatik, destination=OsCore  # Module Unit Under Test Ref | The reference to the AUTOSAR OS Core, for which the tests shall be executed.
          reference vItaHlpOsTestCommunicationTaskRef: set at pre-compile, origin=Vector Informatik, destination=OsTask  # Test Communication Task Ref | The reference to a BASIC OS Task mapped to an application of the core on which the tests shall be executed. The task must not be used/activated by the RTE/BRE during execution of vItaHlp. The task implementation is provided by vItaHlp.
          container vItaHlpOsStandardTestCounterTestElement [0..*]  # StandardTest - CounterTestElement | Definition of test element parameters used for the OS Counter test. Add a container for each test element.
            reference vItaHlpOsStandardTestCounterTestElementCounterRef: set at pre-compile, origin=Vector Informatik, destination=OsCounter  # Counter Ref | The reference to the OS Counter, which is considered to be used for the Standard Test. For detailed information regarding the demands on the counter which is used in the test, please refer to the description of the vItaHlpOsStandardTestCounter parameter.
            reference vItaHlpOsStandardTestCounterTestElementTaskRef: set at pre-compile, origin=Vector Informatik, destination=OsTask  # Task Ref | The reference to the OS Task, which is activated by the alarm associated with the OS Counter used for the Standard Test. For detailed information regarding the demands on the task which is used in the test, please refer to the description of the vItaHlpOsStandardTestCounter parameter.
      container vItaHlpEthTestModule [0..*]  # Definitions of Eth test modules for vItaHlp. Add a container for each Ethernet driver under test. An Eth test module may comprise several EthTestConfig containers.
        foreign reference vItaHlpEthModuleRef: set at pre-compile, origin=Vector Informatik, destination-type=ECUC-MODULE-CONFIGURATION-VALUES  # Module Ref | The reference to an Eth module (Ethernet driver).
        container vItaHlpEthTestConfig [1..*]  # Definition of parameters used for the vItaHlp Eth module tests. Add a container for each Ethernet controller under test.
          string vItaHlpEthCanoeChannelName: set at pre-compile, origin=Vector Informatik, min-length=1  # Canoe Channel Name | Set the name as configured in the CANoe network. Do not use CANoe keywords (Eth1...Eth32) as channel name. Generally avoid using similar constructs like Eth0, Eth00, etc. for channel names.
          boolean vItaHlpEthStandardTestCommunicationTx: set at pre-compile, origin=Vector Informatik, default-value=true  # Standard Test - Communication Tx | Enables the Eth transmission test for the Unit Under Test (Ethernet controller).
          boolean vItaHlpEthStandardTestCommunicationRx: set at pre-compile, origin=Vector Informatik, default-value=true  # Standard Test - Communication Rx | Enables the Eth reception test for the Unit Under Test (Ethernet controller).
          reference vItaHlpEthModuleUnitUnderTestRef: set at pre-compile, origin=Vector Informatik, destination=EthCtrlConfig  # Module Unit Under Test Ref | The reference to the Ethernet controller, for which the tests shall be executed.
      container vItaHlpFlsTestModule [0..1]  # Definitions of Fls test module for vItaHlp. A Fls test module may comprise several FlsTestConfig containers.
        container vItaHlpFlsTestConfig [1..*]  # Definition of parameters used for the vItaHlp Fls module tests. Add a container for each flashable sector under test.
          boolean vItaHlpFlsStandardTestFlsWrite: set at pre-compile, origin=Vector Informatik, default-value=true  # Standard Test - Flash Write | Enables the Flash Write test for the Unit Under Test (FlsSector). Requires the following APIs from the Fls module to be enabled: - /Fls/FlsGeneral/FlsCompareApi
          boolean vItaHlpFlsStandardTestFlsRead: set at pre-compile, origin=Vector Informatik, default-value=true  # Standard Test - Flash Read | Enables the Flash Read test for the Unit Under Test (FlsSector).
          boolean vItaHlpFlsStandardTestFlsCompare: set at pre-compile, origin=Vector Informatik, default-value=true  # Standard Test - Flash Compare | Enables the Flash Compare test for the Unit Under Test (FlsSector). Requires the following APIs from the Fls module to be enabled: - /Fls/FlsGeneral/FlsCompareApi - /Fls/FlsGeneral/FlsGetJobResultApi
          boolean vItaHlpFlsStandardTestFlsEraseAndBlankCheck: set at pre-compile, origin=Vector Informatik, default-value=false  # Standard Test - Flash Erase and BlankCheck | Enables the Flash Erase and BlankCheck test for the Unit Under Test (FlsSector). Disable this test, in case the Fls_BlankCheck API is not supported at all by the DUT, or in case the Fls_BlankCheck API is disabled for the given Fls driver module. Requires the following APIs from the Fls module to be enabled: - /Fls/FlsGeneral/FlsGetJobResultApi
          reference vItaHlpFlsModuleUnitUnderTestRef: set at pre-compile, origin=Vector Informatik, destination=FlsSector  # The reference to the flashable sector, for which the tests shall be executed.
          container vItaHlpFlsStandardTestTestElement [1..*]  # StandardTest - TestElement | Definition of test element parameters used for the Fls test. Add a container for each test element.
            integer vItaHlpFlsStandardTestTestElementStartPage: 0.., set at pre-compile, origin=Vector Informatik, default-value=0  # Start Page | The index of the page of a flash memory area, which is used for the test. The index 0 denotes the first page of the first sector. The index is unique over all flash pages of the Unit Under Test (FlsSector).
            integer vItaHlpFlsStandardTestTestElementNumberOfPages: 1.., set at pre-compile, origin=Vector Informatik, default-value=1  # Number of Pages | The number of consecutive flash pages, used for the test. The maximum number of flash pages is given by the number of configured flash sectors (FlsNumberOfSectors), the size of a flash sector (FlsSectorSize) and the size of a flash page (FlsPageSize) as: max number of pages = FlsNumberOfSectors * FlsSectorSize / FlsPageSize
      container vItaHlpMcuTestModule [0..1]  # Definitions of MCU test module for vItaHlp. The MCU test module contains a single MCUTestConfig container.
        container vItaHlpMcuTestConfig  # Definition of parameters used for the vItaHlp MCU module tests.
          boolean vItaHlpMcuStandardTestPerformReset: set at pre-compile, origin=Vector Informatik, default-value=true  # Standard Test - Perform Reset | Enables the MCU Perform Reset test.
          boolean vItaHlpMcuStandardTestClockTiming: set at pre-compile, origin=Vector Informatik, default-value=true  # Standard Test - Clock Timing | Enables the MCU Clock Timing test. The MCU Clock Timing test requires an OS alarm with a configured OsAlarmAction OsAlarmActivateTask. The referenced task must not be used/activated by the RTE/BRE during execution of vItaHlp. Moreover, the referenced task must not be used by another vItaHlp test module. The task implementation is provided by vItaHlp.
          reference vItaHlpMcuStandardTestClockTimingTestElementAlarmRef [0..1]: set at pre-compile, origin=Vector Informatik, destination=OsAlarm  # Alarm Ref | The reference to the OS alarm, which is used to perform the MCU Clock Timing test. For detailed information regarding the demands on the alarm which is used in the test, please refer to the description of the vItaHlpMcuStandardTestClockTiming parameter.
      container vItaHlpLinTestModule [0..*]  # Definitions of LIN test modules for vItaHlp. Add a container for each LIN Driver under test. A LIN test module may comprise several LinTestConfig containers.
        foreign reference vItaHlpLinModuleRef: set at pre-compile, origin=Vector Informatik, destination-type=ECUC-MODULE-CONFIGURATION-VALUES  # Module Ref | The reference to a LIN module (LIN Driver).
        container vItaHlpLinTestConfig [1..*]  # Definition of parameters used for the vItaHlp LIN module tests. Add a container for each LIN channel under test.
          string vItaHlpLinCanoeChannelName: set at pre-compile, origin=Vector Informatik, min-length=1  # Canoe Channel Name | Set the name as configured in the CANoe network. Do not use CANoe keywords (LIN1...LIN32) as channel name. Generally avoid using similar constructs like LIN0, LIN00, etc. for channel names.
          boolean vItaHlpLinStandardTestCommunicationMasterResponse: set at pre-compile, origin=Vector Informatik, default-value=true  # Standard Test - Communication Master Response | Enables the LIN transmission test with response from LIN Master for the Unit Under Test (LIN channel).
          boolean vItaHlpLinStandardTestCommunicationSlaveResponse: set at pre-compile, origin=Vector Informatik, default-value=true  # Standard Test - Communication Slave Response | Enables the LIN transmission test with response from LIN Slave for the Unit Under Test (LIN channel).
          boolean vItaHlpLinStandardTestSleepWakeupFromMaster: set at pre-compile, origin=Vector Informatik, default-value=true  # Standard Test - Sleep/Wakeup from Master | Enables the LIN Sleep/Wakeup test for the Unit Under Test (LIN channel). The wakeup is initiated from LIN Master.
          boolean vItaHlpLinStandardTestSleepWakeupFromSlave: set at pre-compile, origin=Vector Informatik, default-value=true  # Standard Test - Sleep/Wakeup from Slave | Enables the LIN Sleep/Wakeup test for the Unit Under Test (LIN channel). The wakeup is requested from LIN Slave.
          boolean vItaHlpLinStandardTestCommunicationIgnoreResponse: set at pre-compile, origin=Vector Informatik, default-value=false  # Standard Test - Communication Ignore Response | Enables the LIN transmission test for no response on LIN channel under test. The test can be enabled only for LIN Slave nodes.
          enumeration vItaHlpLinModuleUnitUnderTestNodeType: {MASTER, SLAVE}, set at pre-compile, origin=Vector Informatik, default-value=MASTER  # Node Type | The node type of the LIN channel, for which the tests shall be executed.
          reference vItaHlpLinModuleUnitUnderTestRef: set at pre-compile, origin=Vector Informatik, destination=LinChannel  # Module Unit Under Test Ref | The reference to the LIN channel, for which the tests shall be executed.
      container vItaHlpWdgTestModule [0..*]  # Definitions of WDG test modules for vItaHlp. Add a container for each Watchdog driver under test. The WDG test module contains a single WDG TestConfig container.
        foreign reference vItaHlpWdgModuleRef: set at pre-compile, origin=Vector Informatik, destination-type=ECUC-MODULE-CONFIGURATION-VALUES  # The reference to a WDG module (Watchdog driver).
        container vItaHlpWdgTestConfig  # Definition of parameters used for the vItaHlp WDG module tests.
          boolean vItaHlpWdgStandardTestImmediateReset: set at pre-compile, origin=Vector Informatik, default-value=true  # Standard Test - Immediate Reset | Enables the WDG Immediate Reset test.
          boolean vItaHlpWdgStandardTestTimingResetSlow: set at pre-compile, origin=Vector Informatik, default-value=true  # Standard Test - Timing Reset Slow | Enables the WDG test to verify the timing conditions of the watchdog driver. For this test, the watchdog hardware is configured with a long timeout period (Slow-Mode). The test can be enabled, if the HW derivative - Supports Slow-Mode AND - Slow-Mode is configured as default mode OR switching to Slow-Mode is supported during runtime.
          boolean vItaHlpWdgStandardTestTimingResetFast: set at pre-compile, origin=Vector Informatik, default-value=true  # Standard Test - Timing Reset Fast | Enables the WDG test to verify the timing conditions of the watchdog driver. For this test, the watchdog hardware is configured with a short timeout period (Fast-Mode). The test can be enabled, if the HW derivative - Supports Fast-Mode AND - Fast-Mode is configured as default mode OR switching to Fast-Mode is supported during runtime.
          boolean vItaHlpWdgStandardTestDisableAllowed: set at pre-compile, origin=Vector Informatik, default-value=true  # Standard Test - Disable Allowed | Enables the WDG test to verify, if disabling of the watchdog driver is allowed. Enable this test, if switching from Fast-Mode or Slow-Mode to Off-Mode is supported during runtime.
          integer vItaHlpTimeoutPeriodSlow [0..1]: 0..65535, set at pre-compile, origin=Vector Informatik  # The timeout period used for triggering the watchdog hardware, if configured for long timeout period (Slow-Mode).
          integer vItaHlpTimeoutPeriodFast [0..1]: 0..65535, set at pre-compile, origin=Vector Informatik  # The timeout period used for triggering the watchdog hardware, if configured for short timeout period (Fast-Mode).
    container vItaHlpTestCom [0..1]  # Test Communication for vItaHlp.
      reference vItaHlpTestComSpinlockRef [0..1]: set at pre-compile, origin=Vector Informatik, destination=OsSpinlock  # The reference to an OS Spinlock which is used to control the access to the vItaHlp event handler from tasks running on different cores. The OS Spinlock is not needed for tests in a single core environment.
      choice container vItaHlpTestComLinkLayer  # Select the link layer used for the test communication.
        container vItaHlpTestComTcm [0..1]  # Definition of parameters used for test control communication via TCM module. Note: This container contains only the configuration parameters needed for vItaHlp for the test communication via TCM. The configuration and setup of the TCM module needs further manual steps which are described in the Technical Reference of the TCM.
          string vItaHlpTcmCanoeChannelName: set at pre-compile, origin=Vector Informatik, min-length=1  # Canoe Channel Name | Set the name as configured in the CANoe network. Do not use CANoe keywords (CAN1...CAN32) as channel name. Generally avoid using similar constructs like CAN0, CAN00, etc. for channel names.
        container vItaHlpTestComCan [0..1]
          string vItaHlpCanCanoeChannelName: set at pre-compile, origin=Vector Informatik, min-length=1  # Canoe Channel Name | Set the name as configured in the CANoe network. Do not use CANoe keywords (CAN1...CAN32) as channel name. Generally avoid using similar constructs like CAN0, CAN00, etc. for channel names. Note: Please take care that the Canoe Channel names are consistent (e.g. use the same Canoe Channel name if TestCom and CAN Test Module references the same CAN Controller).
          reference vItaHlpCanControllerRef: set at pre-compile, origin=Vector Informatik, destination=CanController  # CAN Controller Ref | The reference to the CAN Controller, which shall be used for the test communication. Following CAN-IDs are used for the test communication: - Tx CAN ID: 0 - Rx CAN ID: 1 It must be ensured, that an Rx Basic Hardware Object for the referenced CAN Controller is available, which can receive the specified CAN ID.
        container vItaHlpTestComEth [0..1]
          string vItaHlpEthCanoeChannelName: set at pre-compile, origin=Vector Informatik, min-length=1  # Canoe Channel Name | Set the name as configured in the CANoe network. Do not use CANoe keywords (Eth1...Eth32) as channel name. Generally avoid using similar constructs like Eth0, Eth00, etc. for channel names. Note: Please take care that the Canoe Channel names are consistent (e.g. use the same Canoe Channel name if TestCom and Eth Test Module references the same Eth Controller).
          reference vItaHlpEthControllerRef: set at pre-compile, origin=Vector Informatik, destination=EthCtrlConfig  # Eth Controller Ref | The reference to the Eth Controller, which shall be used for the test communication. Following Eth_FrameType (EtherType) definitions are used for the test communication: - Tx Eth_FrameType: 0xBACC - Rx Eth_FrameType: 0xFEED
