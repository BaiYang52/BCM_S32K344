AUTOSAR XML (schema 4-2-1)
package /MICROSAR
  module config vLinkGen_Pre: definition=vLinkGen
    vLinkGenPublishedInformation: vLinkGenGeneration=2
