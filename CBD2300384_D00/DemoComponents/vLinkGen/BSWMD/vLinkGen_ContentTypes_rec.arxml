AUTOSAR XML (schema 4-2-1)
package /MICROSAR
  module config vLinkGen_Rec: definition=vLinkGen
    vLinkGenContentTypes
      RAM_CODE (vLinkGenConstContentType): vLinkGenConstContentTypeCopyRef=RAM_CODE_COPY
      RAM_CONST (vLinkGenConstContentType): vLinkGenConstContentTypeCopyRef=RAM_CONST_COPY
      3 x vLinkGenVarContentType:
        GLOBAL_DATA: vLinkGenVarContentTypeCopyRef=GLOBAL_CONST
        LOCAL_DATA: vLinkGenVarContentTypeCopyRef=LOCAL_CONST
        RETENTION_DATA: vLinkGenVarContentTypeCopyRef=GLOBAL_CONST
