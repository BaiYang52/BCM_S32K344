AUTOSAR XML (schema 4-2-1)
package /MICROSAR
  module config vLinkGen_Pre: definition=vLinkGen
    vLinkGenContentTypes
      15 x vLinkGenConstContentType:
        GLOBAL_CODE: vLinkGenConstContentTypeLocal=0
        LOCAL_CODE: vLinkGenConstContentTypeLocal=1
        GLOBAL_CONST: vLinkGenConstContentTypeLocal=0
        LOCAL_CONST: vLinkGenConstContentTypeLocal=1
        GLOBAL_EXCVEC_CODE: vLinkGenConstContentTypeLocal=0
        LOCAL_EXCVEC_CODE: vLinkGenConstContentTypeLocal=1
        GLOBAL_EXCVEC_CONST: vLinkGenConstContentTypeLocal=1
        LOCAL_EXCVEC_CONST: vLinkGenConstContentTypeLocal=1
        GLOBAL_INTVEC_CODE: vLinkGenConstContentTypeLocal=0
        LOCAL_INTVEC_CODE: vLinkGenConstContentTypeLocal=1
        GLOBAL_INTVEC_CONST: vLinkGenConstContentTypeLocal=0
        LOCAL_INTVEC_CONST: vLinkGenConstContentTypeLocal=1
        STARTUP_CODE: vLinkGenConstContentTypeLocal=0
        RAM_CODE: vLinkGenConstContentTypeLocal=0
        RAM_CONST: vLinkGenConstContentTypeLocal=0
      8 x vLinkGenVarContentType:
        GLOBAL_DATA: vLinkGenVarContentTypeLocal=0
        LOCAL_DATA: vLinkGenVarContentTypeLocal=1
        RETENTION_DATA: vLinkGenVarContentTypeLocal=0
        STARTUP_STACK: vLinkGenVarContentTypeLocal=1
        STACKS: vLinkGenVarContentTypeLocal=1
        RAM_CODE_COPY: vLinkGenVarContentTypeLocal=0
        RAM_CONST_COPY: vLinkGenVarContentTypeLocal=0
        SHARED_DATA: vLinkGenVarContentTypeLocal=0
      APPLICATION_ENTRY (vLinkGenConstContentType): vLinkGenConstContentTypeLocal=0
