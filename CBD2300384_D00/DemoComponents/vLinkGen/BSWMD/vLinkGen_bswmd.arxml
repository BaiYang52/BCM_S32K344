AUTOSAR XML (schema 4-2-1)
package /MICROSAR
  bsw implementation vLinkGen_Impl: programming-language=C, sw-version=2.06.01, used-code-generator=DaVinci Configurator, vendor-id=30, ar-release-version=4.02.01, preconfigured-configuration=vLinkGen_Pre, recommended-configuration=vLinkGen_Rec, vendor-specific-module-def=vLinkGen
  module definition vLinkGen [0..1]: category=VENDOR_SPECIFIC_MODULE_DEFINITION, variants pre-compile  # The MICROSAR linker script generator provides an abstract way to create compiler specfic linker scripts, so that code, constants and variables (linker symbols) in a binary are placed at the intended location in the target memory (e.g. ROM, RAM, etc.). The basic idea of vLinkGen is to have a compiler independent description of the linker script to be able to apply it in a similar way for several projects. #Memory #MemoryMapping #Vector
    container vLinkGenGeneral: multiplicity set at pre-compile  # General configuration parameters of the vLinkGen.
      enumeration vLinkGenFileGeneration: {STANDARD, ONE_FILE_PER_VARIANT, MODULE_SNIPPETS, VARIANT_SNIPPETS, LOGICAL_GROUP_SNIPPETS}, multiplicity set at pre-compile, origin=Vector Informatik, set at pre-compile, default-value=STANDARD  # File Generation | Specifies how the linker script shall be generated. The different types of generation are described below. STANDARD: Generate one complete compiler specific linker script. Logical groups that are assigned to one or more variants are encapsulated with C preprocessor macros. If variants are configured, this file may need to be preprocessed before it can be passed to the linker. This applies to all linkers that do not have their own preprocessor that can resolve C preprocessor macros (e.g. #ifdef ...). The name of the generated linker script is: 'vLinkGen_Template.<ext>' ONE_FILE_PER_VARIANT: Generate complete linker scripts per variant containing all Logical Groups assigned to the variant as well as all without a variant. They can be used as they are and passed to the linker. These files are generated as follows: 'vLinkGen_Template_<VariantName>.<ext>' MODULE_SNIPPETS: Generate several linker script snippets containing all Logical Groups (including all Section Groups) with a module reference. See notes below. These snippets are generated as follows: 'vLinkGen_Inc_<ModuleName>.<ext>' VARIANT_SNIPPETS: Generate several linker script snippets containing all Logical Groups (including all Section Groups) of a variant. See notes below. These snippets are generated as follows: 'vLinkGen_Inc_<VariantName>.<ext>' LOGICAL_GROUP_SNIPPETS: Generate several linker script snippets containing all Section Groups of a Logical Group. See notes below. These snippets are generated as follows: 'vLinkGen_Inc_<LogicalGroupName>.<ext>' Note: - Snippets are not supported by all compilers. - Snippets only contain the corresponding logical groups and nothing else. - Snippets cannot be passed directly to the linker. They must be included by other linker scripts. However, the names of the Memory Region Blocks (e.g. FLASH) must match the memory definitions from the linker script into which the snippets are to be included. - If variants are configured, logical groups inside the snippets are encapsulated the same way as for STANDARD generation. - Snippets never contain memory definitions and global (Pre/Post) user groups. - <ext> means the compiler specific file extension of the linker script.
      string vLinkGenEntrySymbol [0..1]: multiplicity set at pre-compile, origin=Vector Informatik, set at pre-compile, default-value=StartupEntry  # Startup Entry Symbol | Defines the symbol for the startup entry. This symbol is required by some compilers to define the entry point of the program code. Note: This parameter is currently only evaluated in projects with Tasking Compiler.
      string vLinkGenUserConfigFile [0..1]: multiplicity set at pre-compile, origin=Vector Informatik, set at pre-compile  # User Config File | Reference to an external text file that will be included during generation to vLinkGen_Cfg.h. The content of the user configuration file will be added at the beginning of the generated module configuration file and allows altering or extending the generated code. Note: In contrast to the other MICROSAR components, vLinkGen inserts the user config file at the beginning of vLinkGen_Cfg.h. This is necessary to make possible defined variant macros also known in the file itself. Caution: User configuration files can cause the software module to malfunction and must only be used with great care!
    container vLinkGenMemLayout: multiplicity set at pre-compile  # Container to structure all memory layout relevant configuration parameters.
      container vLinkGenLinkerSections: multiplicity set at pre-compile  # Container to structure the configuration parameters of the different Linker Section types. Note: Linker Sections are comparable to so called input sections from (some) compiler manuals.
        container vLinkGenLinkerCodeSection [0..*]: multiplicity set at pre-compile  # This container includes all configuration parameters for a CODE Linker Section.
          linker symbol vLinkGenLinkerCodeSectionName: multiplicity set at pre-compile, origin=Vector Informatik, set at pre-compile, default-value=text  # Name | This parameter specifies the name of the Linker Section to be generated in the linker script. Note: Preceding periods ('.') need not be specified here. They will be added by vLinkGen if necessary. If sections with special values are required, a vLinkGenLinkerSpecSection can be used instead.
          integer vLinkGenLinkerCodeSectionAlignment [0..1]: 0..4294967295, multiplicity set at pre-compile, origin=Vector Informatik, set at pre-compile, default-value=0  # Alignment | This value specifies the optional alignment of the Linker Section in bytes. This allows the start address of the Linker Section to be aligned accordingly after linking.
          boolean vLinkGenLinkerCodeSectionFast: multiplicity set at pre-compile, origin=Vector Informatik, set at pre-compile, default-value=false  # Fast Addressing | Specifies whether the Linker Section shall be linked for fast addressing (NEAR) or not (FAR). Note: This parameter is only needed for a few compilers, but should always be set correctly.
          string vLinkGenLinkerCodeSectionFiles [0..1]: multiplicity set at pre-compile, origin=Vector Informatik, set at pre-compile  # Filenames | Specifies the name of one ore more files from which the content of the Linker Section is to be linked. Whereby the names of individual files or archives (libraries) with the files they contain can be specified. So it is possible to place the content of a linker section only from one or more files to a certain position. If several files or archives are to be specified, they must be entered as a semicolon-separated list. Where an archive is defined by a name followed by parentheses. Within these parentheses, members of the archive can optionally be specified as a comma-separated list. See examples below. From this, vLinkGen generates, if necessary for the selected compiler, individual selection commands for each file or archive. For individual selection commands, the file names are generated according to their specified order. Examples: - file.o - file_a.o;file_b.o;file_c.o - lib.a() - lib.a(file_a.o,file_b.o) - lib1.a(file_*); lib2.a(*); file_?.o - /usr/folder/lib/lib.a(/usr/folder/source/file1.o) - C:/folder/lib/lib.a(C:/folder/source/file1.o) Note: - The specified file or archive names will be generated as they are. The string is only split and whitespaces are removed. - That means for most compilers it is also possible to specify wildcards (*, ?) and complete paths. - Ensure that UNIX style file paths do not contain parentheses.
          reference vLinkGenLinkerCodeSectionFlag [0..*]: multiplicity set at pre-compile, origin=Vector Informatik, set at pre-compile, destination=vLinkGenConstSectionFlag  # Compiler Specific Flags | Defines compiler specific flags to be generated for the Linker Section. Note: The flags to be selected are predefined and cannot be changed. If no flags are selectable, the compiler either does not support flags on section level or the vLinkGen doesn't support them.
          foreign reference vLinkGenLinkerCodeSectionModule [0..1]: multiplicity set at pre-compile, origin=Vector Informatik, set at pre-compile, destination-type=ECUC-MODULE-CONFIGURATION-VALUES  # Module Ref | Optional reference to the module which owns (requires) this Linker Section. Note: If this reference is set, the container is typically created by another module's generator.
        container vLinkGenLinkerConstSection [0..*]: multiplicity set at pre-compile  # This container includes all configuration parameters for a CONST Linker Section.
          linker symbol vLinkGenLinkerConstSectionName: multiplicity set at pre-compile, origin=Vector Informatik, set at pre-compile, default-value=rodata  # Name | This parameter specifies the name of the Linker Section to be generated in the linker script. Note: Preceding periods ('.') need not be specified here. They will be added by vLinkGen if necessary. If sections with special values are required, a vLinkGenLinkerSpecSection can be used instead.
          integer vLinkGenLinkerConstSectionAlignment [0..1]: 0..4294967295, multiplicity set at pre-compile, origin=Vector Informatik, set at pre-compile, default-value=0  # Alignment | This value specifies the optional alignment of the Linker Section in bytes. This allows the start address of the Linker Section to be aligned accordingly after linking.
          boolean vLinkGenLinkerConstSectionFast: multiplicity set at pre-compile, origin=Vector Informatik, set at pre-compile, default-value=false  # Fast Addressing | Specifies whether the Linker Section shall be linked for fast addressing (NEAR) or not (FAR). Note: This parameter is only needed for a few compilers, but should always be set correctly.
          string vLinkGenLinkerConstSectionFiles [0..1]: multiplicity set at pre-compile, origin=Vector Informatik, set at pre-compile  # Filenames | Specifies the name of one ore more files from which the content of the Linker Section is to be linked. Whereby the names of individual files or archives (libraries) with the files they contain can be specified. So it is possible to place the content of a linker section only from one or more files to a certain position. If several files or archives are to be specified, they must be entered as a semicolon-separated list. Where an archive is defined by a name followed by parentheses. Within these parentheses, members of the archive can optionally be specified as a comma-separated list. See examples below. From this, vLinkGen generates, if necessary for the selected compiler, individual selection commands for each file or archive. For individual selection commands, the file names are generated according to their specified order. Examples: - file.o - file_a.o;file_b.o;file_c.o - lib.a() - lib.a(file_a.o,file_b.o) - lib1.a(file_*); lib2.a(*); file_?.o - /usr/folder/lib/lib.a(/usr/folder/source/file1.o) - C:/folder/lib/lib.a(C:/folder/source/file1.o) Note: - The specified file or archive names will be generated as they are. The string is only split and whitespaces are removed. - That means for most compilers it is also possible to specify wildcards (*, ?) and complete paths. - Ensure that UNIX style file paths do not contain parentheses.
          reference vLinkGenLinkerConstSectionFlag [0..*]: multiplicity set at pre-compile, origin=Vector Informatik, set at pre-compile, destination=vLinkGenConstSectionFlag  # Compiler Specific Flags | Defines compiler specific flags to be generated for the Linker Section. Note: The flags to be selected are predefined and cannot be changed. If no flags are selectable, the compiler either does not support flags on section level or the vLinkGen doesn't support them.
          foreign reference vLinkGenLinkerConstSectionModule [0..1]: multiplicity set at pre-compile, origin=Vector Informatik, set at pre-compile, destination-type=ECUC-MODULE-CONFIGURATION-VALUES  # Module Ref | Optional reference to the module which owns (requires) this Linker Section. Note: If this reference is set, the container is typically created by another module's generator.
        container vLinkGenLinkerVarSection [0..*]: multiplicity set at pre-compile  # This container includes all configuration parameters for a VAR Linker Section.
          linker symbol vLinkGenLinkerVarSectionName: multiplicity set at pre-compile, origin=Vector Informatik, set at pre-compile, default-value=data  # Name | This parameter specifies the name of the Linker Section to be generated in the linker script. Note: Preceding periods ('.') need not be specified here. They will be added by vLinkGen if necessary. If sections with special values are required, a vLinkGenLinkerSpecSection can be used instead.
          integer vLinkGenLinkerVarSectionAlignment [0..1]: 0..4294967295, multiplicity set at pre-compile, origin=Vector Informatik, set at pre-compile, default-value=0  # Alignment | This value specifies the optional alignment of the Linker Section in bytes. This allows the start address of the Linker Section to be aligned accordingly after linking.
          boolean vLinkGenLinkerVarSectionFast: multiplicity set at pre-compile, origin=Vector Informatik, set at pre-compile, default-value=false  # Fast Addressing | Specifies whether the Linker Section shall be linked for fast addressing (NEAR) or not (FAR). Note: This parameter is only needed for a few compilers, but should always be set correctly.
          string vLinkGenLinkerVarSectionFiles [0..1]: multiplicity set at pre-compile, origin=Vector Informatik, set at pre-compile  # Filenames | Specifies the name of one ore more files from which the content of the Linker Section is to be linked. Whereby the names of individual files or archives (libraries) with the files they contain can be specified. So it is possible to place the content of a linker section only from one or more files to a certain position. If several files or archives are to be specified, they must be entered as a semicolon-separated list. Where an archive is defined by a name followed by parentheses. Within these parentheses, members of the archive can optionally be specified as a comma-separated list. See examples below. From this, vLinkGen generates, if necessary for the selected compiler, individual selection commands for each file or archive. For individual selection commands, the file names are generated according to their specified order. Examples: - file.o - file_a.o;file_b.o;file_c.o - lib.a() - lib.a(file_a.o,file_b.o) - lib1.a(file_*); lib2.a(*); file_?.o - /usr/folder/lib/lib.a(/usr/folder/source/file1.o) - C:/folder/lib/lib.a(C:/folder/source/file1.o) Note: - The specified file or archive names will be generated as they are. The string is only split and whitespaces are removed. - That means for most compilers it is also possible to specify wildcards (*, ?) and complete paths. - Ensure that UNIX style file paths do not contain parentheses.
          reference vLinkGenLinkerVarSectionFlag [0..*]: multiplicity set at pre-compile, origin=Vector Informatik, set at pre-compile, destination=vLinkGenVarSectionFlag  # Compiler Specific Flags | Defines compiler specific flags to be generated for the Linker Section. Note: The flags to be selected are predefined and cannot be changed. If no flags are selectable, the compiler either does not support flags on section level or the vLinkGen doesn't support them.
          foreign reference vLinkGenLinkerVarSectionModule [0..1]: multiplicity set at pre-compile, origin=Vector Informatik, set at pre-compile, destination-type=ECUC-MODULE-CONFIGURATION-VALUES  # Module Ref | Optional reference to the module which owns (requires) this Linker Section. Note: If this reference is set, the container is typically created by another module's generator.
        container vLinkGenLinkerStackSection [0..*]: multiplicity set at pre-compile  # This container includes all configuration parameters for a STACK Linker Section. Caution: STACK Linker Sections are special variable sections, which shall only be used by the operating system.
          linker symbol vLinkGenLinkerStackSectionName: multiplicity set at pre-compile, origin=Vector Informatik, set at pre-compile, default-value=stack  # Name | This parameter specifies the name of the Linker Section to be generated in the linker script. Note: Preceding periods ('.') need not be specified here. They will be added by vLinkGen if necessary. If sections with special values are required, a vLinkGenLinkerSpecSection can be used instead.
          integer vLinkGenLinkerStackSectionAlignment [0..1]: 0..4294967295, multiplicity set at pre-compile, origin=Vector Informatik, set at pre-compile, default-value=0  # Alignment | This value specifies the optional alignment of the Linker Section in bytes. This allows the start address of the Linker Section to be aligned accordingly after linking.
          reference vLinkGenLinkerStackSectionFlag [0..*]: multiplicity set at pre-compile, origin=Vector Informatik, set at pre-compile, destination=vLinkGenVarSectionFlag  # Compiler Specific Flags | Defines compiler specific flags to be generated for the Linker Section. Note: The flags to be selected are predefined and cannot be changed. If no flags are selectable, the compiler either does not support flags on section level or the vLinkGen doesn't support them.
          foreign reference vLinkGenLinkerStackSectionModule [0..1]: multiplicity set at pre-compile, origin=Vector Informatik, set at pre-compile, destination-type=ECUC-MODULE-CONFIGURATION-VALUES  # Module Ref | Optional reference to the module which owns (requires) this Linker Section. Note: If this reference is set, the container is typically created by another module's generator.
        container vLinkGenLinkerSpecSection [0..*]: multiplicity set at pre-compile  # This container includes all configuration parameters for a compiler specific Linker Section. Note: These sections are generated as configured, so the entered values must contain linker specific code. For details, see chapter "Sections with Special Values" of the Technical Reference.
          string vLinkGenLinkerSpecSectionValue: multiplicity set at pre-compile, origin=Vector Informatik, set at pre-compile  # Value | This parameter specifies the compiler specific section value. Note: For details about the generation of the specific section values, see chapter "Special Section Generation" of the Technical Reference.
          integer vLinkGenLinkerSpecSectionAlignment [0..1]: 0..4294967295, multiplicity set at pre-compile, origin=Vector Informatik, set at pre-compile, default-value=0  # Alignment | This value specifies the optional alignment of the Linker Section in bytes. This allows the start address of the Linker Section to be aligned accordingly after linking.
          integer vLinkGenLinkerSpecSectionPad [0..1]: 0..4294967295, multiplicity set at pre-compile, origin=Vector Informatik, set at pre-compile, default-value=0  # Padding | This value specifies the optional padding (reserved size) of the Linker Section in bytes.
          reference vLinkGenLinkerSpecSectionFlag [0..*]: multiplicity set at pre-compile, origin=Vector Informatik, set at pre-compile, destination=vLinkGenSpecSectionFlag  # Compiler Specific Flags | Defines compiler specific flags to be generated for the Linker Section. Note: The flags to be selected are predefined and cannot be changed. If no flags are selectable, the compiler either does not support flags on section level or the vLinkGen doesn't support them.
          foreign reference vLinkGenLinkerSpecSectionModule [0..1]: multiplicity set at pre-compile, origin=Vector Informatik, set at pre-compile, destination-type=ECUC-MODULE-CONFIGURATION-VALUES  # Module Ref | Optional reference to the module which owns (requires) this Linker Section. Note: If this reference is set, the container is typically created by another module's generator.
      container vLinkGenLogicalConstGroup [0..*]: multiplicity set at pre-compile  # This container includes all configuration parameters for a Logical CONST Group. Logical Groups are an abstraction layer to group multiple Section Groups and map them to a Memory Region Block.
        integer vLinkGenConstGroupPosition: 0..4294967295, multiplicity set at pre-compile, origin=Vector Informatik, set at pre-compile, default-value=5  # Position | Specifies the relative position of the Logical Group within all Logical Groups. If multiple groups have the same position, they are sorted alphabetically by their container names. Note: With some compilers, the actual order of the Logical Group after linking may differ from the configured one. This is a compiler limitation and cannot be influenced by vLinkGen.
        integer vLinkGenConstGroupCore [0..1]: 0..4294967295, multiplicity set at pre-compile, origin=Vector Informatik, set at pre-compile, default-value=0  # Core Id | Specifies the physical core ID to which the Logical Group is assigned. Only relevant for groups with core local content. Which is defined by the optionally referenced Content Type.
        integer vLinkGenConstGroupInitCore [0..1]: 0..4294967295, multiplicity set at pre-compile, origin=Vector Informatik, set at pre-compile, default-value=0  # Core Id (ROM to RAM copy) | Specifies the physical core ID which shall perform the copying from ROM to RAM for all assigned sections. This applies to all sections which are assigned to an underlying Section Group with Init Policy set to COPY_TO_RAM.
        reference vLinkGenConstGroupRegion: multiplicity set at pre-compile, origin=Vector Informatik, set at pre-compile, destination=vLinkGenMemoryRegionBlock  # Default Memory Region Block | Reference to the ROM Memory Region Block where the containing Section Groups shall be linked to by default. Where default means, in case it is not specifically overwritten for variants. See optional vLinkGenConstGroupVariantHandling for details.
        reference vLinkGenConstGroupRamRegion [0..1]: multiplicity set at pre-compile, origin=Vector Informatik, set at pre-compile, destination=vLinkGenMemoryRegionBlock  # Default Memory Region Block (RAM Copy) | Reference to the RAM Memory Region Block where the containing Section Groups shall be copied to at ECU startup by default. Where default means, in case it is not specifically overwritten for variants. See optional vLinkGenConstGroupVariantHandling for details. Note: Depending on this parameter, the vLinkGen only generates a structure which can be used to copy code or constants from ROM to RAM. This is normally done by the startup code of the vBRS. For details please refer to the TechnicalReference.
        reference vLinkGenConstGroupVariant [0..*]: multiplicity set at pre-compile, origin=Vector Informatik, set at pre-compile, destination=vLinkGenVariant  # Variants | References to the linker script variants in which the Logical Group should be used. Note: - If variants are configured but this group is not assigned to one, it applies to all of them. - If it is not possible to delete a variant from the list, please check if there is a vLinkGenConstGroupVariantSpecifics subcontainer that refers to this variant.
        foreign reference vLinkGenConstGroupModule [0..1]: multiplicity set at pre-compile, origin=Vector Informatik, set at pre-compile, destination-type=ECUC-MODULE-CONFIGURATION-VALUES  # Module Ref | Optional reference to the module which owns (requires) this Logical Group. Note: If this reference is set, the container is typically created by another module's generator.
        reference vLinkGenConstGroupContentType [0..1]: multiplicity set at pre-compile, origin=Vector Informatik, set at pre-compile, destination=vLinkGenConstContentType  # Content Type | Specifies the type of content of the Logical Group. What means which kind of constants (code or data) it will contain after linking. Note: If set, vLinkGen will set the Default Memory Region Block references to the appropriate values. What means if an available Memory Region Block is found, the reference will be set automatically and cannot be changed afterwards. If it is necessary to change the Memory Region Block reference, this content type has to be removed.
        reference vLinkGenConstGroupFlag [0..*]: multiplicity set at pre-compile, origin=Vector Informatik, set at pre-compile, destination=vLinkGenLogicalConstGroupFlag  # Compiler Specific Flags | Defines compiler specific flags to be generated for the Logical Group. Note: The flags to be selected are predefined and cannot be changed. If none are selectable, the compiler either does not support flags on group level or the vLinkGen doesn't support them.
        container vLinkGenConstSectionGroup [0..*]: multiplicity set at pre-compile  # Specifies a group of Linker Sections whose content shall be linked into this Section Group. Note: Section Groups are comparable to output sections from (some) compiler manuals.
          integer vLinkGenConstSectionGroupPosition: 0..4294967295, multiplicity set at pre-compile, origin=Vector Informatik, set at pre-compile, default-value=0  # Position | Specifies the relative position of the Section Group within its parent Logical Group. If multiple groups have the same position, they are sorted alphabetically by their container names.
          integer vLinkGenConstSectionGroupAlignment [0..1]: 0..4294967295, multiplicity set at pre-compile, origin=Vector Informatik, set at pre-compile, default-value=4  # Alignment | This value specifies the optional start address alignment of the Section Group in bytes.
          integer vLinkGenConstSectionGroupEndAlignment [0..1]: 0..4294967295, multiplicity set at pre-compile, origin=Vector Informatik, set at pre-compile, default-value=4  # End Alignment | This value specifies the optional end (length) alignment of the Section Group in bytes. This allows the generated END or LIMIT labels to be aligned accordingly.
          integer vLinkGenConstSectionGroupSize [0..1]: 0..4294967295, multiplicity set at pre-compile, origin=Vector Informatik, set at pre-compile, default-value=0  # Group Size | This value specifies the optional size of the Section Group in bytes. This can be used to keep an area free in the memory layout for groups without any Linker Sections (empty groups).
          integer vLinkGenConstSectionGroupGapSize [0..1]: 0..4294967295, multiplicity set at pre-compile, origin=Vector Informatik, set at pre-compile, default-value=0  # Gap Size | This value specifies the size of the optional gap to be kept free after the Section Group in bytes. In order to correctly configure the MPU on some platforms, a certain area must be left free after the individual MPU regions. This area can be configured via this parameter. The vLinkGen then generates the linker script in the appropriate way so the configured area after the section group is kept free after linking.
          enumeration vLinkGenConstSectionGroupInit: {NONE, COPY_TO_RAM}, multiplicity set at pre-compile, origin=Vector Informatik, set at pre-compile, default-value=NONE  # Init Policy | Specifies whether the Section Group shall be copied from ROM to RAM at ECU startup or not. This is typically used to execute code from RAM. NONE: Default behavior for the CONST Section Group. No copying from ROM to RAM. COPY_TO_RAM: Copy Section Group from ROM to RAM at ECU startup.
          enumeration vLinkGenConstSectionGroupInitStage: {NONE, ZERO, HARD_RESET_ONLY, ONE, TWO, THREE}, multiplicity set at pre-compile, origin=Vector Informatik, set at pre-compile, default-value=ONE  # Init Stage | Specifies the stage at ECU startup for the copying of the Section Group. This parameter is only evaluated if the Init Policy is set to COPY_TO_RAM. NONE: No initialization configured. ZERO: Always initialized first during the default vBRS startup routine. HARD_RESET_ONLY: Same initialization stage as ONE. However, initialization is only done if a hardware reset occurred. ONE: Always initialized second during the default vBRS startup routine. By default, this value should be used if an initialization is required. TWO, THREE: Optional init stages, which are initialized accordingly after the HARD_RESET_ONLY stage. Shall only be used if really necessary. One use case might be to reset the Wdg between the initialization of two stages.
          choice reference vLinkGenConstSectionGroupRef [0..*]: multiplicity set at pre-compile, origin=Vector Informatik, set at pre-compile, destination=[vLinkGenLinkerCodeSection, vLinkGenLinkerConstSection, vLinkGenLinkerSpecSection]  # Sections | Reference to the sections which shall be linked into the Section Group.
          choice reference vLinkGenConstSectionGroupFlag [0..*]: multiplicity set at pre-compile, origin=Vector Informatik, set at pre-compile, destination=vLinkGenConstGroupFlag  # Compiler Specific Flags | Defines compiler specific flags to be generated for the Section Group. Note: The flags to be selected are predefined and cannot be changed. If none are selectable, the compiler either does not support flags on group level or the vLinkGen doesn't support them.
        container vLinkGenConstGroupVariantHandling [0..1]: multiplicity set at pre-compile  # Collection of variant specific Memory Region Block mappings, with which it is possible to link a logical group (respectively all of their containing Section Groups) to different memory areas in different variants. The following behavior applies when setting the Memory Region Block references: - For all variants, the "default" references from the Logical Group are used - If a variant is specified in a variant specifics, then the "overwriting" references are used - Where the "overwriting" references in the variant specifics are optional. - This means that for a variant, for example, only the ROM/RAM copy can be linked elsewhere.
          container vLinkGenConstGroupVariantSpecifics [0..*]: multiplicity set at pre-compile  # Specifies variant specific Memory Region Block overwrites. See vLinkGenConstGroupVariantHandling description for details.
            reference vLinkGenConstGroupSpecificRegion [0..1]: multiplicity set at pre-compile, origin=Vector Informatik, set at pre-compile, destination=vLinkGenMemoryRegionBlock  # Overwriting Memory Region Block | Overwrites the default Memory Region Block from the parent Logical Group in the variants listed below.
            reference vLinkGenConstGroupSpecificRamRegion [0..1]: multiplicity set at pre-compile, origin=Vector Informatik, set at pre-compile, destination=vLinkGenMemoryRegionBlock  # Overwriting Memory Region Block (RAM Copy) | Overwrites the default Memory Region Block (RAM Copy) from the parent Logical Group in the variants listed below.
            reference vLinkGenConstGroupSpecificVariant [0..*]: multiplicity set at pre-compile, origin=Vector Informatik, set at pre-compile, destination=vLinkGenVariant  # Variants | References to the linker script variants for which the overwritten Memory Region Block references are to apply. Note: - Variants specified here must also be added to the parent Logical Group Variants.
      container vLinkGenLogicalVarGroup [0..*]: multiplicity set at pre-compile  # This container includes all configuration parameters for a Logical VAR Group. Logical Groups are an abstraction layer to group multiple Section Groups and map them to a Memory Region Block.
        integer vLinkGenVarGroupPosition: 0..4294967295, multiplicity set at pre-compile, origin=Vector Informatik, set at pre-compile, default-value=5  # Position | Specifies the relative position of the Logical Group within all Logical Groups. If multiple groups have the same position, they are sorted alphabetically by their container names. Note: With some compilers, the actual order of the Logical Group after linking may differ from the configured one. This is a compiler limitation and cannot be influenced by vLinkGen.
        integer vLinkGenVarGroupCore [0..1]: 0..4294967295, multiplicity set at pre-compile, origin=Vector Informatik, set at pre-compile, default-value=0  # Core Id | Specifies the physical core ID to which the Logical Group is assigned. Only relevant for groups with core local content. Which is defined by the optionally referenced Content Type.
        integer vLinkGenVarGroupInitCore [0..1]: 0..4294967295, multiplicity set at pre-compile, origin=Vector Informatik, set at pre-compile, default-value=0  # Core Id (ROM to RAM copy) | Specifies the physical core ID which shall perform the initialization of all assigned INIT and ZERO_INIT sections. This applies to all sections which are assigned to an underlying Section Group with Init Policy set to INIT or ZERO_INIT.
        reference vLinkGenVarGroupRegion: multiplicity set at pre-compile, origin=Vector Informatik, set at pre-compile, destination=vLinkGenMemoryRegionBlock  # Default Memory Region Block | Reference to the RAM Memory Region Block where the containing Section Groups shall be linked to by default. Where default means, in case it is not specifically overwritten for variants. See optional vLinkGenVarGroupVariantHandling for details.
        reference vLinkGenVarGroupRomRegion [0..1]: multiplicity set at pre-compile, origin=Vector Informatik, set at pre-compile, destination=vLinkGenMemoryRegionBlock  # Default Memory Region Block (ROM Copy) | Reference to the ROM Memory Region Block where the predefined data of the containing Section Groups variables shall be linked to by default. Where default means, in case it is not specifically overwritten for variants. See optional vLinkGenVarGroupVariantHandling for details. Typically used for initialization of INIT data (ROM to RAM copy). Note: Depending on this parameter, the vLinkGen only generates a structure which can be used to initialize configured Linker Sections with concrete data. This is normally done by the startup code of the vBRS. For details please refer to the TechnicalReference.
        reference vLinkGenVarGroupVariant [0..*]: multiplicity set at pre-compile, origin=Vector Informatik, set at pre-compile, destination=vLinkGenVariant  # Variants | References to the linker script variants in which the Logical Group should be used. Note: - If variants are configured but this group is not assigned to one, it applies to all of them. - If it is not possible to delete a variant from the list, please check if there is a vLinkGenVarGroupVariantSpecifics subcontainer that refers to this variant.
        foreign reference vLinkGenVarGroupModule [0..1]: multiplicity set at pre-compile, origin=Vector Informatik, set at pre-compile, destination-type=ECUC-MODULE-CONFIGURATION-VALUES  # Module Ref | Optional reference to the module which owns (requires) this Logical Group. Note: If this reference is set, the container is typically created by another module's generator.
        reference vLinkGenVarGroupContentType [0..1]: multiplicity set at pre-compile, origin=Vector Informatik, set at pre-compile, destination=vLinkGenVarContentType  # Content Type | Specifies the type of content of the Logical Group. What means which kind of data it will contain after linking. Note: If set, vLinkGen will set the Default Memory Region Block references to the appropriate values. What means if an available Memory Region Block is found, the reference will be set automatically and cannot be changed afterwards. If it is necessary to change the Memory Region Block reference, this content type has to be removed.
        reference vLinkGenVarGroupFlag [0..*]: multiplicity set at pre-compile, origin=Vector Informatik, set at pre-compile, destination=vLinkGenLogicalVarGroupFlag  # Compiler Specific Flags | Defines compiler specific flags to be generated for the Logical Group. Note: The flags to be selected are predefined and cannot be changed. If none are selectable, the compiler either does not support flags on group level or the vLinkGen doesn't support them.
        container vLinkGenVarSectionGroup [0..*]: multiplicity set at pre-compile  # Specifies a group of Linker Sections whose content shall be linked into this Section Group. Note: Section Groups are comparable to output sections from (some) compiler manuals.
          integer vLinkGenVarSectionGroupPosition: 0..4294967295, multiplicity set at pre-compile, origin=Vector Informatik, set at pre-compile, default-value=0  # Position | Specifies the relative position of the Section Group within its parent Logical Group. If multiple groups have the same position, they are sorted alphabetically by their container names.
          integer vLinkGenVarSectionGroupAlignment [0..1]: 0..4294967295, multiplicity set at pre-compile, origin=Vector Informatik, set at pre-compile, default-value=4  # Alignment | This value specifies the optional start address alignment of the Section Group in bytes.
          integer vLinkGenVarSectionGroupEndAlignment [0..1]: 0..4294967295, multiplicity set at pre-compile, origin=Vector Informatik, set at pre-compile, default-value=4  # End Alignment | This value specifies the optional end (length) alignment of the Section Group in bytes. This allows the generated END or LIMIT labels to be aligned accordingly.
          integer vLinkGenVarSectionGroupSize [0..1]: 0..4294967295, multiplicity set at pre-compile, origin=Vector Informatik, set at pre-compile, default-value=0  # Group Size | This value specifies the optional size of the Section Group in bytes. This can be used to keep an area free in the memory layout for groups without any Linker Sections (empty groups).
          integer vLinkGenVarSectionGroupGapSize [0..1]: 0..4294967295, multiplicity set at pre-compile, origin=Vector Informatik, set at pre-compile, default-value=0  # Gap Size | This value specifies the size of the optional gap to be kept free after the Section Group in bytes. In order to correctly configure the MPU on some platforms, a certain area must be left free after the individual MPU regions. This area can be configured via this parameter. The vLinkGen then generates the linker script in the appropriate way so the configured area after the section group is kept free after linking.
          enumeration vLinkGenVarSectionGroupInit: {NONE, INIT, ZERO_INIT}, multiplicity set at pre-compile, origin=Vector Informatik, set at pre-compile, default-value=NONE  # Init Policy | Specifies whether the Section Group shall be initialized at ECU startup or not. NONE: No initialization required. INIT: Initialize all variable data within the Section Group with predefined values (ROM to RAM copy). ZERO_INIT: Initialize all variable data within the Section Group with completely with zeros.
          enumeration vLinkGenVarSectionGroupInitStage: {NONE, EARLY, ZERO, HARD_RESET_ONLY, ONE, TWO, THREE}, multiplicity set at pre-compile, origin=Vector Informatik, set at pre-compile, default-value=ONE  # Init Stage | Specifies the stage at ECU startup for the initialization of the Section Group. This parameter is only evaluated if the Init Policy is set to value other than NONE. NONE: No initialization configured. EARLY: Initialize always directly after reset. Shall only be used if really necessary. Since the PLL might not be initialized at that time, the initialization of large areas may take a long time. Only supported for ZERO_INIT Section Groups. ZERO: Always initialized first during the default vBRS startup routine. HARD_RESET_ONLY: Same initialization stage as ONE. However, initialization is only done if a hardware reset occurred. ONE: Always initialized second during the default vBRS startup routine. By default, this value should be used if an initialization is required. TWO, THREE: Optional init stages, which are initialized accordingly after the HARD_RESET_ONLY stage. Shall only be used if really necessary. One use case might be to reset the Wdg between the initialization of two stages.
          choice reference vLinkGenVarSectionGroupRef [0..*]: multiplicity set at pre-compile, origin=Vector Informatik, set at pre-compile, destination=[vLinkGenLinkerVarSection, vLinkGenLinkerStackSection, vLinkGenLinkerSpecSection]  # Sections | Reference to the sections which shall be linked into the Section Group.
          choice reference vLinkGenVarSectionGroupFlag [0..*]: multiplicity set at pre-compile, origin=Vector Informatik, set at pre-compile, destination=vLinkGenVarGroupFlag  # Compiler Specific Flags | Defines compiler specific flags to be generated for the Section Group. Note: The flags to be selected are predefined and cannot be changed. If none are selectable, the compiler either does not support flags on group level or the vLinkGen doesn't support them.
        container vLinkGenVarGroupVariantHandling [0..1]: multiplicity set at pre-compile  # Collection of variant specific Memory Region Block mappings, with which it is possible to link a logical group (respectively all of their containing Section Groups) to different memory areas in different variants. The following behavior applies when setting the Memory Region Block references: - For all variants, the "default" references from the Logical Group are used - If a variant is specified in a variant specifics, then the "overwriting" references are used - Where the "overwriting" references in the variant specifics are optional. - This means that for a variant, for example, only the ROM/RAM copy can be linked elsewhere.
          container vLinkGenVarGroupVariantSpecifics [0..*]: multiplicity set at pre-compile  # Specifies variant specific Memory Region Block overwrites. See vLinkGenVarGroupVariantHandling description for details.
            reference vLinkGenVarGroupSpecificRegion [0..1]: multiplicity set at pre-compile, origin=Vector Informatik, set at pre-compile, destination=vLinkGenMemoryRegionBlock  # Overwriting Memory Region Block | Overwrites the default Memory Region Block from the parent Logical Group in the variants listed below.
            reference vLinkGenVarGroupSpecificRomRegion [0..1]: multiplicity set at pre-compile, origin=Vector Informatik, set at pre-compile, destination=vLinkGenMemoryRegionBlock  # Overwriting Memory Region Block (ROM Copy) | Overwrites the default Memory Region Block (ROM Copy) from the parent Logical Group in the variants listed below.
            reference vLinkGenVarGroupSpecificVariant [0..*]: multiplicity set at pre-compile, origin=Vector Informatik, set at pre-compile, destination=vLinkGenVariant  # Variants | References to the linker script variants for which the overwritten Memory Region Block references are to apply. Note: - Variants specified here must also be added to the parent Logical Group Variants.
      container vLinkGenLogicalSymbolGroup [0..*]: multiplicity set at pre-compile  # This container includes all configuration parameters for a Logical Symbol Group. Logical Symbol Groups are an abstraction layer to group multiple Linker Symbols and generate them in the list of Logical Groups. Note: Some compilers expect global symbols to be defined at a certain position in the linker script. In this case the configured position is simply ignored.
        integer vLinkGenSymbolGroupPosition: 0..4294967295, multiplicity set at pre-compile, origin=Vector Informatik, set at pre-compile, default-value=5  # Position | Specifies the relative position of the Logical Group within all Logical Groups. If multiple groups have the same position, they are sorted alphabetically by their container names. Note: With some compilers, the actual order of the Logical Group after linking may differ from the configured one. This is a compiler limitation and cannot be influenced by vLinkGen.
        reference vLinkGenSymbolGroupVariant [0..*]: multiplicity set at pre-compile, origin=Vector Informatik, set at pre-compile, destination=vLinkGenVariant  # Variants | Reference to the linker script variants in which this group should be used. Note: If variants are configured but this group is not assigned to one, it applies to all of them.
        foreign reference vLinkGenSymbolGroupModule [0..1]: multiplicity set at pre-compile, origin=Vector Informatik, set at pre-compile, destination-type=ECUC-MODULE-CONFIGURATION-VALUES  # Module Ref | Optional reference to the module which owns (requires) this Logical Group. Note: If this reference is set, the container is typically created by another module's generator.
        container vLinkGenLinkerSymbol [1..*]: multiplicity set at pre-compile  # This container includes all configuration parameters for a compiler independent symbol definition which can have a name and a value. That means it is possible to assign values to own symbols, and vLinkGen will generate these assignments in the appropriate syntax into the linker script. Note: Some compilers do not support the definition of global Linker Symbols at all or only to a limited extent. This should be considered when using Linker Symbols. However, vLinkGen will issue warnings if a compiler does not support them or only to a limited extent.
          integer vLinkGenLinkerSymbolPosition: 0..4294967295, multiplicity set at pre-compile, origin=Vector Informatik, set at pre-compile, default-value=0  # Position | Specifies the relative position of the Linker Symbol within its parent Logical Group. If multiple symbols have the same position, they are sorted alphabetically by their container names.
          linker symbol vLinkGenLinkerSymbolName: multiplicity set at pre-compile, origin=Vector Informatik, set at pre-compile  # Name | This parameter specifies the name of the symbol. Note: The symbol must be a valid linker symbol.
          string vLinkGenLinkerSymbolValue: multiplicity set at pre-compile, origin=Vector Informatik, set at pre-compile  # Value | This parameter specifies the value that the symbol should get.
      container vLinkGenLogicalUserGroup [0..*]: multiplicity set at pre-compile  # This container includes all configuration parameters for a Logical User Group. Logical Groups are an abstraction layer to group multiple Section Groups and map them to a Memory Region Block.
        integer vLinkGenUserGroupPosition: 0..4294967295, multiplicity set at pre-compile, origin=Vector Informatik, set at pre-compile, default-value=5  # Position | Specifies the relative position of the Logical Group within all Logical Groups. If multiple groups have the same position, they are sorted alphabetically by their container names. Note: With some compilers, the actual order of the Logical Group after linking may differ from the configured one. This is a compiler limitation and cannot be influenced by vLinkGen.
        enumeration vLinkGenUserGroupPlacement: {PRE, POST, GROUP_LIST}, multiplicity set at pre-compile, origin=Vector Informatik, set at pre-compile, default-value=PRE  # Placement | Specifies where the user code group should be generated in the linker script. PRE: The user code is generated at the beginning of the linker script. POST: The user code is generated at the end of the linker script. GROUP_LIST: The user code is generated within the Section Groups list at the specified position. If set, the Memory Region Block reference need also to be set for some compilers.
        reference vLinkGenUserGroupRegion [0..1]: multiplicity set at pre-compile, origin=Vector Informatik, set at pre-compile, destination=vLinkGenMemoryRegionBlock  # Memory Region Block | Reference to the Memory Region Block where the user Section Group should be linked to. Note: Only applicable if, vLinkGenUserGroupPlacement is set to GROUP_LIST and the compiler requires the configuration.
        reference vLinkGenUserGroupVariant [0..*]: multiplicity set at pre-compile, origin=Vector Informatik, set at pre-compile, destination=vLinkGenVariant  # Variants | Reference to the linker script variants in which this group should be used. Note: If variants are configured but this group is not assigned to one, it applies to all of them.
        foreign reference vLinkGenUserGroupModule [0..1]: multiplicity set at pre-compile, origin=Vector Informatik, set at pre-compile, destination-type=ECUC-MODULE-CONFIGURATION-VALUES  # Module Ref | Optional reference to the module which owns (requires) this Logical Group. Note: If this reference is set, the container is typically created by another module's generator.
        container vLinkGenUserSectionGroup [0..*]: multiplicity set at pre-compile  # Specifies an user code section that is generated into the linker script at the specified position.
          integer vLinkGenUserSectionGroupPosition: 0..4294967295, multiplicity set at pre-compile, origin=Vector Informatik, set at pre-compile, default-value=0  # Position | Specifies the relative position of the Section Group within its parent Logical Group. If multiple groups have the same position, they are sorted alphabetically by their container names.
          multiline string vLinkGenUserSectionGroupValue: multiplicity set at pre-compile, origin=Vector Informatik, set at pre-compile  # User Code | Specifies the compiler specific user code that is directly generated into the linker script.
      container vLinkGenMemoryRegion [0..*]: multiplicity set at pre-compile  # This container includes all configuration parameters for one Memory Region. Memory Regions are a logical abstraction layer to separate the configuration from the actual memory layout and to make it hardware independent.
        integer vLinkGenMemoryRegionAddrOffset: 0..4294967295, multiplicity set at pre-compile, origin=Vector Informatik, set at pre-compile, default-value=0  # Offset | Specifies the offset of the Memory Region to the referenced hardware region start address. The resulting start address of the Memory Region is calculated from the start address of the hardware memory area in vBaseEnv and this offset value.
        integer vLinkGenMemoryRegionSize: 0..4294967295, multiplicity set at pre-compile, origin=Vector Informatik, set at pre-compile, default-value=0  # Size | This value specifies the size of the Memory Region in bytes. A hardware memory area can be splitted into multiple Memory Regions in vLinkGen. In this the sizes of all Memory Regions must not exceed the size of the actual hardware memory area.
        integer vLinkGenMemoryRegionAddress: 0..4294967295, multiplicity set at pre-compile, origin=Vector Informatik, set at pre-compile, default-value=0  # Calculated Start Address | Shows the calculated start address of the Memory Region. The displayed value is the actual start address of the Memory Region after linking. It is calculated from the start address of the hardware memory area in vBaseEnv and the address offset of the Memory Region. Caution: This parameter is for information only and must not be changed manually.
        boolean vLinkGenMemoryRegionAvailable: multiplicity set at pre-compile, origin=Vector Informatik, set at pre-compile, default-value=true  # Calculated Availability | Specifies whether or not this Memory Region is available. What means the referenced Hardware Memory Area exists on the tested derivative or not. To change, either select a different Hardware Memory Area or change the tested derivative in the vBaseEnv configuration. Note: The tested derivative is defined by '/vBaseEnv/vBaseEnvGeneral/vBaseEnvTestedDerivativeRef'. Caution: This parameter is for information only and must not be changed manually.
        reference vLinkGenMemoryRegionHwRegion: multiplicity set at pre-compile, origin=Vector Informatik, set at pre-compile, destination=vBaseEnvMemLayoutHwRegion  # Hardware Memory Area | Reference to the hardware memory area where the Memory Region should be mapped to. The hardware memory areas are predefined in the vBaseEnv and cannot be changed. They reflect the actual memory layout in the hardware.
        container vLinkGenMemoryRegionBlock [1..*]: multiplicity set at pre-compile  # This container includes all configuration parameters for a Memory Region Block. Memory Region Blocks can be used to partition a Memory Region. They are used for the actual memory definitions in the generated linker script. Note: The position of a Memory Region Block in the memory area is determined by its position, size and boundary. The actual start addresses of several blocks within a Memory Region are calculated using these parameters.
          integer vLinkGenMemoryRegionBlockPosition: 0..4294967295, multiplicity set at pre-compile, origin=Vector Informatik, set at pre-compile, default-value=0  # Position | Specifies the relative position of the Memory Region Block within its parent Memory Region. If multiple blocks have the same position, they are sorted alphabetically by their container names.
          integer vLinkGenMemoryRegionBlockSize: 0..4294967295, multiplicity set at pre-compile, origin=Vector Informatik, set at pre-compile, default-value=0  # Size | This value specifies the size of the Memory Region Block in bytes. A Memory Region can be splitted into multiple Memory Region Blocks. In this the sizes of all blocks must not exceed the size of the parent Memory Region.
          integer vLinkGenMemoryRegionBlockAddress: 0..4294967295, multiplicity set at pre-compile, origin=Vector Informatik, set at pre-compile, default-value=0  # Calculated Start Address | Shows the calculated start address of the Memory Region Block. The displayed value is the actual start address of the Memory Region Block after linking. It is derived from the calculated start address of its parent Memory Region and its own boundary and position. Caution: This parameter is for information only and must not be changed manually.
          enumeration vLinkGenMemoryRegionBlockBoundary: {LOWER, UPPER}, multiplicity set at pre-compile, origin=Vector Informatik, set at pre-compile, default-value=LOWER  # Boundary | This value defines the location of the memory area block within its parent memory area. Memory Region Blocks can be mapped either to the lower (lower address value) or upper (higher address value) end of the Memory Region. Their start address is then calculated based on the boundary value, their position and the size of their preceding blocks. This can be useful if, for example, between two Memory Region Blocks within a Memory Region an area in memory is to be left free. LOWER: The Memory Region Block is linked to the lower boundary of the Memory Region. UPPER: The Memory Region Block is linked to the upper boundary of the Memory Region.
          enumeration vLinkGenMemoryRegionBlockInitStage: {NONE, EARLY, HARD_RESET_ONLY, ONE}, multiplicity set at pre-compile, origin=Vector Informatik, set at pre-compile, default-value=NONE  # Init Stage | This parameter defines whether the complete Memory Region Block shall be initialized with zeros and when. This is typically required for ECC protected memory areas before the first read or write access. NONE: No initialization required. EARLY: Initialize always directly after reset. Shall only be used if really necessary. Since the PLL might not be initialized at that time, the initialization of large areas may take a long time. HARD_RESET_ONLY: Same initialization stage as ONE. However, initialization is only done if a hardware reset occurred. ONE: Always initialized second during the default vBRS startup routine. By default, this value should be used if an initialization is required.
          integer vLinkGenMemoryRegionBlockCore [0..1]: 0..4294967295, multiplicity set at pre-compile, origin=Vector Informatik, set at pre-compile, default-value=0  # Core Id | Specifies the physical core ID to which the Memory Region Block is assigned. Only relevant for core local Memory Region Blocks, respectively core local hardware memory areas.
          integer vLinkGenMemoryRegionBlockInitCore [0..1]: 0..4294967295, multiplicity set at pre-compile, origin=Vector Informatik, set at pre-compile, default-value=0  # Core Id (zero initialization) | Specifies the physical core ID which shall perform the zero initialization of the Memory Region Block. Only relevant if Init Stage is set to a value other than NONE.
          reference vLinkGenMemoryRegionBlockFlag [0..*]: multiplicity set at pre-compile, origin=Vector Informatik, set at pre-compile, destination=vLinkGenRegionBlockFlag  # Compiler Specific Flags | Defines compiler specific flags to be generated for the Memory Region Block. Note: The flags to be selected are predefined and cannot be changed. If none are selectable, the compiler either does not support flags on Memory Region Block level or the vLinkGen doesn't support them.
          choice reference vLinkGenMemoryRegionBlockContentType [0..*]: multiplicity set at pre-compile, origin=Vector Informatik, set at pre-compile, destination=[vLinkGenConstContentType, vLinkGenVarContentType]  # Valid Content Types | Specifies the valid content types which can be mapped to the Memory Region Block. What means which kind of code, constants or data can be linked into this memory area.
    container vLinkGenPublishedInformation: multiplicity set at pre-compile  # Contains additional published compiler specific informations. Caution: This container (and all including sub-elements) must not be changed manually.
      integer vLinkGenGeneration: 0..4294967295, multiplicity set at pre-compile, origin=Vector Informatik, set at pre-compile, default-value=0  # Defines the internal vLinkGen code generation.
      integer vLinkGenDefaultConstGroupAlignment [0..1]: 0..4294967295, multiplicity set at pre-compile, origin=Vector Informatik, set at pre-compile, default-value=0  # Default CONST Group Start Alignment | Specifies the optional default start address alignment for all CONST Section Groups in bytes. Note: It is only used for newly created groups that have no predefined values (e.g. recommended configuration). It can, however, be changed in the groups later.
      integer vLinkGenDefaultVarGroupAlignment [0..1]: 0..4294967295, multiplicity set at pre-compile, origin=Vector Informatik, set at pre-compile, default-value=0  # Default VAR Group Start Alignment | Specifies the optional default start address alignment for all VAR Section Groups in bytes. Note: It is only used for newly created groups that have no predefined values (e.g. recommended configuration). It can, however, be changed in the groups later.
      boolean vLinkGenDuplicatedLabels: multiplicity set at pre-compile, origin=Vector Informatik, set at pre-compile, default-value=false  # Duplicated Labels | Specifies whether the vLinkGen shall generate duplicated labels or not. true: Generate additional labels with double underscores ("__") at the beginning false: Normal label generation. No duplicated labels
      container vLinkGenRegionBlockFlags [0..1]: multiplicity set at pre-compile  # Collection of compiler specific Memory Region Block flags.
        container vLinkGenRegionBlockFlag [1..*]: multiplicity set at pre-compile  # Definition of a compiler specific Memory Region Block flag.
      container vLinkGenLogicalConstGroupFlags [0..1]: multiplicity set at pre-compile  # Collection of compiler specific Logical Group flags.
        container vLinkGenLogicalConstGroupFlag [1..*]: multiplicity set at pre-compile  # Definition of a compiler specific Logical Group flag.
      container vLinkGenConstGroupFlags [0..1]: multiplicity set at pre-compile  # Collection of compiler specific Section Group flags.
        container vLinkGenConstGroupFlag [1..*]: multiplicity set at pre-compile  # Definition of a compiler specific Section Group flag.
      container vLinkGenConstSectionFlags [0..1]: multiplicity set at pre-compile  # Collection of compiler specific Linker Section flags.
        container vLinkGenConstSectionFlag [1..*]: multiplicity set at pre-compile  # Definition of a compiler specific Linker Section flag.
      container vLinkGenLogicalVarGroupFlags [0..1]: multiplicity set at pre-compile  # Collection of compiler specific Logical Group flags.
        container vLinkGenLogicalVarGroupFlag [1..*]: multiplicity set at pre-compile  # Definition of a compiler specific Logical Group flag.
      container vLinkGenVarGroupFlags [0..1]: multiplicity set at pre-compile  # Collection of compiler specific Section Group flags.
        container vLinkGenVarGroupFlag [1..*]: multiplicity set at pre-compile  # Definition of a compiler specific Section Group flag.
      container vLinkGenVarSectionFlags [0..1]: multiplicity set at pre-compile  # Collection of compiler specific Linker Section flags.
        container vLinkGenVarSectionFlag [1..*]: multiplicity set at pre-compile  # Definition of a compiler specific Linker Section flag.
      container vLinkGenSpecSectionFlags [0..1]: multiplicity set at pre-compile  # Collection of compiler specific Linker Section flags.
        container vLinkGenSpecSectionFlag [1..*]: multiplicity set at pre-compile  # Definition of a compiler specific Linker Section flag.
    container vLinkGenVariantHandling [0..1]: multiplicity set at pre-compile  # This container contains all configuration parameters for the variant handling. Caution: If variants are configured, exactly one of them must always be defined in a build process. For example, by passing it as compiler and/or linker option (e.g. -D<VariantName>).
      container vLinkGenVariant [1..*]: multiplicity set at pre-compile  # This container specifies one linker script variant.
    container vLinkGenContentTypes [0..1]: multiplicity set at pre-compile  # This container contains all content types. Content types can be used to automatically assign Logical Groups to an appropriate Memory Region Block depending on their expected content. Note: The vLinkGen comes with a predefined set of default content types. However, it is always possible to define additional ones.
      container vLinkGenConstContentType [0..*]: multiplicity set at pre-compile  # Definition of a constant (code or data) content type.
        boolean vLinkGenConstContentTypeLocal: multiplicity set at pre-compile, origin=Vector Informatik, set at pre-compile, default-value=false  # Core Local Content | Specifies whether or not this type of content has to be linked to a core local Memory Region, respectively a core local hardware memory area.
        reference vLinkGenConstContentTypeCopyRef [0..1]: multiplicity set at pre-compile, origin=Vector Informatik, set at pre-compile, destination=vLinkGenVarContentType  # Copy Content Type | Specifies the content type which shall be used to retrieve the appropriate Memory Region Block where the RAM copy shall be linked to.
      container vLinkGenVarContentType [0..*]: multiplicity set at pre-compile  # Definition of a variable (data) content type.
        boolean vLinkGenVarContentTypeLocal: multiplicity set at pre-compile, origin=Vector Informatik, set at pre-compile, default-value=false  # Core Local Content | Specifies whether or not this type of content has to be linked to a core local Memory Region, respectively a core local hardware memory area.
        reference vLinkGenVarContentTypeCopyRef [0..1]: multiplicity set at pre-compile, origin=Vector Informatik, set at pre-compile, destination=vLinkGenConstContentType  # Copy Content Type | Specifies the content type which shall be used to retrieve the appropriate Memory Region Block where the initialization data shall be linked to.
