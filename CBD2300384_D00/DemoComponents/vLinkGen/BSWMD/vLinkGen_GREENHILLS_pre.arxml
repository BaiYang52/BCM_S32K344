AUTOSAR XML (schema 4-2-1)
package /MICROSAR
  module config vLinkGen_Pre: definition=vLinkGen
    vLinkGenPublishedInformation
      vLinkGenConstGroupFlags
        5 x vLinkGenConstGroupFlag:
          ABS
          CLEAR
          NOCLEAR
          NOLOAD
          NOCHECKSUM
      vLinkGenVarGroupFlags
        5 x vLinkGenVarGroupFlag:
          ABS
          CLEAR
          NOCLEAR
          NOLOAD
          NOCHECKSUM
