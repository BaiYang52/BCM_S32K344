AUTOSAR XML (schema 4-2-1)
package /MICROSAR
  module config vLinkGen_Rec: definition=vLinkGen
    vLinkGenMemLayout
      vLinkGenLinkerSections
        text (vLinkGenLinkerCodeSection): vLinkGenLinkerCodeSectionName=text
        text_vle (vLinkGenLinkerCodeSection): vLinkGenLinkerCodeSectionName=vletext
        6 x vLinkGenLinkerSpecSection:
          secinfo: vLinkGenLinkerSpecSectionValue=.secinfo
          syscall: vLinkGenLinkerSpecSectionValue=.syscall
          fixaddr: vLinkGenLinkerSpecSectionValue=.fixaddr
          fixtype: vLinkGenLinkerSpecSectionValue=.fixtype
          picbase: vLinkGenLinkerSpecSectionValue=.picbase
          pidbase: vLinkGenLinkerSpecSectionValue=.pidbase
        6 x vLinkGenLinkerConstSection:
          rodata: vLinkGenLinkerConstSectionName=rodata
          rosdata: vLinkGenLinkerConstSectionName=rosdata, vLinkGenLinkerConstSectionFast=1
          ldata: vLinkGenLinkerConstSectionName=ldata, vLinkGenLinkerConstSectionFast=1
          sdata2: vLinkGenLinkerConstSectionName=sdata2, vLinkGenLinkerConstSectionFast=1
          rozdata: vLinkGenLinkerConstSectionName=rozdata, vLinkGenLinkerConstSectionFast=1
          zrodata: vLinkGenLinkerConstSectionName=zrodata, vLinkGenLinkerConstSectionFast=1
        data (vLinkGenLinkerVarSection): vLinkGenLinkerVarSectionName=data
        sdabase (vLinkGenLinkerSpecSection): vLinkGenLinkerSpecSectionValue=.sdabase
        sdata (vLinkGenLinkerVarSection): vLinkGenLinkerVarSectionName=sdata, vLinkGenLinkerVarSectionFast=1
        tdata (vLinkGenLinkerSpecSection): vLinkGenLinkerSpecSectionValue=.tdata
        zdata (vLinkGenLinkerVarSection): vLinkGenLinkerVarSectionName=zdata, vLinkGenLinkerVarSectionFast=1
        PPC_EMB_SDATA0 (vLinkGenLinkerSpecSection): vLinkGenLinkerSpecSectionValue=.PPC.EMB.sdata0
        bss (vLinkGenLinkerVarSection): vLinkGenLinkerVarSectionName=bss
        COMMON (vLinkGenLinkerSpecSection): vLinkGenLinkerSpecSectionValue=COMMON
        sbss (vLinkGenLinkerVarSection): vLinkGenLinkerVarSectionName=sbss, vLinkGenLinkerVarSectionFast=1
        SMALLCOMMON (vLinkGenLinkerSpecSection): vLinkGenLinkerSpecSectionValue=SMALLCOMMON
        zbss (vLinkGenLinkerVarSection): vLinkGenLinkerVarSectionName=zbss, vLinkGenLinkerVarSectionFast=1
        PPC_EMB_SBSS0 (vLinkGenLinkerSpecSection): vLinkGenLinkerSpecSectionValue=.PPC.EMB.sbss0
        ZEROCOMMON (vLinkGenLinkerSpecSection): vLinkGenLinkerSpecSectionValue=ZEROCOMMON
        stack (vLinkGenLinkerVarSection): vLinkGenLinkerVarSectionName=stack
      Const_Default (vLinkGenLogicalConstGroup): vLinkGenConstGroupPosition=1000, vLinkGenConstGroupContentType=GLOBAL_CONST
        7 x vLinkGenConstSectionGroup:
          text: vLinkGenConstSectionGroupRef=vLinkGenLinkerSections/text, vLinkGenConstSectionGroupRef=text_vle, vLinkGenConstSectionGroupRef=syscall, vLinkGenConstSectionGroupRef=fixaddr, vLinkGenConstSectionGroupRef=fixtype, vLinkGenConstSectionGroupRef=picbase, vLinkGenConstSectionGroupRef=pidbase
          secinfo: vLinkGenConstSectionGroupRef=vLinkGenLinkerSections/secinfo
          rodata: vLinkGenConstSectionGroupRef=vLinkGenLinkerSections/rodata
          rozdata: vLinkGenConstSectionGroupRef=vLinkGenLinkerSections/rozdata, vLinkGenConstSectionGroupRef=zrodata
          tdata: vLinkGenConstSectionGroupRef=vLinkGenLinkerSections/tdata
          rosdata: vLinkGenConstSectionGroupRef=vLinkGenLinkerSections/rosdata, vLinkGenConstSectionGroupRef=ldata
          sdata2: vLinkGenConstSectionGroupRef=vLinkGenLinkerSections/sdata2
      Data_Default (vLinkGenLogicalVarGroup): vLinkGenVarGroupPosition=1000, vLinkGenVarGroupContentType=GLOBAL_DATA
        9 x vLinkGenVarSectionGroup:
          data: vLinkGenVarSectionGroupInit=INIT, vLinkGenVarSectionGroupRef=vLinkGenLinkerSections/data
          sdabase: vLinkGenVarSectionGroupRef=vLinkGenLinkerSections/sdabase
          sdata: vLinkGenVarSectionGroupInit=INIT, vLinkGenVarSectionGroupRef=vLinkGenLinkerSections/sdata
          zdata: vLinkGenVarSectionGroupInit=INIT, vLinkGenVarSectionGroupRef=vLinkGenLinkerSections/zdata, vLinkGenVarSectionGroupRef=PPC_EMB_SDATA0
          bss: vLinkGenVarSectionGroupInit=ZERO_INIT, vLinkGenVarSectionGroupRef=vLinkGenLinkerSections/bss, vLinkGenVarSectionGroupRef=COMMON, vLinkGenVarSectionGroupFlag=CLEAR
          sbss: vLinkGenVarSectionGroupInit=ZERO_INIT, vLinkGenVarSectionGroupRef=vLinkGenLinkerSections/sbss, vLinkGenVarSectionGroupRef=SMALLCOMMON, vLinkGenVarSectionGroupFlag=CLEAR
          zbss: vLinkGenVarSectionGroupInit=ZERO_INIT, vLinkGenVarSectionGroupRef=vLinkGenLinkerSections/zbss, vLinkGenVarSectionGroupRef=PPC_EMB_SBSS0, vLinkGenVarSectionGroupRef=ZEROCOMMON, vLinkGenVarSectionGroupFlag=CLEAR
          stack: vLinkGenVarSectionGroupRef=vLinkGenLinkerSections/stack
          heap: vLinkGenVarSectionGroupAlignment=16, vLinkGenVarSectionGroupSize=1024, vLinkGenVarSectionGroupFlag=NOCLEAR
