AUTOSAR XML (schema 4-0-3)
# COPYRIGHT
# Copyright (c) 2023 by Vector Informatik GmbH. All rights reserved.
# This software is copyright protected and proprietary to Vector Informatik GmbH.
# Vector Informatik GmbH grants to you only those rights as set out in the license conditions.
package /MICROSAR
  bsw implementation vBRS_Impl: programming-language=C, sw-version=1.00.00, used-code-generator=DaVinci Configurator, vendor-id=30, ar-release-version=4.00.03, preconfigured-configuration=vBRS_Pre, recommended-configuration=vBRS_Rec, vendor-specific-module-def=vBRS
  module definition vBRS [0..1]: category=VENDOR_SPECIFIC_MODULE_DEFINITION, variants pre-compile  # Basic Runtime System | The Vector Basic Runtime System (vBRS) provides functionality to initialize a microcontrollers' memory, PLL, Ports and Watchdog. It also provides startup code and functionalities for basic initialization and handling of the different Vector Software stacks. It is part of the vBaseEnv. For internal development and external use. #vBaseEnv #Startup #Vector
    container vBRSGeneral  # General configuration parameters of the vBRS.
      boolean vBRSEnableSupportLEDs: set at pre-compile, origin=Vector Informatik, default-value=false  # Toggle LED-Pin | Use the functionality of a blinking live-LED for the used EvalBoard. Sets the following generated parameters: BRS_ENABLE_SUPPORT_LEDS in vBrsCfg.h
      boolean vBRSEnableSafeContextSupport: set at pre-compile, origin=Vector Informatik, default-value=false  # Enable OS SafeContext (SC3) support | Enable support of SafeContext OS (used for OS partitioning UseCase). Sets the following generated parameters: BRS_ENABLE_SAFECTXSUPPORT in vBrsCfg.h
      boolean vBRSEnableMultiCoreSupport: set at pre-compile, origin=Vector Informatik, default-value=false  # Enable OS MultiCore support | Enable support of MultiCore OS. Sets the following generated parameters: BRS_ENABLE_OS_MULTICORESUPPORT in vBrsCfg.h
      string vBRSUserConfigFile [0..1]: set at pre-compile, origin=Vector Informatik  # User config header file | If a file name is entered here, it will be included in vBrsCfg.h.
      boolean vBRSEnableSupportToggleWdPin: set at pre-compile, origin=Vector Informatik, default-value=false  # Toggle WD-Pin | Use the functionality of a toggling pin to trigger external watchdogs for the used EvalBoard. Sets the following generated parameters: BRS_ENABLE_SUPPORT_TOGGLE_WD_PIN in vBrsCfg.h
      boolean vBRSEnableSupportToggleCustomPin: set at pre-compile, origin=Vector Informatik, default-value=false  # Toggle Custom-Pin | Use the functionality of a toggling pin for the used EvalBoard. Sets the following generated parameters: BRS_ENABLE_SUPPORT_TOGGLE_CUSTOM_PIN in vBrsCfg.h
      boolean vBRSEnableEcuMStubGeneration: set at pre-compile, origin=Vector Informatik, default-value=false  # Generation of EcuM Stub | If no real EcuM is part of the configuration, this functionality generates an EcuM.c/h stub, that calls the Init-functions of the ASR modules as specified in the EcuC/EcucGeneral/BswInitialization configuration.
      boolean vBRSDisableSetupSupport: set at pre-compile, origin=Vector Informatik, default-value=false  # Activate this, if you don't want the BRS to guide you through the default MSR stack configuration (e.g. AutosolvingActions for mandatory tasks).
      boolean vBRSEnableSchmStubGeneration: set at pre-compile, origin=Vector Informatik, default-value=false  # Generation of SchM Stub | Activate this, if the SchM stubs, containing the defines for EXCLUSIVE AREAs, should be generated. Needed, if the ASR RTE/SchM is not part of the configuration, but modules are using the SchM exclusive area mechanism.
      boolean vBRSEnableSchmStubSupportDrvCanAN: set at pre-compile, origin=Vector Informatik, default-value=true  # Generation of SchM Stub - support DrvCan AN | Prevents the SchM stub from generation of the following exclusive areas: CAN Driver (CAN_EXCLUSIVE_AREA_6) CAN Interface (CANIF_EXCLUSIVE_AREA_0) CANSM (CANSM_ EXCLUSIVE_AREA_1, CANSM_ EXCLUSIVE_AREA_4) COMM (COMM_ EXCLUSIVE_AREA_1) As described within CanDriver ApplicationNote AN-ISC-8-1149. The implementation of these APIs, under consideration of this AN, is already part of static BrsMain_Appl.c.
      boolean vBRSEnableSchmStubEmptyExclusiveAreaHandling: set at pre-compile, origin=Vector Informatik, default-value=false  # Generation of SchM Stub - empty exclusive area handling | For normal, all module specific exclusive are calls are mapped to SuspendAllInterrupts()/ResumeAllInterrupts(). If this feature is activated, the SchM stub will generate them as empty calls instead. E.g. in SchM_Mcu.h: # define SchM_Enter_Mcu_MCU_EXCLUSIVE_AREA_00() # define SchM_Exit_Mcu_MCU_EXCLUSIVE_AREA_00() instead of # define SchM_Enter_Mcu_MCU_EXCLUSIVE_AREA_00() SuspendAllInterrupts() # define SchM_Exit_Mcu_MCU_EXCLUSIVE_AREA_00() ResumeAllInterrupts() This is mainly for polling environments, where no OS is used and therefore no specific disabling of interrupts is necessary.
      enumeration vBRSExecutionInstance: set at pre-compile, origin=Vector Informatik, default-value=Application  # This executable: Execution Instance | Configure the execution instance of the application, handled by this configuration. As sometimes, there exist several applications in one system, they need to be separated. "Application" stands for a "normal" application executable (e.g. MSR or CANbedded stack), which could be standalone or called out of a FBL or BM. "FBL" stands for a FlashBootLoader executable, which could be standalone or called out of a BM. "FBL_Updater" stands for a FlashBootLoader Updater executable, which could be standalone or called out of a BM. "BM" stands for a Boot Manager executable, which is the startup entry and decides to call a FBL, Updater or Application. "BM_FBL" stands for a Boot Manager and FlashBootLoader executable, which are compiled together. The BootManager part is the startup entry and decides to call the FBL part, Updater or Application. "HSM" stands for a HSM Core executable, which could be standalone or called out of a BM (if also a HSM updater is present). "FlashDriver" stands for a standalone binary, containing a flasher driver instance only. There is no runtime part included. Sets the following generated parameters in vBrsCfg.h: BRS_ENABLE_FBL for the values "FBL", "FBL_Updater", "BM" and "BM_FBL" BRS_ENABLE_HSM_SUPPORT for the value "HSM" Sets the following generated parameters in Makefile.config.generated: BRS_ENABLE_HSM_SUPPORT, BRS_ENABLE_FBL_SUPPORT
        Application  # normal application instance
        FBL  # FBL instance
        FBL_Updater  # FBL Updater instance
        BM  # BM instance
        BM_FBL  # BM+FBL combined instance
        HSM  # HSM instance
        FlashDriver  # FBL FlashDriver instance
      boolean vBRSFirstInstance: set at pre-compile, origin=Vector Informatik, default-value=true  # This executable: First execution instance in system | Configure, if this executable is the first instance of the system. Set this parameter to enabled, if this instance should contain the brsStartupEntry and initialize the core. Only one single executable of a system with several executables should be the first instance. All other executables are starting with Brs_ApplicationEntry(). E.g. in a FBL UseCase with standalone BM, the BM is the first executable and the FBL, Updater, MSR-Application are not. If there is only a single executable in the system, of course this application is also the first one. Sets the following generated parameters: BRS_FIRST_EXECUTION_INSTANCE in vBrsCfg.h
      boolean vBRSEnableCoreSpecificVLinkGenConfig: set at pre-compile, origin=Vector Informatik, default-value=false  # Enable core specific vLinkGen config validation | Enable the validation of core specific vLinkGen config data based on cores configured within /EcuC/EcucHardware/EcucCoreDefinitions and /Os/OsCores.
      boolean vBRSFblSupportEcuMInit: set at pre-compile, origin=Vector Informatik, default-value=false  # This executable: FBL/BM support with EcuMInit | Configure, if the FBL stack should be started inside main() via a call of EcuM_Init() or a call of FblMain(). This parameter only has an effect, if Execution Instance is "FBL", "FBL_Updater", "BM" or "BM_FBL". FBL without EcuM_Init() is the oldstyle FBL integration, started with a direct call of FblMain(). FBL with EcuM_Init() means, module initialization is done in EcuM_Init() (real EcuM or EcuM Stub), but the cyclic handling is done in FBL. Sets the following generated parameters: BRS_FBL_WITH_ECUMINIT or BRS_FBL_NO_ECUMINIT in vBrsCfg.h
      boolean vBRSFblSupportExceptionTableInRam: set at pre-compile, origin=Vector Informatik, default-value=true  # This executable: FBL/BM exception table in RAM | Configure, if the additional ExceptionTable in RAM should be initialized. This will cause a call of BrsHw_ExceptionTable_Init() in main(), which will program the vector table base address to Brs_ExcVectRam. The depending SectionGroup needs to be configured with Init Policy COPY_TO_RAM in vLinkGen as well. This allows proper exception handling during erase/re-program of flash. The parameter only has an effect, if Execution Instance is "FBL", "FBL_Updater", "BM" or "BM_FBL". Sets the following generated parameter: BRS_FBL_EXCEPTIONTABLE_IN_RAM in vBrsCfg.h
      reference vBRSToggleLEDDioChannel [0..1]: set at pre-compile, origin=Vector Informatik, destination=DioChannel  # Toggle LED-Pin - Dio channel reference | Dio channel reference setting for toggling the LED port. Only relevant if non-stub Dio is part of the configuration.
      reference vBRSToggleWdPinDioChannel [0..1]: set at pre-compile, origin=Vector Informatik, destination=DioChannel  # Toggle WD-Pin - Dio channel reference | Dio channel reference setting for toggling the WD port. Only relevant if non-stub Dio is part of the configuration.
      reference vBRSToggleCustomPinDioChannel [0..1]: set at pre-compile, origin=Vector Informatik, destination=DioChannel  # Toggle Custom-Pin - Dio channel reference | Dio channel reference setting for toggling the Custom port. Only relevant if non-stub Dio is part of the configuration.
      reference vBRSVariantUsageOfvLinkGen [0..1]: set at pre-compile, origin=Vector Informatik, destination=vLinkGenVariant  # This executable: Use vLinkGen Variant | vLinkGenVariant reference for current executable. The chosen variant will be generated into vBrsCfg.h and then be used in vLinkGen_Lcfg.c. Furthermore, it will also be generated as BRS_LINKER_COMMAND_FILE_POSTFIX into Makefile.config.generated. This will override the LINKER_COMMAND_FILE parameter in the Makefile. LINKER_COMMAND_FILE is used for the linkage target of the MakeSupport. Note: /MICROSAR/vLinkGen/vLinkGenGeneral/vLinkGenFileGeneration shall be set to ONE_FILE_PER_VARIANT, in order to generate the corresponding link file for each variant.
      container vBRSOverrideInitPhase [0..*]  # This container includes all configuration parameters for the EcuM Stub, to override the EcuC/EcucGeneral/BswInitialization/InitFunction InitPhase configuration, if needed.
        enumeration vBRSInitPhase: {NO_INIT, INIT_MEMORY, INIT_ZERO, INIT_ONE_EARLY, INIT_ONE, INIT_ONE_LATE, INIT_TWO_MCAL, INIT_TWO_TRCV, INIT_TWO_DRV, INIT_TWO_IF, INIT_TWO_COM, INIT_TWO_SM, INIT_TWO_NM, INIT_TWO_TP, INIT_TWO_SYS, INIT_TWO_POST_NVMREADALL, INIT_THREE}, set at pre-compile, origin=Vector Informatik  # InitPhase, the InitFunction should be called instead
        reference vBRSInitFunction: set at pre-compile, origin=Vector Informatik, destination=InitFunction  # Reference to the InitFunction, whose init phase should be overwritten
    container vBRSHwConfig [0..1]
      integer vBRSOscClock: 0..18446744073709551615, set at pre-compile, origin=Vector Informatik, default-value=0  # Clock Config: Oscillator Clock Frequency | Frequency of the board specific external oscillator. Sets the following generated parameters: BRS_OSC_CLK in vBrsCfg.h MAIN_OSC_CLK in Makefile.config.generated
      integer vBRSTimebaseClock: 0..18446744073709551615, set at pre-compile, origin=Vector Informatik, default-value=0  # Clock Config: Timebase (PLL) clock frequency | Frequency, used for PLL calculation (normally used as CPU core clock). Sets the following generated parameters: BRS_TIMEBASE_CLOCK in vBrsCfg.h TIMEBASE_CLOCK in Makefile.config.generated
      integer vBRSPeriphClock: 0..18446744073709551615, set at pre-compile, origin=Vector Informatik, default-value=0  # Clock Config: Peripheral (Timer) Clock Frequency | Frequency of the controller peripherals, at least for the default timer, used by the OS. This frequency value is used to calculate the proper value of the TicksPerBase value inside the OS configuration. If the frequencies for communication peripherals differ from this peripheral clock, they could be configured within the depending communictaion channel configuration (e.g. vBRSHwConfig/vBRSDriverHandlingCAN/vBRSDriverHandlingCAN_Clock). Sets the following generated parameters: BRS_PERIPH_CLOCK in vBrsCfg.h PERIPH_CLOCK in Makefile.config.generated
      boolean vBRSEnablePortHandling: set at pre-compile, origin=Vector Informatik, default-value=false  # BrsHw: Enable Port Handling | Enable the handling of Ports configuration inside BrsHw. Sets the following generated parameter: BRS_ENABLE_PORT in vBrsCfg.h
      boolean vBRSEnableWatchdogHandling: set at pre-compile, origin=Vector Informatik, default-value=false  # BrsHw: Enable Watchdog Handling | Enable the handling of Watchdog configuration inside BrsHw. Sets the following generated parameter: BRS_ENABLE_WATCHDOG in vBrsCfg.h
      boolean vBRSEnablePLLClocksHandling: set at pre-compile, origin=Vector Informatik, default-value=false  # BrsHw: Enable PLL&Clocks Handling | Enable the handling of PLL and Clocks configuration inside BrsHw. Sets the following generated parameter: BRS_ENABLE_PLLCLOCKS in vBrsCfg.h
      enumeration vBRSCompilerInstructionSet [0..1]: set at pre-compile, origin=Vector Informatik  # Makesupport: Compiler Instruction Set | Select the platform dependent Instruction Set for compile/link of the project. Note: not all platforms are supporting different instruction sets. Generated as the following: Makefile.config.generated: INSTRUCTION_SET = xxx vBrsCfg.h: BRS_INSTRUCTION_SET_xxx
        THUMB  # Thumb Mode for Arm core controllers
        ARM  # Arm Mode for Arm core controllers
        VLE  # Vle Mode for PPC core controllers
        BOOKE  # Book-E Mode for PPC core controllers
      boolean vBRSCompilerEnableFPU [0..1]: set at pre-compile, origin=Vector Informatik  # Makesupport: Enable FPU support | Enable FPU usage on the controller. This has effect on the compiler/linker options. Note: not all platforms are supporting enabling/disabling of FPU usage. Generated as the following: Makefile.config.generated: FPU_USED = 1/0 vBrsCfg.h: BRS_FPU_USED
      string vBRSPeriphClockDescription [0..1]: set at pre-compile, origin=Vector Informatik  # Clock Config: Peripheral (Timer) Clock Description | Platform/family specific preconfig parameter with description of the recommended platform/family clock values and for usage of the peripheral clock (connection to OS timer).
      multiline string vBRSMakefileUserCode [0..*]: set at pre-compile, origin=Vector Informatik  # Makesupport: UserCode | Define here additional UserCode, to be generated into Makefile.config.generated
      boolean vBRSPreferPLLWatchdogInit: set at pre-compile, origin=Vector Informatik, default-value=false  # BrsHw: Prefer PLL and Watchdog Init | Prefer the initialization of PLL and Watchdog, previous to memory initialization. This will cause the depending init calls, previous to init stage HardReset, inside the callout BrsMain_MemoryInit_StageHardReset_Hook() of BrsMain_Callout_Stubs.c. Sets the following generated parameter: BRS_ENABLE_PREFER_PLL_WATCHDOG_INIT in vBrsCfg.h
      string vBRSCompilerPath [0..1]: set at pre-compile, origin=Vector Informatik  # Makesupport: Compiler Path | Base path of the embedded compiler, to be used from the MakeSupport. This parameter allows to override the COMPILER_BASE_WIN parameter in the Makefile. Use absolute paths, w/o blanks. See default path in Makefile for an example. Generated as BRS_COMPILER_PATH into Makefile.config.generated.
      string vBRSProjectName [0..1]: set at pre-compile, origin=Vector Informatik  # Makesupport: Project Name | Name of this project, to be used by the MakeSupport. This parameter allows to override the PROJECT_NAME parameter in the Makefile.static. PROJECT_NAME is used as target name by the MakeSupport. Generated as BRS_PROJECT_NAME into Makefile.config.generated.
      reference vBRSMcuClockReferencePointForBrsPeriphClock [0..1]: set at pre-compile, origin=Vector Informatik, destination=McuClockReferencePoint  # Clock Config: Peripheral (Timer) Clock Mcu Reference | McuClockReferencePoint reference for peripheral clock setting. If set, a solving action is provided to set the BrsPeriphClock to the value, this reference is pointing to.
      reference vBRSEvaluationBoard [0..1]: set at pre-compile, origin=Vector Informatik, destination=vBRSEvalBoardInfo  # BrsHw: Select Evaluation Board | Select a Eval Board from the list of supported ones. Sets the following generated parameters: BRS_EVA_BOARD_xxx in vBrsCfg.h EVA_BOARD in Makefile.config.generated
      container vBRSDriverHandlingCAN [0..1]
        boolean vBRSEnableDriverHandlingCAN: set at pre-compile, origin=Vector Informatik, default-value=true  # Enable handling of CAN driver | This switch enables the handling of driver specific settings of - PLL and clock settings - Port Pin settings - On some platforms additional register settings, e.g. inside BrsHwPreInitPowerOn() or BrsHw_EnableHwAccess() To handle this inside the BrsHw Sourcecode, the define BRS_ENABLE_CAN_SUPPORT is generated.
        boolean vBRSDriverHandlingCAN_channel0: set at pre-compile, origin=Vector Informatik  # Handling of channel 00 | Enable the configuration of communication channel 0. Sets the following generated parameter: BRS_ENABLE_CAN_CHANNEL_0 in vBrsCfg.h
        boolean vBRSDriverHandlingCAN_channel1: set at pre-compile, origin=Vector Informatik, default-value=false  # Handling of channel 01 | Enable the configuration of communication channel 1. Sets the following generated parameter: BRS_ENABLE_CAN_CHANNEL_1 in vBrsCfg.h
        boolean vBRSDriverHandlingCAN_channel2: set at pre-compile, origin=Vector Informatik, default-value=false  # Handling of channel 02 | Enable the configuration of communication channel 2. Sets the following generated parameter: BRS_ENABLE_CAN_CHANNEL_2 in vBrsCfg.h
        boolean vBRSDriverHandlingCAN_channel3: set at pre-compile, origin=Vector Informatik, default-value=false  # Handling of channel 03 | Enable the configuration of communication channel 3. Sets the following generated parameter: BRS_ENABLE_CAN_CHANNEL_3 in vBrsCfg.h
        boolean vBRSDriverHandlingCAN_channel4: set at pre-compile, origin=Vector Informatik, default-value=false  # Handling of channel 04 | Enable the configuration of communication channel 4. Sets the following generated parameter: BRS_ENABLE_CAN_CHANNEL_4 in vBrsCfg.h
        boolean vBRSDriverHandlingCAN_channel5: set at pre-compile, origin=Vector Informatik, default-value=false  # Handling of channel 05 | Enable the configuration of communication channel 5. Sets the following generated parameter: BRS_ENABLE_CAN_CHANNEL_5 in vBrsCfg.h
        boolean vBRSDriverHandlingCAN_channel6: set at pre-compile, origin=Vector Informatik, default-value=false  # Handling of channel 06 | Enable the configuration of communication channel 6. Sets the following generated parameter: BRS_ENABLE_CAN_CHANNEL_6 in vBrsCfg.h
        boolean vBRSDriverHandlingCAN_channel7: set at pre-compile, origin=Vector Informatik, default-value=false  # Handling of channel 07 | Enable the configuration of communication channel 7. Sets the following generated parameter: BRS_ENABLE_CAN_CHANNEL_7 in vBrsCfg.h
        boolean vBRSDriverHandlingCAN_channel8: set at pre-compile, origin=Vector Informatik, default-value=false  # Handling of channel 08 | Enable the configuration of communication channel 8. Sets the following generated parameter: BRS_ENABLE_CAN_CHANNEL_8 in vBrsCfg.h
        boolean vBRSDriverHandlingCAN_channel9: set at pre-compile, origin=Vector Informatik, default-value=false  # Handling of channel 09 | Enable the configuration of communication channel 9. Sets the following generated parameter: BRS_ENABLE_CAN_CHANNEL_9 in vBrsCfg.h
        boolean vBRSDriverHandlingCAN_PeripheralClock: set at pre-compile, origin=Vector Informatik, default-value=true  # Frequency is similar with timer peripheral clock | If enabled, the clock defined in vBRSHwConfig/vBRSPeriphClock will also be used for the peripheral clock, used by the CAN driver. If the clock, provided to the driver cell, is different, disable this parameter and configure the valid frequency within the paramter vBRSDriverHandlingCAN_Clock or vBRSDriverHandlingCAN_ClockRef (if Mcu is used)
        integer vBRSDriverHandlingCAN_Clock [0..1]: 0..18446744073709551615, set at pre-compile, origin=Vector Informatik, default-value=0  # Frequency of peripheral clock | Frequency, used for PLL calculation of CAN driver peripheral clock. Sets the following generated parameters: BRS_CAN_CLOCK in vBrsCfg.h
        boolean vBRSDriverHandlingCAN_channel{10..19}: set at pre-compile, origin=Vector Informatik, default-value=false  # Handling of channel {10..19} | Enable the configuration of communication channel {10..19}. Sets the following generated parameter: BRS_ENABLE_CAN_CHANNEL_{10..19} in vBrsCfg.h
        reference vBRSDriverHandlingCAN_ClockRef [0..1]: set at pre-compile, origin=Vector Informatik, destination=McuClockReferencePoint  # Frequency of peripheral clock - Mcu Reference | McuClockReferencePoint reference for peripheral clock setting. If set, a solving action is provided to set the peripheral clock to the value, this reference is pointing to.
      container vBRSDriverHandlingLIN [0..1]
        boolean vBRSEnableDriverHandlingLIN: set at pre-compile, origin=Vector Informatik, default-value=true  # Enable handling of LIN driver | This switch enables the handling of driver specific settings of - PLL and clock settings - Port Pin settings - On some platforms additional register settings, e.g. inside BrsHwPreInitPowerOn() or BrsHw_EnableHwAccess() To handle this inside the BrsHw Sourcecode, the define BRS_ENABLE_LIN_SUPPORT is generated.
        boolean vBRSDriverHandlingLIN_channel0: set at pre-compile, origin=Vector Informatik  # Handling of channel 00 | Enable the configuration of communication channel 0. Sets the following generated parameter: BRS_ENABLE_LIN_CHANNEL_0 in vBrsCfg.h
        boolean vBRSDriverHandlingLIN_channel1: set at pre-compile, origin=Vector Informatik, default-value=false  # Handling of channel 01 | Enable the configuration of communication channel 1. Sets the following generated parameter: BRS_ENABLE_LIN_CHANNEL_1 in vBrsCfg.h
        boolean vBRSDriverHandlingLIN_channel2: set at pre-compile, origin=Vector Informatik, default-value=false  # Handling of channel 02 | Enable the configuration of communication channel 2. Sets the following generated parameter: BRS_ENABLE_LIN_CHANNEL_2 in vBrsCfg.h
        boolean vBRSDriverHandlingLIN_channel3: set at pre-compile, origin=Vector Informatik, default-value=false  # Handling of channel 03 | Enable the configuration of communication channel 3. Sets the following generated parameter: BRS_ENABLE_LIN_CHANNEL_3 in vBrsCfg.h
        boolean vBRSDriverHandlingLIN_channel4: set at pre-compile, origin=Vector Informatik, default-value=false  # Handling of channel 04 | Enable the configuration of communication channel 4. Sets the following generated parameter: BRS_ENABLE_LIN_CHANNEL_4 in vBrsCfg.h
        boolean vBRSDriverHandlingLIN_channel5: set at pre-compile, origin=Vector Informatik, default-value=false  # Handling of channel 05 | Enable the configuration of communication channel 5. Sets the following generated parameter: BRS_ENABLE_LIN_CHANNEL_5 in vBrsCfg.h
        boolean vBRSDriverHandlingLIN_channel6: set at pre-compile, origin=Vector Informatik, default-value=false  # Handling of channel 06 | Enable the configuration of communication channel 6. Sets the following generated parameter: BRS_ENABLE_LIN_CHANNEL_6 in vBrsCfg.h
        boolean vBRSDriverHandlingLIN_channel7: set at pre-compile, origin=Vector Informatik, default-value=false  # Handling of channel 07 | Enable the configuration of communication channel 7. Sets the following generated parameter: BRS_ENABLE_LIN_CHANNEL_7 in vBrsCfg.h
        boolean vBRSDriverHandlingLIN_channel8: set at pre-compile, origin=Vector Informatik, default-value=false  # Handling of channel 08 | Enable the configuration of communication channel 8. Sets the following generated parameter: BRS_ENABLE_LIN_CHANNEL_8 in vBrsCfg.h
        boolean vBRSDriverHandlingLIN_channel9: set at pre-compile, origin=Vector Informatik, default-value=false  # Handling of channel 09 | Enable the configuration of communication channel 9. Sets the following generated parameter: BRS_ENABLE_LIN_CHANNEL_9 in vBrsCfg.h
        integer vBRSDriverHandlingLIN_Clock [0..1]: 0..18446744073709551615, set at pre-compile, origin=Vector Informatik, default-value=0  # Frequency of peripheral clock | Frequency, used for PLL calculation of LIN driver peripheral clock. Sets the following generated parameters: BRS_LIN_CLOCK in vBrsCfg.h
        boolean vBRSDriverHandlingLIN_PeripheralClock: set at pre-compile, origin=Vector Informatik, default-value=true  # Frequency is similar with timer peripheral clock | If enabled, the clock defined in vBRSHwConfig/vBRSPeriphClock will also be used for the peripheral clock, used by the LIN driver. If the clock, provided to the driver cell, is different, disable this parameter and configure the valid frequency within the paramter vBRSDriverHandlingLIN_Clock or vBRSDriverHandlingLIN_ClockRef (if Mcu is used)
        boolean vBRSDriverHandlingLIN_channel{10..16}: set at pre-compile, origin=Vector Informatik, default-value=false  # Handling of channel {10..16} | Enable the configuration of communication channel {10..16}. Sets the following generated parameter: BRS_ENABLE_LIN_CHANNEL_{10..16} in vBrsCfg.h
        boolean vBRSDriverHandlingLIN_channel17: set at pre-compile, origin=Vector Informatik, default-value=false  # Handling of channel 17 | Enable the configuration of communication channel 10. Sets the following generated parameter: BRS_ENABLE_LIN_CHANNEL_10 in vBrsCfg.h
        boolean vBRSDriverHandlingLIN_channel{18..22}: set at pre-compile, origin=Vector Informatik, default-value=false  # Handling of channel {18..22} | Enable the configuration of communication channel {18..22}. Sets the following generated parameter: BRS_ENABLE_LIN_CHANNEL_{18..22} in vBrsCfg.h
        reference vBRSDriverHandlingLIN_ClockRef [0..1]: set at pre-compile, origin=Vector Informatik, destination=McuClockReferencePoint  # Frequency of peripheral clock - Mcu Reference | McuClockReferencePoint reference for peripheral clock setting. If set, a solving action is provided to set the peripheral clock to the value, this reference is pointing to.
      container vBRSDriverHandlingFlexray [0..1]
        boolean vBRSEnableDriverHandlingFlexray: set at pre-compile, origin=Vector Informatik, default-value=true  # Enable handling of FlexRay driver | This switch enables the handling of driver specific settings of - PLL and clock settings - Port Pin settings - On some platforms additional register settings, e.g. inside BrsHwPreInitPowerOn() or BrsHw_EnableHwAccess() To handle this inside the BrsHw Sourcecode, the define BRS_ENABLE_FLEXRAY_SUPPORT is generated.
        boolean vBRSDriverHandlingFlexray_channel0A: set at pre-compile, origin=Vector Informatik  # Handling of channel 0A | Enable the configuration of communication channel 0A. Sets the following generated parameter: BRS_ENABLE_FLEXRAY_CHANNEL_0A in vBrsCfg.h
        boolean vBRSDriverHandlingFlexray_channel0B: set at pre-compile, origin=Vector Informatik, default-value=false  # Handling of channel 0B | Enable the configuration of communication channel 0B. Sets the following generated parameter: BRS_ENABLE_FLEXRAY_CHANNEL_0B in vBrsCfg.h
        boolean vBRSDriverHandlingFlexray_channel1A: set at pre-compile, origin=Vector Informatik, default-value=false  # Handling of channel 1A | Enable the configuration of communication channel 1A. Sets the following generated parameter: BRS_ENABLE_FLEXRAY_CHANNEL_1A in vBrsCfg.h
        boolean vBRSDriverHandlingFlexray_channel1B: set at pre-compile, origin=Vector Informatik, default-value=false  # Handling of channel 1B | Enable the configuration of communication channel 1B. Sets the following generated parameter: BRS_ENABLE_FLEXRAY_CHANNEL_1B in vBrsCfg.h
        boolean vBRSDriverHandlingFlexray_PeripheralClock: set at pre-compile, origin=Vector Informatik, default-value=true  # Frequency is similar with timer peripheral clock | If enabled, the clock defined in vBRSHwConfig/vBRSPeriphClock will also be used for the peripheral clock, used by the FlexRay driver. If the clock, provided to the driver cell, is different, disable this parameter and configure the valid frequency within the paramter vBRSDriverHandlingFlexray_Clock or vBRSDriverHandlingFlexray_ClockRef (if Mcu is used)
        integer vBRSDriverHandlingFlexray_Clock [0..1]: 0..18446744073709551615, set at pre-compile, origin=Vector Informatik, default-value=0  # Frequency of peripheral clock | Frequency, used for PLL calculation of FlexRay driver peripheral clock. Sets the following generated parameters: BRS_FLEXRAY_CLOCK in vBrsCfg.h
        reference vBRSDriverHandlingFlexray_ClockRef [0..1]: set at pre-compile, origin=Vector Informatik, destination=McuClockReferencePoint  # Frequency of peripheral clock - Mcu Reference | McuClockReferencePoint reference for peripheral clock setting. If set, a solving action is provided to set the peripheral clock to the value, this reference is pointing to.
      container vBRSDriverHandlingEthernet [0..1]
        boolean vBRSEnableDriverHandlingEthernet: set at pre-compile, origin=Vector Informatik, default-value=true  # Enable handling of EtherNet driver | This switch enables the handling of driver specific settings of - PLL and clock settings - Port Pin settings - On some platforms additional register settings, e.g. inside BrsHwPreInitPowerOn() or BrsHw_EnableHwAccess() To handle this inside the BrsHw Sourcecode, the define BRS_ENABLE_ETHERNET_SUPPORT is generated.
        boolean vBRSDriverHandlingEthernet_PeripheralClock: set at pre-compile, origin=Vector Informatik, default-value=true  # Frequency is similar with timer peripheral clock | If enabled, the clock defined in vBRSHwConfig/vBRSPeriphClock will also be used for the peripheral clock, used by the EtherNet driver. If the clock, provided to the driver cell, is different, disable this parameter and configure the valid frequency within the paramter vBRSDriverHandlingEthernet_Clock or vBRSDriverHandlingEthernet_ClockRef (if Mcu is used)
        integer vBRSDriverHandlingEthernet_Clock [0..1]: 0..18446744073709551615, set at pre-compile, origin=Vector Informatik, default-value=0  # Frequency of peripheral clock | Frequency, used for PLL calculation of EtherNet driver peripheral clock. Sets the following generated parameters: BRS_ETHERNET_CLOCK in vBrsCfg.h
        reference vBRSDriverHandlingEthernet_ClockRef [0..1]: set at pre-compile, origin=Vector Informatik, destination=McuClockReferencePoint  # Frequency of peripheral clock - Mcu Reference | McuClockReferencePoint reference for peripheral clock setting. If set, a solving action is provided to set the peripheral clock to the value, this reference is pointing to.
      container vBRSEvalBoardInfo [1..*]
        string vBRSEvalBoardDescription: set at pre-compile, origin=Vector Informatik  # Evaluation Board Description | General description of the supported evaluation board.
        string vBRSEvalBoard: set at pre-compile, origin=Vector Informatik  # Evaluation Board Define | Define, used in SourceCode, for this specific Evaluation Board. Most times, this is used for board specific pin settings. Sets the following generated parameters: BRS_EVA_BOARD_x in vBrsCfg.h
        integer vBRSEvalBoardOscClock [0..1]: 0..18446744073709551615, set at pre-compile, origin=Vector Informatik, default-value=0  # Evaluation Board Oscillator Clock Frequency | Defines the frequency of the oscillator clock, equipped on the specific evaluation board. This valus will be verified through the vBRS generator to fit with the configured value of vBRSOscClock.
      container vBRSDriverHandlingHyperbus [0..1]
        boolean vBRSEnableDriverHandlingHyperbus: set at pre-compile, origin=Vector Informatik, default-value=true  # Enable handling of Hyperbus driver | This switch enables the handling of driver specific settings of - PLL and clock settings - Port Pin settings - On some platforms additional register settings, e.g. inside BrsHwPreInitPowerOn() or BrsHw_EnableHwAccess() To handle this inside the BrsHw Sourcecode, the define BRS_ENABLE_HYPERBUS_SUPPORT is generated.
        boolean vBRSDriverHandlingHyperbus_channel0: set at pre-compile, origin=Vector Informatik  # Handling of channel 00 | Enable the configuration of communication channel 0. Sets the following generated parameter: BRS_ENABLE_HYPERBUS_CHANNEL_0 in vBrsCfg.h
        boolean vBRSDriverHandlingHyperbus_channel1: set at pre-compile, origin=Vector Informatik, default-value=false  # Handling of channel 01 | Enable the configuration of communication channel 1. Sets the following generated parameter: BRS_ENABLE_HYPERBUS_CHANNEL_1 in vBrsCfg.h
        boolean vBRSDriverHandlingHyperbus_PeripheralClock: set at pre-compile, origin=Vector Informatik, default-value=true  # Frequency is similar with timer peripheral clock | If enabled, the clock defined in vBRSHwConfig/vBRSPeriphClock will also be used for the peripheral clock, used by the Hyperbus driver. If the clock, provided to the driver cell, is different, disable this parameter and configure the valid frequency within the paramter vBRSDriverHandlingHyperbus_Clock or vBRSDriverHandlingHyperbus_ClockRef (if Mcu is used)
        integer vBRSDriverHandlingHyperbus_Clock [0..1]: 0..18446744073709551615, set at pre-compile, origin=Vector Informatik, default-value=0  # Frequency of peripheral clock | Frequency, used for PLL calculation of Hyperbus driver peripheral clock. Sets the following generated parameters: BRS_HYPERBUS_CLOCK in vBrsCfg.h
        reference vBRSDriverHandlingHyperbus_ClockRef [0..1]: set at pre-compile, origin=Vector Informatik, destination=McuClockReferencePoint  # Frequency of peripheral clock - Mcu Reference | McuClockReferencePoint reference for peripheral clock setting. If set, a solving action is provided to set the peripheral clock to the value, this reference is pointing to.
      container vBRSDriverHandlingI2C [0..1]
        boolean vBRSEnableDriverHandlingI2C: set at pre-compile, origin=Vector Informatik, default-value=true  # Enable handling of I2C driver | This switch enables the handling of driver specific settings of - PLL and clock settings - Port Pin settings - On some platforms additional register settings, e.g. inside BrsHwPreInitPowerOn() or BrsHw_EnableHwAccess() To handle this inside the BrsHw Sourcecode, the define BRS_ENABLE_I2C_SUPPORT is generated.
        boolean vBRSDriverHandlingI2C_channel0: set at pre-compile, origin=Vector Informatik  # Handling of channel 00 | Enable the configuration of communication channel 0. Sets the following generated parameter: BRS_ENABLE_I2C_CHANNEL_0 in vBrsCfg.h
        boolean vBRSDriverHandlingI2C_channel1: set at pre-compile, origin=Vector Informatik, default-value=false  # Handling of channel 01 | Enable the configuration of communication channel 1. Sets the following generated parameter: BRS_ENABLE_I2C_CHANNEL_1 in vBrsCfg.h
        boolean vBRSDriverHandlingI2C_PeripheralClock: set at pre-compile, origin=Vector Informatik, default-value=true  # Frequency is similar with timer peripheral clock | If enabled, the clock defined in vBRSHwConfig/vBRSPeriphClock will also be used for the peripheral clock, used by the I2C driver. If the clock, provided to the driver cell, is different, disable this parameter and configure the valid frequency within the paramter vBRSDriverHandlingI2C_Clock or vBRSDriverHandlingI2C_ClockRef (if Mcu is used)
        integer vBRSDriverHandlingI2C_Clock [0..1]: 0..18446744073709551615, set at pre-compile, origin=Vector Informatik, default-value=0  # Frequency of peripheral clock | Frequency, used for PLL calculation of I2C driver peripheral clock. Sets the following generated parameters: BRS_I2C_CLOCK in vBrsCfg.h
        reference vBRSDriverHandlingI2C_ClockRef [0..1]: set at pre-compile, origin=Vector Informatik, destination=McuClockReferencePoint  # Frequency of peripheral clock - Mcu Reference | McuClockReferencePoint reference for peripheral clock setting. If set, a solving action is provided to set the peripheral clock to the value, this reference is pointing to.
      container vBRSDriverHandlingSpi [0..1]
        boolean vBRSEnableDriverHandlingSpi: set at pre-compile, origin=Vector Informatik, default-value=true  # Enable handling of Spi driver | This switch enables the handling of driver specific settings of - PLL and clock settings - Port Pin settings - On some platforms additional register settings, e.g. inside BrsHwPreInitPowerOn() or BrsHw_EnableHwAccess() To handle this inside the BrsHw Sourcecode, the define BRS_ENABLE_SPI_SUPPORT is generated.
        boolean vBRSDriverHandlingSpi_channel0: set at pre-compile, origin=Vector Informatik  # Handling of channel 00 | Enable the configuration of communication channel 0. Sets the following generated parameter: BRS_ENABLE_SPI_CHANNEL_0 in vBrsCfg.h
        boolean vBRSDriverHandlingSpi_PeripheralClock: set at pre-compile, origin=Vector Informatik, default-value=true  # Frequency is similar with timer peripheral clock | If enabled, the clock defined in vBRSHwConfig/vBRSPeriphClock will also be used for the peripheral clock, used by the Spi driver. If the clock, provided to the driver cell, is different, disable this parameter and configure the valid frequency within the paramter vBRSDriverHandlingSpi_Clock or vBRSDriverHandlingSpi_ClockRef (if Mcu is used)
        integer vBRSDriverHandlingSpi_Clock [0..1]: 0..18446744073709551615, set at pre-compile, origin=Vector Informatik, default-value=0  # Frequency of peripheral clock | Frequency, used for PLL calculation of Hyperbus driver peripheral clock. Sets the following generated parameters: BRS_SPI_CLOCK in vBrsCfg.h
        reference vBRSDriverHandlingSpi_ClockRef [0..1]: set at pre-compile, origin=Vector Informatik, destination=McuClockReferencePoint  # Frequency of peripheral clock - Mcu Reference | McuClockReferencePoint reference for peripheral clock setting. If set, a solving action is provided to set the peripheral clock to the value, this reference is pointing to.
    container vBRSTestsuiteSupport [0..1]  # Support for Vector internal Testsuites
      boolean vBRSEnableTestsuiteSupport: set at pre-compile, origin=Vector Informatik, default-value=true  # Enable support of the Generic TestSuite connectioin. Via the define BRS_ENABLE_TESTSUITE_SUPPORT, the Generic TestSuite concept headerfile BrsTestsuite.h will be included and the Generic Testsuite init function BrsTestsuiteInit() will be called within BrsMain.c
      enumeration vBRSTccSupport: set at pre-compile, origin=Vector Informatik, default-value=None  # vBRS Tcc Support
        None
        TCCviaComIf  # TCC via ComIf
      container vBRSTcc [0..1]
        container vBRSComIfUpperLayerRxPdu  # This container specifies Rx PDU that is received by the BRS through communication stack.
          integer vBRSComIfHandleId: 0..65535, set at pre-compile, origin=Vector Informatik, symbolic-name-value=true, default-value=0  # ECU wide unique, symbolic handle for the Pdu.
          reference vBRSComIfPduRef: set at pre-compile, origin=Vector Informatik, destination=Pdu  # Reference to the "global" Pdu structure to allow harmonization of handle IDs in the COM-Stack.
        container vBRSComIfUpperLayerTxPdu  # This container specifies Tx PDU that is transmitted by the CDD through communication stack.
          integer vBRSComIfHandleId: 0..65535, set at pre-compile, origin=Vector Informatik, symbolic-name-value=true, default-value=0  # ECU wide unique, symbolic handle for the Pdu.
          reference vBRSComIfPduRef: set at pre-compile, origin=Vector Informatik, destination=Pdu  # Reference to the "global" Pdu structure to allow harmonization of handle IDs in the COM-Stack.
    container vBRSMemoryInit
      integer vBRSInitPatternBlocks: 0..4294967295, set at pre-compile, origin=Vector Informatik, default-value=0  # Init pattern for Zero Init Blocks | Configure the init pattern for the Brs_MemoryZeroInit() call within Brs_ApplicationEntry(). This value is for the blocks, configured with "Init Policy" = ZERO_INIT and a "Init Stage" from ZERO up to THREE within the vLinkGen configuration. The pattern must be 32-bit aligned. Default value is 0x0.
      integer vBRSInitPatternHardResetBlocks: 0..4294967295, set at pre-compile, origin=Vector Informatik, default-value=0  # Init pattern for Hard Reset Zero Init Blocks | Configure the init pattern for the Brs_MemoryZeroInit() call within Brs_ApplicationEntry(). This value is for the blocks, configured with "Init Policy" = ZERO_INIT and the "Init Stage" HARD_RESET_ONLY within the vLinkGen configuration. The pattern must be 32-bit aligned. Default value is 0x0.
      integer vBRSInitPatternAreas: 0..4294967295, set at pre-compile, origin=Vector Informatik, default-value=0  # Init pattern for Zero Init Areas | Configure the init pattern for the Brs_MemoryZeroInit() call within Brs_ApplicationEntry(). This value is for the groups, configured with "Init Policy" = ZERO_INIT and a "Init Stage" from ZERO up to THREE within the vLinkGen configuration. The pattern must be 32-bit aligned. Default value is 0x0.
      integer vBRSInitPatternHardResetAreas: 0..4294967295, set at pre-compile, origin=Vector Informatik, default-value=0  # Init pattern for Hard Reset Zero Init Areas | Configure the init pattern for the Brs_MemoryZeroInit() call within Brs_ApplicationEntry(). This value is for the groups, configured with "Init Policy" = ZERO_INIT and the "Init Stage" HARD_RESET_ONLY within the vLinkGen configuration. The pattern must be 32-bit aligned. Default value is 0x0.
  module config vBRS_Pre: definition=vBRS
  module config vBRS_Rec: definition=vBRS
