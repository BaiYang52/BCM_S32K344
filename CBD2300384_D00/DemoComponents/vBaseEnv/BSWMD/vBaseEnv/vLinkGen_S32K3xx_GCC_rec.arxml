AUTOSAR XML (schema 4-2-1)
package /MICROSAR
  module config vLinkGen_Rec: definition=vLinkGen
    vLinkGenMemLayout
      Startup_Labels (vLinkGenLogicalSymbolGroup)
        Startup_Labels1 (vLinkGenLinkerSymbol): vLinkGenLinkerSymbolName=_start, vLinkGenLinkerSymbolValue=brsStartupEntry +1
