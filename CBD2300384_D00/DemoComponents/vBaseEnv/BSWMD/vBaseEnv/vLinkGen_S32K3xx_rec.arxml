AUTOSAR XML (schema 4-2-1)
package /MICROSAR
  module config vLinkGen_Rec: definition=vLinkGen
    vLinkGenMemLayout
      RAM (vLinkGenMemoryRegion): vLinkGenMemoryRegionHwRegion=PRAM0
        3 x vLinkGenMemoryRegionBlock, all with vLinkGenMemoryRegionBlockInitCore=0, vLinkGenMemoryRegionBlockInitStage=EARLY:
          RAM: vLinkGenMemoryRegionBlockContentType=GLOBAL_DATA, vLinkGenMemoryRegionBlockContentType=LOCAL_DATA, vLinkGenMemoryRegionBlockContentType=RAM_CODE_COPY, vLinkGenMemoryRegionBlockContentType=RAM_CONST_COPY, vLinkGenMemoryRegionBlockContentType=RETENTION_DATA, vLinkGenMemoryRegionBlockContentType=STACKS
          Variables_Shared: vLinkGenMemoryRegionBlockSize=16, vLinkGenMemoryRegionBlockBoundary=UPPER, vLinkGenMemoryRegionBlockContentType=SHARED_DATA
          StartupStack_Shared: vLinkGenMemoryRegionBlockPosition=1, vLinkGenMemoryRegionBlockSize=1024, vLinkGenMemoryRegionBlockBoundary=UPPER, vLinkGenMemoryRegionBlockContentType=STARTUP_STACK
      FLASH (vLinkGenMemoryRegion): vLinkGenMemoryRegionHwRegion=Program_Flash
        5 x vLinkGenMemoryRegionBlock:
          IVT_Block: vLinkGenMemoryRegionBlockSize=1024
          CoreExceptions_FirstExecInst: vLinkGenMemoryRegionBlockPosition=1, vLinkGenMemoryRegionBlockSize=960, vLinkGenMemoryRegionBlockContentType=GLOBAL_EXCVEC_CODE, vLinkGenMemoryRegionBlockContentType=GLOBAL_EXCVEC_CONST
          StartupCode_FirstExecInst: vLinkGenMemoryRegionBlockPosition=2, vLinkGenMemoryRegionBlockSize=1024, vLinkGenMemoryRegionBlockContentType=STARTUP_CODE
          ApplicationEntry: vLinkGenMemoryRegionBlockPosition=3, vLinkGenMemoryRegionBlockSize=256, vLinkGenMemoryRegionBlockCore=0, vLinkGenMemoryRegionBlockContentType=APPLICATION_ENTRY
          FLASH: vLinkGenMemoryRegionBlockPosition=4, vLinkGenMemoryRegionBlockContentType=LOCAL_INTVEC_CONST, vLinkGenMemoryRegionBlockContentType=LOCAL_INTVEC_CODE, vLinkGenMemoryRegionBlockContentType=LOCAL_EXCVEC_CONST, vLinkGenMemoryRegionBlockContentType=LOCAL_EXCVEC_CODE, vLinkGenMemoryRegionBlockContentType=GLOBAL_INTVEC_CODE, vLinkGenMemoryRegionBlockContentType=GLOBAL_INTVEC_CONST, vLinkGenMemoryRegionBlockContentType=GLOBAL_CODE, vLinkGenMemoryRegionBlockContentType=GLOBAL_CONST, vLinkGenMemoryRegionBlockContentType=LOCAL_CODE, vLinkGenMemoryRegionBlockContentType=LOCAL_CONST, vLinkGenMemoryRegionBlockContentType=RAM_CODE, vLinkGenMemoryRegionBlockContentType=RAM_CONST
      IVTFIELD (vLinkGenLogicalConstGroup): vLinkGenConstGroupRegion=IVT_Block
        IVTField (vLinkGenConstSectionGroup): vLinkGenConstSectionGroupRef=vLinkGenLinkerSections/IVTField
      vLinkGenLinkerSections
        IVTField (vLinkGenLinkerConstSection): vLinkGenLinkerConstSectionName=IVTField
