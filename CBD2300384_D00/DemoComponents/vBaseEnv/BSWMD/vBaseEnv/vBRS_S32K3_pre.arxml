AUTOSAR XML (schema 4-0-3)
package /MICROSAR
  module config vBRS_Pre: definition=vBRS
    vBRSHwConfig: vBRSPeriphClockDescription=Initial value for Peripheral Clock: 120MHz
      3 x vBRSEvalBoardInfo:
        S32K3XXEVB: vBRSEvalBoard=S32K3XXEVB, vBRSEvalBoardDescription=Toggle PTA31 for LED support, vBRSEvalBoardOscClock=16000000  # NXP S32K3XX Customer Evaluation Board (S32K3XXEVB-Q257)
        S32K3XXCVB: vBRSEvalBoard=S32K3XXCVB, vBRSEvalBoardDescription=No User LED available, vBRSEvalBoardOscClock=16000000  # NXP S32K3XX Customer Evaluation Board (S32K3XXCVB-Q257)
        S32K396BGA: vBRSEvalBoard=S32K396BGA, vBRSEvalBoardDescription=Toggle PTH7 for LED support, vBRSEvalBoardOscClock=40000000  # NXP S32K396 Customer Evaluation Board (S32K396-BGA-DC)
  module config vBRS_Rec: definition=vBRS
    vBRSHwConfig: vBRSCompilerInstructionSet=THUMB
