AUTOSAR XML (schema 4-0-3)
package /MICROSAR
  module config vBRS_Pre: definition=vBRS
  module config vBRS_Rec: definition=vBRS
    vBRSGeneral: vBRSEnableCoreSpecificVLinkGenConfig=1
