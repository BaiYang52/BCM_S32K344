AUTOSAR XML (schema 4-2-1)
package /MICROSAR
  module config vLinkGen_Rec: definition=vLinkGen
    vLinkGenMemLayout
      4 x vLinkGenLogicalConstGroup:
        Brs_ExcVect: vLinkGenConstGroupPosition=1, vLinkGenConstGroupContentType=GLOBAL_EXCVEC_CONST
          Brs_ExcVect (vLinkGenConstSectionGroup): vLinkGenConstSectionGroupRef=brsExcVect, vLinkGenConstSectionGroupRef=brsExcVectConst
        Brs_Startup_Code: vLinkGenConstGroupPosition=1, vLinkGenConstGroupContentType=STARTUP_CODE
          Brs_Startup_Code (vLinkGenConstSectionGroup): vLinkGenConstSectionGroupRef=brsStartup
          BrsMain_Startup_Code (vLinkGenConstSectionGroup): vLinkGenConstSectionGroupRef=brsMainStartup
        Brs_Shared_Const: vLinkGenConstGroupContentType=GLOBAL_CONST
          Brs_Shared_Const (vLinkGenConstSectionGroup): vLinkGenConstSectionGroupRef=brsSharedConst
        Brs_ApplicationEntry: vLinkGenConstGroupPosition=1, vLinkGenConstGroupContentType=APPLICATION_ENTRY
          Brs_ApplicationEntry (vLinkGenConstSectionGroup): vLinkGenConstSectionGroupRef=brsApplicationEntry
      Brs_Shared_Var (vLinkGenLogicalVarGroup): vLinkGenVarGroupContentType=SHARED_DATA
        Brs_Shared_Var (vLinkGenVarSectionGroup): vLinkGenVarSectionGroupRef=brsSharedVar
      vLinkGenLinkerSections
        5 x vLinkGenLinkerCodeSection:
          brsExcVect: vLinkGenLinkerCodeSectionName=brsExcVect
          brsStartup: vLinkGenLinkerCodeSectionName=brsStartup
          brsMainStartup: vLinkGenLinkerCodeSectionName=brsMainStartup
          brsSharedConst: vLinkGenLinkerCodeSectionName=brsSharedConst
          brsApplicationEntry: vLinkGenLinkerCodeSectionName=brsApplicationEntry
        brsExcVectConst (vLinkGenLinkerConstSection): vLinkGenLinkerConstSectionName=brsExcVectConst
        brsSharedVar (vLinkGenLinkerVarSection): vLinkGenLinkerVarSectionName=brsSharedVar
