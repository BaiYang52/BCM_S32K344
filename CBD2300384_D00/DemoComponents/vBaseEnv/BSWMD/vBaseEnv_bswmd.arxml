AUTOSAR XML (schema 4-0-3)
# COPYRIGHT
# Copyright (c) 2021 by Vector Informatik GmbH. All rights reserved.
# This software is copyright protected and proprietary to Vector Informatik GmbH.
# Vector Informatik GmbH grants to you only those rights as set out in the license conditions.
package /MICROSAR
  bsw implementation vBaseEnv_Impl: programming-language=C, sw-version=1.00.00, used-code-generator=DaVinci Configurator, vendor-id=30, ar-release-version=4.03.00, preconfigured-configuration=vBaseEnv_Pre, recommended-configuration=vBaseEnv_Rec, vendor-specific-module-def=vBaseEnv
  module definition vBaseEnv [0..1]: category=VENDOR_SPECIFIC_MODULE_DEFINITION, variants pre-compile  # Vector Base Environment | The Vector Base Environment (vBaseEnv) provides everything necessary to get a microcontroller project compiled/linked and performs a basic hardware setup (inlcuding memory init, PLL init, Port init and Watchdog init) in order to get a cyclic runtime behavior. #vBRS #OS #vLinkGen #Startup #Vector
    container vBaseEnvGeneral
      reference vBaseEnvTestedDerivativeRef: set at pre-compile, origin=Vector Informatik, destination=vBaseEnvDerivativeInformation  # Tested Derivative | Select a Tested Derivative from the list of supported ones.
      container vBaseEnvDerivativeInformation [1..*]
        integer vBaseEnvCpuMaxFrequency: 0.., set at pre-compile, origin=Vector Informatik, default-value=100000000  # Configure the maximum frequency of this derivative. This value is used to validate the vBRS PLL configuration.
        integer vBaseEnvAvailableChannels_Flexray: 0..256, set at pre-compile, origin=Vector Informatik, default-value=0  # Configure the amount of Flexray channels, available on this derivative.
        integer vBaseEnvAvailableChannels_Can: 0..256, set at pre-compile, origin=Vector Informatik, default-value=0  # Configure the amount of CAN channels, available on this derivative.
        integer vBaseEnvAvailableChannels_Lin: 0..256, set at pre-compile, origin=Vector Informatik, default-value=0  # Configure the amount of LIN channels, available on this derivative.
        integer vBaseEnvAvailableChannels_Ethernet: 0..256, set at pre-compile, origin=Vector Informatik, default-value=0  # Configure the amount of Ethernet channels, available on this derivative.
        integer vBaseEnvCpuCoreAmount: 1..256, set at pre-compile, origin=Vector Informatik, default-value=1  # Configure the amount of cores, available on this derivative. This value will be generated into vBrsCfg.h as BRS_CPU_CORE_AMOUNT
        string vBaseEnvTestedDerivative: set at pre-compile, origin=Vector Informatik  # Configure the correct Mcu_Derivative value of this derivative. This value will be generated into vBrsCfg.h as BRS_DERIVATIVE_x
        string vBaseEnvTestedDerivativeDescription: set at pre-compile, origin=Vector Informatik  # Describe here more precisely this derivative. This description is only textual information for the user.
        enumeration vBaseEnvCpuCore [0..1]: set at pre-compile, origin=Vector Informatik  # Configure the core architecture of this derivative. This value will be generated into vBrsCfg.h as BRS_CPU_CORE_x
          OTHER  # Generic value for cores with no specific value
          ARC_EM6  # DesignWare ARC EM6
          CORTEX_M0  # Arm Cortex M0
          CORTEX_M0PLUS  # Arm Cortex M0+
          CORTEX_M3  # Arm Cortex M3
          CORTEX_M4  # Arm Cortex M4
          CORTEX_M4F  # Arm Cortex M4F
          CORTEX_M7  # Arm Cortex M7
          CORTEX_M33  # Arm Cortex M33
          CORTEX_R4  # Arm Cortex R4
          CORTEX_R4F  # Arm Cortex R4F
          CORTEX_R5  # ARM Cortex R5
          CORTEX_R5F  # Arm Cortex R5F
          CORTEX_R7  # ARM Cortex R7
          CORTEX_R52  # Arm Cortex R52
          E200Z0  # NXP/ST PowerPC RISC Core e200z0
          E200Z210  # NXP/ST PowerPC RISC Core e200z210
          E200Z215  # NXP/ST PowerPC RISC Core e200z215
          E200Z225  # NXP/ST PowerPC RISC Core e200z225
          E200Z410  # NXP/ST PowerPC RISC Core e200z410
          E200Z420  # NXP/ST PowerPC RISC Core e200z420
          E200Z425  # NXP/ST PowerPC RISC Core e200z425
          E200Z710  # NXP/ST PowerPC RISC Core e200z710
          E200Z720  # NXP/ST PowerPC RISC Core e200z720
          E200Z726  # NXP/ST PowerPC RISC Core e200z726
          E200Z759  # NXP/ST PowerPC RISC Core e200z759
          G3K  # Renesas G3K
          G3KH  # Renesas G3KH
          G3M  # Renesas G3M
          G4MH  # Renesas G4MH
          TC161  # Infineon TriCore Aurix Core
          TC162  # Infineon TriCore AurixPlus Core
          TC18  # Infineon TriCore Aurix 3G (TC4xx)
        integer vBaseEnvCpuInitCore [0..1]: 0..255, set at pre-compile, origin=Vector Informatik  # Configure the core ID of the core, which should be used for general initialization. For normal, this is the boot core. This value will be generated into vBrsCfg.h as BRS_CPU_INIT_CORE
        string vBaseEnvUsedManual [0..1]: set at pre-compile, origin=Vector Informatik  # Manual and version, used for the development of the vBaseEnv preconfig
        integer vBaseEnvAvailableChannels_Hyperbus: 0..256, set at pre-compile, origin=Vector Informatik, default-value=0  # Configure the amount of Hyperbus channels, available on this derivative.
        integer vBaseEnvAvailableChannels_I2c: 0..256, set at pre-compile, origin=Vector Informatik, default-value=0  # Configure the amount of I2C channels, available on this derivative.
        integer vBaseEnvAvailableChannels_Spi: 0..256, set at pre-compile, origin=Vector Informatik, default-value=0  # Configure the amount of Spi channels, available on this derivative.
        container vBaseEnvAdditionalParameters [0..1]  # Additional parameters for generation of additional defines, if necessary for the depending platform.
          string vBaseEnvDerivativeGroup [0..1]: set at pre-compile, origin=Vector Informatik  # Define the Derivative Group of this derivative
          enumeration vBaseEnvPllGroup [0..1]: set at pre-compile, origin=Vector Informatik  # Configure the PLL Group of your derivative
            A  # PLL Group A
            A{1..4}  # PLL Group A{1..4}
            B  # PLL Group B
            C  # PLL Group C
            D  # PLL Group D
            E  # PLL Group E
            F  # PLL Group F
            G  # PLL Group G
            H  # PLL Group H
            I  # PLL Group I
            J  # PLL Group J
            K  # PLL Group K
            L  # PLL Group L
            A5  # PLL Group A5
            E1  # PLL Group E1
          enumeration vBaseEnvClockGroup [0..1]: set at pre-compile, origin=Vector Informatik  # Configure the Clock Group of your derivative
            A  # Clock Group A
            A{1..4}  # Clock Group A{1..4}
            B  # Clock Group B
            C  # Clock Group C
            D  # Clock Group D
            E  # Clock Group E
            F  # Clock Group F
            G  # Clock Group G
            H  # Clock Group H
            I  # Clock Group I
            J  # Clock Group J
            K  # Clock Group K
            L  # Clock Group L
          enumeration vBaseEnvPortGroup [0..1]: set at pre-compile, origin=Vector Informatik  # Configure the Port Group of your derivative
            A  # Port Group A
            A{1..4}  # Port Group A{1..4}
            B  # Port Group B
            B1  # Port Group B1
            B2  # Port Group B2
            C  # Port Group C
            D  # Port Group D
            E  # Port Group E
            F  # Port Group F
            G  # Port Group G
            H  # Port Group H
            I  # Port Group I
            J  # Port Group J
            K  # Port Group K
            L  # Port Group L
          enumeration vBaseEnvProtectionGroup [0..1]: set at pre-compile, origin=Vector Informatik  # Configure the Protection Group of your derivative
            A  # Protection Group A
            B  # Protection Group B
            C  # Protection Group C
            D  # Protection Group D
            E  # Protection Group E
            F  # Protection Group F
            G  # Protection Group G
            H  # Protection Group H
            I  # Protection Group I
            J  # Protection Group J
            K  # Protection Group K
            L  # Protection Group L
            NONE  # No Protection Group
          enumeration vBaseEnvResetGroup [0..1]: set at pre-compile, origin=Vector Informatik  # Configure the Reset Group of your derivative
            A  # Reset Group A
            B  # Reset Group B
            C  # Reset Group C
            D  # Reset Group D
            E  # Reset Group E
            F  # Reset Group F
            G  # Reset Group G
            H  # Reset Group H
            I  # Reset Group I
            J  # Reset Group J
            K  # Reset Group K
            L  # Reset Group L
          enumeration vBaseEnvWatchdogGroup [0..1]: set at pre-compile, origin=Vector Informatik  # Configure the Watchdog Group of your derivative
            NONE  # Watchdog Group NONE
            A  # Watchdog Group A
            A{1..7}  # Watchdog Group A{1..7}
            B  # Watchdog Group B
            C  # Watchdog Group C
            D  # Watchdog Group D
            E  # Watchdog Group E
          enumeration vBaseEnvOpModeGroup [0..1]: set at pre-compile, origin=Vector Informatik  # Configure the Operation Mode Group of your derivative
            NONE  # Operation Mode Group NONE
            A  # Operation Mode Group A
            A1  # Operation Mode Group A1
            A2  # Operation Mode Group A2
            B  # Operation Mode Group B
            C  # Operation Mode Group C
            D  # Operation Mode Group D
            E  # Operation Mode Group E
          enumeration vBaseEnvUserModeAccessGroup [0..1]: set at pre-compile, origin=Vector Informatik  # Configure the User Mode Access Group of your derivative
            A  # User Mode Access Group A
            A1  # User Mode Access Group A1
            A2  # User Mode Access Group A2
            B  # User Mode Access Group B
            C  # User Mode Access Group C
            D  # User Mode Access Group D
            E  # User Mode Access Group E
            F  # User Mode Access Group F
          boolean vBaseEnvPowerDownModes [0..1]: set at pre-compile, origin=Vector Informatik, default-value=false  # Configure, if Power Down Modes to be used for your derivative
        container vBaseEnvMemLayoutHwRegion [0..*]  # Memory Layout Hardware Region | Container to structure the configuration parameters of hardware memory regions.
          integer vBaseEnvHwRegionStartAddress: 0..4294967295, set at pre-compile, origin=Vector Informatik, default-value=0  # Hardware Region Start Address | Start address of the hardware memory region.
          integer vBaseEnvHwRegionSize: 0..4294967295, set at pre-compile, origin=Vector Informatik, default-value=0  # Hardware Region Size | Size of the hardware memory region.
          integer vBaseEnvHwRegionEccAlignment [0..1]: 0..4294967295, set at pre-compile, origin=Vector Informatik, default-value=0  # Hardware Region ECC Alignment | Required ECC Alignment of the hardware memory region.
          enumeration vBaseEnvHwRegionType [0..1]: set at pre-compile, origin=Vector Informatik  # Hardware Region Type | Type of the hardware memory region. This parameter is necessary for some linkers (e.g. Tasking), to distinguish between RAM/ROM/NVRAM.
            RAM  # Random-Access Memory
            ROM  # Read-Only Memory
            NVRAM  # Non-Volatile Random-Access Memory
        container vBaseEnvClockSettings [0..1]  # Container for derivative specific default clock settings (oscillator + peripherals). This allows solving actions to update the depending frequncy settings in the vBRSHwConfig container.
          integer vBaseEnvOscClock [0..1]: 0..18446744073709551615, set at pre-compile, origin=Vector Informatik  # Oscillator clock frequency | Frequency of the board specific external oscillator.
          integer vBaseEnvTimebaseClock [0..1]: 0..18446744073709551615, set at pre-compile, origin=Vector Informatik  # Timebase (PLL) clock frequency | Frequency, used for PLL calculation (normally used as CPU core clock).
          integer vBaseEnvPeriphClock [0..1]: 0..18446744073709551615, set at pre-compile, origin=Vector Informatik  # Peripheral (Timer) clock frequency | Frequency of the controller peripherals, at least for the default timer, used by the OS. If the frequencies for communication peripherals differ from this peripheral clock, they could be configured through the depending communictaion peripheral clock parameter.
          integer vBaseEnvCanClock [0..1]: 0..18446744073709551615, set at pre-compile, origin=Vector Informatik  # Frequency of peripheral clock: CAN | Default frequency, used for PLL calculation of CAN driver peripheral clock.
          integer vBaseEnvLinClock [0..1]: 0..18446744073709551615, set at pre-compile, origin=Vector Informatik  # Frequency of peripheral clock: LIN | Default frequency, used for PLL calculation of LIN driver peripheral clock.
          integer vBaseEnvFlexrayClock [0..1]: 0..18446744073709551615, set at pre-compile, origin=Vector Informatik  # Frequency of peripheral clock: FlexRay | Default frequency, used for PLL calculation of FlexRay driver peripheral clock.
          integer vBaseEnvEthernetClock [0..1]: 0..18446744073709551615, set at pre-compile, origin=Vector Informatik  # Frequency of peripheral clock: EtherNet | Default frequency, used for PLL calculation of EtherNet driver peripheral clock.
          integer vBaseEnvHyperbusClock [0..1]: 0..18446744073709551615, set at pre-compile, origin=Vector Informatik  # Frequency of peripheral clock: Hyperbus | Default frequency, used for PLL calculation of Hyperbus driver peripheral clock.
          integer vBaseEnvI2cClock [0..1]: 0..18446744073709551615, set at pre-compile, origin=Vector Informatik  # Frequency of peripheral clock: I2C | Default frequency, used for PLL calculation of I2C driver peripheral clock.
          integer vBaseEnvSpiClock [0..1]: 0..18446744073709551615, set at pre-compile, origin=Vector Informatik  # Frequency of peripheral clock: SPI | Default frequency, used for PLL calculation of Spi driver peripheral clock.
      container vBaseEnvMemLayoutHwRegion [0..*]  # Memory Layout Hardware Region | Container to structure the configuration parameters of hardware memory regions.
      container vBaseEnvInterruptHandling [0..1]  # Container for family specific default interrupt settings
        container vBaseEnvCan [0..1]
          container vBaseEnvChannel [0..*]
            integer vBaseEnvIndex: 0.., set at pre-compile, origin=Vector Informatik  # Channel Index | Logical channel
            integer vBaseEnvIsrInterruptPriority: 0.., set at pre-compile, origin=Vector Informatik  # Channel Priority
            integer vBaseEnvIsrInterruptSource: 0.., set at pre-compile, origin=Vector Informatik  # Channel Source Number
        container vBaseEnvLin [0..1]
          container vBaseEnvChannel [0..*]
            integer vBaseEnvIndex: 0.., set at pre-compile, origin=Vector Informatik  # Channel Index | Logical channel
            integer vBaseEnvIsrInterruptPriority: 0.., set at pre-compile, origin=Vector Informatik  # Channel Priority
            integer vBaseEnvIsrInterruptSource: 0.., set at pre-compile, origin=Vector Informatik  # Channel Source Number
        container vBaseEnvFlexray [0..1]
          container vBaseEnvChannel [0..*]
            integer vBaseEnvIndex: 0.., set at pre-compile, origin=Vector Informatik  # Channel Index | Logical channel
            integer vBaseEnvIsrInterruptPriority: 0.., set at pre-compile, origin=Vector Informatik  # Channel Priority
            integer vBaseEnvIsrInterruptSource: 0.., set at pre-compile, origin=Vector Informatik  # Channel Source Number
        container vBaseEnvEthernet [0..1]
          container vBaseEnvChannel [0..*]
            integer vBaseEnvIndex: 0.., set at pre-compile, origin=Vector Informatik  # Channel Index | Logical channel
            integer vBaseEnvIsrInterruptPriority: 0.., set at pre-compile, origin=Vector Informatik  # Channel Priority
            integer vBaseEnvIsrInterruptSource: 0.., set at pre-compile, origin=Vector Informatik  # Channel Source Number
        container vBaseEnvHyperbus [0..1]
          container vBaseEnvChannel [0..*]
            integer vBaseEnvIndex: 0.., set at pre-compile, origin=Vector Informatik  # Channel Index | Logical channel
            integer vBaseEnvIsrInterruptPriority: 0.., set at pre-compile, origin=Vector Informatik  # Channel Priority
            integer vBaseEnvIsrInterruptSource: 0.., set at pre-compile, origin=Vector Informatik  # Channel Source Number
        container vBaseEnvI2c [0..1]
          container vBaseEnvChannel [0..*]
            integer vBaseEnvIndex: 0.., set at pre-compile, origin=Vector Informatik  # Channel Index | Logical channel
            integer vBaseEnvIsrInterruptPriority: 0.., set at pre-compile, origin=Vector Informatik  # Channel Priority
            integer vBaseEnvIsrInterruptSource: 0.., set at pre-compile, origin=Vector Informatik  # Channel Source Number
        container vBaseEnvSpi [0..1]
          container vBaseEnvChannel [0..*]
            integer vBaseEnvIndex: 0.., set at pre-compile, origin=Vector Informatik  # Channel Index | Logical channel
            integer vBaseEnvIsrInterruptPriority: 0.., set at pre-compile, origin=Vector Informatik  # Channel Priority
            integer vBaseEnvIsrInterruptSource: 0.., set at pre-compile, origin=Vector Informatik  # Channel Source Number
      container vBaseEnvPeripheralClocks [0..1]  # Container for family specific default peripheral clock settings
        container vBaseEnvCan [0..1]
          integer vBaseEnvCan_Clock [0..1]: 0..18446744073709551615, set at pre-compile, origin=Vector Informatik, default-value=0  # Frequency of CAN peripheral clock | Default frequency, used for PLL calculation of CAN driver peripheral clock.
          reference vBaseEnvCan_ClockRef [0..1]: set at pre-compile, origin=Vector Informatik, destination=McuClockReferencePoint  # Frequency of CAN peripheral clock - Mcu Reference | Default McuClockReferencePoint reference for CAN peripheral clock setting.
        container vBaseEnvLin [0..1]
          integer vBaseEnvLin_Clock [0..1]: 0..18446744073709551615, set at pre-compile, origin=Vector Informatik, default-value=0  # Frequency of LIN peripheral clock | Default frequency, used for PLL calculation of LIN driver peripheral clock.
          reference vBaseEnvLin_ClockRef [0..1]: set at pre-compile, origin=Vector Informatik, destination=McuClockReferencePoint  # Frequency of LIN peripheral clock - Mcu Reference | Default McuClockReferencePoint reference for LIN peripheral clock setting.
        container vBaseEnvFlexray [0..1]
          integer vBaseEnvFlexray_Clock [0..1]: 0..18446744073709551615, set at pre-compile, origin=Vector Informatik, default-value=0  # Frequency of FlexRay peripheral clock | Default frequency, used for PLL calculation of FlexRay driver peripheral clock.
          reference vBaseEnvFlexray_ClockRef [0..1]: set at pre-compile, origin=Vector Informatik, destination=McuClockReferencePoint  # Frequency of FlexRay peripheral clock - Mcu Reference | Default McuClockReferencePoint reference for FlexRay peripheral clock setting.
        container vBaseEnvEthernet [0..1]
          integer vBaseEnvEthernet_Clock [0..1]: 0..18446744073709551615, set at pre-compile, origin=Vector Informatik, default-value=0  # Frequency of EtherNet peripheral clock | Default frequency, used for PLL calculation of EtherNet driver peripheral clock.
          reference vBaseEnvEthernet_ClockRef [0..1]: set at pre-compile, origin=Vector Informatik, destination=McuClockReferencePoint  # Frequency of EtherNet peripheral clock - Mcu Reference | Default McuClockReferencePoint reference for EtherNet peripheral clock setting.
        container vBaseEnvHyperbus [0..1]
          integer vBaseEnvHyperbus_Clock [0..1]: 0..18446744073709551615, set at pre-compile, origin=Vector Informatik, default-value=0  # Frequency of Hyperbus peripheral clock | Default frequency, used for PLL calculation of Hyperbus driver peripheral clock.
          reference vBaseEnvHyperbus_ClockRef [0..1]: set at pre-compile, origin=Vector Informatik, destination=McuClockReferencePoint  # Frequency of Hyperbus peripheral clock - Mcu Reference | Default McuClockReferencePoint reference for Hyperbus peripheral clock setting.
        container vBaseEnvI2c [0..1]
          integer vBaseEnvI2c_Clock [0..1]: 0..18446744073709551615, set at pre-compile, origin=Vector Informatik, default-value=0  # Frequency of I2C peripheral clock | Default frequency, used for PLL calculation of I2C driver peripheral clock.
          reference vBaseEnvI2c_ClockRef [0..1]: set at pre-compile, origin=Vector Informatik, destination=McuClockReferencePoint  # Frequency of I2C peripheral clock - Mcu Reference | Default McuClockReferencePoint reference for I2C peripheral clock setting.
        container vBaseEnvSpi [0..1]
          integer vBaseEnvSpi_Clock [0..1]: 0..18446744073709551615, set at pre-compile, origin=Vector Informatik, default-value=0  # Frequency of Spi peripheral clock | Default frequency, used for PLL calculation of Spi driver peripheral clock.
          reference vBaseEnvSpi_ClockRef [0..1]: set at pre-compile, origin=Vector Informatik, destination=McuClockReferencePoint  # Frequency of Spi peripheral clock - Mcu Reference | Default McuClockReferencePoint reference for Spi peripheral clock setting.
      container vBaseEnvStartupStackSettings [0..1]  # Container for family specific startup stack settings, if they differ to the default settings
        integer vBaseEnvStackAlignment [0..1]: 0..4294967295, set at pre-compile, origin=Vector Informatik, default-value=4  # Configure the startup stack alignment for each core. This value will be validated in the vLinkGen stack section. This value is only needed, if the default value 4 is not sufficient for this platform.
        integer vBaseEnvStackEndAlignment [0..1]: 0..4294967295, set at pre-compile, origin=Vector Informatik, default-value=4  # Configure the startup stack end alignment for each core. This value will be validated in the vLinkGen stack section. This value is only needed, if the default value 4 is not sufficient for this platform.
        integer vBaseEnvStackSize [0..1]: 0..4294967295, set at pre-compile, origin=Vector Informatik, default-value=1024  # Configure the startup stack size for each core. This value will be validated in the vLinkGen stack section and generated into vBrs_Lcfg.c as StartupStackSize. This value is only needed, if the default value 1024 is not sufficient for this platform.
