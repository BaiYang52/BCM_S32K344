AUTOSAR XML (schema 00046)
package /AUTOSAR_Wdg/BswModuleDescriptions
  bsw module description Wdg: module-id=102
    provided-entrys:
      Wdg_43_Instance0_ClearResetRequest
      Wdg_43_Instance0_GetVersionInfo
      Wdg_43_Instance0_Init
      Wdg_43_Instance0_Service
      Wdg_43_Instance0_SetMode
      Wdg_43_Instance0_SetServiceAddress
      Wdg_43_Instance0_SetTriggerCondition
      Wdg_43_Instance1_ClearResetRequest
      Wdg_43_Instance1_GetVersionInfo
      Wdg_43_Instance1_Init
      Wdg_43_Instance1_Service
      Wdg_43_Instance1_SetMode
      Wdg_43_Instance1_SetServiceAddress
      Wdg_43_Instance1_SetTriggerCondition
      Wdg_43_Instance2_ClearResetRequest
      Wdg_43_Instance2_GetVersionInfo
      Wdg_43_Instance2_Init
      Wdg_43_Instance2_Service
      Wdg_43_Instance2_SetMode
      Wdg_43_Instance2_SetServiceAddress
      Wdg_43_Instance2_SetTriggerCondition
      Wdg_Cbk_GptNotification{0..2}
      Swt_Ip_Swt0_Isr
      Swt_Ip_Swt{10..12}_Isr
      Swt_Ip_Swt{1..9}_Isr
    bsw internal behavior InternalBehavior_0
      12 x exclusive area:
        WDG_EXCLUSIVE_AREA_{00..11}
      24 x bsw called entity:
        Wdg_43_Instance0_ClearResetRequest: can-enter-exclusive-area=WDG_EXCLUSIVE_AREA_08, implemented-entry=Wdg_43_Instance0_ClearResetRequest
        Wdg_43_Instance0_GetVersionInfo: implemented-entry=Wdg_43_Instance0_GetVersionInfo
        Wdg_43_Instance0_Init: can-enter-exclusive-area=[WDG_EXCLUSIVE_AREA_01, WDG_EXCLUSIVE_AREA_02, WDG_EXCLUSIVE_AREA_06, WDG_EXCLUSIVE_AREA_07], implemented-entry=Wdg_43_Instance0_Init
        Wdg_43_Instance0_Service: can-enter-exclusive-area=WDG_EXCLUSIVE_AREA_09, implemented-entry=Wdg_43_Instance0_Service
        Wdg_43_Instance0_SetMode: can-enter-exclusive-area=[WDG_EXCLUSIVE_AREA_03, WDG_EXCLUSIVE_AREA_04, WDG_EXCLUSIVE_AREA_06, WDG_EXCLUSIVE_AREA_07, WDG_EXCLUSIVE_AREA_10, WDG_EXCLUSIVE_AREA_11], implemented-entry=Wdg_43_Instance0_SetMode
        Wdg_43_Instance0_SetServiceAddress: implemented-entry=Wdg_43_Instance0_SetServiceAddress
        Wdg_43_Instance0_SetTriggerCondition: can-enter-exclusive-area=WDG_EXCLUSIVE_AREA_05, implemented-entry=Wdg_43_Instance0_SetTriggerCondition
        Wdg_43_Instance1_ClearResetRequest: can-enter-exclusive-area=WDG_EXCLUSIVE_AREA_08, implemented-entry=Wdg_43_Instance1_ClearResetRequest
        Wdg_43_Instance1_GetVersionInfo: implemented-entry=Wdg_43_Instance1_GetVersionInfo
        Wdg_43_Instance1_Init: can-enter-exclusive-area=[WDG_EXCLUSIVE_AREA_01, WDG_EXCLUSIVE_AREA_02, WDG_EXCLUSIVE_AREA_06, WDG_EXCLUSIVE_AREA_07], implemented-entry=Wdg_43_Instance1_Init
        Wdg_43_Instance1_Service: can-enter-exclusive-area=WDG_EXCLUSIVE_AREA_09, implemented-entry=Wdg_43_Instance1_Service
        Wdg_43_Instance1_SetMode: can-enter-exclusive-area=[WDG_EXCLUSIVE_AREA_03, WDG_EXCLUSIVE_AREA_04, WDG_EXCLUSIVE_AREA_06, WDG_EXCLUSIVE_AREA_07, WDG_EXCLUSIVE_AREA_10, WDG_EXCLUSIVE_AREA_11], implemented-entry=Wdg_43_Instance1_SetMode
        Wdg_43_Instance1_SetServiceAddress: implemented-entry=Wdg_43_Instance1_SetServiceAddress
        Wdg_43_Instance1_SetTriggerCondition: can-enter-exclusive-area=WDG_EXCLUSIVE_AREA_05, implemented-entry=Wdg_43_Instance1_SetTriggerCondition
        Wdg_43_Instance2_ClearResetRequest: implemented-entry=Wdg_43_Instance2_ClearResetRequest
        Wdg_43_Instance2_GetVersionInfo: implemented-entry=Wdg_43_Instance2_GetVersionInfo
        Wdg_43_Instance2_Init: implemented-entry=Wdg_43_Instance2_Init
        Wdg_43_Instance2_Service: implemented-entry=Wdg_43_Instance2_Service
        Wdg_43_Instance2_SetMode: implemented-entry=Wdg_43_Instance2_SetMode
        Wdg_43_Instance2_SetServiceAddress: implemented-entry=Wdg_43_Instance2_SetServiceAddress
        Wdg_43_Instance2_SetTriggerCondition: implemented-entry=Wdg_43_Instance2_SetTriggerCondition
        Wdg_Cbk_GptNotification0: can-enter-exclusive-area=WDG_EXCLUSIVE_AREA_00, implemented-entry=Wdg_Cbk_GptNotification0
        Wdg_Cbk_GptNotification1: can-enter-exclusive-area=WDG_EXCLUSIVE_AREA_00, implemented-entry=Wdg_Cbk_GptNotification1
        Wdg_Cbk_GptNotification2: implemented-entry=Wdg_Cbk_GptNotification2
      13 x bsw interrupt entity, all with interrupt-category=CAT-2, interrupt-source=Hardware:
        Swt_Ip_Swt0_Isr: implemented-entry=Swt_Ip_Swt0_Isr
        Swt_Ip_Swt{10..12}_Isr: implemented-entry=Swt_Ip_Swt{10..12}_Isr
        Swt_Ip_Swt{1..9}_Isr: implemented-entry=Swt_Ip_Swt{1..9}_Isr
package /AUTOSAR_Wdg/BswModuleEntrys
  37 x bsw module entry, all with is-synchronous=true, sw-service-impl-policy=STANDARD:
    Wdg_43_Instance0_ClearResetRequest: service-id=0x06, is-reentrant=false, call-type=REGULAR, execution-context=UNSPECIFIED
    Wdg_43_Instance0_GetVersionInfo: service-id=0x04, is-reentrant=true, call-type=REGULAR, execution-context=UNSPECIFIED
    Wdg_43_Instance0_Init: service-id=0x00, is-reentrant=false, call-type=REGULAR, execution-context=UNSPECIFIED
    Wdg_43_Instance0_Service: service-id=0x05, is-reentrant=false, call-type=REGULAR, execution-context=UNSPECIFIED
    Wdg_43_Instance0_SetMode: service-id=0x01, is-reentrant=false, call-type=REGULAR, execution-context=UNSPECIFIED
    Wdg_43_Instance0_SetServiceAddress: service-id=0x08, is-reentrant=false, call-type=REGULAR, execution-context=UNSPECIFIED
    Wdg_43_Instance0_SetTriggerCondition: service-id=0x03, is-reentrant=false, call-type=REGULAR, execution-context=UNSPECIFIED
    Wdg_43_Instance1_ClearResetRequest: service-id=0x06, is-reentrant=false, call-type=REGULAR, execution-context=UNSPECIFIED
    Wdg_43_Instance1_GetVersionInfo: service-id=0x04, is-reentrant=true, call-type=REGULAR, execution-context=UNSPECIFIED
    Wdg_43_Instance1_Init: service-id=0x00, is-reentrant=false, call-type=REGULAR, execution-context=UNSPECIFIED
    Wdg_43_Instance1_Service: service-id=0x05, is-reentrant=false, call-type=REGULAR, execution-context=UNSPECIFIED
    Wdg_43_Instance1_SetMode: service-id=0x01, is-reentrant=false, call-type=REGULAR, execution-context=UNSPECIFIED
    Wdg_43_Instance1_SetServiceAddress: service-id=0x08, is-reentrant=false, call-type=REGULAR, execution-context=UNSPECIFIED
    Wdg_43_Instance1_SetTriggerCondition: service-id=0x03, is-reentrant=false, call-type=REGULAR, execution-context=UNSPECIFIED
    Wdg_43_Instance2_ClearResetRequest: service-id=0x06, is-reentrant=false, call-type=REGULAR, execution-context=UNSPECIFIED
    Wdg_43_Instance2_GetVersionInfo: service-id=0x04, is-reentrant=true, call-type=REGULAR, execution-context=UNSPECIFIED
    Wdg_43_Instance2_Init: service-id=0x00, is-reentrant=false, call-type=REGULAR, execution-context=UNSPECIFIED
    Wdg_43_Instance2_Service: service-id=0x05, is-reentrant=false, call-type=REGULAR, execution-context=UNSPECIFIED
    Wdg_43_Instance2_SetMode: service-id=0x01, is-reentrant=false, call-type=REGULAR, execution-context=UNSPECIFIED
    Wdg_43_Instance2_SetServiceAddress: service-id=0x08, is-reentrant=false, call-type=REGULAR, execution-context=UNSPECIFIED
    Wdg_43_Instance2_SetTriggerCondition: service-id=0x03, is-reentrant=false, call-type=REGULAR, execution-context=UNSPECIFIED
    Wdg_Cbk_GptNotification{0..2}: service-id=0x07, is-reentrant=false, call-type=REGULAR, execution-context=UNSPECIFIED
    Swt_Ip_Swt0_Isr: service-id=0, is-reentrant=false, call-type=INTERRUPT, execution-context=INTERRUPT-CAT-2
    Swt_Ip_Swt{10..12}_Isr: service-id=0, is-reentrant=false, call-type=INTERRUPT, execution-context=INTERRUPT-CAT-2
    Swt_Ip_Swt{1..9}_Isr: service-id=0, is-reentrant=false, call-type=INTERRUPT, execution-context=INTERRUPT-CAT-2
package /Wdg_TS_T40D34M20I1R0/Implementations
  bsw implementation BswImplementation_0: programming-language=C, sw-version=2.0.1, vendor-id=43, ar-release-version=4.4.0, behavior=InternalBehavior_0, vendor-specific-module-def=Wdg
    code-descriptors:
      code Files
        artifact-descriptors:
          short-label=config::Wdg.xdm, category=SWCFG
          short-label=doc::RTD_WDG_IM.pdf, category=SWDOC
          short-label=doc::RTD_WDG_UM.pdf, category=SWDOC
          short-label=examples::EBT::Wdg_Example_S32K312::generate::epc::Base.xdm, category=SWCFG
          short-label=examples::EBT::Wdg_Example_S32K312::generate::epc::Dem.xdm, category=SWCFG
          short-label=examples::EBT::Wdg_Example_S32K312::generate::epc::EcuC.xdm, category=SWCFG
          short-label=examples::EBT::Wdg_Example_S32K312::generate::epc::Gpt.xdm, category=SWCFG
          short-label=examples::EBT::Wdg_Example_S32K312::generate::epc::Mcu.xdm, category=SWCFG
          short-label=examples::EBT::Wdg_Example_S32K312::generate::epc::Os.xdm, category=SWCFG
          short-label=examples::EBT::Wdg_Example_S32K312::generate::epc::Platform.xdm, category=SWCFG
          short-label=examples::EBT::Wdg_Example_S32K312::generate::epc::Resource.xdm, category=SWCFG
          short-label=examples::EBT::Wdg_Example_S32K312::generate::epc::Wdg.xdm, category=SWCFG
          short-label=examples::EBT::Wdg_Example_S32K312::include::check_example.h, category=SWHDR
          short-label=examples::EBT::Wdg_Example_S32K312::src::main.c, category=SWSRC
          short-label=examples::EBT::Wdg_Example_S32K312::TresosProject::Wdg_Example_S32K312::.prefs::preferences.xdm, category=SWCFG
          short-label=examples::EBT::Wdg_Example_S32K312::TresosProject::Wdg_Example_S32K312::config::Base.xdm, category=SWCFG
          short-label=examples::EBT::Wdg_Example_S32K312::TresosProject::Wdg_Example_S32K312::config::Dem.xdm, category=SWCFG
          short-label=examples::EBT::Wdg_Example_S32K312::TresosProject::Wdg_Example_S32K312::config::EcuC.xdm, category=SWCFG
          short-label=examples::EBT::Wdg_Example_S32K312::TresosProject::Wdg_Example_S32K312::config::Gpt.xdm, category=SWCFG
          short-label=examples::EBT::Wdg_Example_S32K312::TresosProject::Wdg_Example_S32K312::config::Mcu.xdm, category=SWCFG
          short-label=examples::EBT::Wdg_Example_S32K312::TresosProject::Wdg_Example_S32K312::config::Os.xdm, category=SWCFG
          short-label=examples::EBT::Wdg_Example_S32K312::TresosProject::Wdg_Example_S32K312::config::Platform.xdm, category=SWCFG
          short-label=examples::EBT::Wdg_Example_S32K312::TresosProject::Wdg_Example_S32K312::config::Resource.xdm, category=SWCFG
          short-label=examples::EBT::Wdg_Example_S32K312::TresosProject::Wdg_Example_S32K312::config::Wdg.xdm, category=SWCFG
          short-label=examples::EBT::Wdg_Example_S32K342::generate::epc::Base.xdm, category=SWCFG
          short-label=examples::EBT::Wdg_Example_S32K342::generate::epc::Dem.xdm, category=SWCFG
          short-label=examples::EBT::Wdg_Example_S32K342::generate::epc::EcuC.xdm, category=SWCFG
          short-label=examples::EBT::Wdg_Example_S32K342::generate::epc::Gpt.xdm, category=SWCFG
          short-label=examples::EBT::Wdg_Example_S32K342::generate::epc::Mcu.xdm, category=SWCFG
          short-label=examples::EBT::Wdg_Example_S32K342::generate::epc::Os.xdm, category=SWCFG
          short-label=examples::EBT::Wdg_Example_S32K342::generate::epc::Platform.xdm, category=SWCFG
          short-label=examples::EBT::Wdg_Example_S32K342::generate::epc::Resource.xdm, category=SWCFG
          short-label=examples::EBT::Wdg_Example_S32K342::generate::epc::Wdg.xdm, category=SWCFG
          short-label=examples::EBT::Wdg_Example_S32K342::include::check_example.h, category=SWHDR
          short-label=examples::EBT::Wdg_Example_S32K342::src::main.c, category=SWSRC
          short-label=examples::EBT::Wdg_Example_S32K342::TresosProject::Wdg_Example_S32K342::.prefs::preferences.xdm, category=SWCFG
          short-label=examples::EBT::Wdg_Example_S32K342::TresosProject::Wdg_Example_S32K342::config::Base.xdm, category=SWCFG
          short-label=examples::EBT::Wdg_Example_S32K342::TresosProject::Wdg_Example_S32K342::config::Dem.xdm, category=SWCFG
          short-label=examples::EBT::Wdg_Example_S32K342::TresosProject::Wdg_Example_S32K342::config::EcuC.xdm, category=SWCFG
          short-label=examples::EBT::Wdg_Example_S32K342::TresosProject::Wdg_Example_S32K342::config::Gpt.xdm, category=SWCFG
          short-label=examples::EBT::Wdg_Example_S32K342::TresosProject::Wdg_Example_S32K342::config::Mcu.xdm, category=SWCFG
          short-label=examples::EBT::Wdg_Example_S32K342::TresosProject::Wdg_Example_S32K342::config::Os.xdm, category=SWCFG
          short-label=examples::EBT::Wdg_Example_S32K342::TresosProject::Wdg_Example_S32K342::config::Platform.xdm, category=SWCFG
          short-label=examples::EBT::Wdg_Example_S32K342::TresosProject::Wdg_Example_S32K342::config::Resource.xdm, category=SWCFG
          short-label=examples::EBT::Wdg_Example_S32K342::TresosProject::Wdg_Example_S32K342::config::Wdg.xdm, category=SWCFG
          short-label=examples::EBT::Wdg_Example_S32K344::generate::epc::Base.xdm, category=SWCFG
          short-label=examples::EBT::Wdg_Example_S32K344::generate::epc::Dem.xdm, category=SWCFG
          short-label=examples::EBT::Wdg_Example_S32K344::generate::epc::EcuC.xdm, category=SWCFG
          short-label=examples::EBT::Wdg_Example_S32K344::generate::epc::Gpt.xdm, category=SWCFG
          short-label=examples::EBT::Wdg_Example_S32K344::generate::epc::Mcu.xdm, category=SWCFG
          short-label=examples::EBT::Wdg_Example_S32K344::generate::epc::Os.xdm, category=SWCFG
          short-label=examples::EBT::Wdg_Example_S32K344::generate::epc::Platform.xdm, category=SWCFG
          short-label=examples::EBT::Wdg_Example_S32K344::generate::epc::Resource.xdm, category=SWCFG
          short-label=examples::EBT::Wdg_Example_S32K344::generate::epc::Wdg.xdm, category=SWCFG
          short-label=examples::EBT::Wdg_Example_S32K344::include::check_example.h, category=SWHDR
          short-label=examples::EBT::Wdg_Example_S32K344::src::main.c, category=SWSRC
          short-label=examples::EBT::Wdg_Example_S32K344::TresosProject::Wdg_Example_S32K344::.prefs::preferences.xdm, category=SWCFG
          short-label=examples::EBT::Wdg_Example_S32K344::TresosProject::Wdg_Example_S32K344::config::Base.xdm, category=SWCFG
          short-label=examples::EBT::Wdg_Example_S32K344::TresosProject::Wdg_Example_S32K344::config::Dem.xdm, category=SWCFG
          short-label=examples::EBT::Wdg_Example_S32K344::TresosProject::Wdg_Example_S32K344::config::EcuC.xdm, category=SWCFG
          short-label=examples::EBT::Wdg_Example_S32K344::TresosProject::Wdg_Example_S32K344::config::Gpt.xdm, category=SWCFG
          short-label=examples::EBT::Wdg_Example_S32K344::TresosProject::Wdg_Example_S32K344::config::Mcu.xdm, category=SWCFG
          short-label=examples::EBT::Wdg_Example_S32K344::TresosProject::Wdg_Example_S32K344::config::Os.xdm, category=SWCFG
          short-label=examples::EBT::Wdg_Example_S32K344::TresosProject::Wdg_Example_S32K344::config::Platform.xdm, category=SWCFG
          short-label=examples::EBT::Wdg_Example_S32K344::TresosProject::Wdg_Example_S32K344::config::Resource.xdm, category=SWCFG
          short-label=examples::EBT::Wdg_Example_S32K344::TresosProject::Wdg_Example_S32K344::config::Wdg.xdm, category=SWCFG
          short-label=examples::S32DS::Swt_Ip_Example_S32K312::include::check_example.h, category=SWHDR
          short-label=examples::S32DS::Swt_Ip_Example_S32K312::Project_Settings::Startup_Code::exceptions.c, category=SWSRC
          short-label=examples::S32DS::Swt_Ip_Example_S32K312::Project_Settings::Startup_Code::nvic.c, category=SWSRC
          short-label=examples::S32DS::Swt_Ip_Example_S32K312::Project_Settings::Startup_Code::startup.c, category=SWSRC
          short-label=examples::S32DS::Swt_Ip_Example_S32K312::Project_Settings::Startup_Code::system.c, category=SWSRC
          short-label=examples::S32DS::Swt_Ip_Example_S32K312::src::main.c, category=SWSRC
          short-label=examples::S32DS::Swt_Ip_Example_S32K342::include::check_example.h, category=SWHDR
          short-label=examples::S32DS::Swt_Ip_Example_S32K342::Project_Settings::Startup_Code::exceptions.c, category=SWSRC
          short-label=examples::S32DS::Swt_Ip_Example_S32K342::Project_Settings::Startup_Code::nvic.c, category=SWSRC
          short-label=examples::S32DS::Swt_Ip_Example_S32K342::Project_Settings::Startup_Code::startup.c, category=SWSRC
          short-label=examples::S32DS::Swt_Ip_Example_S32K342::Project_Settings::Startup_Code::system.c, category=SWSRC
          short-label=examples::S32DS::Swt_Ip_Example_S32K342::src::main.c, category=SWSRC
          short-label=examples::S32DS::Swt_Ip_Example_S32K344::include::check_example.h, category=SWHDR
          short-label=examples::S32DS::Swt_Ip_Example_S32K344::Project_Settings::Startup_Code::exceptions.c, category=SWSRC
          short-label=examples::S32DS::Swt_Ip_Example_S32K344::Project_Settings::Startup_Code::nvic.c, category=SWSRC
          short-label=examples::S32DS::Swt_Ip_Example_S32K344::Project_Settings::Startup_Code::startup.c, category=SWSRC
          short-label=examples::S32DS::Swt_Ip_Example_S32K344::Project_Settings::Startup_Code::system.c, category=SWSRC
          short-label=examples::S32DS::Swt_Ip_Example_S32K344::src::main.c, category=SWSRC
          short-label=examples::S32DS::Wdg_Example_S32K312::include::check_example.h, category=SWHDR
          short-label=examples::S32DS::Wdg_Example_S32K312::Project_Settings::Startup_Code::exceptions.c, category=SWSRC
          short-label=examples::S32DS::Wdg_Example_S32K312::Project_Settings::Startup_Code::nvic.c, category=SWSRC
          short-label=examples::S32DS::Wdg_Example_S32K312::Project_Settings::Startup_Code::startup.c, category=SWSRC
          short-label=examples::S32DS::Wdg_Example_S32K312::Project_Settings::Startup_Code::system.c, category=SWSRC
          short-label=examples::S32DS::Wdg_Example_S32K312::src::main.c, category=SWSRC
          short-label=examples::S32DS::Wdg_Example_S32K342::include::check_example.h, category=SWHDR
          short-label=examples::S32DS::Wdg_Example_S32K342::Project_Settings::Startup_Code::exceptions.c, category=SWSRC
          short-label=examples::S32DS::Wdg_Example_S32K342::Project_Settings::Startup_Code::nvic.c, category=SWSRC
          short-label=examples::S32DS::Wdg_Example_S32K342::Project_Settings::Startup_Code::startup.c, category=SWSRC
          short-label=examples::S32DS::Wdg_Example_S32K342::Project_Settings::Startup_Code::system.c, category=SWSRC
          short-label=examples::S32DS::Wdg_Example_S32K342::src::main.c, category=SWSRC
          short-label=examples::S32DS::Wdg_Example_S32K344::include::check_example.h, category=SWHDR
          short-label=examples::S32DS::Wdg_Example_S32K344::Project_Settings::Startup_Code::exceptions.c, category=SWSRC
          short-label=examples::S32DS::Wdg_Example_S32K344::Project_Settings::Startup_Code::nvic.c, category=SWSRC
          short-label=examples::S32DS::Wdg_Example_S32K344::Project_Settings::Startup_Code::startup.c, category=SWSRC
          short-label=examples::S32DS::Wdg_Example_S32K344::Project_Settings::Startup_Code::system.c, category=SWSRC
          short-label=examples::S32DS::Wdg_Example_S32K344::src::main.c, category=SWSRC
          short-label=include::Swt_Ip.h, category=SWHDR
          short-label=include::Swt_Ip_Irq.h, category=SWHDR
          short-label=include::Swt_Ip_Types.h, category=SWHDR
          short-label=include::Wdg_43_Instance{0..2}.h, category=SWHDR
          short-label=include::Wdg_Channel.h, category=SWHDR
          short-label=include::Wdg_ChannelTypes.h, category=SWHDR
          short-label=include::Wdg_EnvCfg.h, category=SWHDR
          short-label=include::Wdg_Ipw.h, category=SWHDR
          short-label=include::Wdg_Ipw_Types.h, category=SWHDR
          short-label=src::Swt_Ip.c, category=SWSRC
          short-label=src::Swt_Ip_Irq.c, category=SWSRC
          short-label=src::Wdg_43_Instance{0..2}.c, category=SWSRC
          short-label=src::Wdg_Channel.c, category=SWSRC
          short-label=src::Wdg_Ipw.c, category=SWSRC
    compiler GCC_Compiler:
      name=GCC Compiler
      options=-mcpu=cortex-m7 -mthumb -mlittle-endian -mfpu=fpv5-sp-d16 -mfloat-abi=hard -std=c99 -Os -ggdb3 -Wall -Wextra -pedantic -Wstrict-prototypes -Wundef -Wunused -Werror=implicit-function-declaration -Wsign-compare -Wdouble-promotion -fno-short-enums -funsigned-char -funsigned-bitfields -fomit-frame-pointer -fno-common -fstack-usage -fdump-ipa-all -c -DS32K3XX -DS32K344 -DGCC -DUSE_SW_VECTOR_MODE -DD_CACHE_ENABLE -DI_CACHE_ENABLE -DENABLE_FPU -DMCAL_ENABLE_USER_MODE_SUPPORT
      vendor=GCC Systems
      version=NXP GCC 10.2.0 20200723 (Build 1728 Revision g5963bc8)
    compiler GHS_Compiler:
      name=Green Hills
      options=-cpu=cortexm7 -thumb -fpu=vfpv5_d16 -fsingle -C99 --ghstd=last -Osize --gnu_asm -dual_debug -G -keeptempfiles -Wimplicit-int -Wshadow -Wtrigraphs -Wundef --unsigned_chars --unsigned_fields --no_commons --no_exceptions --no_slash_comment --prototype_errors --incorrect_pragma_warnings -c -DS32K3XX -DS32K344 -DGHS -DUSE_SW_VECTOR_MODE -DD_CACHE_ENABLE -DI_CACHE_ENABLE -DENABLE_FPU -DMCAL_ENABLE_USER_MODE_SUPPORT
      vendor=Green Hills
      version=Green Hills Multi 7.1.6d / Compiler 2021.1.4
    compiler IAR_Compiler:
      name=IAR Compiler
      options=--cpu=Cortex-M7 --cpu_mode=thumb --endian=little --fpu=FPv5-SP -e -Ohz --debug --no_clustering --no_mem_idioms --do_explicit_zero_opt_in_named_sections --require_prototypes --no_wrap_diagnostics --diag_suppress=Pa050 -DS32K3XX -DS32K344 -DIAR -DUSE_SW_VECTOR_MODE -DD_CACHE_ENABLE -DI_CACHE_ENABLE -DENABLE_FPU -DMCAL_ENABLE_USER_MODE_SUPPORT
      vendor=IAR Systems
      version=IAR ANSI C/C++ Compiler v.8.50.10 (safety version)
    generated-artifacts:
      31 x dependency on artifact:
        Swt_Ip_Cfg_Defines_h: artifact-descriptor={short-label=generate::include::Swt_Ip_Cfg_Defines.h, category=SWHDR}, usages=COMPILE
        Swt_Ip_DeviceRegisters_h: artifact-descriptor={short-label=generate::include::Swt_Ip_DeviceRegisters.h, category=SWHDR}, usages=COMPILE
        Wdg_Cfg_h: artifact-descriptor={short-label=generate::include::Wdg_Cfg.h, category=SWHDR}, usages=COMPILE
        Wdg_CfgExt_h: artifact-descriptor={short-label=generate::include::Wdg_CfgExt.h, category=SWHDR}, usages=COMPILE
        Wdg_Cfg_Defines_h: artifact-descriptor={short-label=generate::include::Wdg_Cfg_Defines.h, category=SWHDR}, usages=COMPILE
        Wdg_Ipw_Cfg_Defines_h: artifact-descriptor={short-label=generate::include::Wdg_Ipw_Cfg_Defines.h, category=SWHDR}, usages=COMPILE
        Wdg_CfgExt_c: artifact-descriptor={short-label=generate::src::Wdg_CfgExt.c, category=SWSRC}, usages=COMPILE
        Wdg_43_Instance{0..2}_Lcfg_c: artifact-descriptor={short-label=generate_LT::src::Wdg_43_Instance{0..2}_Lcfg.c, category=SWSRC}, usages=LINK
        Swt_43_Instance{0..2}_Ip_PBcfg_h: artifact-descriptor={short-label=generate_PB::include::Swt_43_Instance{0..2}_Ip_PBcfg.h, category=SWHDR}, usages=EXECUTE
        Wdg_43_Instance0_Ipw_PBcfg_h: artifact-descriptor={short-label=generate_PB::include::Wdg_43_Instance0_Ipw_PBcfg.h, category=SWHDR}, usages=EXECUTE
        Wdg_43_Instance0_PBcfg_h: artifact-descriptor={short-label=generate_PB::include::Wdg_43_Instance0_PBcfg.h, category=SWHDR}, usages=EXECUTE
        Wdg_43_Instance1_Ipw_PBcfg_h: artifact-descriptor={short-label=generate_PB::include::Wdg_43_Instance1_Ipw_PBcfg.h, category=SWHDR}, usages=EXECUTE
        Wdg_43_Instance1_PBcfg_h: artifact-descriptor={short-label=generate_PB::include::Wdg_43_Instance1_PBcfg.h, category=SWHDR}, usages=EXECUTE
        Wdg_43_Instance2_Ipw_PBcfg_h: artifact-descriptor={short-label=generate_PB::include::Wdg_43_Instance2_Ipw_PBcfg.h, category=SWHDR}, usages=EXECUTE
        Wdg_43_Instance2_PBcfg_h: artifact-descriptor={short-label=generate_PB::include::Wdg_43_Instance2_PBcfg.h, category=SWHDR}, usages=EXECUTE
        Swt_43_Instance{0..2}_Ip_PBcfg_c: artifact-descriptor={short-label=generate_PB::src::Swt_43_Instance{0..2}_Ip_PBcfg.c, category=SWSRC}, usages=EXECUTE
        Wdg_43_Instance0_Ipw_PBcfg_c: artifact-descriptor={short-label=generate_PB::src::Wdg_43_Instance0_Ipw_PBcfg.c, category=SWSRC}, usages=EXECUTE
        Wdg_43_Instance0_PBcfg_c: artifact-descriptor={short-label=generate_PB::src::Wdg_43_Instance0_PBcfg.c, category=SWSRC}, usages=EXECUTE
        Wdg_43_Instance1_Ipw_PBcfg_c: artifact-descriptor={short-label=generate_PB::src::Wdg_43_Instance1_Ipw_PBcfg.c, category=SWSRC}, usages=EXECUTE
        Wdg_43_Instance1_PBcfg_c: artifact-descriptor={short-label=generate_PB::src::Wdg_43_Instance1_PBcfg.c, category=SWSRC}, usages=EXECUTE
        Wdg_43_Instance2_Ipw_PBcfg_c: artifact-descriptor={short-label=generate_PB::src::Wdg_43_Instance2_Ipw_PBcfg.c, category=SWSRC}, usages=EXECUTE
        Wdg_43_Instance2_PBcfg_c: artifact-descriptor={short-label=generate_PB::src::Wdg_43_Instance2_PBcfg.c, category=SWSRC}, usages=EXECUTE
        Wdg_43_Instance{0..2}_Cfg_c: artifact-descriptor={short-label=generate_PC::src::Wdg_43_Instance{0..2}_Cfg.c, category=SWSRC}, usages=COMPILE
    linker GCC_Linker: name=GCC Compiler, options=-Wl,-Map,filename -T linkerfile --entry=Reset_Handler -nostartfiles -mcpu=cortexm7 -mthumb -mfpu=fpv5-sp-d16 -mfloat-abi=hard -mlittle-endian -ggdb3 -lc -lm -lgcc, vendor=GCC Systems, version=NXP GCC 10.2.0 20200723 (Build 1728 Revision g5963bc8)
    linker GHS_Linker: name=Green Hills, options=-e Reset_Handler -T linker_script_file.ld -map -keepmap -Mn -delete -ignore_debug_references -Llibrary_path -larch -lstartup -lind_sd -v -keep=C40_Ip_AccessCode -nostartfiles, vendor=Green Hills, version=Green Hills Multi 7.1.6d / Compiler 2021.1.4
    linker IAR_Linker: name=IAR Compiler, options=--map filename --config linkerfile --cpu=Cortex-M7 --fpu=FPv5-SP --entry _start --enable_stack_usage --skip_dynamic_initialization --no_wrap_diagnostics, vendor=IAR Systems, version=IAR ANSI C/C++ Compiler v.8.50.10 (safety version)
    resource consumption ResourceConsumption
      9 x memory section:
        WDG_CODE: alignment=UNSPECIFIED, sw-addrmethod=CODE, symbol=CODE
        WDG_CONFIG_DATA_16: alignment=16, sw-addrmethod=CONFIG_DATA, symbol=CONFIG_DATA_16
        WDG_CONFIG_DATA_32: alignment=32, sw-addrmethod=CONFIG_DATA, symbol=CONFIG_DATA_32
        WDG_CONFIG_DATA_UNSPECIFIED: alignment=UNSPECIFIED, sw-addrmethod=CONFIG_DATA, symbol=CONFIG_DATA_UNSPECIFIED
        WDG_CONST_UNSPECIFIED: alignment=UNSPECIFIED, sw-addrmethod=CONST, symbol=CONST_UNSPECIFIED
        WDG_RAMCODE: alignment=UNSPECIFIED, sw-addrmethod=RAMCODE, symbol=RAMCODE
        WDG_VAR_CLEARED_32: alignment=32, sw-addrmethod=VAR_CLEARED, symbol=VAR_CLEARED_32
        WDG_VAR_CLEARED_UNSPECIFIED: alignment=UNSPECIFIED, sw-addrmethod=VAR_CLEARED, symbol=VAR_CLEARED_UNSPECIFIED
        WDG_VAR_INIT_UNSPECIFIED: alignment=UNSPECIFIED, sw-addrmethod=VAR_INIT, symbol=VAR_INIT_UNSPECIFIED
