AUTOSAR XML (schema 00046)
package /AUTOSAR_Rm/BswModuleDescriptions
  bsw module description Rm: module-id=255
    provided-entrys:
      Rm_GetVersionInfo
      Rm_Init
      Rm_Mpu_M7_EnableRegion
      Rm_Mpu_M7_GetErrorDetails
      Rm_Mpu_M7_SetAccessRight
      Rm_Mpu_M7_SetRegionConfig
      Rm_SemaphoreGetStatus
      Rm_SemaphoreLockGate
      Rm_SemaphoreResetAllGates
      Rm_SemaphoreResetGate
      Rm_SemaphoreUnlockGate
      Rm_XbicEnableMasterFeedbackCheck
      Rm_XbicEnableSlaveEDCCheck
      Rm_XbicErrorInjection
      Rm_XbicErrorInjectionDisable
      Rm_XbicFeedbackCheckAndEDCCheckDisable
      Rm_XbicGetErrorStatus
      Rm_XrdcGetDomainID
      Rm_XrdcGetDomainIDErrorStatus
      Rm_XrdcInstanceInit
      Rm_XrdcSetProcessID
    bsw internal behavior InternalBehavior_0
      5 x exclusive area:
        RM_EXCLUSIVE_AREA_{00..04}
      21 x bsw called entity:
        Rm_GetVersionInfo: implemented-entry=Rm_GetVersionInfo
        Rm_Init: implemented-entry=Rm_Init
        Rm_Mpu_M7_EnableRegion: implemented-entry=Rm_Mpu_M7_EnableRegion
        Rm_Mpu_M7_GetErrorDetails: implemented-entry=Rm_Mpu_M7_GetErrorDetails
        Rm_Mpu_M7_SetAccessRight: implemented-entry=Rm_Mpu_M7_SetAccessRight
        Rm_Mpu_M7_SetRegionConfig: implemented-entry=Rm_Mpu_M7_SetRegionConfig
        Rm_SemaphoreGetStatus: implemented-entry=Rm_SemaphoreGetStatus
        Rm_SemaphoreLockGate: implemented-entry=Rm_SemaphoreLockGate
        Rm_SemaphoreResetAllGates: implemented-entry=Rm_SemaphoreResetAllGates
        Rm_SemaphoreResetGate: implemented-entry=Rm_SemaphoreResetGate
        Rm_SemaphoreUnlockGate: implemented-entry=Rm_SemaphoreUnlockGate
        Rm_XbicEnableMasterFeedbackCheck: can-enter-exclusive-area=RM_EXCLUSIVE_AREA_01, implemented-entry=Rm_XbicEnableMasterFeedbackCheck
        Rm_XbicEnableSlaveEDCCheck: can-enter-exclusive-area=RM_EXCLUSIVE_AREA_02, implemented-entry=Rm_XbicEnableSlaveEDCCheck
        Rm_XbicErrorInjection: can-enter-exclusive-area=RM_EXCLUSIVE_AREA_03, implemented-entry=Rm_XbicErrorInjection
        Rm_XbicErrorInjectionDisable: can-enter-exclusive-area=RM_EXCLUSIVE_AREA_04, implemented-entry=Rm_XbicErrorInjectionDisable
        Rm_XbicFeedbackCheckAndEDCCheckDisable: implemented-entry=Rm_XbicFeedbackCheckAndEDCCheckDisable
        Rm_XbicGetErrorStatus: implemented-entry=Rm_XbicGetErrorStatus
        Rm_XrdcGetDomainID: implemented-entry=Rm_XrdcGetDomainID
        Rm_XrdcGetDomainIDErrorStatus: implemented-entry=Rm_XrdcGetDomainIDErrorStatus
        Rm_XrdcInstanceInit: implemented-entry=Rm_XrdcInstanceInit
        Rm_XrdcSetProcessID: can-enter-exclusive-area=RM_EXCLUSIVE_AREA_00, implemented-entry=Rm_XrdcSetProcessID
package /AUTOSAR_Rm/BswModuleEntrys
  21 x bsw module entry, all with is-synchronous=true, call-type=REGULAR, execution-context=UNSPECIFIED, sw-service-impl-policy=STANDARD:
    Rm_GetVersionInfo: service-id=0x01, is-reentrant=true
    Rm_Init: service-id=0x00, is-reentrant=false
    Rm_Mpu_M7_EnableRegion: service-id=0x0a, is-reentrant=false
    Rm_Mpu_M7_GetErrorDetails: service-id=0x0c, is-reentrant=false
    Rm_Mpu_M7_SetAccessRight: service-id=0x0b, is-reentrant=false
    Rm_Mpu_M7_SetRegionConfig: service-id=0x09, is-reentrant=false
    Rm_SemaphoreGetStatus: service-id=0x08, is-reentrant=false
    Rm_SemaphoreLockGate: service-id=0x04, is-reentrant=false
    Rm_SemaphoreResetAllGates: service-id=0x07, is-reentrant=false
    Rm_SemaphoreResetGate: service-id=0x06, is-reentrant=false
    Rm_SemaphoreUnlockGate: service-id=0x05, is-reentrant=false
    Rm_XbicEnableMasterFeedbackCheck: service-id=0x1c, is-reentrant=true
    Rm_XbicEnableSlaveEDCCheck: service-id=0x1d, is-reentrant=true
    Rm_XbicErrorInjection: service-id=0x15, is-reentrant=true
    Rm_XbicErrorInjectionDisable: service-id=0x16, is-reentrant=true
    Rm_XbicFeedbackCheckAndEDCCheckDisable: service-id=0x13, is-reentrant=false
    Rm_XbicGetErrorStatus: service-id=0x14, is-reentrant=false
    Rm_XrdcGetDomainID: service-id=0x03, is-reentrant=false
    Rm_XrdcGetDomainIDErrorStatus: service-id=0x12, is-reentrant=false
    Rm_XrdcInstanceInit: service-id=0x1b, is-reentrant=false
    Rm_XrdcSetProcessID: service-id=0x02, is-reentrant=true
package /Rm_TS_T40D34M20I1R0/Implementations
  bsw implementation BswImplementation_0: programming-language=C, sw-version=2.0.1, vendor-id=43, ar-release-version=4.4.0, behavior=InternalBehavior_0, vendor-specific-module-def=Rm
    code-descriptors:
      code Files
        artifact-descriptors:
          short-label=config::Rm.xdm, category=SWCFG
          short-label=doc::RTD_RM_IM.pdf, category=SWDOC
          short-label=doc::RTD_RM_UM.pdf, category=SWDOC
          short-label=examples::EBT::Rm_Example_S32K312::generate::epc::Base.xdm, category=SWCFG
          short-label=examples::EBT::Rm_Example_S32K312::generate::epc::Resource.xdm, category=SWCFG
          short-label=examples::EBT::Rm_Example_S32K312::generate::epc::Rm.xdm, category=SWCFG
          short-label=examples::EBT::Rm_Example_S32K312::include::check_example.h, category=SWHDR
          short-label=examples::EBT::Rm_Example_S32K312::src::main.c, category=SWSRC
          short-label=examples::EBT::Rm_Example_S32K312::TresosProject::Rm_Example_S32K312::.prefs::preferences.xdm, category=SWCFG
          short-label=examples::EBT::Rm_Example_S32K312::TresosProject::Rm_Example_S32K312::config::Base.xdm, category=SWCFG
          short-label=examples::EBT::Rm_Example_S32K312::TresosProject::Rm_Example_S32K312::config::EcuC.xdm, category=SWCFG
          short-label=examples::EBT::Rm_Example_S32K312::TresosProject::Rm_Example_S32K312::config::Resource.xdm, category=SWCFG
          short-label=examples::EBT::Rm_Example_S32K312::TresosProject::Rm_Example_S32K312::config::Rm.xdm, category=SWCFG
          short-label=examples::EBT::Rm_Example_S32K342::generate::epc::Base.xdm, category=SWCFG
          short-label=examples::EBT::Rm_Example_S32K342::generate::epc::Resource.xdm, category=SWCFG
          short-label=examples::EBT::Rm_Example_S32K342::generate::epc::Rm.xdm, category=SWCFG
          short-label=examples::EBT::Rm_Example_S32K342::include::check_example.h, category=SWHDR
          short-label=examples::EBT::Rm_Example_S32K342::src::main.c, category=SWSRC
          short-label=examples::EBT::Rm_Example_S32K342::TresosProject::Rm_Example_S32K342::.prefs::preferences.xdm, category=SWCFG
          short-label=examples::EBT::Rm_Example_S32K342::TresosProject::Rm_Example_S32K342::config::Base.xdm, category=SWCFG
          short-label=examples::EBT::Rm_Example_S32K342::TresosProject::Rm_Example_S32K342::config::EcuC.xdm, category=SWCFG
          short-label=examples::EBT::Rm_Example_S32K342::TresosProject::Rm_Example_S32K342::config::Resource.xdm, category=SWCFG
          short-label=examples::EBT::Rm_Example_S32K342::TresosProject::Rm_Example_S32K342::config::Rm.xdm, category=SWCFG
          short-label=examples::EBT::Rm_Example_S32K344::generate::epc::Base.xdm, category=SWCFG
          short-label=examples::EBT::Rm_Example_S32K344::generate::epc::Resource.xdm, category=SWCFG
          short-label=examples::EBT::Rm_Example_S32K344::generate::epc::Rm.xdm, category=SWCFG
          short-label=examples::EBT::Rm_Example_S32K344::include::check_example.h, category=SWHDR
          short-label=examples::EBT::Rm_Example_S32K344::src::main.c, category=SWSRC
          short-label=examples::EBT::Rm_Example_S32K344::TresosProject::Rm_Example_S32K344::.prefs::preferences.xdm, category=SWCFG
          short-label=examples::EBT::Rm_Example_S32K344::TresosProject::Rm_Example_S32K344::config::Base.xdm, category=SWCFG
          short-label=examples::EBT::Rm_Example_S32K344::TresosProject::Rm_Example_S32K344::config::EcuC.xdm, category=SWCFG
          short-label=examples::EBT::Rm_Example_S32K344::TresosProject::Rm_Example_S32K344::config::Resource.xdm, category=SWCFG
          short-label=examples::EBT::Rm_Example_S32K344::TresosProject::Rm_Example_S32K344::config::Rm.xdm, category=SWCFG
          short-label=examples::EBT::Rm_Semaphore_Example_S32K342::generate::epc::Base.xdm, category=SWCFG
          short-label=examples::EBT::Rm_Semaphore_Example_S32K342::generate::epc::Mcl.xdm, category=SWCFG
          short-label=examples::EBT::Rm_Semaphore_Example_S32K342::generate::epc::Resource.xdm, category=SWCFG
          short-label=examples::EBT::Rm_Semaphore_Example_S32K342::generate::epc::Rm.xdm, category=SWCFG
          short-label=examples::EBT::Rm_Semaphore_Example_S32K342::include::check_example.h, category=SWHDR
          short-label=examples::EBT::Rm_Semaphore_Example_S32K342::src::main.c, category=SWSRC
          short-label=examples::EBT::Rm_Semaphore_Example_S32K342::TresosProject::Rm_Semaphore_Example_S32K342::.prefs::preferences.xdm, category=SWCFG
          short-label=examples::EBT::Rm_Semaphore_Example_S32K342::TresosProject::Rm_Semaphore_Example_S32K342::config::Base.xdm, category=SWCFG
          short-label=examples::EBT::Rm_Semaphore_Example_S32K342::TresosProject::Rm_Semaphore_Example_S32K342::config::EcuC.xdm, category=SWCFG
          short-label=examples::EBT::Rm_Semaphore_Example_S32K342::TresosProject::Rm_Semaphore_Example_S32K342::config::Mcl.xdm, category=SWCFG
          short-label=examples::EBT::Rm_Semaphore_Example_S32K342::TresosProject::Rm_Semaphore_Example_S32K342::config::Resource.xdm, category=SWCFG
          short-label=examples::EBT::Rm_Semaphore_Example_S32K342::TresosProject::Rm_Semaphore_Example_S32K342::config::Rm.xdm, category=SWCFG
          short-label=examples::EBT::Rm_Semaphore_Example_S32K344::generate::epc::Base.xdm, category=SWCFG
          short-label=examples::EBT::Rm_Semaphore_Example_S32K344::generate::epc::Mcl.xdm, category=SWCFG
          short-label=examples::EBT::Rm_Semaphore_Example_S32K344::generate::epc::Resource.xdm, category=SWCFG
          short-label=examples::EBT::Rm_Semaphore_Example_S32K344::generate::epc::Rm.xdm, category=SWCFG
          short-label=examples::EBT::Rm_Semaphore_Example_S32K344::include::check_example.h, category=SWHDR
          short-label=examples::EBT::Rm_Semaphore_Example_S32K344::src::main.c, category=SWSRC
          short-label=examples::EBT::Rm_Semaphore_Example_S32K344::TresosProject::Rm_Semaphore_Example_S32K344::.prefs::preferences.xdm, category=SWCFG
          short-label=examples::EBT::Rm_Semaphore_Example_S32K344::TresosProject::Rm_Semaphore_Example_S32K344::config::Base.xdm, category=SWCFG
          short-label=examples::EBT::Rm_Semaphore_Example_S32K344::TresosProject::Rm_Semaphore_Example_S32K344::config::EcuC.xdm, category=SWCFG
          short-label=examples::EBT::Rm_Semaphore_Example_S32K344::TresosProject::Rm_Semaphore_Example_S32K344::config::Mcl.xdm, category=SWCFG
          short-label=examples::EBT::Rm_Semaphore_Example_S32K344::TresosProject::Rm_Semaphore_Example_S32K344::config::Resource.xdm, category=SWCFG
          short-label=examples::EBT::Rm_Semaphore_Example_S32K344::TresosProject::Rm_Semaphore_Example_S32K344::config::Rm.xdm, category=SWCFG
          short-label=examples::S32DS::Mpu_Ip_Example_S32K312::include::check_example.h, category=SWHDR
          short-label=examples::S32DS::Mpu_Ip_Example_S32K312::Project_Settings::Startup_Code::exceptions.c, category=SWSRC
          short-label=examples::S32DS::Mpu_Ip_Example_S32K312::Project_Settings::Startup_Code::nvic.c, category=SWSRC
          short-label=examples::S32DS::Mpu_Ip_Example_S32K312::Project_Settings::Startup_Code::startup.c, category=SWSRC
          short-label=examples::S32DS::Mpu_Ip_Example_S32K312::Project_Settings::Startup_Code::system.c, category=SWSRC
          short-label=examples::S32DS::Mpu_Ip_Example_S32K312::src::main.c, category=SWSRC
          short-label=examples::S32DS::Mpu_Ip_Example_S32K344::include::check_example.h, category=SWHDR
          short-label=examples::S32DS::Mpu_Ip_Example_S32K344::Project_Settings::Startup_Code::exceptions.c, category=SWSRC
          short-label=examples::S32DS::Mpu_Ip_Example_S32K344::Project_Settings::Startup_Code::nvic.c, category=SWSRC
          short-label=examples::S32DS::Mpu_Ip_Example_S32K344::Project_Settings::Startup_Code::startup.c, category=SWSRC
          short-label=examples::S32DS::Mpu_Ip_Example_S32K344::Project_Settings::Startup_Code::system.c, category=SWSRC
          short-label=examples::S32DS::Mpu_Ip_Example_S32K344::src::main.c, category=SWSRC
          short-label=examples::S32DS::Rm_Example_S32K312::include::check_example.h, category=SWHDR
          short-label=examples::S32DS::Rm_Example_S32K312::Project_Settings::Startup_Code::exceptions.c, category=SWSRC
          short-label=examples::S32DS::Rm_Example_S32K312::Project_Settings::Startup_Code::nvic.c, category=SWSRC
          short-label=examples::S32DS::Rm_Example_S32K312::Project_Settings::Startup_Code::startup.c, category=SWSRC
          short-label=examples::S32DS::Rm_Example_S32K312::Project_Settings::Startup_Code::system.c, category=SWSRC
          short-label=examples::S32DS::Rm_Example_S32K312::src::main.c, category=SWSRC
          short-label=examples::S32DS::Rm_Example_S32K342::include::check_example.h, category=SWHDR
          short-label=examples::S32DS::Rm_Example_S32K342::Project_Settings::Startup_Code::exceptions.c, category=SWSRC
          short-label=examples::S32DS::Rm_Example_S32K342::Project_Settings::Startup_Code::nvic.c, category=SWSRC
          short-label=examples::S32DS::Rm_Example_S32K342::Project_Settings::Startup_Code::startup.c, category=SWSRC
          short-label=examples::S32DS::Rm_Example_S32K342::Project_Settings::Startup_Code::system.c, category=SWSRC
          short-label=examples::S32DS::Rm_Example_S32K342::src::main.c, category=SWSRC
          short-label=examples::S32DS::Rm_Example_S32K344::include::check_example.h, category=SWHDR
          short-label=examples::S32DS::Rm_Example_S32K344::Project_Settings::Startup_Code::exceptions.c, category=SWSRC
          short-label=examples::S32DS::Rm_Example_S32K344::Project_Settings::Startup_Code::nvic.c, category=SWSRC
          short-label=examples::S32DS::Rm_Example_S32K344::Project_Settings::Startup_Code::startup.c, category=SWSRC
          short-label=examples::S32DS::Rm_Example_S32K344::Project_Settings::Startup_Code::system.c, category=SWSRC
          short-label=examples::S32DS::Rm_Example_S32K344::src::main.c, category=SWSRC
          short-label=examples::S32DS::Rm_Semaphore_Example_S32K342::include::check_example.h, category=SWHDR
          short-label=examples::S32DS::Rm_Semaphore_Example_S32K342::Project_Settings::Startup_Code::exceptions.c, category=SWSRC
          short-label=examples::S32DS::Rm_Semaphore_Example_S32K342::Project_Settings::Startup_Code::nvic.c, category=SWSRC
          short-label=examples::S32DS::Rm_Semaphore_Example_S32K342::Project_Settings::Startup_Code::startup.c, category=SWSRC
          short-label=examples::S32DS::Rm_Semaphore_Example_S32K342::Project_Settings::Startup_Code::system.c, category=SWSRC
          short-label=examples::S32DS::Rm_Semaphore_Example_S32K342::src::main.c, category=SWSRC
          short-label=examples::S32DS::Rm_Semaphore_Example_S32K342::src::sys_init.c, category=SWSRC
          short-label=examples::S32DS::Rm_Semaphore_Example_S32K344::include::check_example.h, category=SWHDR
          short-label=examples::S32DS::Rm_Semaphore_Example_S32K344::Project_Settings::Startup_Code::exceptions.c, category=SWSRC
          short-label=examples::S32DS::Rm_Semaphore_Example_S32K344::Project_Settings::Startup_Code::nvic.c, category=SWSRC
          short-label=examples::S32DS::Rm_Semaphore_Example_S32K344::Project_Settings::Startup_Code::startup.c, category=SWSRC
          short-label=examples::S32DS::Rm_Semaphore_Example_S32K344::Project_Settings::Startup_Code::system.c, category=SWSRC
          short-label=examples::S32DS::Rm_Semaphore_Example_S32K344::src::main.c, category=SWSRC
          short-label=examples::S32DS::Rm_Semaphore_Example_S32K344::src::sys_init.c, category=SWSRC
          short-label=examples::S32DS::Xrdc_Ip_Example_S32K312::include::check_example.h, category=SWHDR
          short-label=examples::S32DS::Xrdc_Ip_Example_S32K312::Project_Settings::Startup_Code::exceptions.c, category=SWSRC
          short-label=examples::S32DS::Xrdc_Ip_Example_S32K312::Project_Settings::Startup_Code::nvic.c, category=SWSRC
          short-label=examples::S32DS::Xrdc_Ip_Example_S32K312::Project_Settings::Startup_Code::startup.c, category=SWSRC
          short-label=examples::S32DS::Xrdc_Ip_Example_S32K312::Project_Settings::Startup_Code::system.c, category=SWSRC
          short-label=examples::S32DS::Xrdc_Ip_Example_S32K312::src::main.c, category=SWSRC
          short-label=examples::S32DS::Xrdc_Ip_Example_S32K344::include::check_example.h, category=SWHDR
          short-label=examples::S32DS::Xrdc_Ip_Example_S32K344::Project_Settings::Startup_Code::exceptions.c, category=SWSRC
          short-label=examples::S32DS::Xrdc_Ip_Example_S32K344::Project_Settings::Startup_Code::nvic.c, category=SWSRC
          short-label=examples::S32DS::Xrdc_Ip_Example_S32K344::Project_Settings::Startup_Code::startup.c, category=SWSRC
          short-label=examples::S32DS::Xrdc_Ip_Example_S32K344::Project_Settings::Startup_Code::system.c, category=SWSRC
          short-label=examples::S32DS::Xrdc_Ip_Example_S32K344::src::main.c, category=SWSRC
          short-label=include::Axbs_Ip.h, category=SWHDR
          short-label=include::Axbs_Ip_Device_Registers.h, category=SWHDR
          short-label=include::Axbs_Ip_TrustedFunctions.h, category=SWHDR
          short-label=include::Axbs_Ip_Types.h, category=SWHDR
          short-label=include::CDD_Rm.h, category=SWHDR
          short-label=include::CDD_Rm_Ipw.h, category=SWHDR
          short-label=include::Mpu_M7_Ip.h, category=SWHDR
          short-label=include::Mpu_M7_Ip_DeviceRegisters.h, category=SWHDR
          short-label=include::Mpu_M7_Ip_TrustedFunctions.h, category=SWHDR
          short-label=include::Mpu_M7_Ip_Types.h, category=SWHDR
          short-label=include::Pflash_Ip.h, category=SWHDR
          short-label=include::Pflash_Ip_Device_Registers.h, category=SWHDR
          short-label=include::Pflash_Ip_TrustedFunctions.h, category=SWHDR
          short-label=include::Pflash_Ip_Types.h, category=SWHDR
          short-label=include::Sema42_Ip.h, category=SWHDR
          short-label=include::Sema42_Ip_DeviceRegisters.h, category=SWHDR
          short-label=include::Sema42_Ip_TrustedFunctions.h, category=SWHDR
          short-label=include::Sema42_Ip_Types.h, category=SWHDR
          short-label=include::Virt_Wrapper_Ip.h, category=SWHDR
          short-label=include::Virt_Wrapper_Ip_Device_Registers.h, category=SWHDR
          short-label=include::Virt_Wrapper_Ip_TrustedFunctions.h, category=SWHDR
          short-label=include::Virt_Wrapper_Ip_Types.h, category=SWHDR
          short-label=include::Xbic_Ip.h, category=SWHDR
          short-label=include::Xbic_Ip_Device_Registers.h, category=SWHDR
          short-label=include::Xbic_Ip_TrustedFunctions.h, category=SWHDR
          short-label=include::Xbic_Ip_Types.h, category=SWHDR
          short-label=include::Xrdc_Ip.h, category=SWHDR
          short-label=include::Xrdc_Ip_Device_Registers.h, category=SWHDR
          short-label=include::Xrdc_Ip_TrustedFunctions.h, category=SWHDR
          short-label=include::Xrdc_Ip_Types.h, category=SWHDR
          short-label=src::Axbs_Ip.c, category=SWSRC
          short-label=src::CDD_Rm.c, category=SWSRC
          short-label=src::CDD_Rm_Ipw.c, category=SWSRC
          short-label=src::Mpu_M7_Ip.c, category=SWSRC
          short-label=src::Pflash_Ip.c, category=SWSRC
          short-label=src::Sema42_Ip.c, category=SWSRC
          short-label=src::Virt_Wrapper_Ip.c, category=SWSRC
          short-label=src::Xbic_Ip.c, category=SWSRC
          short-label=src::Xrdc_Ip.c, category=SWSRC
    compiler GCC_Compiler:
      name=GCC Compiler
      options=-mcpu=cortex-m7 -mthumb -mlittle-endian -mfpu=fpv5-sp-d16 -mfloat-abi=hard -std=c99 -Os -ggdb3 -Wall -Wextra -pedantic -Wstrict-prototypes -Wundef -Wunused -Werror=implicit-function-declaration -Wsign-compare -Wdouble-promotion -fno-short-enums -funsigned-char -funsigned-bitfields -fomit-frame-pointer -fno-common -fstack-usage -fdump-ipa-all -c -DS32K3XX -DS32K344 -DGCC -DUSE_SW_VECTOR_MODE -DD_CACHE_ENABLE -DI_CACHE_ENABLE -DENABLE_FPU -DMCAL_ENABLE_USER_MODE_SUPPORT
      vendor=GCC Systems
      version=NXP GCC 10.2.0 20200723 (Build 1728 Revision g5963bc8)
    compiler GHS_Compiler:
      name=Green Hills
      options=-cpu=cortexm7 -thumb -fpu=vfpv5_d16 -fsingle -C99 --ghstd=last -Osize --gnu_asm -dual_debug -G -keeptempfiles -Wimplicit-int -Wshadow -Wtrigraphs -Wundef --unsigned_chars --unsigned_fields --no_commons --no_exceptions --no_slash_comment --prototype_errors --incorrect_pragma_warnings -c -DS32K3XX -DS32K344 -DGHS -DUSE_SW_VECTOR_MODE -DD_CACHE_ENABLE -DI_CACHE_ENABLE -DENABLE_FPU -DMCAL_ENABLE_USER_MODE_SUPPORT
      vendor=Green Hills
      version=Green Hills Multi 7.1.6d / Compiler 2021.1.4
    compiler IAR_Compiler:
      name=IAR Compiler
      options=--cpu=Cortex-M7 --cpu_mode=thumb --endian=little --fpu=FPv5-SP -e -Ohz --debug --no_clustering --no_mem_idioms --do_explicit_zero_opt_in_named_sections --require_prototypes --no_wrap_diagnostics --diag_suppress=Pa050 -DS32K3XX -DS32K344 -DIAR -DUSE_SW_VECTOR_MODE -DD_CACHE_ENABLE -DI_CACHE_ENABLE -DENABLE_FPU -DMCAL_ENABLE_USER_MODE_SUPPORT
      vendor=IAR Systems
      version=IAR ANSI C/C++ Compiler v.8.50.10 (safety version)
    generated-artifacts:
      33 x dependency on artifact:
        Axbs_Ip_PBcfg_h: artifact-descriptor={short-label=generate_PB::include::Axbs_Ip_PBcfg.h, category=SWHDR}, usages=EXECUTE
        CDD_Rm_Ipw_PBcfg_h: artifact-descriptor={short-label=generate_PB::include::CDD_Rm_Ipw_PBcfg.h, category=SWHDR}, usages=EXECUTE
        CDD_Rm_PBcfg_h: artifact-descriptor={short-label=generate_PB::include::CDD_Rm_PBcfg.h, category=SWHDR}, usages=EXECUTE
        Pflash_Ip_PBcfg_h: artifact-descriptor={short-label=generate_PB::include::Pflash_Ip_PBcfg.h, category=SWHDR}, usages=EXECUTE
        Virt_Wrapper_Ip_PBcfg_h: artifact-descriptor={short-label=generate_PB::include::Virt_Wrapper_Ip_PBcfg.h, category=SWHDR}, usages=EXECUTE
        Xbic_Ip_PBcfg_h: artifact-descriptor={short-label=generate_PB::include::Xbic_Ip_PBcfg.h, category=SWHDR}, usages=EXECUTE
        Xrdc_Ip_PBcfg_h: artifact-descriptor={short-label=generate_PB::include::Xrdc_Ip_PBcfg.h, category=SWHDR}, usages=EXECUTE
        Axbs_Ip_PBcfg_c: artifact-descriptor={short-label=generate_PB::src::Axbs_Ip_PBcfg.c, category=SWSRC}, usages=EXECUTE
        CDD_Rm_Ipw_PBcfg_c: artifact-descriptor={short-label=generate_PB::src::CDD_Rm_Ipw_PBcfg.c, category=SWSRC}, usages=EXECUTE
        CDD_Rm_PBcfg_c: artifact-descriptor={short-label=generate_PB::src::CDD_Rm_PBcfg.c, category=SWSRC}, usages=EXECUTE
        Pflash_Ip_PBcfg_c: artifact-descriptor={short-label=generate_PB::src::Pflash_Ip_PBcfg.c, category=SWSRC}, usages=EXECUTE
        Virt_Wrapper_Ip_PBcfg_c: artifact-descriptor={short-label=generate_PB::src::Virt_Wrapper_Ip_PBcfg.c, category=SWSRC}, usages=EXECUTE
        Xbic_Ip_PBcfg_c: artifact-descriptor={short-label=generate_PB::src::Xbic_Ip_PBcfg.c, category=SWSRC}, usages=EXECUTE
        Xrdc_Ip_PBcfg_c: artifact-descriptor={short-label=generate_PB::src::Xrdc_Ip_PBcfg.c, category=SWSRC}, usages=EXECUTE
        Axbs_Ip_Cfg_h: artifact-descriptor={short-label=generate_PC::include::Axbs_Ip_Cfg.h, category=SWHDR}, usages=COMPILE
        Axbs_Ip_Cfg_Defines_h: artifact-descriptor={short-label=generate_PC::include::Axbs_Ip_Cfg_Defines.h, category=SWHDR}, usages=COMPILE
        CDD_Rm_Cfg_h: artifact-descriptor={short-label=generate_PC::include::CDD_Rm_Cfg.h, category=SWHDR}, usages=COMPILE
        CDD_Rm_Ipw_Cfg_h: artifact-descriptor={short-label=generate_PC::include::CDD_Rm_Ipw_Cfg.h, category=SWHDR}, usages=COMPILE
        Mpu_M7_Ip_Cfg_h: artifact-descriptor={short-label=generate_PC::include::Mpu_M7_Ip_Cfg.h, category=SWHDR}, usages=COMPILE
        Mpu_M7_Ip_Cfg_Defines_h: artifact-descriptor={short-label=generate_PC::include::Mpu_M7_Ip_Cfg_Defines.h, category=SWHDR}, usages=COMPILE
        Pflash_Ip_Cfg_h: artifact-descriptor={short-label=generate_PC::include::Pflash_Ip_Cfg.h, category=SWHDR}, usages=COMPILE
        Pflash_Ip_Cfg_Defines_h: artifact-descriptor={short-label=generate_PC::include::Pflash_Ip_Cfg_Defines.h, category=SWHDR}, usages=COMPILE
        Sema42_Ip_Cfg_Defines_h: artifact-descriptor={short-label=generate_PC::include::Sema42_Ip_Cfg_Defines.h, category=SWHDR}, usages=COMPILE
        Virt_Wrapper_Ip_Cfg_h: artifact-descriptor={short-label=generate_PC::include::Virt_Wrapper_Ip_Cfg.h, category=SWHDR}, usages=COMPILE
        Virt_Wrapper_Ip_Cfg_Defines_h: artifact-descriptor={short-label=generate_PC::include::Virt_Wrapper_Ip_Cfg_Defines.h, category=SWHDR}, usages=COMPILE
        Xbic_Ip_Cfg_h: artifact-descriptor={short-label=generate_PC::include::Xbic_Ip_Cfg.h, category=SWHDR}, usages=COMPILE
        Xbic_Ip_Cfg_Defines_h: artifact-descriptor={short-label=generate_PC::include::Xbic_Ip_Cfg_Defines.h, category=SWHDR}, usages=COMPILE
        Xrdc_Ip_Cfg_h: artifact-descriptor={short-label=generate_PC::include::Xrdc_Ip_Cfg.h, category=SWHDR}, usages=COMPILE
        Xrdc_Ip_Cfg_Defines_h: artifact-descriptor={short-label=generate_PC::include::Xrdc_Ip_Cfg_Defines.h, category=SWHDR}, usages=COMPILE
        CDD_Rm_Cfg_c: artifact-descriptor={short-label=generate_PC::src::CDD_Rm_Cfg.c, category=SWSRC}, usages=COMPILE
        Mpu_M7_Ip_Cfg_c: artifact-descriptor={short-label=generate_PC::src::Mpu_M7_Ip_Cfg.c, category=SWSRC}, usages=COMPILE
        Pflash_Ip_Cfg_c: artifact-descriptor={short-label=generate_PC::src::Pflash_Ip_Cfg.c, category=SWSRC}, usages=COMPILE
        Xrdc_Ip_Cfg_c: artifact-descriptor={short-label=generate_PC::src::Xrdc_Ip_Cfg.c, category=SWSRC}, usages=COMPILE
    linker GCC_Linker: name=GCC Compiler, options=-Wl,-Map,filename -T linkerfile --entry=Reset_Handler -nostartfiles -mcpu=cortexm7 -mthumb -mfpu=fpv5-sp-d16 -mfloat-abi=hard -mlittle-endian -ggdb3 -lc -lm -lgcc, vendor=GCC Systems, version=NXP GCC 10.2.0 20200723 (Build 1728 Revision g5963bc8)
    linker GHS_Linker: name=Green Hills, options=-e Reset_Handler -T linker_script_file.ld -map -keepmap -Mn -delete -ignore_debug_references -Llibrary_path -larch -lstartup -lind_sd -v -keep=C40_Ip_AccessCode -nostartfiles, vendor=Green Hills, version=Green Hills Multi 7.1.6d / Compiler 2021.1.4
    linker IAR_Linker: name=IAR Compiler, options=--map filename --config linkerfile --cpu=Cortex-M7 --fpu=FPv5-SP --entry _start --enable_stack_usage --skip_dynamic_initialization --no_wrap_diagnostics, vendor=IAR Systems, version=IAR ANSI C/C++ Compiler v.8.50.10 (safety version)
    resource consumption ResourceConsumption
      7 x memory section:
        RM_CODE: alignment=UNSPECIFIED, sw-addrmethod=CODE, symbol=CODE
        RM_CONFIG_DATA_UNSPECIFIED: alignment=UNSPECIFIED, sw-addrmethod=CONFIG_DATA, symbol=CONFIG_DATA_UNSPECIFIED
        RM_CONFIG_DATA_UNSPECIFIED_NO_CACHEABLE: alignment=UNSPECIFIED, sw-addrmethod=CONFIG_DATA_UNSPECIFIED_NO, symbol=CONFIG_DATA_UNSPECIFIED_NO_CACHEABLE
        RM_CONST_16: alignment=16, sw-addrmethod=CONST, symbol=CONST_16
        RM_CONST_32: alignment=32, sw-addrmethod=CONST, symbol=CONST_32
        RM_CONST_8: alignment=8, sw-addrmethod=CONST, symbol=CONST_8
        RM_VAR_CLEARED_UNSPECIFIED: alignment=UNSPECIFIED, sw-addrmethod=VAR_CLEARED, symbol=VAR_CLEARED_UNSPECIFIED
