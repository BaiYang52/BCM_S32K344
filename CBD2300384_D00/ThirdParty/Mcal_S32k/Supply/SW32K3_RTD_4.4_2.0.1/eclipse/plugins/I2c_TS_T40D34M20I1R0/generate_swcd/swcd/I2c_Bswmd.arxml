AUTOSAR XML (schema 00046)
package /AUTOSAR_I2c/BswModuleDescriptions
  bsw module description I2c: module-id=255
    provided-entrys:
      I2c_AsyncTransmit
      I2c_DeInit
      I2c_GetStatus
      I2c_GetVersionInfo
      I2c_Init
      I2c_PrepareSlaveBuffer
      I2c_StartListening
      I2c_SyncTransmit
      LPI2C0_Master_IRQHandler
      LPI2C0_Master_Slave_IRQHandler
      LPI2C0_Slave_IRQHandler
      LPI2C1_Master_IRQHandler
      LPI2C1_Master_Slave_IRQHandler
      LPI2C1_Slave_IRQHandler
    bsw internal behavior InternalBehavior_0
      exclusive area I2C_EXCLUSIVE_AREA_00
      exclusive area I2C_EXCLUSIVE_AREA_01
      8 x bsw called entity:
        I2c_AsyncTransmit: can-enter-exclusive-area=I2C_EXCLUSIVE_AREA_01, implemented-entry=I2c_AsyncTransmit
        I2c_DeInit: implemented-entry=I2c_DeInit
        I2c_GetStatus: implemented-entry=I2c_GetStatus
        I2c_GetVersionInfo: implemented-entry=I2c_GetVersionInfo
        I2c_Init: implemented-entry=I2c_Init
        I2c_PrepareSlaveBuffer: implemented-entry=I2c_PrepareSlaveBuffer
        I2c_StartListening: implemented-entry=I2c_StartListening
        I2c_SyncTransmit: can-enter-exclusive-area=I2C_EXCLUSIVE_AREA_00, implemented-entry=I2c_SyncTransmit
      6 x bsw interrupt entity, all with interrupt-category=CAT-2, interrupt-source=Hardware:
        LPI2C0_Master_IRQHandler: implemented-entry=LPI2C0_Master_IRQHandler
        LPI2C0_Master_Slave_IRQHandler: implemented-entry=LPI2C0_Master_Slave_IRQHandler
        LPI2C0_Slave_IRQHandler: implemented-entry=LPI2C0_Slave_IRQHandler
        LPI2C1_Master_IRQHandler: implemented-entry=LPI2C1_Master_IRQHandler
        LPI2C1_Master_Slave_IRQHandler: implemented-entry=LPI2C1_Master_Slave_IRQHandler
        LPI2C1_Slave_IRQHandler: implemented-entry=LPI2C1_Slave_IRQHandler
package /AUTOSAR_I2c/BswModuleEntrys
  14 x bsw module entry, all with sw-service-impl-policy=STANDARD:
    I2c_AsyncTransmit: service-id=0x03, is-reentrant=true, is-synchronous=true, call-type=REGULAR, execution-context=UNSPECIFIED
    I2c_DeInit: service-id=0x01, is-reentrant=false, is-synchronous=true, call-type=REGULAR, execution-context=UNSPECIFIED
    I2c_GetStatus: service-id=0x04, is-reentrant=true, is-synchronous=true, call-type=REGULAR, execution-context=UNSPECIFIED
    I2c_GetVersionInfo: service-id=0x0a, is-reentrant=true, is-synchronous=false, call-type=REGULAR, execution-context=UNSPECIFIED
    I2c_Init: service-id=0x00, is-reentrant=false, is-synchronous=true, call-type=REGULAR, execution-context=UNSPECIFIED
    I2c_PrepareSlaveBuffer: service-id=0x05, is-reentrant=true, is-synchronous=true, call-type=REGULAR, execution-context=UNSPECIFIED
    I2c_StartListening: service-id=0x06, is-reentrant=true, is-synchronous=true, call-type=REGULAR, execution-context=UNSPECIFIED
    I2c_SyncTransmit: service-id=0x02, is-reentrant=true, is-synchronous=true, call-type=REGULAR, execution-context=UNSPECIFIED
    LPI2C0_Master_IRQHandler: service-id=0, is-reentrant=false, is-synchronous=true, call-type=INTERRUPT, execution-context=INTERRUPT-CAT-2
    LPI2C0_Master_Slave_IRQHandler: service-id=0, is-reentrant=false, is-synchronous=true, call-type=INTERRUPT, execution-context=INTERRUPT-CAT-2
    LPI2C0_Slave_IRQHandler: service-id=0, is-reentrant=false, is-synchronous=true, call-type=INTERRUPT, execution-context=INTERRUPT-CAT-2
    LPI2C1_Master_IRQHandler: service-id=0, is-reentrant=false, is-synchronous=true, call-type=INTERRUPT, execution-context=INTERRUPT-CAT-2
    LPI2C1_Master_Slave_IRQHandler: service-id=0, is-reentrant=false, is-synchronous=true, call-type=INTERRUPT, execution-context=INTERRUPT-CAT-2
    LPI2C1_Slave_IRQHandler: service-id=0, is-reentrant=false, is-synchronous=true, call-type=INTERRUPT, execution-context=INTERRUPT-CAT-2
package /I2c_TS_T40D34M20I1R0/Implementations
  bsw implementation BswImplementation_0: programming-language=C, sw-version=2.0.1, vendor-id=43, ar-release-version=4.4.0, behavior=InternalBehavior_0, vendor-specific-module-def=I2c
    code-descriptors:
      code Files
        artifact-descriptors:
          short-label=config::I2c.xdm, category=SWCFG
          short-label=doc::RTD_I2C_IM.pdf, category=SWDOC
          short-label=doc::RTD_I2C_UM.pdf, category=SWDOC
          short-label=examples::EBT::I2c_HLD_FLEXIO_Transfer_S32K312::generate::epc::Base.xdm, category=SWCFG
          short-label=examples::EBT::I2c_HLD_FLEXIO_Transfer_S32K312::generate::epc::Dem.xdm, category=SWCFG
          short-label=examples::EBT::I2c_HLD_FLEXIO_Transfer_S32K312::generate::epc::EcuC.xdm, category=SWCFG
          short-label=examples::EBT::I2c_HLD_FLEXIO_Transfer_S32K312::generate::epc::I2c.xdm, category=SWCFG
          short-label=examples::EBT::I2c_HLD_FLEXIO_Transfer_S32K312::generate::epc::Mcl.xdm, category=SWCFG
          short-label=examples::EBT::I2c_HLD_FLEXIO_Transfer_S32K312::generate::epc::Mcu.xdm, category=SWCFG
          short-label=examples::EBT::I2c_HLD_FLEXIO_Transfer_S32K312::generate::epc::Os.xdm, category=SWCFG
          short-label=examples::EBT::I2c_HLD_FLEXIO_Transfer_S32K312::generate::epc::Platform.xdm, category=SWCFG
          short-label=examples::EBT::I2c_HLD_FLEXIO_Transfer_S32K312::generate::epc::Port.xdm, category=SWCFG
          short-label=examples::EBT::I2c_HLD_FLEXIO_Transfer_S32K312::generate::epc::Resource.xdm, category=SWCFG
          short-label=examples::EBT::I2c_HLD_FLEXIO_Transfer_S32K312::include::check_example.h, category=SWHDR
          short-label=examples::EBT::I2c_HLD_FLEXIO_Transfer_S32K312::src::main.c, category=SWSRC
          short-label=examples::EBT::I2c_HLD_FLEXIO_Transfer_S32K312::TresosProject::I2c_HLD_FLEXIO_Transfer_S32K312::.prefs::preferences.xdm, category=SWCFG
          short-label=examples::EBT::I2c_HLD_FLEXIO_Transfer_S32K312::TresosProject::I2c_HLD_FLEXIO_Transfer_S32K312::config::Base.xdm, category=SWCFG
          short-label=examples::EBT::I2c_HLD_FLEXIO_Transfer_S32K312::TresosProject::I2c_HLD_FLEXIO_Transfer_S32K312::config::Dem.xdm, category=SWCFG
          short-label=examples::EBT::I2c_HLD_FLEXIO_Transfer_S32K312::TresosProject::I2c_HLD_FLEXIO_Transfer_S32K312::config::EcuC.xdm, category=SWCFG
          short-label=examples::EBT::I2c_HLD_FLEXIO_Transfer_S32K312::TresosProject::I2c_HLD_FLEXIO_Transfer_S32K312::config::I2c.xdm, category=SWCFG
          short-label=examples::EBT::I2c_HLD_FLEXIO_Transfer_S32K312::TresosProject::I2c_HLD_FLEXIO_Transfer_S32K312::config::Mcl.xdm, category=SWCFG
          short-label=examples::EBT::I2c_HLD_FLEXIO_Transfer_S32K312::TresosProject::I2c_HLD_FLEXIO_Transfer_S32K312::config::Mcu.xdm, category=SWCFG
          short-label=examples::EBT::I2c_HLD_FLEXIO_Transfer_S32K312::TresosProject::I2c_HLD_FLEXIO_Transfer_S32K312::config::Os.xdm, category=SWCFG
          short-label=examples::EBT::I2c_HLD_FLEXIO_Transfer_S32K312::TresosProject::I2c_HLD_FLEXIO_Transfer_S32K312::config::Platform.xdm, category=SWCFG
          short-label=examples::EBT::I2c_HLD_FLEXIO_Transfer_S32K312::TresosProject::I2c_HLD_FLEXIO_Transfer_S32K312::config::Port.xdm, category=SWCFG
          short-label=examples::EBT::I2c_HLD_FLEXIO_Transfer_S32K312::TresosProject::I2c_HLD_FLEXIO_Transfer_S32K312::config::Resource.xdm, category=SWCFG
          short-label=examples::EBT::I2c_HLD_FLEXIO_Transfer_S32K342::generate::epc::Base.xdm, category=SWCFG
          short-label=examples::EBT::I2c_HLD_FLEXIO_Transfer_S32K342::generate::epc::Dem.xdm, category=SWCFG
          short-label=examples::EBT::I2c_HLD_FLEXIO_Transfer_S32K342::generate::epc::EcuC.xdm, category=SWCFG
          short-label=examples::EBT::I2c_HLD_FLEXIO_Transfer_S32K342::generate::epc::I2c.xdm, category=SWCFG
          short-label=examples::EBT::I2c_HLD_FLEXIO_Transfer_S32K342::generate::epc::Mcl.xdm, category=SWCFG
          short-label=examples::EBT::I2c_HLD_FLEXIO_Transfer_S32K342::generate::epc::Mcu.xdm, category=SWCFG
          short-label=examples::EBT::I2c_HLD_FLEXIO_Transfer_S32K342::generate::epc::Os.xdm, category=SWCFG
          short-label=examples::EBT::I2c_HLD_FLEXIO_Transfer_S32K342::generate::epc::Platform.xdm, category=SWCFG
          short-label=examples::EBT::I2c_HLD_FLEXIO_Transfer_S32K342::generate::epc::Port.xdm, category=SWCFG
          short-label=examples::EBT::I2c_HLD_FLEXIO_Transfer_S32K342::generate::epc::Resource.xdm, category=SWCFG
          short-label=examples::EBT::I2c_HLD_FLEXIO_Transfer_S32K342::include::check_example.h, category=SWHDR
          short-label=examples::EBT::I2c_HLD_FLEXIO_Transfer_S32K342::src::main.c, category=SWSRC
          short-label=examples::EBT::I2c_HLD_FLEXIO_Transfer_S32K342::TresosProject::I2c_HLD_FLEXIO_Transfer_S32K342::.prefs::preferences.xdm, category=SWCFG
          short-label=examples::EBT::I2c_HLD_FLEXIO_Transfer_S32K342::TresosProject::I2c_HLD_FLEXIO_Transfer_S32K342::config::Base.xdm, category=SWCFG
          short-label=examples::EBT::I2c_HLD_FLEXIO_Transfer_S32K342::TresosProject::I2c_HLD_FLEXIO_Transfer_S32K342::config::Dem.xdm, category=SWCFG
          short-label=examples::EBT::I2c_HLD_FLEXIO_Transfer_S32K342::TresosProject::I2c_HLD_FLEXIO_Transfer_S32K342::config::EcuC.xdm, category=SWCFG
          short-label=examples::EBT::I2c_HLD_FLEXIO_Transfer_S32K342::TresosProject::I2c_HLD_FLEXIO_Transfer_S32K342::config::I2c.xdm, category=SWCFG
          short-label=examples::EBT::I2c_HLD_FLEXIO_Transfer_S32K342::TresosProject::I2c_HLD_FLEXIO_Transfer_S32K342::config::Mcl.xdm, category=SWCFG
          short-label=examples::EBT::I2c_HLD_FLEXIO_Transfer_S32K342::TresosProject::I2c_HLD_FLEXIO_Transfer_S32K342::config::Mcu.xdm, category=SWCFG
          short-label=examples::EBT::I2c_HLD_FLEXIO_Transfer_S32K342::TresosProject::I2c_HLD_FLEXIO_Transfer_S32K342::config::Os.xdm, category=SWCFG
          short-label=examples::EBT::I2c_HLD_FLEXIO_Transfer_S32K342::TresosProject::I2c_HLD_FLEXIO_Transfer_S32K342::config::Platform.xdm, category=SWCFG
          short-label=examples::EBT::I2c_HLD_FLEXIO_Transfer_S32K342::TresosProject::I2c_HLD_FLEXIO_Transfer_S32K342::config::Port.xdm, category=SWCFG
          short-label=examples::EBT::I2c_HLD_FLEXIO_Transfer_S32K342::TresosProject::I2c_HLD_FLEXIO_Transfer_S32K342::config::Resource.xdm, category=SWCFG
          short-label=examples::EBT::I2c_HLD_FLEXIO_Transfer_S32K344::generate::epc::Base.xdm, category=SWCFG
          short-label=examples::EBT::I2c_HLD_FLEXIO_Transfer_S32K344::generate::epc::Dem.xdm, category=SWCFG
          short-label=examples::EBT::I2c_HLD_FLEXIO_Transfer_S32K344::generate::epc::EcuC.xdm, category=SWCFG
          short-label=examples::EBT::I2c_HLD_FLEXIO_Transfer_S32K344::generate::epc::I2c.xdm, category=SWCFG
          short-label=examples::EBT::I2c_HLD_FLEXIO_Transfer_S32K344::generate::epc::Mcl.xdm, category=SWCFG
          short-label=examples::EBT::I2c_HLD_FLEXIO_Transfer_S32K344::generate::epc::Mcu.xdm, category=SWCFG
          short-label=examples::EBT::I2c_HLD_FLEXIO_Transfer_S32K344::generate::epc::Os.xdm, category=SWCFG
          short-label=examples::EBT::I2c_HLD_FLEXIO_Transfer_S32K344::generate::epc::Platform.xdm, category=SWCFG
          short-label=examples::EBT::I2c_HLD_FLEXIO_Transfer_S32K344::generate::epc::Port.xdm, category=SWCFG
          short-label=examples::EBT::I2c_HLD_FLEXIO_Transfer_S32K344::generate::epc::Resource.xdm, category=SWCFG
          short-label=examples::EBT::I2c_HLD_FLEXIO_Transfer_S32K344::include::check_example.h, category=SWHDR
          short-label=examples::EBT::I2c_HLD_FLEXIO_Transfer_S32K344::src::main.c, category=SWSRC
          short-label=examples::EBT::I2c_HLD_FLEXIO_Transfer_S32K344::TresosProject::I2c_HLD_FLEXIO_Transfer_S32K344::.prefs::preferences.xdm, category=SWCFG
          short-label=examples::EBT::I2c_HLD_FLEXIO_Transfer_S32K344::TresosProject::I2c_HLD_FLEXIO_Transfer_S32K344::config::Base.xdm, category=SWCFG
          short-label=examples::EBT::I2c_HLD_FLEXIO_Transfer_S32K344::TresosProject::I2c_HLD_FLEXIO_Transfer_S32K344::config::Dem.xdm, category=SWCFG
          short-label=examples::EBT::I2c_HLD_FLEXIO_Transfer_S32K344::TresosProject::I2c_HLD_FLEXIO_Transfer_S32K344::config::EcuC.xdm, category=SWCFG
          short-label=examples::EBT::I2c_HLD_FLEXIO_Transfer_S32K344::TresosProject::I2c_HLD_FLEXIO_Transfer_S32K344::config::I2c.xdm, category=SWCFG
          short-label=examples::EBT::I2c_HLD_FLEXIO_Transfer_S32K344::TresosProject::I2c_HLD_FLEXIO_Transfer_S32K344::config::Mcl.xdm, category=SWCFG
          short-label=examples::EBT::I2c_HLD_FLEXIO_Transfer_S32K344::TresosProject::I2c_HLD_FLEXIO_Transfer_S32K344::config::Mcu.xdm, category=SWCFG
          short-label=examples::EBT::I2c_HLD_FLEXIO_Transfer_S32K344::TresosProject::I2c_HLD_FLEXIO_Transfer_S32K344::config::Os.xdm, category=SWCFG
          short-label=examples::EBT::I2c_HLD_FLEXIO_Transfer_S32K344::TresosProject::I2c_HLD_FLEXIO_Transfer_S32K344::config::Platform.xdm, category=SWCFG
          short-label=examples::EBT::I2c_HLD_FLEXIO_Transfer_S32K344::TresosProject::I2c_HLD_FLEXIO_Transfer_S32K344::config::Port.xdm, category=SWCFG
          short-label=examples::EBT::I2c_HLD_FLEXIO_Transfer_S32K344::TresosProject::I2c_HLD_FLEXIO_Transfer_S32K344::config::Resource.xdm, category=SWCFG
          short-label=examples::EBT::I2c_HLD_FLEXIO_Transfer_S32K344_Q172::generate::epc::Base.xdm, category=SWCFG
          short-label=examples::EBT::I2c_HLD_FLEXIO_Transfer_S32K344_Q172::generate::epc::Dem.xdm, category=SWCFG
          short-label=examples::EBT::I2c_HLD_FLEXIO_Transfer_S32K344_Q172::generate::epc::EcuC.xdm, category=SWCFG
          short-label=examples::EBT::I2c_HLD_FLEXIO_Transfer_S32K344_Q172::generate::epc::I2c.xdm, category=SWCFG
          short-label=examples::EBT::I2c_HLD_FLEXIO_Transfer_S32K344_Q172::generate::epc::Mcl.xdm, category=SWCFG
          short-label=examples::EBT::I2c_HLD_FLEXIO_Transfer_S32K344_Q172::generate::epc::Mcu.xdm, category=SWCFG
          short-label=examples::EBT::I2c_HLD_FLEXIO_Transfer_S32K344_Q172::generate::epc::Os.xdm, category=SWCFG
          short-label=examples::EBT::I2c_HLD_FLEXIO_Transfer_S32K344_Q172::generate::epc::Platform.xdm, category=SWCFG
          short-label=examples::EBT::I2c_HLD_FLEXIO_Transfer_S32K344_Q172::generate::epc::Port.xdm, category=SWCFG
          short-label=examples::EBT::I2c_HLD_FLEXIO_Transfer_S32K344_Q172::generate::epc::Resource.xdm, category=SWCFG
          short-label=examples::EBT::I2c_HLD_FLEXIO_Transfer_S32K344_Q172::include::check_example.h, category=SWHDR
          short-label=examples::EBT::I2c_HLD_FLEXIO_Transfer_S32K344_Q172::src::main.c, category=SWSRC
          short-label=examples::EBT::I2c_HLD_FLEXIO_Transfer_S32K344_Q172::TresosProject::I2c_HLD_FLEXIO_Transfer_S32K344_Q172::.prefs::preferences.xdm, category=SWCFG
          short-label=examples::EBT::I2c_HLD_FLEXIO_Transfer_S32K344_Q172::TresosProject::I2c_HLD_FLEXIO_Transfer_S32K344_Q172::config::Base.xdm, category=SWCFG
          short-label=examples::EBT::I2c_HLD_FLEXIO_Transfer_S32K344_Q172::TresosProject::I2c_HLD_FLEXIO_Transfer_S32K344_Q172::config::Dem.xdm, category=SWCFG
          short-label=examples::EBT::I2c_HLD_FLEXIO_Transfer_S32K344_Q172::TresosProject::I2c_HLD_FLEXIO_Transfer_S32K344_Q172::config::EcuC.xdm, category=SWCFG
          short-label=examples::EBT::I2c_HLD_FLEXIO_Transfer_S32K344_Q172::TresosProject::I2c_HLD_FLEXIO_Transfer_S32K344_Q172::config::I2c.xdm, category=SWCFG
          short-label=examples::EBT::I2c_HLD_FLEXIO_Transfer_S32K344_Q172::TresosProject::I2c_HLD_FLEXIO_Transfer_S32K344_Q172::config::Mcl.xdm, category=SWCFG
          short-label=examples::EBT::I2c_HLD_FLEXIO_Transfer_S32K344_Q172::TresosProject::I2c_HLD_FLEXIO_Transfer_S32K344_Q172::config::Mcu.xdm, category=SWCFG
          short-label=examples::EBT::I2c_HLD_FLEXIO_Transfer_S32K344_Q172::TresosProject::I2c_HLD_FLEXIO_Transfer_S32K344_Q172::config::Os.xdm, category=SWCFG
          short-label=examples::EBT::I2c_HLD_FLEXIO_Transfer_S32K344_Q172::TresosProject::I2c_HLD_FLEXIO_Transfer_S32K344_Q172::config::Platform.xdm, category=SWCFG
          short-label=examples::EBT::I2c_HLD_FLEXIO_Transfer_S32K344_Q172::TresosProject::I2c_HLD_FLEXIO_Transfer_S32K344_Q172::config::Port.xdm, category=SWCFG
          short-label=examples::EBT::I2c_HLD_FLEXIO_Transfer_S32K344_Q172::TresosProject::I2c_HLD_FLEXIO_Transfer_S32K344_Q172::config::Resource.xdm, category=SWCFG
          short-label=examples::EBT::I2c_HLD_LPI2C_Transfer_S32K312::generate::epc::Base.xdm, category=SWCFG
          short-label=examples::EBT::I2c_HLD_LPI2C_Transfer_S32K312::generate::epc::Dem.xdm, category=SWCFG
          short-label=examples::EBT::I2c_HLD_LPI2C_Transfer_S32K312::generate::epc::EcuC.xdm, category=SWCFG
          short-label=examples::EBT::I2c_HLD_LPI2C_Transfer_S32K312::generate::epc::I2c.xdm, category=SWCFG
          short-label=examples::EBT::I2c_HLD_LPI2C_Transfer_S32K312::generate::epc::Mcl.xdm, category=SWCFG
          short-label=examples::EBT::I2c_HLD_LPI2C_Transfer_S32K312::generate::epc::Mcu.xdm, category=SWCFG
          short-label=examples::EBT::I2c_HLD_LPI2C_Transfer_S32K312::generate::epc::Os.xdm, category=SWCFG
          short-label=examples::EBT::I2c_HLD_LPI2C_Transfer_S32K312::generate::epc::Platform.xdm, category=SWCFG
          short-label=examples::EBT::I2c_HLD_LPI2C_Transfer_S32K312::generate::epc::Port.xdm, category=SWCFG
          short-label=examples::EBT::I2c_HLD_LPI2C_Transfer_S32K312::generate::epc::Resource.xdm, category=SWCFG
          short-label=examples::EBT::I2c_HLD_LPI2C_Transfer_S32K312::include::check_example.h, category=SWHDR
          short-label=examples::EBT::I2c_HLD_LPI2C_Transfer_S32K312::src::main.c, category=SWSRC
          short-label=examples::EBT::I2c_HLD_LPI2C_Transfer_S32K312::TresosProject::I2c_HLD_LPI2C_Transfer_S32K312::.prefs::preferences.xdm, category=SWCFG
          short-label=examples::EBT::I2c_HLD_LPI2C_Transfer_S32K312::TresosProject::I2c_HLD_LPI2C_Transfer_S32K312::config::Base.xdm, category=SWCFG
          short-label=examples::EBT::I2c_HLD_LPI2C_Transfer_S32K312::TresosProject::I2c_HLD_LPI2C_Transfer_S32K312::config::Dem.xdm, category=SWCFG
          short-label=examples::EBT::I2c_HLD_LPI2C_Transfer_S32K312::TresosProject::I2c_HLD_LPI2C_Transfer_S32K312::config::EcuC.xdm, category=SWCFG
          short-label=examples::EBT::I2c_HLD_LPI2C_Transfer_S32K312::TresosProject::I2c_HLD_LPI2C_Transfer_S32K312::config::I2c.xdm, category=SWCFG
          short-label=examples::EBT::I2c_HLD_LPI2C_Transfer_S32K312::TresosProject::I2c_HLD_LPI2C_Transfer_S32K312::config::Mcl.xdm, category=SWCFG
          short-label=examples::EBT::I2c_HLD_LPI2C_Transfer_S32K312::TresosProject::I2c_HLD_LPI2C_Transfer_S32K312::config::Mcu.xdm, category=SWCFG
          short-label=examples::EBT::I2c_HLD_LPI2C_Transfer_S32K312::TresosProject::I2c_HLD_LPI2C_Transfer_S32K312::config::Os.xdm, category=SWCFG
          short-label=examples::EBT::I2c_HLD_LPI2C_Transfer_S32K312::TresosProject::I2c_HLD_LPI2C_Transfer_S32K312::config::Platform.xdm, category=SWCFG
          short-label=examples::EBT::I2c_HLD_LPI2C_Transfer_S32K312::TresosProject::I2c_HLD_LPI2C_Transfer_S32K312::config::Port.xdm, category=SWCFG
          short-label=examples::EBT::I2c_HLD_LPI2C_Transfer_S32K312::TresosProject::I2c_HLD_LPI2C_Transfer_S32K312::config::Resource.xdm, category=SWCFG
          short-label=examples::EBT::I2c_HLD_LPI2C_Transfer_S32K342::generate::epc::Base.xdm, category=SWCFG
          short-label=examples::EBT::I2c_HLD_LPI2C_Transfer_S32K342::generate::epc::Dem.xdm, category=SWCFG
          short-label=examples::EBT::I2c_HLD_LPI2C_Transfer_S32K342::generate::epc::EcuC.xdm, category=SWCFG
          short-label=examples::EBT::I2c_HLD_LPI2C_Transfer_S32K342::generate::epc::I2c.xdm, category=SWCFG
          short-label=examples::EBT::I2c_HLD_LPI2C_Transfer_S32K342::generate::epc::Mcl.xdm, category=SWCFG
          short-label=examples::EBT::I2c_HLD_LPI2C_Transfer_S32K342::generate::epc::Mcu.xdm, category=SWCFG
          short-label=examples::EBT::I2c_HLD_LPI2C_Transfer_S32K342::generate::epc::Os.xdm, category=SWCFG
          short-label=examples::EBT::I2c_HLD_LPI2C_Transfer_S32K342::generate::epc::Platform.xdm, category=SWCFG
          short-label=examples::EBT::I2c_HLD_LPI2C_Transfer_S32K342::generate::epc::Port.xdm, category=SWCFG
          short-label=examples::EBT::I2c_HLD_LPI2C_Transfer_S32K342::generate::epc::Resource.xdm, category=SWCFG
          short-label=examples::EBT::I2c_HLD_LPI2C_Transfer_S32K342::include::check_example.h, category=SWHDR
          short-label=examples::EBT::I2c_HLD_LPI2C_Transfer_S32K342::src::main.c, category=SWSRC
          short-label=examples::EBT::I2c_HLD_LPI2C_Transfer_S32K342::TresosProject::I2c_HLD_LPI2C_Transfer_S32K342::.prefs::preferences.xdm, category=SWCFG
          short-label=examples::EBT::I2c_HLD_LPI2C_Transfer_S32K342::TresosProject::I2c_HLD_LPI2C_Transfer_S32K342::config::Base.xdm, category=SWCFG
          short-label=examples::EBT::I2c_HLD_LPI2C_Transfer_S32K342::TresosProject::I2c_HLD_LPI2C_Transfer_S32K342::config::Dem.xdm, category=SWCFG
          short-label=examples::EBT::I2c_HLD_LPI2C_Transfer_S32K342::TresosProject::I2c_HLD_LPI2C_Transfer_S32K342::config::EcuC.xdm, category=SWCFG
          short-label=examples::EBT::I2c_HLD_LPI2C_Transfer_S32K342::TresosProject::I2c_HLD_LPI2C_Transfer_S32K342::config::I2c.xdm, category=SWCFG
          short-label=examples::EBT::I2c_HLD_LPI2C_Transfer_S32K342::TresosProject::I2c_HLD_LPI2C_Transfer_S32K342::config::Mcl.xdm, category=SWCFG
          short-label=examples::EBT::I2c_HLD_LPI2C_Transfer_S32K342::TresosProject::I2c_HLD_LPI2C_Transfer_S32K342::config::Mcu.xdm, category=SWCFG
          short-label=examples::EBT::I2c_HLD_LPI2C_Transfer_S32K342::TresosProject::I2c_HLD_LPI2C_Transfer_S32K342::config::Os.xdm, category=SWCFG
          short-label=examples::EBT::I2c_HLD_LPI2C_Transfer_S32K342::TresosProject::I2c_HLD_LPI2C_Transfer_S32K342::config::Platform.xdm, category=SWCFG
          short-label=examples::EBT::I2c_HLD_LPI2C_Transfer_S32K342::TresosProject::I2c_HLD_LPI2C_Transfer_S32K342::config::Port.xdm, category=SWCFG
          short-label=examples::EBT::I2c_HLD_LPI2C_Transfer_S32K342::TresosProject::I2c_HLD_LPI2C_Transfer_S32K342::config::Resource.xdm, category=SWCFG
          short-label=examples::EBT::I2c_HLD_LPI2C_Transfer_S32K344::generate::epc::Base.xdm, category=SWCFG
          short-label=examples::EBT::I2c_HLD_LPI2C_Transfer_S32K344::generate::epc::Dem.xdm, category=SWCFG
          short-label=examples::EBT::I2c_HLD_LPI2C_Transfer_S32K344::generate::epc::EcuC.xdm, category=SWCFG
          short-label=examples::EBT::I2c_HLD_LPI2C_Transfer_S32K344::generate::epc::I2c.xdm, category=SWCFG
          short-label=examples::EBT::I2c_HLD_LPI2C_Transfer_S32K344::generate::epc::Mcl.xdm, category=SWCFG
          short-label=examples::EBT::I2c_HLD_LPI2C_Transfer_S32K344::generate::epc::Mcu.xdm, category=SWCFG
          short-label=examples::EBT::I2c_HLD_LPI2C_Transfer_S32K344::generate::epc::Os.xdm, category=SWCFG
          short-label=examples::EBT::I2c_HLD_LPI2C_Transfer_S32K344::generate::epc::Platform.xdm, category=SWCFG
          short-label=examples::EBT::I2c_HLD_LPI2C_Transfer_S32K344::generate::epc::Port.xdm, category=SWCFG
          short-label=examples::EBT::I2c_HLD_LPI2C_Transfer_S32K344::generate::epc::Resource.xdm, category=SWCFG
          short-label=examples::EBT::I2c_HLD_LPI2C_Transfer_S32K344::include::check_example.h, category=SWHDR
          short-label=examples::EBT::I2c_HLD_LPI2C_Transfer_S32K344::src::main.c, category=SWSRC
          short-label=examples::EBT::I2c_HLD_LPI2C_Transfer_S32K344::TresosProject::I2c_HLD_LPI2C_Transfer_S32K344::.prefs::preferences.xdm, category=SWCFG
          short-label=examples::EBT::I2c_HLD_LPI2C_Transfer_S32K344::TresosProject::I2c_HLD_LPI2C_Transfer_S32K344::config::Base.xdm, category=SWCFG
          short-label=examples::EBT::I2c_HLD_LPI2C_Transfer_S32K344::TresosProject::I2c_HLD_LPI2C_Transfer_S32K344::config::Dem.xdm, category=SWCFG
          short-label=examples::EBT::I2c_HLD_LPI2C_Transfer_S32K344::TresosProject::I2c_HLD_LPI2C_Transfer_S32K344::config::EcuC.xdm, category=SWCFG
          short-label=examples::EBT::I2c_HLD_LPI2C_Transfer_S32K344::TresosProject::I2c_HLD_LPI2C_Transfer_S32K344::config::I2c.xdm, category=SWCFG
          short-label=examples::EBT::I2c_HLD_LPI2C_Transfer_S32K344::TresosProject::I2c_HLD_LPI2C_Transfer_S32K344::config::Mcl.xdm, category=SWCFG
          short-label=examples::EBT::I2c_HLD_LPI2C_Transfer_S32K344::TresosProject::I2c_HLD_LPI2C_Transfer_S32K344::config::Mcu.xdm, category=SWCFG
          short-label=examples::EBT::I2c_HLD_LPI2C_Transfer_S32K344::TresosProject::I2c_HLD_LPI2C_Transfer_S32K344::config::Os.xdm, category=SWCFG
          short-label=examples::EBT::I2c_HLD_LPI2C_Transfer_S32K344::TresosProject::I2c_HLD_LPI2C_Transfer_S32K344::config::Platform.xdm, category=SWCFG
          short-label=examples::EBT::I2c_HLD_LPI2C_Transfer_S32K344::TresosProject::I2c_HLD_LPI2C_Transfer_S32K344::config::Port.xdm, category=SWCFG
          short-label=examples::EBT::I2c_HLD_LPI2C_Transfer_S32K344::TresosProject::I2c_HLD_LPI2C_Transfer_S32K344::config::Resource.xdm, category=SWCFG
          short-label=examples::S32DS::I2c_HLD_FLEXIO_Transfer_S32K312::include::check_example.h, category=SWHDR
          short-label=examples::S32DS::I2c_HLD_FLEXIO_Transfer_S32K312::Project_Settings::Startup_Code::exceptions.c, category=SWSRC
          short-label=examples::S32DS::I2c_HLD_FLEXIO_Transfer_S32K312::Project_Settings::Startup_Code::nvic.c, category=SWSRC
          short-label=examples::S32DS::I2c_HLD_FLEXIO_Transfer_S32K312::Project_Settings::Startup_Code::startup.c, category=SWSRC
          short-label=examples::S32DS::I2c_HLD_FLEXIO_Transfer_S32K312::Project_Settings::Startup_Code::system.c, category=SWSRC
          short-label=examples::S32DS::I2c_HLD_FLEXIO_Transfer_S32K312::src::main.c, category=SWSRC
          short-label=examples::S32DS::I2c_HLD_FLEXIO_Transfer_S32K342::include::check_example.h, category=SWHDR
          short-label=examples::S32DS::I2c_HLD_FLEXIO_Transfer_S32K342::Project_Settings::Startup_Code::exceptions.c, category=SWSRC
          short-label=examples::S32DS::I2c_HLD_FLEXIO_Transfer_S32K342::Project_Settings::Startup_Code::nvic.c, category=SWSRC
          short-label=examples::S32DS::I2c_HLD_FLEXIO_Transfer_S32K342::Project_Settings::Startup_Code::startup.c, category=SWSRC
          short-label=examples::S32DS::I2c_HLD_FLEXIO_Transfer_S32K342::Project_Settings::Startup_Code::system.c, category=SWSRC
          short-label=examples::S32DS::I2c_HLD_FLEXIO_Transfer_S32K342::src::main.c, category=SWSRC
          short-label=examples::S32DS::I2c_HLD_FLEXIO_Transfer_S32K344::include::check_example.h, category=SWHDR
          short-label=examples::S32DS::I2c_HLD_FLEXIO_Transfer_S32K344::Project_Settings::Startup_Code::exceptions.c, category=SWSRC
          short-label=examples::S32DS::I2c_HLD_FLEXIO_Transfer_S32K344::Project_Settings::Startup_Code::nvic.c, category=SWSRC
          short-label=examples::S32DS::I2c_HLD_FLEXIO_Transfer_S32K344::Project_Settings::Startup_Code::startup.c, category=SWSRC
          short-label=examples::S32DS::I2c_HLD_FLEXIO_Transfer_S32K344::Project_Settings::Startup_Code::system.c, category=SWSRC
          short-label=examples::S32DS::I2c_HLD_FLEXIO_Transfer_S32K344::src::main.c, category=SWSRC
          short-label=examples::S32DS::I2c_HLD_FLEXIO_Transfer_S32K344_Q172::include::check_example.h, category=SWHDR
          short-label=examples::S32DS::I2c_HLD_FLEXIO_Transfer_S32K344_Q172::Project_Settings::Startup_Code::exceptions.c, category=SWSRC
          short-label=examples::S32DS::I2c_HLD_FLEXIO_Transfer_S32K344_Q172::Project_Settings::Startup_Code::nvic.c, category=SWSRC
          short-label=examples::S32DS::I2c_HLD_FLEXIO_Transfer_S32K344_Q172::Project_Settings::Startup_Code::startup.c, category=SWSRC
          short-label=examples::S32DS::I2c_HLD_FLEXIO_Transfer_S32K344_Q172::Project_Settings::Startup_Code::system.c, category=SWSRC
          short-label=examples::S32DS::I2c_HLD_FLEXIO_Transfer_S32K344_Q172::src::main.c, category=SWSRC
          short-label=examples::S32DS::I2c_HLD_LPI2C_Transfer_S32K312::include::check_example.h, category=SWHDR
          short-label=examples::S32DS::I2c_HLD_LPI2C_Transfer_S32K312::Project_Settings::Startup_Code::exceptions.c, category=SWSRC
          short-label=examples::S32DS::I2c_HLD_LPI2C_Transfer_S32K312::Project_Settings::Startup_Code::nvic.c, category=SWSRC
          short-label=examples::S32DS::I2c_HLD_LPI2C_Transfer_S32K312::Project_Settings::Startup_Code::startup.c, category=SWSRC
          short-label=examples::S32DS::I2c_HLD_LPI2C_Transfer_S32K312::Project_Settings::Startup_Code::system.c, category=SWSRC
          short-label=examples::S32DS::I2c_HLD_LPI2C_Transfer_S32K312::src::main.c, category=SWSRC
          short-label=examples::S32DS::I2c_HLD_LPI2C_Transfer_S32K342::include::check_example.h, category=SWHDR
          short-label=examples::S32DS::I2c_HLD_LPI2C_Transfer_S32K342::Project_Settings::Startup_Code::exceptions.c, category=SWSRC
          short-label=examples::S32DS::I2c_HLD_LPI2C_Transfer_S32K342::Project_Settings::Startup_Code::nvic.c, category=SWSRC
          short-label=examples::S32DS::I2c_HLD_LPI2C_Transfer_S32K342::Project_Settings::Startup_Code::startup.c, category=SWSRC
          short-label=examples::S32DS::I2c_HLD_LPI2C_Transfer_S32K342::Project_Settings::Startup_Code::system.c, category=SWSRC
          short-label=examples::S32DS::I2c_HLD_LPI2C_Transfer_S32K342::src::main.c, category=SWSRC
          short-label=examples::S32DS::I2c_HLD_LPI2C_Transfer_S32K344::include::check_example.h, category=SWHDR
          short-label=examples::S32DS::I2c_HLD_LPI2C_Transfer_S32K344::Project_Settings::Startup_Code::exceptions.c, category=SWSRC
          short-label=examples::S32DS::I2c_HLD_LPI2C_Transfer_S32K344::Project_Settings::Startup_Code::nvic.c, category=SWSRC
          short-label=examples::S32DS::I2c_HLD_LPI2C_Transfer_S32K344::Project_Settings::Startup_Code::startup.c, category=SWSRC
          short-label=examples::S32DS::I2c_HLD_LPI2C_Transfer_S32K344::Project_Settings::Startup_Code::system.c, category=SWSRC
          short-label=examples::S32DS::I2c_HLD_LPI2C_Transfer_S32K344::src::main.c, category=SWSRC
          short-label=examples::S32DS::I2c_IP_FLEXIO_Transfer_S32K312::include::check_example.h, category=SWHDR
          short-label=examples::S32DS::I2c_IP_FLEXIO_Transfer_S32K312::Project_Settings::Startup_Code::exceptions.c, category=SWSRC
          short-label=examples::S32DS::I2c_IP_FLEXIO_Transfer_S32K312::Project_Settings::Startup_Code::nvic.c, category=SWSRC
          short-label=examples::S32DS::I2c_IP_FLEXIO_Transfer_S32K312::Project_Settings::Startup_Code::startup.c, category=SWSRC
          short-label=examples::S32DS::I2c_IP_FLEXIO_Transfer_S32K312::Project_Settings::Startup_Code::system.c, category=SWSRC
          short-label=examples::S32DS::I2c_IP_FLEXIO_Transfer_S32K312::src::main.c, category=SWSRC
          short-label=examples::S32DS::I2c_IP_FLEXIO_Transfer_S32K342::include::check_example.h, category=SWHDR
          short-label=examples::S32DS::I2c_IP_FLEXIO_Transfer_S32K342::Project_Settings::Startup_Code::exceptions.c, category=SWSRC
          short-label=examples::S32DS::I2c_IP_FLEXIO_Transfer_S32K342::Project_Settings::Startup_Code::nvic.c, category=SWSRC
          short-label=examples::S32DS::I2c_IP_FLEXIO_Transfer_S32K342::Project_Settings::Startup_Code::startup.c, category=SWSRC
          short-label=examples::S32DS::I2c_IP_FLEXIO_Transfer_S32K342::Project_Settings::Startup_Code::system.c, category=SWSRC
          short-label=examples::S32DS::I2c_IP_FLEXIO_Transfer_S32K342::src::main.c, category=SWSRC
          short-label=examples::S32DS::I2c_IP_FLEXIO_Transfer_S32K344::include::check_example.h, category=SWHDR
          short-label=examples::S32DS::I2c_IP_FLEXIO_Transfer_S32K344::Project_Settings::Startup_Code::exceptions.c, category=SWSRC
          short-label=examples::S32DS::I2c_IP_FLEXIO_Transfer_S32K344::Project_Settings::Startup_Code::nvic.c, category=SWSRC
          short-label=examples::S32DS::I2c_IP_FLEXIO_Transfer_S32K344::Project_Settings::Startup_Code::startup.c, category=SWSRC
          short-label=examples::S32DS::I2c_IP_FLEXIO_Transfer_S32K344::Project_Settings::Startup_Code::system.c, category=SWSRC
          short-label=examples::S32DS::I2c_IP_FLEXIO_Transfer_S32K344::src::main.c, category=SWSRC
          short-label=examples::S32DS::I2c_IP_FLEXIO_Transfer_S32K344_Q172::include::check_example.h, category=SWHDR
          short-label=examples::S32DS::I2c_IP_FLEXIO_Transfer_S32K344_Q172::Project_Settings::Startup_Code::exceptions.c, category=SWSRC
          short-label=examples::S32DS::I2c_IP_FLEXIO_Transfer_S32K344_Q172::Project_Settings::Startup_Code::nvic.c, category=SWSRC
          short-label=examples::S32DS::I2c_IP_FLEXIO_Transfer_S32K344_Q172::Project_Settings::Startup_Code::startup.c, category=SWSRC
          short-label=examples::S32DS::I2c_IP_FLEXIO_Transfer_S32K344_Q172::Project_Settings::Startup_Code::system.c, category=SWSRC
          short-label=examples::S32DS::I2c_IP_FLEXIO_Transfer_S32K344_Q172::src::main.c, category=SWSRC
          short-label=examples::S32DS::I2c_IP_LPI2C_Transfer_S32K312::include::check_example.h, category=SWHDR
          short-label=examples::S32DS::I2c_IP_LPI2C_Transfer_S32K312::Project_Settings::Startup_Code::exceptions.c, category=SWSRC
          short-label=examples::S32DS::I2c_IP_LPI2C_Transfer_S32K312::Project_Settings::Startup_Code::nvic.c, category=SWSRC
          short-label=examples::S32DS::I2c_IP_LPI2C_Transfer_S32K312::Project_Settings::Startup_Code::startup.c, category=SWSRC
          short-label=examples::S32DS::I2c_IP_LPI2C_Transfer_S32K312::Project_Settings::Startup_Code::system.c, category=SWSRC
          short-label=examples::S32DS::I2c_IP_LPI2C_Transfer_S32K312::src::main.c, category=SWSRC
          short-label=examples::S32DS::I2c_IP_LPI2C_Transfer_S32K342::include::check_example.h, category=SWHDR
          short-label=examples::S32DS::I2c_IP_LPI2C_Transfer_S32K342::Project_Settings::Startup_Code::exceptions.c, category=SWSRC
          short-label=examples::S32DS::I2c_IP_LPI2C_Transfer_S32K342::Project_Settings::Startup_Code::nvic.c, category=SWSRC
          short-label=examples::S32DS::I2c_IP_LPI2C_Transfer_S32K342::Project_Settings::Startup_Code::startup.c, category=SWSRC
          short-label=examples::S32DS::I2c_IP_LPI2C_Transfer_S32K342::Project_Settings::Startup_Code::system.c, category=SWSRC
          short-label=examples::S32DS::I2c_IP_LPI2C_Transfer_S32K342::src::main.c, category=SWSRC
          short-label=examples::S32DS::I2c_IP_LPI2C_Transfer_S32K344::include::check_example.h, category=SWHDR
          short-label=examples::S32DS::I2c_IP_LPI2C_Transfer_S32K344::Project_Settings::Startup_Code::exceptions.c, category=SWSRC
          short-label=examples::S32DS::I2c_IP_LPI2C_Transfer_S32K344::Project_Settings::Startup_Code::nvic.c, category=SWSRC
          short-label=examples::S32DS::I2c_IP_LPI2C_Transfer_S32K344::Project_Settings::Startup_Code::startup.c, category=SWSRC
          short-label=examples::S32DS::I2c_IP_LPI2C_Transfer_S32K344::Project_Settings::Startup_Code::system.c, category=SWSRC
          short-label=examples::S32DS::I2c_IP_LPI2C_Transfer_S32K344::src::main.c, category=SWSRC
          short-label=include::CDD_I2c.h, category=SWHDR
          short-label=include::Flexio_I2c_Ip.h, category=SWHDR
          short-label=include::Flexio_I2c_Ip_Callbacks.h, category=SWHDR
          short-label=include::Flexio_I2c_Ip_Features.h, category=SWHDR
          short-label=include::Flexio_I2c_Ip_HwAccess.h, category=SWHDR
          short-label=include::Flexio_I2c_Ip_Irq.h, category=SWHDR
          short-label=include::Flexio_I2c_Ip_TrustedFunctions.h, category=SWHDR
          short-label=include::Flexio_I2c_Ip_Types.h, category=SWHDR
          short-label=include::I2c_Ipw.h, category=SWHDR
          short-label=include::I2c_Ipw_Types.h, category=SWHDR
          short-label=include::I2c_Types.h, category=SWHDR
          short-label=include::Lpi2c_Ip.h, category=SWHDR
          short-label=include::Lpi2c_Ip_Callbacks.h, category=SWHDR
          short-label=include::Lpi2c_Ip_Features.h, category=SWHDR
          short-label=include::Lpi2c_Ip_HwAccess.h, category=SWHDR
          short-label=include::Lpi2c_Ip_Irq.h, category=SWHDR
          short-label=include::Lpi2c_Ip_TrustedFunctions.h, category=SWHDR
          short-label=include::Lpi2c_Ip_Types.h, category=SWHDR
          short-label=src::CDD_I2c.c, category=SWSRC
          short-label=src::Flexio_I2c_Ip.c, category=SWSRC
          short-label=src::I2c_Ipw.c, category=SWSRC
          short-label=src::Lpi2c_Ip.c, category=SWSRC
          short-label=src::Lpi2c_Ip_HwAccess.c, category=SWSRC
          short-label=src::Lpi2c_Ip_Irq.c, category=SWSRC
    compiler GCC_Compiler:
      name=GCC Compiler
      options=-mcpu=cortex-m7 -mthumb -mlittle-endian -mfpu=fpv5-sp-d16 -mfloat-abi=hard -std=c99 -Os -ggdb3 -Wall -Wextra -pedantic -Wstrict-prototypes -Wundef -Wunused -Werror=implicit-function-declaration -Wsign-compare -Wdouble-promotion -fno-short-enums -funsigned-char -funsigned-bitfields -fomit-frame-pointer -fno-common -fstack-usage -fdump-ipa-all -c -DS32K3XX -DS32K344 -DGCC -DUSE_SW_VECTOR_MODE -DD_CACHE_ENABLE -DI_CACHE_ENABLE -DENABLE_FPU -DMCAL_ENABLE_USER_MODE_SUPPORT
      vendor=GCC Systems
      version=NXP GCC 10.2.0 20200723 (Build 1728 Revision g5963bc8)
    compiler GHS_Compiler:
      name=Green Hills
      options=-cpu=cortexm7 -thumb -fpu=vfpv5_d16 -fsingle -C99 --ghstd=last -Osize --gnu_asm -dual_debug -G -keeptempfiles -Wimplicit-int -Wshadow -Wtrigraphs -Wundef --unsigned_chars --unsigned_fields --no_commons --no_exceptions --no_slash_comment --prototype_errors --incorrect_pragma_warnings -c -DS32K3XX -DS32K344 -DGHS -DUSE_SW_VECTOR_MODE -DD_CACHE_ENABLE -DI_CACHE_ENABLE -DENABLE_FPU -DMCAL_ENABLE_USER_MODE_SUPPORT
      vendor=Green Hills
      version=Green Hills Multi 7.1.6d / Compiler 2021.1.4
    compiler IAR_Compiler:
      name=IAR Compiler
      options=--cpu=Cortex-M7 --cpu_mode=thumb --endian=little --fpu=FPv5-SP -e -Ohz --debug --no_clustering --no_mem_idioms --do_explicit_zero_opt_in_named_sections --require_prototypes --no_wrap_diagnostics --diag_suppress=Pa050 -DS32K3XX -DS32K344 -DIAR -DUSE_SW_VECTOR_MODE -DD_CACHE_ENABLE -DI_CACHE_ENABLE -DENABLE_FPU -DMCAL_ENABLE_USER_MODE_SUPPORT
      vendor=IAR Systems
      version=IAR ANSI C/C++ Compiler v.8.50.10 (safety version)
    generated-artifacts:
      14 x dependency on artifact:
        CDD_I2c_PBcfg_h: artifact-descriptor={short-label=generate_PB::include::CDD_I2c_PBcfg.h, category=SWHDR}, usages=EXECUTE
        Flexio_I2c_Ip_Cfg_h: artifact-descriptor={short-label=generate_PB::include::Flexio_I2c_Ip_Cfg.h, category=SWHDR}, usages=EXECUTE
        Flexio_I2c_Ip_CfgDefines_h: artifact-descriptor={short-label=generate_PB::include::Flexio_I2c_Ip_CfgDefines.h, category=SWHDR}, usages=EXECUTE
        Flexio_I2c_Ip_PBcfg_h: artifact-descriptor={short-label=generate_PB::include::Flexio_I2c_Ip_PBcfg.h, category=SWHDR}, usages=EXECUTE
        I2c_Ipw_PBcfg_h: artifact-descriptor={short-label=generate_PB::include::I2c_Ipw_PBcfg.h, category=SWHDR}, usages=EXECUTE
        Lpi2c_Ip_Cfg_h: artifact-descriptor={short-label=generate_PB::include::Lpi2c_Ip_Cfg.h, category=SWHDR}, usages=EXECUTE
        Lpi2c_Ip_CfgDefines_h: artifact-descriptor={short-label=generate_PB::include::Lpi2c_Ip_CfgDefines.h, category=SWHDR}, usages=EXECUTE
        Lpi2c_Ip_PBcfg_h: artifact-descriptor={short-label=generate_PB::include::Lpi2c_Ip_PBcfg.h, category=SWHDR}, usages=EXECUTE
        CDD_I2c_PBcfg_c: artifact-descriptor={short-label=generate_PB::src::CDD_I2c_PBcfg.c, category=SWSRC}, usages=EXECUTE
        Flexio_I2c_Ip_PBcfg_c: artifact-descriptor={short-label=generate_PB::src::Flexio_I2c_Ip_PBcfg.c, category=SWSRC}, usages=EXECUTE
        I2c_Ipw_PBcfg_c: artifact-descriptor={short-label=generate_PB::src::I2c_Ipw_PBcfg.c, category=SWSRC}, usages=EXECUTE
        Lpi2c_Ip_PBcfg_c: artifact-descriptor={short-label=generate_PB::src::Lpi2c_Ip_PBcfg.c, category=SWSRC}, usages=EXECUTE
        CDD_I2c_Cfg_h: artifact-descriptor={short-label=generate_PC::include::CDD_I2c_Cfg.h, category=SWHDR}, usages=COMPILE
        CDD_I2c_Cfg_c: artifact-descriptor={short-label=generate_PC::src::CDD_I2c_Cfg.c, category=SWSRC}, usages=COMPILE
    linker GCC_Linker: name=GCC Compiler, options=-Wl,-Map,filename -T linkerfile --entry=Reset_Handler -nostartfiles -mcpu=cortexm7 -mthumb -mfpu=fpv5-sp-d16 -mfloat-abi=hard -mlittle-endian -ggdb3 -lc -lm -lgcc, vendor=GCC Systems, version=NXP GCC 10.2.0 20200723 (Build 1728 Revision g5963bc8)
    linker GHS_Linker: name=Green Hills, options=-e Reset_Handler -T linker_script_file.ld -map -keepmap -Mn -delete -ignore_debug_references -Llibrary_path -larch -lstartup -lind_sd -v -keep=C40_Ip_AccessCode -nostartfiles, vendor=Green Hills, version=Green Hills Multi 7.1.6d / Compiler 2021.1.4
    linker IAR_Linker: name=IAR Compiler, options=--map filename --config linkerfile --cpu=Cortex-M7 --fpu=FPv5-SP --entry _start --enable_stack_usage --skip_dynamic_initialization --no_wrap_diagnostics, vendor=IAR Systems, version=IAR ANSI C/C++ Compiler v.8.50.10 (safety version)
    resource consumption ResourceConsumption
      8 x memory section:
        I2C_CODE: alignment=UNSPECIFIED, sw-addrmethod=CODE, symbol=CODE
        I2C_CONFIG_DATA_UNSPECIFIED: alignment=UNSPECIFIED, sw-addrmethod=CONFIG_DATA, symbol=CONFIG_DATA_UNSPECIFIED
        I2C_CONST_UNSPECIFIED: alignment=UNSPECIFIED, sw-addrmethod=CONST, symbol=CONST_UNSPECIFIED
        I2C_VAR_CLEARED_8: alignment=8, sw-addrmethod=VAR_CLEARED, symbol=VAR_CLEARED_8
        I2C_VAR_CLEARED_UNSPECIFIED: alignment=UNSPECIFIED, sw-addrmethod=VAR_CLEARED, symbol=VAR_CLEARED_UNSPECIFIED
        I2C_VAR_CLEARED_UNSPECIFIED_NO_CACHEABLE: alignment=UNSPECIFIED, sw-addrmethod=VAR_CLEARED_UNSPECIFIED_NO, symbol=VAR_CLEARED_UNSPECIFIED_NO_CACHEABLE
        I2C_VAR_INIT_8: alignment=8, sw-addrmethod=VAR_INIT, symbol=VAR_INIT_8
        I2C_VAR_INIT_8_NO_CACHEABLE: alignment=UNSPECIFIED, sw-addrmethod=VAR_INIT, symbol=VAR_INIT_8_NO_CACHEABLE
