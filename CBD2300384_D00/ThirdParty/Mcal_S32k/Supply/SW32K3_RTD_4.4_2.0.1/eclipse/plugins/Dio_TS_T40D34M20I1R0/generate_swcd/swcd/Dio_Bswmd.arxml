AUTOSAR XML (schema 00046)
package /AUTOSAR_Dio/BswModuleDescriptions
  bsw module description Dio: module-id=120
    provided-entrys:
      Dio_FlipChannel
      Dio_GetVersionInfo
      Dio_MaskedWritePort
      Dio_ReadChannel
      Dio_ReadChannelGroup
      Dio_ReadPort
      Dio_WriteChannel
      Dio_WriteChannelGroup
      Dio_WritePort
    bsw internal behavior InternalBehavior_0
      exclusive area DIO_EXCLUSIVE_AREA_00
      9 x bsw called entity:
        Dio_FlipChannel: can-enter-exclusive-area=DIO_EXCLUSIVE_AREA_00, implemented-entry=Dio_FlipChannel
        Dio_GetVersionInfo: implemented-entry=Dio_GetVersionInfo
        Dio_MaskedWritePort: implemented-entry=Dio_MaskedWritePort
        Dio_ReadChannel: implemented-entry=Dio_ReadChannel
        Dio_ReadChannelGroup: implemented-entry=Dio_ReadChannelGroup
        Dio_ReadPort: implemented-entry=Dio_ReadPort
        Dio_WriteChannel: implemented-entry=Dio_WriteChannel
        Dio_WriteChannelGroup: implemented-entry=Dio_WriteChannelGroup
        Dio_WritePort: implemented-entry=Dio_WritePort
package /AUTOSAR_Dio/BswModuleEntrys
  9 x bsw module entry, all with is-reentrant=true, is-synchronous=true, call-type=REGULAR, execution-context=UNSPECIFIED, sw-service-impl-policy=STANDARD:
    Dio_FlipChannel: service-id=0x11
    Dio_GetVersionInfo: service-id=0x12
    Dio_MaskedWritePort: service-id=0x13
    Dio_ReadChannel: service-id=0x00
    Dio_ReadChannelGroup: service-id=0x04
    Dio_ReadPort: service-id=0x02
    Dio_WriteChannel: service-id=0x01
    Dio_WriteChannelGroup: service-id=0x05
    Dio_WritePort: service-id=0x03
package /Dio_TS_T40D34M20I1R0/Implementations
  bsw implementation BswImplementation_0: programming-language=C, sw-version=2.0.1, vendor-id=43, ar-release-version=4.4.0, behavior=InternalBehavior_0, vendor-specific-module-def=Dio
    code-descriptors:
      code Files
        artifact-descriptors:
          short-label=config::Dio.xdm, category=SWCFG
          short-label=doc::RTD_DIO_IM.pdf, category=SWDOC
          short-label=doc::RTD_DIO_UM.pdf, category=SWDOC
          short-label=examples::EBT::Dio_Example_S32K312::generate::epc::Base.xdm, category=SWCFG
          short-label=examples::EBT::Dio_Example_S32K312::generate::epc::Dem.xdm, category=SWCFG
          short-label=examples::EBT::Dio_Example_S32K312::generate::epc::Dio.xdm, category=SWCFG
          short-label=examples::EBT::Dio_Example_S32K312::generate::epc::Mcu.xdm, category=SWCFG
          short-label=examples::EBT::Dio_Example_S32K312::generate::epc::Os.xdm, category=SWCFG
          short-label=examples::EBT::Dio_Example_S32K312::generate::epc::Platform.xdm, category=SWCFG
          short-label=examples::EBT::Dio_Example_S32K312::generate::epc::Port.xdm, category=SWCFG
          short-label=examples::EBT::Dio_Example_S32K312::generate::epc::Resource.xdm, category=SWCFG
          short-label=examples::EBT::Dio_Example_S32K312::include::check_example.h, category=SWHDR
          short-label=examples::EBT::Dio_Example_S32K312::src::main.c, category=SWSRC
          short-label=examples::EBT::Dio_Example_S32K312::TresosProject::Dio_Example_S32K312::.prefs::preferences.xdm, category=SWCFG
          short-label=examples::EBT::Dio_Example_S32K312::TresosProject::Dio_Example_S32K312::config::Base.xdm, category=SWCFG
          short-label=examples::EBT::Dio_Example_S32K312::TresosProject::Dio_Example_S32K312::config::Dem.xdm, category=SWCFG
          short-label=examples::EBT::Dio_Example_S32K312::TresosProject::Dio_Example_S32K312::config::Dio.xdm, category=SWCFG
          short-label=examples::EBT::Dio_Example_S32K312::TresosProject::Dio_Example_S32K312::config::EcuC.xdm, category=SWCFG
          short-label=examples::EBT::Dio_Example_S32K312::TresosProject::Dio_Example_S32K312::config::Mcu.xdm, category=SWCFG
          short-label=examples::EBT::Dio_Example_S32K312::TresosProject::Dio_Example_S32K312::config::Os.xdm, category=SWCFG
          short-label=examples::EBT::Dio_Example_S32K312::TresosProject::Dio_Example_S32K312::config::Platform.xdm, category=SWCFG
          short-label=examples::EBT::Dio_Example_S32K312::TresosProject::Dio_Example_S32K312::config::Port.xdm, category=SWCFG
          short-label=examples::EBT::Dio_Example_S32K312::TresosProject::Dio_Example_S32K312::config::Resource.xdm, category=SWCFG
          short-label=examples::EBT::Dio_Example_S32K342::generate::epc::Base.xdm, category=SWCFG
          short-label=examples::EBT::Dio_Example_S32K342::generate::epc::Dem.xdm, category=SWCFG
          short-label=examples::EBT::Dio_Example_S32K342::generate::epc::Dio.xdm, category=SWCFG
          short-label=examples::EBT::Dio_Example_S32K342::generate::epc::Mcu.xdm, category=SWCFG
          short-label=examples::EBT::Dio_Example_S32K342::generate::epc::Os.xdm, category=SWCFG
          short-label=examples::EBT::Dio_Example_S32K342::generate::epc::Platform.xdm, category=SWCFG
          short-label=examples::EBT::Dio_Example_S32K342::generate::epc::Port.xdm, category=SWCFG
          short-label=examples::EBT::Dio_Example_S32K342::generate::epc::Resource.xdm, category=SWCFG
          short-label=examples::EBT::Dio_Example_S32K342::include::check_example.h, category=SWHDR
          short-label=examples::EBT::Dio_Example_S32K342::src::main.c, category=SWSRC
          short-label=examples::EBT::Dio_Example_S32K342::TresosProject::Dio_Example_S32K342::.prefs::preferences.xdm, category=SWCFG
          short-label=examples::EBT::Dio_Example_S32K342::TresosProject::Dio_Example_S32K342::config::Base.xdm, category=SWCFG
          short-label=examples::EBT::Dio_Example_S32K342::TresosProject::Dio_Example_S32K342::config::Dem.xdm, category=SWCFG
          short-label=examples::EBT::Dio_Example_S32K342::TresosProject::Dio_Example_S32K342::config::Dio.xdm, category=SWCFG
          short-label=examples::EBT::Dio_Example_S32K342::TresosProject::Dio_Example_S32K342::config::EcuC.xdm, category=SWCFG
          short-label=examples::EBT::Dio_Example_S32K342::TresosProject::Dio_Example_S32K342::config::Mcu.xdm, category=SWCFG
          short-label=examples::EBT::Dio_Example_S32K342::TresosProject::Dio_Example_S32K342::config::Os.xdm, category=SWCFG
          short-label=examples::EBT::Dio_Example_S32K342::TresosProject::Dio_Example_S32K342::config::Platform.xdm, category=SWCFG
          short-label=examples::EBT::Dio_Example_S32K342::TresosProject::Dio_Example_S32K342::config::Port.xdm, category=SWCFG
          short-label=examples::EBT::Dio_Example_S32K342::TresosProject::Dio_Example_S32K342::config::Resource.xdm, category=SWCFG
          short-label=examples::EBT::Dio_Example_S32K344::generate::epc::Base.xdm, category=SWCFG
          short-label=examples::EBT::Dio_Example_S32K344::generate::epc::Dem.xdm, category=SWCFG
          short-label=examples::EBT::Dio_Example_S32K344::generate::epc::Dio.xdm, category=SWCFG
          short-label=examples::EBT::Dio_Example_S32K344::generate::epc::Mcu.xdm, category=SWCFG
          short-label=examples::EBT::Dio_Example_S32K344::generate::epc::Os.xdm, category=SWCFG
          short-label=examples::EBT::Dio_Example_S32K344::generate::epc::Platform.xdm, category=SWCFG
          short-label=examples::EBT::Dio_Example_S32K344::generate::epc::Port.xdm, category=SWCFG
          short-label=examples::EBT::Dio_Example_S32K344::generate::epc::Resource.xdm, category=SWCFG
          short-label=examples::EBT::Dio_Example_S32K344::include::check_example.h, category=SWHDR
          short-label=examples::EBT::Dio_Example_S32K344::src::main.c, category=SWSRC
          short-label=examples::EBT::Dio_Example_S32K344::TresosProject::Dio_Example_S32K344::.prefs::preferences.xdm, category=SWCFG
          short-label=examples::EBT::Dio_Example_S32K344::TresosProject::Dio_Example_S32K344::config::Base.xdm, category=SWCFG
          short-label=examples::EBT::Dio_Example_S32K344::TresosProject::Dio_Example_S32K344::config::Dem.xdm, category=SWCFG
          short-label=examples::EBT::Dio_Example_S32K344::TresosProject::Dio_Example_S32K344::config::Dio.xdm, category=SWCFG
          short-label=examples::EBT::Dio_Example_S32K344::TresosProject::Dio_Example_S32K344::config::EcuC.xdm, category=SWCFG
          short-label=examples::EBT::Dio_Example_S32K344::TresosProject::Dio_Example_S32K344::config::Mcu.xdm, category=SWCFG
          short-label=examples::EBT::Dio_Example_S32K344::TresosProject::Dio_Example_S32K344::config::Os.xdm, category=SWCFG
          short-label=examples::EBT::Dio_Example_S32K344::TresosProject::Dio_Example_S32K344::config::Platform.xdm, category=SWCFG
          short-label=examples::EBT::Dio_Example_S32K344::TresosProject::Dio_Example_S32K344::config::Port.xdm, category=SWCFG
          short-label=examples::EBT::Dio_Example_S32K344::TresosProject::Dio_Example_S32K344::config::Resource.xdm, category=SWCFG
          short-label=examples::S32DS::Dio_Example_S32K312::include::check_example.h, category=SWHDR
          short-label=examples::S32DS::Dio_Example_S32K312::Project_Settings::Startup_Code::exceptions.c, category=SWSRC
          short-label=examples::S32DS::Dio_Example_S32K312::Project_Settings::Startup_Code::nvic.c, category=SWSRC
          short-label=examples::S32DS::Dio_Example_S32K312::Project_Settings::Startup_Code::startup.c, category=SWSRC
          short-label=examples::S32DS::Dio_Example_S32K312::Project_Settings::Startup_Code::system.c, category=SWSRC
          short-label=examples::S32DS::Dio_Example_S32K312::src::main.c, category=SWSRC
          short-label=examples::S32DS::Dio_Example_S32K342::include::check_example.h, category=SWHDR
          short-label=examples::S32DS::Dio_Example_S32K342::Project_Settings::Startup_Code::exceptions.c, category=SWSRC
          short-label=examples::S32DS::Dio_Example_S32K342::Project_Settings::Startup_Code::nvic.c, category=SWSRC
          short-label=examples::S32DS::Dio_Example_S32K342::Project_Settings::Startup_Code::startup.c, category=SWSRC
          short-label=examples::S32DS::Dio_Example_S32K342::Project_Settings::Startup_Code::system.c, category=SWSRC
          short-label=examples::S32DS::Dio_Example_S32K342::src::main.c, category=SWSRC
          short-label=examples::S32DS::Dio_Example_S32K344::include::check_example.h, category=SWHDR
          short-label=examples::S32DS::Dio_Example_S32K344::Project_Settings::Startup_Code::exceptions.c, category=SWSRC
          short-label=examples::S32DS::Dio_Example_S32K344::Project_Settings::Startup_Code::nvic.c, category=SWSRC
          short-label=examples::S32DS::Dio_Example_S32K344::Project_Settings::Startup_Code::startup.c, category=SWSRC
          short-label=examples::S32DS::Dio_Example_S32K344::Project_Settings::Startup_Code::system.c, category=SWSRC
          short-label=examples::S32DS::Dio_Example_S32K344::src::main.c, category=SWSRC
          short-label=examples::S32DS::Siul2_Dio_Ip_Example_S32K312::include::check_example.h, category=SWHDR
          short-label=examples::S32DS::Siul2_Dio_Ip_Example_S32K312::Project_Settings::Startup_Code::exceptions.c, category=SWSRC
          short-label=examples::S32DS::Siul2_Dio_Ip_Example_S32K312::Project_Settings::Startup_Code::nvic.c, category=SWSRC
          short-label=examples::S32DS::Siul2_Dio_Ip_Example_S32K312::Project_Settings::Startup_Code::startup.c, category=SWSRC
          short-label=examples::S32DS::Siul2_Dio_Ip_Example_S32K312::Project_Settings::Startup_Code::system.c, category=SWSRC
          short-label=examples::S32DS::Siul2_Dio_Ip_Example_S32K312::src::main.c, category=SWSRC
          short-label=examples::S32DS::Siul2_Dio_Ip_Example_S32K342::include::check_example.h, category=SWHDR
          short-label=examples::S32DS::Siul2_Dio_Ip_Example_S32K342::Project_Settings::Startup_Code::exceptions.c, category=SWSRC
          short-label=examples::S32DS::Siul2_Dio_Ip_Example_S32K342::Project_Settings::Startup_Code::nvic.c, category=SWSRC
          short-label=examples::S32DS::Siul2_Dio_Ip_Example_S32K342::Project_Settings::Startup_Code::startup.c, category=SWSRC
          short-label=examples::S32DS::Siul2_Dio_Ip_Example_S32K342::Project_Settings::Startup_Code::system.c, category=SWSRC
          short-label=examples::S32DS::Siul2_Dio_Ip_Example_S32K342::src::main.c, category=SWSRC
          short-label=examples::S32DS::Siul2_Dio_Ip_Example_S32K344::include::check_example.h, category=SWHDR
          short-label=examples::S32DS::Siul2_Dio_Ip_Example_S32K344::Project_Settings::Startup_Code::exceptions.c, category=SWSRC
          short-label=examples::S32DS::Siul2_Dio_Ip_Example_S32K344::Project_Settings::Startup_Code::nvic.c, category=SWSRC
          short-label=examples::S32DS::Siul2_Dio_Ip_Example_S32K344::Project_Settings::Startup_Code::startup.c, category=SWSRC
          short-label=examples::S32DS::Siul2_Dio_Ip_Example_S32K344::Project_Settings::Startup_Code::system.c, category=SWSRC
          short-label=examples::S32DS::Siul2_Dio_Ip_Example_S32K344::src::main.c, category=SWSRC
          short-label=include::Dio.h, category=SWHDR
          short-label=include::Dio_Ipw.h, category=SWHDR
          short-label=include::Siul2_Dio_Ip.h, category=SWHDR
          short-label=src::Dio.c, category=SWSRC
          short-label=src::Dio_Ipw.c, category=SWSRC
          short-label=src::Siul2_Dio_Ip.c, category=SWSRC
    compiler GCC_Compiler:
      name=GCC Compiler
      options=-mcpu=cortex-m7 -mthumb -mlittle-endian -mfpu=fpv5-sp-d16 -mfloat-abi=hard -std=c99 -Os -ggdb3 -Wall -Wextra -pedantic -Wstrict-prototypes -Wundef -Wunused -Werror=implicit-function-declaration -Wsign-compare -Wdouble-promotion -fno-short-enums -funsigned-char -funsigned-bitfields -fomit-frame-pointer -fno-common -fstack-usage -fdump-ipa-all -c -DS32K3XX -DS32K344 -DGCC -DUSE_SW_VECTOR_MODE -DD_CACHE_ENABLE -DI_CACHE_ENABLE -DENABLE_FPU -DMCAL_ENABLE_USER_MODE_SUPPORT
      vendor=GCC Systems
      version=NXP GCC 10.2.0 20200723 (Build 1728 Revision g5963bc8)
    compiler GHS_Compiler:
      name=Green Hills
      options=-cpu=cortexm7 -thumb -fpu=vfpv5_d16 -fsingle -C99 --ghstd=last -Osize --gnu_asm -dual_debug -G -keeptempfiles -Wimplicit-int -Wshadow -Wtrigraphs -Wundef --unsigned_chars --unsigned_fields --no_commons --no_exceptions --no_slash_comment --prototype_errors --incorrect_pragma_warnings -c -DS32K3XX -DS32K344 -DGHS -DUSE_SW_VECTOR_MODE -DD_CACHE_ENABLE -DI_CACHE_ENABLE -DENABLE_FPU -DMCAL_ENABLE_USER_MODE_SUPPORT
      vendor=Green Hills
      version=Green Hills Multi 7.1.6d / Compiler 2021.1.4
    compiler IAR_Compiler:
      name=IAR Compiler
      options=--cpu=Cortex-M7 --cpu_mode=thumb --endian=little --fpu=FPv5-SP -e -Ohz --debug --no_clustering --no_mem_idioms --do_explicit_zero_opt_in_named_sections --require_prototypes --no_wrap_diagnostics --diag_suppress=Pa050 -DS32K3XX -DS32K344 -DIAR -DUSE_SW_VECTOR_MODE -DD_CACHE_ENABLE -DI_CACHE_ENABLE -DENABLE_FPU -DMCAL_ENABLE_USER_MODE_SUPPORT
      vendor=IAR Systems
      version=IAR ANSI C/C++ Compiler v.8.50.10 (safety version)
    generated-artifacts:
      dependency on artifact Dio_Cfg_h: artifact-descriptor={short-label=generate_PC::include::Dio_Cfg.h, category=SWHDR}, usages=COMPILE
      dependency on artifact Siul2_Dio_Ip_Cfg_h: artifact-descriptor={short-label=generate_PC::include::Siul2_Dio_Ip_Cfg.h, category=SWHDR}, usages=COMPILE
      dependency on artifact Dio_Cfg_c: artifact-descriptor={short-label=generate_PC::src::Dio_Cfg.c, category=SWSRC}, usages=COMPILE
    linker GCC_Linker: name=GCC Compiler, options=-Wl,-Map,filename -T linkerfile --entry=Reset_Handler -nostartfiles -mcpu=cortexm7 -mthumb -mfpu=fpv5-sp-d16 -mfloat-abi=hard -mlittle-endian -ggdb3 -lc -lm -lgcc, vendor=GCC Systems, version=NXP GCC 10.2.0 20200723 (Build 1728 Revision g5963bc8)
    linker GHS_Linker: name=Green Hills, options=-e Reset_Handler -T linker_script_file.ld -map -keepmap -Mn -delete -ignore_debug_references -Llibrary_path -larch -lstartup -lind_sd -v -keep=C40_Ip_AccessCode -nostartfiles, vendor=Green Hills, version=Green Hills Multi 7.1.6d / Compiler 2021.1.4
    linker IAR_Linker: name=IAR Compiler, options=--map filename --config linkerfile --cpu=Cortex-M7 --fpu=FPv5-SP --entry _start --enable_stack_usage --skip_dynamic_initialization --no_wrap_diagnostics, vendor=IAR Systems, version=IAR ANSI C/C++ Compiler v.8.50.10 (safety version)
    resource consumption ResourceConsumption
      6 x memory section:
        DIO_CODE: alignment=UNSPECIFIED, sw-addrmethod=CODE, symbol=CODE
        DIO_CONFIG_DATA_UNSPECIFIED: alignment=UNSPECIFIED, sw-addrmethod=CONFIG_DATA, symbol=CONFIG_DATA_UNSPECIFIED
        DIO_CONST_16: alignment=16, sw-addrmethod=CONST, symbol=CONST_16
        DIO_CONST_32: alignment=32, sw-addrmethod=CONST, symbol=CONST_32
        DIO_CONST_8: alignment=8, sw-addrmethod=CONST, symbol=CONST_8
        DIO_VAR_INIT_32: alignment=32, sw-addrmethod=VAR_INIT, symbol=VAR_INIT_32
