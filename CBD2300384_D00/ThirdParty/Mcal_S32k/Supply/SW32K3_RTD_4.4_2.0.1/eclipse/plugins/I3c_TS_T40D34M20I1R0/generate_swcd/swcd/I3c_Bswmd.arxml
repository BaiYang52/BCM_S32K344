AUTOSAR XML (schema 00046)
package /AUTOSAR_I3c/BswModuleDescriptions
  bsw module description I3c: module-id=255
    provided-entrys:
      I3c_AssignDynamicAddress
      I3c_AsyncTransfer
      I3c_DeInit
      I3c_GetDynamicAddressInfo
      I3c_GetError
      I3c_GetStatus
      I3c_GetTransferStatus
      I3c_GetVersionInfo
      I3c_Init
      I3c_MasterGetBaudRate
      I3c_MasterManualIbiResponse
      I3c_MasterSetBaudRate
      I3c_MasterSetIbiOptions
      I3c_PrepareSlaveBuffer
      I3c_PrepareSlaveTransmission
      I3c_SlaveRequestEvent
      I3c_SyncTransfer
      I3c0_Isr
      I3c1_Isr
    bsw internal behavior InternalBehavior_0
      17 x exclusive area:
        I3C_EXCLUSIVE_AREA_{00..16}
      17 x bsw called entity:
        I3c_AssignDynamicAddress: can-enter-exclusive-area=[I3C_EXCLUSIVE_AREA_00, I3C_EXCLUSIVE_AREA_01], implemented-entry=I3c_AssignDynamicAddress
        I3c_AsyncTransfer: can-enter-exclusive-area=[I3C_EXCLUSIVE_AREA_03, I3C_EXCLUSIVE_AREA_03, I3C_EXCLUSIVE_AREA_07, I3C_EXCLUSIVE_AREA_09], implemented-entry=I3c_AsyncTransfer
        I3c_DeInit: implemented-entry=I3c_DeInit
        I3c_GetDynamicAddressInfo: implemented-entry=I3c_GetDynamicAddressInfo
        I3c_GetError: implemented-entry=I3c_GetError
        I3c_GetStatus: implemented-entry=I3c_GetStatus
        I3c_GetTransferStatus: implemented-entry=I3c_GetTransferStatus
        I3c_GetVersionInfo: implemented-entry=I3c_GetVersionInfo
        I3c_Init: can-enter-exclusive-area=[I3C_EXCLUSIVE_AREA_00, I3C_EXCLUSIVE_AREA_01], implemented-entry=I3c_Init
        I3c_MasterGetBaudRate: implemented-entry=I3c_MasterGetBaudRate
        I3c_MasterManualIbiResponse: can-enter-exclusive-area=I3C_EXCLUSIVE_AREA_15, implemented-entry=I3c_MasterManualIbiResponse
        I3c_MasterSetBaudRate: can-enter-exclusive-area=[I3C_EXCLUSIVE_AREA_05, I3C_EXCLUSIVE_AREA_14], implemented-entry=I3c_MasterSetBaudRate
        I3c_MasterSetIbiOptions: implemented-entry=I3c_MasterSetIbiOptions
        I3c_PrepareSlaveBuffer: can-enter-exclusive-area=I3C_EXCLUSIVE_AREA_11, implemented-entry=I3c_PrepareSlaveBuffer
        I3c_PrepareSlaveTransmission: can-enter-exclusive-area=I3C_EXCLUSIVE_AREA_13, implemented-entry=I3c_PrepareSlaveTransmission
        I3c_SlaveRequestEvent: can-enter-exclusive-area=I3C_EXCLUSIVE_AREA_04, implemented-entry=I3c_SlaveRequestEvent
        I3c_SyncTransfer: can-enter-exclusive-area=[I3C_EXCLUSIVE_AREA_02, I3C_EXCLUSIVE_AREA_02, I3C_EXCLUSIVE_AREA_03, I3C_EXCLUSIVE_AREA_03, I3C_EXCLUSIVE_AREA_06, I3C_EXCLUSIVE_AREA_08, I3C_EXCLUSIVE_AREA_16, I3C_EXCLUSIVE_AREA_16], implemented-entry=I3c_SyncTransfer
      bsw interrupt entity I3c0_Isr: can-enter-exclusive-area=[I3C_EXCLUSIVE_AREA_02, I3C_EXCLUSIVE_AREA_16], implemented-entry=I3c0_Isr, interrupt-category=CAT-2, interrupt-source=Hardware
      bsw interrupt entity I3c1_Isr: implemented-entry=I3c1_Isr, interrupt-category=CAT-2, interrupt-source=Hardware
package /AUTOSAR_I3c/BswModuleEntrys
  19 x bsw module entry, all with is-reentrant=false, is-synchronous=true, sw-service-impl-policy=STANDARD:
    I3c_AssignDynamicAddress: service-id=0x07, call-type=REGULAR, execution-context=UNSPECIFIED
    I3c_AsyncTransfer: service-id=0x03, call-type=REGULAR, execution-context=UNSPECIFIED
    I3c_DeInit: service-id=0x01, call-type=REGULAR, execution-context=UNSPECIFIED
    I3c_GetDynamicAddressInfo: service-id=0x09, call-type=REGULAR, execution-context=UNSPECIFIED
    I3c_GetError: service-id=0x08, call-type=REGULAR, execution-context=UNSPECIFIED
    I3c_GetStatus: service-id=0x10, call-type=REGULAR, execution-context=UNSPECIFIED
    I3c_GetTransferStatus: service-id=0x04, call-type=REGULAR, execution-context=UNSPECIFIED
    I3c_GetVersionInfo: service-id=0x06, call-type=REGULAR, execution-context=UNSPECIFIED
    I3c_Init: service-id=0x00, call-type=REGULAR, execution-context=UNSPECIFIED
    I3c_MasterGetBaudRate: service-id=0x0d, call-type=REGULAR, execution-context=UNSPECIFIED
    I3c_MasterManualIbiResponse: service-id=0x0f, call-type=REGULAR, execution-context=UNSPECIFIED
    I3c_MasterSetBaudRate: service-id=0x0c, call-type=REGULAR, execution-context=UNSPECIFIED
    I3c_MasterSetIbiOptions: service-id=0x0e, call-type=REGULAR, execution-context=UNSPECIFIED
    I3c_PrepareSlaveBuffer: service-id=0x05, call-type=REGULAR, execution-context=UNSPECIFIED
    I3c_PrepareSlaveTransmission: service-id=0x0a, call-type=REGULAR, execution-context=UNSPECIFIED
    I3c_SlaveRequestEvent: service-id=0x0b, call-type=REGULAR, execution-context=UNSPECIFIED
    I3c_SyncTransfer: service-id=0x02, call-type=REGULAR, execution-context=UNSPECIFIED
    I3c0_Isr: service-id=0, call-type=INTERRUPT, execution-context=INTERRUPT-CAT-2
    I3c1_Isr: service-id=0, call-type=INTERRUPT, execution-context=INTERRUPT-CAT-2
package /I3c_TS_T40D34M20I1R0/Implementations
  bsw implementation BswImplementation_0: programming-language=C, sw-version=2.0.1, vendor-id=43, ar-release-version=4.4.0, behavior=InternalBehavior_0, vendor-specific-module-def=I3c
    code-descriptors:
      code Files
        artifact-descriptors:
          short-label=config::I3c.xdm, category=SWCFG
          short-label=doc::RTD_I3C_IM.pdf, category=SWDOC
          short-label=doc::RTD_I3C_UM.pdf, category=SWDOC
          short-label=examples::EBT::I3c_I2c_example_S32K312::generate::epc::Base.xdm, category=SWCFG
          short-label=examples::EBT::I3c_I2c_example_S32K312::generate::epc::Dem.xdm, category=SWCFG
          short-label=examples::EBT::I3c_I2c_example_S32K312::generate::epc::EcuC.xdm, category=SWCFG
          short-label=examples::EBT::I3c_I2c_example_S32K312::generate::epc::I2c.xdm, category=SWCFG
          short-label=examples::EBT::I3c_I2c_example_S32K312::generate::epc::I3c.xdm, category=SWCFG
          short-label=examples::EBT::I3c_I2c_example_S32K312::generate::epc::Mcu.xdm, category=SWCFG
          short-label=examples::EBT::I3c_I2c_example_S32K312::generate::epc::Os.xdm, category=SWCFG
          short-label=examples::EBT::I3c_I2c_example_S32K312::generate::epc::Platform.xdm, category=SWCFG
          short-label=examples::EBT::I3c_I2c_example_S32K312::generate::epc::Port.xdm, category=SWCFG
          short-label=examples::EBT::I3c_I2c_example_S32K312::generate::epc::Resource.xdm, category=SWCFG
          short-label=examples::EBT::I3c_I2c_example_S32K312::include::check_example.h, category=SWHDR
          short-label=examples::EBT::I3c_I2c_example_S32K312::src::main.c, category=SWSRC
          short-label=examples::EBT::I3c_I2c_example_S32K312::TresosProject::I3c_I2c_example_S32K312::.prefs::preferences.xdm, category=SWCFG
          short-label=examples::EBT::I3c_I2c_example_S32K312::TresosProject::I3c_I2c_example_S32K312::config::Base.xdm, category=SWCFG
          short-label=examples::EBT::I3c_I2c_example_S32K312::TresosProject::I3c_I2c_example_S32K312::config::Dem.xdm, category=SWCFG
          short-label=examples::EBT::I3c_I2c_example_S32K312::TresosProject::I3c_I2c_example_S32K312::config::EcuC.xdm, category=SWCFG
          short-label=examples::EBT::I3c_I2c_example_S32K312::TresosProject::I3c_I2c_example_S32K312::config::I2c.xdm, category=SWCFG
          short-label=examples::EBT::I3c_I2c_example_S32K312::TresosProject::I3c_I2c_example_S32K312::config::I3c.xdm, category=SWCFG
          short-label=examples::EBT::I3c_I2c_example_S32K312::TresosProject::I3c_I2c_example_S32K312::config::Mcu.xdm, category=SWCFG
          short-label=examples::EBT::I3c_I2c_example_S32K312::TresosProject::I3c_I2c_example_S32K312::config::Os.xdm, category=SWCFG
          short-label=examples::EBT::I3c_I2c_example_S32K312::TresosProject::I3c_I2c_example_S32K312::config::Platform.xdm, category=SWCFG
          short-label=examples::EBT::I3c_I2c_example_S32K312::TresosProject::I3c_I2c_example_S32K312::config::Port.xdm, category=SWCFG
          short-label=examples::EBT::I3c_I2c_example_S32K312::TresosProject::I3c_I2c_example_S32K312::config::Resource.xdm, category=SWCFG
          short-label=examples::EBT::I3c_I2c_example_S32K342::generate::epc::Base.xdm, category=SWCFG
          short-label=examples::EBT::I3c_I2c_example_S32K342::generate::epc::Dem.xdm, category=SWCFG
          short-label=examples::EBT::I3c_I2c_example_S32K342::generate::epc::EcuC.xdm, category=SWCFG
          short-label=examples::EBT::I3c_I2c_example_S32K342::generate::epc::I2c.xdm, category=SWCFG
          short-label=examples::EBT::I3c_I2c_example_S32K342::generate::epc::I3c.xdm, category=SWCFG
          short-label=examples::EBT::I3c_I2c_example_S32K342::generate::epc::Mcu.xdm, category=SWCFG
          short-label=examples::EBT::I3c_I2c_example_S32K342::generate::epc::Os.xdm, category=SWCFG
          short-label=examples::EBT::I3c_I2c_example_S32K342::generate::epc::Platform.xdm, category=SWCFG
          short-label=examples::EBT::I3c_I2c_example_S32K342::generate::epc::Port.xdm, category=SWCFG
          short-label=examples::EBT::I3c_I2c_example_S32K342::generate::epc::Resource.xdm, category=SWCFG
          short-label=examples::EBT::I3c_I2c_example_S32K342::include::check_example.h, category=SWHDR
          short-label=examples::EBT::I3c_I2c_example_S32K342::src::main.c, category=SWSRC
          short-label=examples::EBT::I3c_I2c_example_S32K342::TresosProject::I3c_I2c_example_S32K342::.prefs::preferences.xdm, category=SWCFG
          short-label=examples::EBT::I3c_I2c_example_S32K342::TresosProject::I3c_I2c_example_S32K342::config::Base.xdm, category=SWCFG
          short-label=examples::EBT::I3c_I2c_example_S32K342::TresosProject::I3c_I2c_example_S32K342::config::Dem.xdm, category=SWCFG
          short-label=examples::EBT::I3c_I2c_example_S32K342::TresosProject::I3c_I2c_example_S32K342::config::EcuC.xdm, category=SWCFG
          short-label=examples::EBT::I3c_I2c_example_S32K342::TresosProject::I3c_I2c_example_S32K342::config::I2c.xdm, category=SWCFG
          short-label=examples::EBT::I3c_I2c_example_S32K342::TresosProject::I3c_I2c_example_S32K342::config::I3c.xdm, category=SWCFG
          short-label=examples::EBT::I3c_I2c_example_S32K342::TresosProject::I3c_I2c_example_S32K342::config::Mcu.xdm, category=SWCFG
          short-label=examples::EBT::I3c_I2c_example_S32K342::TresosProject::I3c_I2c_example_S32K342::config::Os.xdm, category=SWCFG
          short-label=examples::EBT::I3c_I2c_example_S32K342::TresosProject::I3c_I2c_example_S32K342::config::Platform.xdm, category=SWCFG
          short-label=examples::EBT::I3c_I2c_example_S32K342::TresosProject::I3c_I2c_example_S32K342::config::Port.xdm, category=SWCFG
          short-label=examples::EBT::I3c_I2c_example_S32K342::TresosProject::I3c_I2c_example_S32K342::config::Resource.xdm, category=SWCFG
          short-label=examples::EBT::I3c_master_SDR_mode_example_S32K312::generate::epc::Base.xdm, category=SWCFG
          short-label=examples::EBT::I3c_master_SDR_mode_example_S32K312::generate::epc::Dem.xdm, category=SWCFG
          short-label=examples::EBT::I3c_master_SDR_mode_example_S32K312::generate::epc::EcuC.xdm, category=SWCFG
          short-label=examples::EBT::I3c_master_SDR_mode_example_S32K312::generate::epc::I3c.xdm, category=SWCFG
          short-label=examples::EBT::I3c_master_SDR_mode_example_S32K312::generate::epc::Mcu.xdm, category=SWCFG
          short-label=examples::EBT::I3c_master_SDR_mode_example_S32K312::generate::epc::Os.xdm, category=SWCFG
          short-label=examples::EBT::I3c_master_SDR_mode_example_S32K312::generate::epc::Platform.xdm, category=SWCFG
          short-label=examples::EBT::I3c_master_SDR_mode_example_S32K312::generate::epc::Port.xdm, category=SWCFG
          short-label=examples::EBT::I3c_master_SDR_mode_example_S32K312::generate::epc::Resource.xdm, category=SWCFG
          short-label=examples::EBT::I3c_master_SDR_mode_example_S32K312::include::check_example.h, category=SWHDR
          short-label=examples::EBT::I3c_master_SDR_mode_example_S32K312::src::main.c, category=SWSRC
          short-label=examples::EBT::I3c_master_SDR_mode_example_S32K312::TresosProject::I3c_master_SDR_mode_example_S32K312::.prefs::preferences.xdm, category=SWCFG
          short-label=examples::EBT::I3c_master_SDR_mode_example_S32K312::TresosProject::I3c_master_SDR_mode_example_S32K312::config::Base.xdm, category=SWCFG
          short-label=examples::EBT::I3c_master_SDR_mode_example_S32K312::TresosProject::I3c_master_SDR_mode_example_S32K312::config::Dem.xdm, category=SWCFG
          short-label=examples::EBT::I3c_master_SDR_mode_example_S32K312::TresosProject::I3c_master_SDR_mode_example_S32K312::config::EcuC.xdm, category=SWCFG
          short-label=examples::EBT::I3c_master_SDR_mode_example_S32K312::TresosProject::I3c_master_SDR_mode_example_S32K312::config::I3c.xdm, category=SWCFG
          short-label=examples::EBT::I3c_master_SDR_mode_example_S32K312::TresosProject::I3c_master_SDR_mode_example_S32K312::config::Mcu.xdm, category=SWCFG
          short-label=examples::EBT::I3c_master_SDR_mode_example_S32K312::TresosProject::I3c_master_SDR_mode_example_S32K312::config::Os.xdm, category=SWCFG
          short-label=examples::EBT::I3c_master_SDR_mode_example_S32K312::TresosProject::I3c_master_SDR_mode_example_S32K312::config::Platform.xdm, category=SWCFG
          short-label=examples::EBT::I3c_master_SDR_mode_example_S32K312::TresosProject::I3c_master_SDR_mode_example_S32K312::config::Port.xdm, category=SWCFG
          short-label=examples::EBT::I3c_master_SDR_mode_example_S32K312::TresosProject::I3c_master_SDR_mode_example_S32K312::config::Resource.xdm, category=SWCFG
          short-label=examples::EBT::I3c_slave_SDR_mode_example_S32K312::generate::epc::Base.xdm, category=SWCFG
          short-label=examples::EBT::I3c_slave_SDR_mode_example_S32K312::generate::epc::Dem.xdm, category=SWCFG
          short-label=examples::EBT::I3c_slave_SDR_mode_example_S32K312::generate::epc::EcuC.xdm, category=SWCFG
          short-label=examples::EBT::I3c_slave_SDR_mode_example_S32K312::generate::epc::I3c.xdm, category=SWCFG
          short-label=examples::EBT::I3c_slave_SDR_mode_example_S32K312::generate::epc::Mcu.xdm, category=SWCFG
          short-label=examples::EBT::I3c_slave_SDR_mode_example_S32K312::generate::epc::Os.xdm, category=SWCFG
          short-label=examples::EBT::I3c_slave_SDR_mode_example_S32K312::generate::epc::Platform.xdm, category=SWCFG
          short-label=examples::EBT::I3c_slave_SDR_mode_example_S32K312::generate::epc::Port.xdm, category=SWCFG
          short-label=examples::EBT::I3c_slave_SDR_mode_example_S32K312::generate::epc::Resource.xdm, category=SWCFG
          short-label=examples::EBT::I3c_slave_SDR_mode_example_S32K312::include::check_example.h, category=SWHDR
          short-label=examples::EBT::I3c_slave_SDR_mode_example_S32K312::src::main.c, category=SWSRC
          short-label=examples::EBT::I3c_slave_SDR_mode_example_S32K312::TresosProject::I3c_slave_SDR_mode_example_S32K312::.prefs::preferences.xdm, category=SWCFG
          short-label=examples::EBT::I3c_slave_SDR_mode_example_S32K312::TresosProject::I3c_slave_SDR_mode_example_S32K312::config::Base.xdm, category=SWCFG
          short-label=examples::EBT::I3c_slave_SDR_mode_example_S32K312::TresosProject::I3c_slave_SDR_mode_example_S32K312::config::Dem.xdm, category=SWCFG
          short-label=examples::EBT::I3c_slave_SDR_mode_example_S32K312::TresosProject::I3c_slave_SDR_mode_example_S32K312::config::EcuC.xdm, category=SWCFG
          short-label=examples::EBT::I3c_slave_SDR_mode_example_S32K312::TresosProject::I3c_slave_SDR_mode_example_S32K312::config::I3c.xdm, category=SWCFG
          short-label=examples::EBT::I3c_slave_SDR_mode_example_S32K312::TresosProject::I3c_slave_SDR_mode_example_S32K312::config::Mcu.xdm, category=SWCFG
          short-label=examples::EBT::I3c_slave_SDR_mode_example_S32K312::TresosProject::I3c_slave_SDR_mode_example_S32K312::config::Os.xdm, category=SWCFG
          short-label=examples::EBT::I3c_slave_SDR_mode_example_S32K312::TresosProject::I3c_slave_SDR_mode_example_S32K312::config::Platform.xdm, category=SWCFG
          short-label=examples::EBT::I3c_slave_SDR_mode_example_S32K312::TresosProject::I3c_slave_SDR_mode_example_S32K312::config::Port.xdm, category=SWCFG
          short-label=examples::EBT::I3c_slave_SDR_mode_example_S32K312::TresosProject::I3c_slave_SDR_mode_example_S32K312::config::Resource.xdm, category=SWCFG
          short-label=examples::S32DS::I3c_I2c_example_S32K312::include::check_example.h, category=SWHDR
          short-label=examples::S32DS::I3c_I2c_example_S32K312::Project_Settings::Startup_Code::exceptions.c, category=SWSRC
          short-label=examples::S32DS::I3c_I2c_example_S32K312::Project_Settings::Startup_Code::nvic.c, category=SWSRC
          short-label=examples::S32DS::I3c_I2c_example_S32K312::Project_Settings::Startup_Code::startup.c, category=SWSRC
          short-label=examples::S32DS::I3c_I2c_example_S32K312::Project_Settings::Startup_Code::system.c, category=SWSRC
          short-label=examples::S32DS::I3c_I2c_example_S32K312::src::main.c, category=SWSRC
          short-label=examples::S32DS::I3c_I2c_example_S32K342::include::check_example.h, category=SWHDR
          short-label=examples::S32DS::I3c_I2c_example_S32K342::Project_Settings::Startup_Code::exceptions.c, category=SWSRC
          short-label=examples::S32DS::I3c_I2c_example_S32K342::Project_Settings::Startup_Code::nvic.c, category=SWSRC
          short-label=examples::S32DS::I3c_I2c_example_S32K342::Project_Settings::Startup_Code::startup.c, category=SWSRC
          short-label=examples::S32DS::I3c_I2c_example_S32K342::Project_Settings::Startup_Code::system.c, category=SWSRC
          short-label=examples::S32DS::I3c_I2c_example_S32K342::src::main.c, category=SWSRC
          short-label=examples::S32DS::I3c_Ip_LpI2c_Ip_example_S32K312::include::check_example.h, category=SWHDR
          short-label=examples::S32DS::I3c_Ip_LpI2c_Ip_example_S32K312::Project_Settings::Startup_Code::exceptions.c, category=SWSRC
          short-label=examples::S32DS::I3c_Ip_LpI2c_Ip_example_S32K312::Project_Settings::Startup_Code::nvic.c, category=SWSRC
          short-label=examples::S32DS::I3c_Ip_LpI2c_Ip_example_S32K312::Project_Settings::Startup_Code::startup.c, category=SWSRC
          short-label=examples::S32DS::I3c_Ip_LpI2c_Ip_example_S32K312::Project_Settings::Startup_Code::system.c, category=SWSRC
          short-label=examples::S32DS::I3c_Ip_LpI2c_Ip_example_S32K312::src::main.c, category=SWSRC
          short-label=examples::S32DS::I3c_Ip_LpI2c_Ip_example_S32K342::include::check_example.h, category=SWHDR
          short-label=examples::S32DS::I3c_Ip_LpI2c_Ip_example_S32K342::Project_Settings::Startup_Code::exceptions.c, category=SWSRC
          short-label=examples::S32DS::I3c_Ip_LpI2c_Ip_example_S32K342::Project_Settings::Startup_Code::nvic.c, category=SWSRC
          short-label=examples::S32DS::I3c_Ip_LpI2c_Ip_example_S32K342::Project_Settings::Startup_Code::startup.c, category=SWSRC
          short-label=examples::S32DS::I3c_Ip_LpI2c_Ip_example_S32K342::Project_Settings::Startup_Code::system.c, category=SWSRC
          short-label=examples::S32DS::I3c_Ip_LpI2c_Ip_example_S32K342::src::main.c, category=SWSRC
          short-label=examples::S32DS::I3c_Ip_master_SDR_mode_example_S32K312::include::check_example.h, category=SWHDR
          short-label=examples::S32DS::I3c_Ip_master_SDR_mode_example_S32K312::Project_Settings::Startup_Code::exceptions.c, category=SWSRC
          short-label=examples::S32DS::I3c_Ip_master_SDR_mode_example_S32K312::Project_Settings::Startup_Code::nvic.c, category=SWSRC
          short-label=examples::S32DS::I3c_Ip_master_SDR_mode_example_S32K312::Project_Settings::Startup_Code::startup.c, category=SWSRC
          short-label=examples::S32DS::I3c_Ip_master_SDR_mode_example_S32K312::Project_Settings::Startup_Code::system.c, category=SWSRC
          short-label=examples::S32DS::I3c_Ip_master_SDR_mode_example_S32K312::src::main.c, category=SWSRC
          short-label=examples::S32DS::I3c_Ip_slave_SDR_mode_example_S32K312::include::check_example.h, category=SWHDR
          short-label=examples::S32DS::I3c_Ip_slave_SDR_mode_example_S32K312::Project_Settings::Startup_Code::exceptions.c, category=SWSRC
          short-label=examples::S32DS::I3c_Ip_slave_SDR_mode_example_S32K312::Project_Settings::Startup_Code::nvic.c, category=SWSRC
          short-label=examples::S32DS::I3c_Ip_slave_SDR_mode_example_S32K312::Project_Settings::Startup_Code::startup.c, category=SWSRC
          short-label=examples::S32DS::I3c_Ip_slave_SDR_mode_example_S32K312::Project_Settings::Startup_Code::system.c, category=SWSRC
          short-label=examples::S32DS::I3c_Ip_slave_SDR_mode_example_S32K312::src::main.c, category=SWSRC
          short-label=examples::S32DS::I3c_master_SDR_mode_example_S32K312::include::check_example.h, category=SWHDR
          short-label=examples::S32DS::I3c_master_SDR_mode_example_S32K312::Project_Settings::Startup_Code::exceptions.c, category=SWSRC
          short-label=examples::S32DS::I3c_master_SDR_mode_example_S32K312::Project_Settings::Startup_Code::nvic.c, category=SWSRC
          short-label=examples::S32DS::I3c_master_SDR_mode_example_S32K312::Project_Settings::Startup_Code::startup.c, category=SWSRC
          short-label=examples::S32DS::I3c_master_SDR_mode_example_S32K312::Project_Settings::Startup_Code::system.c, category=SWSRC
          short-label=examples::S32DS::I3c_master_SDR_mode_example_S32K312::src::main.c, category=SWSRC
          short-label=examples::S32DS::I3c_slave_SDR_mode_example_S32K312::include::check_example.h, category=SWHDR
          short-label=examples::S32DS::I3c_slave_SDR_mode_example_S32K312::Project_Settings::Startup_Code::exceptions.c, category=SWSRC
          short-label=examples::S32DS::I3c_slave_SDR_mode_example_S32K312::Project_Settings::Startup_Code::nvic.c, category=SWSRC
          short-label=examples::S32DS::I3c_slave_SDR_mode_example_S32K312::Project_Settings::Startup_Code::startup.c, category=SWSRC
          short-label=examples::S32DS::I3c_slave_SDR_mode_example_S32K312::Project_Settings::Startup_Code::system.c, category=SWSRC
          short-label=examples::S32DS::I3c_slave_SDR_mode_example_S32K312::src::main.c, category=SWSRC
          short-label=include::CDD_I3c.h, category=SWHDR
          short-label=include::CDD_I3c_Types.h, category=SWHDR
          short-label=include::I3c_Ip.h, category=SWHDR
          short-label=include::I3c_Ip_HwAccess.h, category=SWHDR
          short-label=include::I3c_Ip_Types.h, category=SWHDR
          short-label=src::CDD_I3c.c, category=SWSRC
          short-label=src::I3c_Ip.c, category=SWSRC
          short-label=src::I3c_Ip_Isr.c, category=SWSRC
    compiler GCC_Compiler:
      name=GCC Compiler
      options=-mcpu=cortex-m7 -mthumb -mlittle-endian -mfpu=fpv5-sp-d16 -mfloat-abi=hard -std=c99 -Os -ggdb3 -Wall -Wextra -pedantic -Wstrict-prototypes -Wundef -Wunused -Werror=implicit-function-declaration -Wsign-compare -Wdouble-promotion -fno-short-enums -funsigned-char -funsigned-bitfields -fomit-frame-pointer -fno-common -fstack-usage -fdump-ipa-all -c -DS32K3XX -DS32K344 -DGCC -DUSE_SW_VECTOR_MODE -DD_CACHE_ENABLE -DI_CACHE_ENABLE -DENABLE_FPU -DMCAL_ENABLE_USER_MODE_SUPPORT
      vendor=GCC Systems
      version=NXP GCC 10.2.0 20200723 (Build 1728 Revision g5963bc8)
    compiler GHS_Compiler:
      name=Green Hills
      options=-cpu=cortexm7 -thumb -fpu=vfpv5_d16 -fsingle -C99 --ghstd=last -Osize --gnu_asm -dual_debug -G -keeptempfiles -Wimplicit-int -Wshadow -Wtrigraphs -Wundef --unsigned_chars --unsigned_fields --no_commons --no_exceptions --no_slash_comment --prototype_errors --incorrect_pragma_warnings -c -DS32K3XX -DS32K344 -DGHS -DUSE_SW_VECTOR_MODE -DD_CACHE_ENABLE -DI_CACHE_ENABLE -DENABLE_FPU -DMCAL_ENABLE_USER_MODE_SUPPORT
      vendor=Green Hills
      version=Green Hills Multi 7.1.6d / Compiler 2021.1.4
    compiler IAR_Compiler:
      name=IAR Compiler
      options=--cpu=Cortex-M7 --cpu_mode=thumb --endian=little --fpu=FPv5-SP -e -Ohz --debug --no_clustering --no_mem_idioms --do_explicit_zero_opt_in_named_sections --require_prototypes --no_wrap_diagnostics --diag_suppress=Pa050 -DS32K3XX -DS32K344 -DIAR -DUSE_SW_VECTOR_MODE -DD_CACHE_ENABLE -DI_CACHE_ENABLE -DENABLE_FPU -DMCAL_ENABLE_USER_MODE_SUPPORT
      vendor=IAR Systems
      version=IAR ANSI C/C++ Compiler v.8.50.10 (safety version)
    generated-artifacts:
      9 x dependency on artifact:
        CDD_I3c_PBcfg_h: artifact-descriptor={short-label=generate_PB::include::CDD_I3c_PBcfg.h, category=SWHDR}, usages=EXECUTE
        I3c_Ip_PBcfg_h: artifact-descriptor={short-label=generate_PB::include::I3c_Ip_PBcfg.h, category=SWHDR}, usages=EXECUTE
        CDD_I3c_PBcfg_c: artifact-descriptor={short-label=generate_PB::src::CDD_I3c_PBcfg.c, category=SWSRC}, usages=EXECUTE
        I3c_Ip_PBcfg_c: artifact-descriptor={short-label=generate_PB::src::I3c_Ip_PBcfg.c, category=SWSRC}, usages=EXECUTE
        CDD_I3c_Cfg_h: artifact-descriptor={short-label=generate_PC::include::CDD_I3c_Cfg.h, category=SWHDR}, usages=COMPILE
        CDD_I3c_CfgDefines_h: artifact-descriptor={short-label=generate_PC::include::CDD_I3c_CfgDefines.h, category=SWHDR}, usages=COMPILE
        I3c_Ip_Cfg_h: artifact-descriptor={short-label=generate_PC::include::I3c_Ip_Cfg.h, category=SWHDR}, usages=COMPILE
        I3c_Ip_CfgDefines_h: artifact-descriptor={short-label=generate_PC::include::I3c_Ip_CfgDefines.h, category=SWHDR}, usages=COMPILE
        CDD_I3c_Cfg_c: artifact-descriptor={short-label=generate_PC::src::CDD_I3c_Cfg.c, category=SWSRC}, usages=COMPILE
    linker GCC_Linker: name=GCC Compiler, options=-Wl,-Map,filename -T linkerfile --entry=Reset_Handler -nostartfiles -mcpu=cortexm7 -mthumb -mfpu=fpv5-sp-d16 -mfloat-abi=hard -mlittle-endian -ggdb3 -lc -lm -lgcc, vendor=GCC Systems, version=NXP GCC 10.2.0 20200723 (Build 1728 Revision g5963bc8)
    linker GHS_Linker: name=Green Hills, options=-e Reset_Handler -T linker_script_file.ld -map -keepmap -Mn -delete -ignore_debug_references -Llibrary_path -larch -lstartup -lind_sd -v -keep=C40_Ip_AccessCode -nostartfiles, vendor=Green Hills, version=Green Hills Multi 7.1.6d / Compiler 2021.1.4
    linker IAR_Linker: name=IAR Compiler, options=--map filename --config linkerfile --cpu=Cortex-M7 --fpu=FPv5-SP --entry _start --enable_stack_usage --skip_dynamic_initialization --no_wrap_diagnostics, vendor=IAR Systems, version=IAR ANSI C/C++ Compiler v.8.50.10 (safety version)
    resource consumption ResourceConsumption
      5 x memory section, all with alignment=UNSPECIFIED:
        I3C_CODE: sw-addrmethod=CODE, symbol=CODE
        I3C_CONFIG_DATA_UNSPECIFIED: sw-addrmethod=CONFIG_DATA, symbol=CONFIG_DATA_UNSPECIFIED
        I3C_CONST_UNSPECIFIED: sw-addrmethod=CONST, symbol=CONST_UNSPECIFIED
        I3C_VAR_CLEARED_UNSPECIFIED: sw-addrmethod=VAR_CLEARED, symbol=VAR_CLEARED_UNSPECIFIED
        I3C_VAR_INIT_UNSPECIFIED: sw-addrmethod=VAR_INIT, symbol=VAR_INIT_UNSPECIFIED
