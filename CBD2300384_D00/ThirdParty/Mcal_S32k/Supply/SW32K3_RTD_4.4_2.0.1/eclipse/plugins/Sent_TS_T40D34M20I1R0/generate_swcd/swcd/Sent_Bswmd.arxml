AUTOSAR XML (schema 00046)
package /AUTOSAR_Sent/BswModuleDescriptions
  bsw module description Sent: module-id=125
    provided-entrys:
      Sent_DeInit
      Sent_GetFastChannelMsgData
      Sent_GetFastMsgData
      Sent_GetSerialChannelMsgData
      Sent_GetSerialMsgData
      Sent_GetVersionInfo
      Sent_Init
    bsw internal behavior InternalBehavior_0
      7 x bsw called entity:
        Sent_DeInit: implemented-entry=Sent_DeInit
        Sent_GetFastChannelMsgData: implemented-entry=Sent_GetFastChannelMsgData
        Sent_GetFastMsgData: implemented-entry=Sent_GetFastMsgData
        Sent_GetSerialChannelMsgData: implemented-entry=Sent_GetSerialChannelMsgData
        Sent_GetSerialMsgData: implemented-entry=Sent_GetSerialMsgData
        Sent_GetVersionInfo: implemented-entry=Sent_GetVersionInfo
        Sent_Init: implemented-entry=Sent_Init
package /AUTOSAR_Sent/BswModuleEntrys
  7 x bsw module entry, all with is-synchronous=true, call-type=REGULAR, execution-context=UNSPECIFIED, sw-service-impl-policy=STANDARD:
    Sent_DeInit: service-id=0x01, is-reentrant=false
    Sent_GetFastChannelMsgData: service-id=0x03, is-reentrant=false
    Sent_GetFastMsgData: service-id=0x05, is-reentrant=false
    Sent_GetSerialChannelMsgData: service-id=0x04, is-reentrant=false
    Sent_GetSerialMsgData: service-id=0x06, is-reentrant=false
    Sent_GetVersionInfo: service-id=0x07, is-reentrant=true
    Sent_Init: service-id=0x02, is-reentrant=false
package /Sent_TS_T40D34M20I1R0/Implementations
  bsw implementation BswImplementation_0: programming-language=C, sw-version=2.0.1, vendor-id=43, ar-release-version=4.4.0, behavior=InternalBehavior_0, vendor-specific-module-def=Sent
    code-descriptors:
      code Files
        artifact-descriptors:
          short-label=config::Sent.xdm, category=SWCFG
          short-label=doc::RTD_SENT_IM.pdf, category=SWDOC
          short-label=doc::RTD_SENT_UM.pdf, category=SWDOC
          short-label=examples::EBT::Sent_Receiver_S32K312::generate::epc::Base.xdm, category=SWCFG
          short-label=examples::EBT::Sent_Receiver_S32K312::generate::epc::EcuC.xdm, category=SWCFG
          short-label=examples::EBT::Sent_Receiver_S32K312::generate::epc::Mcl.xdm, category=SWCFG
          short-label=examples::EBT::Sent_Receiver_S32K312::generate::epc::Mcu.xdm, category=SWCFG
          short-label=examples::EBT::Sent_Receiver_S32K312::generate::epc::Os.xdm, category=SWCFG
          short-label=examples::EBT::Sent_Receiver_S32K312::generate::epc::Port.xdm, category=SWCFG
          short-label=examples::EBT::Sent_Receiver_S32K312::generate::epc::Resource.xdm, category=SWCFG
          short-label=examples::EBT::Sent_Receiver_S32K312::generate::epc::Sent.xdm, category=SWCFG
          short-label=examples::EBT::Sent_Receiver_S32K312::include::check_example.h, category=SWHDR
          short-label=examples::EBT::Sent_Receiver_S32K312::src::main.c, category=SWSRC
          short-label=examples::EBT::Sent_Receiver_S32K312::TresosProject::Sent_Receiver_S32K312::.prefs::preferences.xdm, category=SWCFG
          short-label=examples::EBT::Sent_Receiver_S32K312::TresosProject::Sent_Receiver_S32K312::config::Base.xdm, category=SWCFG
          short-label=examples::EBT::Sent_Receiver_S32K312::TresosProject::Sent_Receiver_S32K312::config::EcuC.xdm, category=SWCFG
          short-label=examples::EBT::Sent_Receiver_S32K312::TresosProject::Sent_Receiver_S32K312::config::Mcl.xdm, category=SWCFG
          short-label=examples::EBT::Sent_Receiver_S32K312::TresosProject::Sent_Receiver_S32K312::config::Mcu.xdm, category=SWCFG
          short-label=examples::EBT::Sent_Receiver_S32K312::TresosProject::Sent_Receiver_S32K312::config::Os.xdm, category=SWCFG
          short-label=examples::EBT::Sent_Receiver_S32K312::TresosProject::Sent_Receiver_S32K312::config::Port.xdm, category=SWCFG
          short-label=examples::EBT::Sent_Receiver_S32K312::TresosProject::Sent_Receiver_S32K312::config::Resource.xdm, category=SWCFG
          short-label=examples::EBT::Sent_Receiver_S32K312::TresosProject::Sent_Receiver_S32K312::config::Sent.xdm, category=SWCFG
          short-label=examples::EBT::Sent_Receiver_S32K342::generate::epc::Base.xdm, category=SWCFG
          short-label=examples::EBT::Sent_Receiver_S32K342::generate::epc::EcuC.xdm, category=SWCFG
          short-label=examples::EBT::Sent_Receiver_S32K342::generate::epc::Mcl.xdm, category=SWCFG
          short-label=examples::EBT::Sent_Receiver_S32K342::generate::epc::Mcu.xdm, category=SWCFG
          short-label=examples::EBT::Sent_Receiver_S32K342::generate::epc::Os.xdm, category=SWCFG
          short-label=examples::EBT::Sent_Receiver_S32K342::generate::epc::Port.xdm, category=SWCFG
          short-label=examples::EBT::Sent_Receiver_S32K342::generate::epc::Resource.xdm, category=SWCFG
          short-label=examples::EBT::Sent_Receiver_S32K342::generate::epc::Sent.xdm, category=SWCFG
          short-label=examples::EBT::Sent_Receiver_S32K342::include::check_example.h, category=SWHDR
          short-label=examples::EBT::Sent_Receiver_S32K342::src::main.c, category=SWSRC
          short-label=examples::EBT::Sent_Receiver_S32K342::TresosProject::Sent_Receiver_S32K342::.prefs::preferences.xdm, category=SWCFG
          short-label=examples::EBT::Sent_Receiver_S32K342::TresosProject::Sent_Receiver_S32K342::config::Base.xdm, category=SWCFG
          short-label=examples::EBT::Sent_Receiver_S32K342::TresosProject::Sent_Receiver_S32K342::config::EcuC.xdm, category=SWCFG
          short-label=examples::EBT::Sent_Receiver_S32K342::TresosProject::Sent_Receiver_S32K342::config::Mcl.xdm, category=SWCFG
          short-label=examples::EBT::Sent_Receiver_S32K342::TresosProject::Sent_Receiver_S32K342::config::Mcu.xdm, category=SWCFG
          short-label=examples::EBT::Sent_Receiver_S32K342::TresosProject::Sent_Receiver_S32K342::config::Os.xdm, category=SWCFG
          short-label=examples::EBT::Sent_Receiver_S32K342::TresosProject::Sent_Receiver_S32K342::config::Port.xdm, category=SWCFG
          short-label=examples::EBT::Sent_Receiver_S32K342::TresosProject::Sent_Receiver_S32K342::config::Resource.xdm, category=SWCFG
          short-label=examples::EBT::Sent_Receiver_S32K342::TresosProject::Sent_Receiver_S32K342::config::Sent.xdm, category=SWCFG
          short-label=examples::EBT::Sent_Receiver_S32K344::generate::epc::Base.xdm, category=SWCFG
          short-label=examples::EBT::Sent_Receiver_S32K344::generate::epc::EcuC.xdm, category=SWCFG
          short-label=examples::EBT::Sent_Receiver_S32K344::generate::epc::Mcl.xdm, category=SWCFG
          short-label=examples::EBT::Sent_Receiver_S32K344::generate::epc::Mcu.xdm, category=SWCFG
          short-label=examples::EBT::Sent_Receiver_S32K344::generate::epc::Os.xdm, category=SWCFG
          short-label=examples::EBT::Sent_Receiver_S32K344::generate::epc::Port.xdm, category=SWCFG
          short-label=examples::EBT::Sent_Receiver_S32K344::generate::epc::Resource.xdm, category=SWCFG
          short-label=examples::EBT::Sent_Receiver_S32K344::generate::epc::Sent.xdm, category=SWCFG
          short-label=examples::EBT::Sent_Receiver_S32K344::include::check_example.h, category=SWHDR
          short-label=examples::EBT::Sent_Receiver_S32K344::src::main.c, category=SWSRC
          short-label=examples::EBT::Sent_Receiver_S32K344::TresosProject::Sent_Receiver_S32K344::.prefs::preferences.xdm, category=SWCFG
          short-label=examples::EBT::Sent_Receiver_S32K344::TresosProject::Sent_Receiver_S32K344::config::Base.xdm, category=SWCFG
          short-label=examples::EBT::Sent_Receiver_S32K344::TresosProject::Sent_Receiver_S32K344::config::EcuC.xdm, category=SWCFG
          short-label=examples::EBT::Sent_Receiver_S32K344::TresosProject::Sent_Receiver_S32K344::config::Mcl.xdm, category=SWCFG
          short-label=examples::EBT::Sent_Receiver_S32K344::TresosProject::Sent_Receiver_S32K344::config::Mcu.xdm, category=SWCFG
          short-label=examples::EBT::Sent_Receiver_S32K344::TresosProject::Sent_Receiver_S32K344::config::Os.xdm, category=SWCFG
          short-label=examples::EBT::Sent_Receiver_S32K344::TresosProject::Sent_Receiver_S32K344::config::Port.xdm, category=SWCFG
          short-label=examples::EBT::Sent_Receiver_S32K344::TresosProject::Sent_Receiver_S32K344::config::Resource.xdm, category=SWCFG
          short-label=examples::EBT::Sent_Receiver_S32K344::TresosProject::Sent_Receiver_S32K344::config::Sent.xdm, category=SWCFG
          short-label=examples::S32DS::Flexio_Sent_Ip_Receiver_S32K312::include::check_example.h, category=SWHDR
          short-label=examples::S32DS::Flexio_Sent_Ip_Receiver_S32K312::Project_Settings::Startup_Code::exceptions.c, category=SWSRC
          short-label=examples::S32DS::Flexio_Sent_Ip_Receiver_S32K312::Project_Settings::Startup_Code::nvic.c, category=SWSRC
          short-label=examples::S32DS::Flexio_Sent_Ip_Receiver_S32K312::Project_Settings::Startup_Code::startup.c, category=SWSRC
          short-label=examples::S32DS::Flexio_Sent_Ip_Receiver_S32K312::Project_Settings::Startup_Code::system.c, category=SWSRC
          short-label=examples::S32DS::Flexio_Sent_Ip_Receiver_S32K312::src::main.c, category=SWSRC
          short-label=examples::S32DS::Flexio_Sent_Ip_Receiver_S32K342::include::check_example.h, category=SWHDR
          short-label=examples::S32DS::Flexio_Sent_Ip_Receiver_S32K342::Project_Settings::Startup_Code::exceptions.c, category=SWSRC
          short-label=examples::S32DS::Flexio_Sent_Ip_Receiver_S32K342::Project_Settings::Startup_Code::nvic.c, category=SWSRC
          short-label=examples::S32DS::Flexio_Sent_Ip_Receiver_S32K342::Project_Settings::Startup_Code::startup.c, category=SWSRC
          short-label=examples::S32DS::Flexio_Sent_Ip_Receiver_S32K342::Project_Settings::Startup_Code::system.c, category=SWSRC
          short-label=examples::S32DS::Flexio_Sent_Ip_Receiver_S32K342::src::main.c, category=SWSRC
          short-label=examples::S32DS::Flexio_Sent_Ip_Receiver_S32K344::include::check_example.h, category=SWHDR
          short-label=examples::S32DS::Flexio_Sent_Ip_Receiver_S32K344::Project_Settings::Startup_Code::exceptions.c, category=SWSRC
          short-label=examples::S32DS::Flexio_Sent_Ip_Receiver_S32K344::Project_Settings::Startup_Code::nvic.c, category=SWSRC
          short-label=examples::S32DS::Flexio_Sent_Ip_Receiver_S32K344::Project_Settings::Startup_Code::startup.c, category=SWSRC
          short-label=examples::S32DS::Flexio_Sent_Ip_Receiver_S32K344::Project_Settings::Startup_Code::system.c, category=SWSRC
          short-label=examples::S32DS::Flexio_Sent_Ip_Receiver_S32K344::src::main.c, category=SWSRC
          short-label=examples::S32DS::Sent_Receiver_S32K312::include::check_example.h, category=SWHDR
          short-label=examples::S32DS::Sent_Receiver_S32K312::Project_Settings::Startup_Code::exceptions.c, category=SWSRC
          short-label=examples::S32DS::Sent_Receiver_S32K312::Project_Settings::Startup_Code::nvic.c, category=SWSRC
          short-label=examples::S32DS::Sent_Receiver_S32K312::Project_Settings::Startup_Code::startup.c, category=SWSRC
          short-label=examples::S32DS::Sent_Receiver_S32K312::Project_Settings::Startup_Code::system.c, category=SWSRC
          short-label=examples::S32DS::Sent_Receiver_S32K312::src::main.c, category=SWSRC
          short-label=examples::S32DS::Sent_Receiver_S32K342::include::check_example.h, category=SWHDR
          short-label=examples::S32DS::Sent_Receiver_S32K342::Project_Settings::Startup_Code::exceptions.c, category=SWSRC
          short-label=examples::S32DS::Sent_Receiver_S32K342::Project_Settings::Startup_Code::nvic.c, category=SWSRC
          short-label=examples::S32DS::Sent_Receiver_S32K342::Project_Settings::Startup_Code::startup.c, category=SWSRC
          short-label=examples::S32DS::Sent_Receiver_S32K342::Project_Settings::Startup_Code::system.c, category=SWSRC
          short-label=examples::S32DS::Sent_Receiver_S32K342::src::main.c, category=SWSRC
          short-label=examples::S32DS::Sent_Receiver_S32K344::include::check_example.h, category=SWHDR
          short-label=examples::S32DS::Sent_Receiver_S32K344::Project_Settings::Startup_Code::exceptions.c, category=SWSRC
          short-label=examples::S32DS::Sent_Receiver_S32K344::Project_Settings::Startup_Code::nvic.c, category=SWSRC
          short-label=examples::S32DS::Sent_Receiver_S32K344::Project_Settings::Startup_Code::startup.c, category=SWSRC
          short-label=examples::S32DS::Sent_Receiver_S32K344::Project_Settings::Startup_Code::system.c, category=SWSRC
          short-label=examples::S32DS::Sent_Receiver_S32K344::src::main.c, category=SWSRC
          short-label=include::CDD_Sent.h, category=SWHDR
          short-label=include::Flexio_Sent_Ip.h, category=SWHDR
          short-label=include::Flexio_Sent_Ip_HwAccess.h, category=SWHDR
          short-label=include::Flexio_Sent_Ip_Irq.h, category=SWHDR
          short-label=include::Flexio_Sent_Ip_Types.h, category=SWHDR
          short-label=include::Sent_Ipw.h, category=SWHDR
          short-label=include::Sent_Ipw_Types.h, category=SWHDR
          short-label=include::Sent_Types.h, category=SWHDR
          short-label=src::CDD_Sent.c, category=SWSRC
          short-label=src::Flexio_Sent_Ip.c, category=SWSRC
          short-label=src::Flexio_Sent_Ip_Irq.c, category=SWSRC
          short-label=src::Sent_Ipw.c, category=SWSRC
    compiler GCC_Compiler:
      name=GCC Compiler
      options=-mcpu=cortex-m7 -mthumb -mlittle-endian -mfpu=fpv5-sp-d16 -mfloat-abi=hard -std=c99 -Os -ggdb3 -Wall -Wextra -pedantic -Wstrict-prototypes -Wundef -Wunused -Werror=implicit-function-declaration -Wsign-compare -Wdouble-promotion -fno-short-enums -funsigned-char -funsigned-bitfields -fomit-frame-pointer -fno-common -fstack-usage -fdump-ipa-all -c -DS32K3XX -DS32K344 -DGCC -DUSE_SW_VECTOR_MODE -DD_CACHE_ENABLE -DI_CACHE_ENABLE -DENABLE_FPU -DMCAL_ENABLE_USER_MODE_SUPPORT
      vendor=GCC Systems
      version=NXP GCC 10.2.0 20200723 (Build 1728 Revision g5963bc8)
    compiler GHS_Compiler:
      name=Green Hills
      options=-cpu=cortexm7 -thumb -fpu=vfpv5_d16 -fsingle -C99 --ghstd=last -Osize --gnu_asm -dual_debug -G -keeptempfiles -Wimplicit-int -Wshadow -Wtrigraphs -Wundef --unsigned_chars --unsigned_fields --no_commons --no_exceptions --no_slash_comment --prototype_errors --incorrect_pragma_warnings -c -DS32K3XX -DS32K344 -DGHS -DUSE_SW_VECTOR_MODE -DD_CACHE_ENABLE -DI_CACHE_ENABLE -DENABLE_FPU -DMCAL_ENABLE_USER_MODE_SUPPORT
      vendor=Green Hills
      version=Green Hills Multi 7.1.6d / Compiler 2021.1.4
    compiler IAR_Compiler:
      name=IAR Compiler
      options=--cpu=Cortex-M7 --cpu_mode=thumb --endian=little --fpu=FPv5-SP -e -Ohz --debug --no_clustering --no_mem_idioms --do_explicit_zero_opt_in_named_sections --require_prototypes --no_wrap_diagnostics --diag_suppress=Pa050 -DS32K3XX -DS32K344 -DIAR -DUSE_SW_VECTOR_MODE -DD_CACHE_ENABLE -DI_CACHE_ENABLE -DENABLE_FPU -DMCAL_ENABLE_USER_MODE_SUPPORT
      vendor=IAR Systems
      version=IAR ANSI C/C++ Compiler v.8.50.10 (safety version)
    generated-artifacts:
      13 x dependency on artifact:
        Flexio_Sent_Ip_PBcfg_h: artifact-descriptor={short-label=generate_PB::include::Flexio_Sent_Ip_PBcfg.h, category=SWHDR}, usages=EXECUTE
        Sent_Ipw_PBcfg_h: artifact-descriptor={short-label=generate_PB::include::Sent_Ipw_PBcfg.h, category=SWHDR}, usages=EXECUTE
        Sent_PBcfg_h: artifact-descriptor={short-label=generate_PB::include::Sent_PBcfg.h, category=SWHDR}, usages=EXECUTE
        Flexio_Sent_Ip_PBcfg_c: artifact-descriptor={short-label=generate_PB::src::Flexio_Sent_Ip_PBcfg.c, category=SWSRC}, usages=EXECUTE
        Sent_Ipw_PBcfg_c: artifact-descriptor={short-label=generate_PB::src::Sent_Ipw_PBcfg.c, category=SWSRC}, usages=EXECUTE
        Sent_PBcfg_c: artifact-descriptor={short-label=generate_PB::src::Sent_PBcfg.c, category=SWSRC}, usages=EXECUTE
        Flexio_Sent_Ip_Cfg_h: artifact-descriptor={short-label=generate_PC::include::Flexio_Sent_Ip_Cfg.h, category=SWHDR}, usages=COMPILE
        Flexio_Sent_Ip_CfgDefines_h: artifact-descriptor={short-label=generate_PC::include::Flexio_Sent_Ip_CfgDefines.h, category=SWHDR}, usages=COMPILE
        Flexio_Sent_Ip_Defines_h: artifact-descriptor={short-label=generate_PC::include::Flexio_Sent_Ip_Defines.h, category=SWHDR}, usages=COMPILE
        Sent_Cfg_h: artifact-descriptor={short-label=generate_PC::include::Sent_Cfg.h, category=SWHDR}, usages=COMPILE
        Sent_Ipw_Cfg_h: artifact-descriptor={short-label=generate_PC::include::Sent_Ipw_Cfg.h, category=SWHDR}, usages=COMPILE
        Flexio_Sent_Ip_Cfg_c: artifact-descriptor={short-label=generate_PC::src::Flexio_Sent_Ip_Cfg.c, category=SWSRC}, usages=COMPILE
        Sent_Ipw_Cfg_c: artifact-descriptor={short-label=generate_PC::src::Sent_Ipw_Cfg.c, category=SWSRC}, usages=COMPILE
    linker GCC_Linker: name=GCC Compiler, options=-Wl,-Map,filename -T linkerfile --entry=Reset_Handler -nostartfiles -mcpu=cortexm7 -mthumb -mfpu=fpv5-sp-d16 -mfloat-abi=hard -mlittle-endian -ggdb3 -lc -lm -lgcc, vendor=GCC Systems, version=NXP GCC 10.2.0 20200723 (Build 1728 Revision g5963bc8)
    linker GHS_Linker: name=Green Hills, options=-e Reset_Handler -T linker_script_file.ld -map -keepmap -Mn -delete -ignore_debug_references -Llibrary_path -larch -lstartup -lind_sd -v -keep=C40_Ip_AccessCode -nostartfiles, vendor=Green Hills, version=Green Hills Multi 7.1.6d / Compiler 2021.1.4
    linker IAR_Linker: name=IAR Compiler, options=--map filename --config linkerfile --cpu=Cortex-M7 --fpu=FPv5-SP --entry _start --enable_stack_usage --skip_dynamic_initialization --no_wrap_diagnostics, vendor=IAR Systems, version=IAR ANSI C/C++ Compiler v.8.50.10 (safety version)
    resource consumption ResourceConsumption
      9 x memory section:
        SENT_CODE: alignment=UNSPECIFIED, sw-addrmethod=CODE, symbol=CODE
        SENT_CONFIG_DATA_UNSPECIFIED: alignment=UNSPECIFIED, sw-addrmethod=CONFIG_DATA, symbol=CONFIG_DATA_UNSPECIFIED
        SENT_CONST_UNSPECIFIED: alignment=UNSPECIFIED, sw-addrmethod=CONST, symbol=CONST_UNSPECIFIED
        SENT_VAR_CLEARED_32: alignment=32, sw-addrmethod=VAR_CLEARED, symbol=VAR_CLEARED_32
        SENT_VAR_CLEARED_32_NO_CACHEABLE: alignment=UNSPECIFIED, sw-addrmethod=VAR_CLEARED_32_NO, symbol=VAR_CLEARED_32_NO_CACHEABLE
        SENT_VAR_CLEARED_8: alignment=8, sw-addrmethod=VAR_CLEARED, symbol=VAR_CLEARED_8
        SENT_VAR_CLEARED_UNSPECIFIED: alignment=UNSPECIFIED, sw-addrmethod=VAR_CLEARED, symbol=VAR_CLEARED_UNSPECIFIED
        SENT_VAR_CLEARED_UNSPECIFIED_NO_CACHEABLE: alignment=UNSPECIFIED, sw-addrmethod=VAR_CLEARED_UNSPECIFIED_NO, symbol=VAR_CLEARED_UNSPECIFIED_NO_CACHEABLE
        SENT_VAR_INIT_UNSPECIFIED: alignment=UNSPECIFIED, sw-addrmethod=VAR_INIT, symbol=VAR_INIT_UNSPECIFIED
