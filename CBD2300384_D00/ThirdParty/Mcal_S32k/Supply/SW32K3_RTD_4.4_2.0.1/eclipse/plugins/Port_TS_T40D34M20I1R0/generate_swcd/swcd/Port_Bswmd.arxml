AUTOSAR XML (schema 00046)
package /AUTOSAR_Port/BswModuleDescriptions
  bsw module description Port: module-id=124
    provided-entrys:
      Port_GetVersionInfo
      Port_Init
      Port_RefreshPortDirection
      Port_ResetPinMode
      Port_Set2PinsDirection
      Port_SetAsUnusedPin
      Port_SetAsUsedPin
      Port_SetPinDirection
      Port_SetPinMode
    bsw internal behavior InternalBehavior_0
      5 x exclusive area:
        PORT_EXCLUSIVE_AREA_00
        PORT_EXCLUSIVE_AREA_{05..08}
      9 x bsw called entity:
        Port_GetVersionInfo: implemented-entry=Port_GetVersionInfo
        Port_Init: implemented-entry=Port_Init
        Port_RefreshPortDirection: can-enter-exclusive-area=PORT_EXCLUSIVE_AREA_07, implemented-entry=Port_RefreshPortDirection
        Port_ResetPinMode: can-enter-exclusive-area=PORT_EXCLUSIVE_AREA_08, implemented-entry=Port_ResetPinMode
        Port_Set2PinsDirection: implemented-entry=Port_Set2PinsDirection
        Port_SetAsUnusedPin: implemented-entry=Port_SetAsUnusedPin
        Port_SetAsUsedPin: implemented-entry=Port_SetAsUsedPin
        Port_SetPinDirection: can-enter-exclusive-area=PORT_EXCLUSIVE_AREA_05, implemented-entry=Port_SetPinDirection
        Port_SetPinMode: can-enter-exclusive-area=[PORT_EXCLUSIVE_AREA_00, PORT_EXCLUSIVE_AREA_06], implemented-entry=Port_SetPinMode
package /AUTOSAR_Port/BswModuleEntrys
  9 x bsw module entry, all with is-synchronous=true, call-type=REGULAR, execution-context=UNSPECIFIED, sw-service-impl-policy=STANDARD:
    Port_GetVersionInfo: service-id=0x03, is-reentrant=true
    Port_Init: service-id=0x00, is-reentrant=false
    Port_RefreshPortDirection: service-id=0x02, is-reentrant=false
    Port_ResetPinMode: service-id=0x07, is-reentrant=false
    Port_Set2PinsDirection: service-id=0x08, is-reentrant=false
    Port_SetAsUnusedPin: service-id=0x05, is-reentrant=false
    Port_SetAsUsedPin: service-id=0x06, is-reentrant=false
    Port_SetPinDirection: service-id=0x01, is-reentrant=true
    Port_SetPinMode: service-id=0x04, is-reentrant=true
package /Port_TS_T40D34M20I1R0/Implementations
  bsw implementation BswImplementation_0: programming-language=C, sw-version=2.0.1, vendor-id=43, ar-release-version=4.4.0, behavior=InternalBehavior_0, recommended-configuration=Port, vendor-specific-module-def=Port
    code-descriptors:
      code Files
        artifact-descriptors:
          short-label=config::Port.xdm, category=SWCFG
          short-label=config_ext::PortRecConfiguration_JtagPins.xdm, category=SWCFG
          short-label=doc::RTD_PORT_IM.pdf, category=SWDOC
          short-label=doc::RTD_PORT_UM.pdf, category=SWDOC
          short-label=examples::EBT::Port_Example_S32K312::generate::epc::Base.xdm, category=SWCFG
          short-label=examples::EBT::Port_Example_S32K312::generate::epc::Dem.xdm, category=SWCFG
          short-label=examples::EBT::Port_Example_S32K312::generate::epc::Dio.xdm, category=SWCFG
          short-label=examples::EBT::Port_Example_S32K312::generate::epc::Mcu.xdm, category=SWCFG
          short-label=examples::EBT::Port_Example_S32K312::generate::epc::Os.xdm, category=SWCFG
          short-label=examples::EBT::Port_Example_S32K312::generate::epc::Platform.xdm, category=SWCFG
          short-label=examples::EBT::Port_Example_S32K312::generate::epc::Port.xdm, category=SWCFG
          short-label=examples::EBT::Port_Example_S32K312::generate::epc::Resource.xdm, category=SWCFG
          short-label=examples::EBT::Port_Example_S32K312::include::check_example.h, category=SWHDR
          short-label=examples::EBT::Port_Example_S32K312::src::main.c, category=SWSRC
          short-label=examples::EBT::Port_Example_S32K312::TresosProject::Port_Example_S32K312::.prefs::preferences.xdm, category=SWCFG
          short-label=examples::EBT::Port_Example_S32K312::TresosProject::Port_Example_S32K312::config::Base.xdm, category=SWCFG
          short-label=examples::EBT::Port_Example_S32K312::TresosProject::Port_Example_S32K312::config::Dem.xdm, category=SWCFG
          short-label=examples::EBT::Port_Example_S32K312::TresosProject::Port_Example_S32K312::config::Dio.xdm, category=SWCFG
          short-label=examples::EBT::Port_Example_S32K312::TresosProject::Port_Example_S32K312::config::EcuC.xdm, category=SWCFG
          short-label=examples::EBT::Port_Example_S32K312::TresosProject::Port_Example_S32K312::config::Mcu.xdm, category=SWCFG
          short-label=examples::EBT::Port_Example_S32K312::TresosProject::Port_Example_S32K312::config::Os.xdm, category=SWCFG
          short-label=examples::EBT::Port_Example_S32K312::TresosProject::Port_Example_S32K312::config::Platform.xdm, category=SWCFG
          short-label=examples::EBT::Port_Example_S32K312::TresosProject::Port_Example_S32K312::config::Port.xdm, category=SWCFG
          short-label=examples::EBT::Port_Example_S32K312::TresosProject::Port_Example_S32K312::config::Resource.xdm, category=SWCFG
          short-label=examples::EBT::Port_Example_S32K342::generate::epc::Base.xdm, category=SWCFG
          short-label=examples::EBT::Port_Example_S32K342::generate::epc::Dem.xdm, category=SWCFG
          short-label=examples::EBT::Port_Example_S32K342::generate::epc::Dio.xdm, category=SWCFG
          short-label=examples::EBT::Port_Example_S32K342::generate::epc::Mcu.xdm, category=SWCFG
          short-label=examples::EBT::Port_Example_S32K342::generate::epc::Os.xdm, category=SWCFG
          short-label=examples::EBT::Port_Example_S32K342::generate::epc::Platform.xdm, category=SWCFG
          short-label=examples::EBT::Port_Example_S32K342::generate::epc::Port.xdm, category=SWCFG
          short-label=examples::EBT::Port_Example_S32K342::generate::epc::Resource.xdm, category=SWCFG
          short-label=examples::EBT::Port_Example_S32K342::include::check_example.h, category=SWHDR
          short-label=examples::EBT::Port_Example_S32K342::src::main.c, category=SWSRC
          short-label=examples::EBT::Port_Example_S32K342::TresosProject::Port_Example_S32K342::.prefs::preferences.xdm, category=SWCFG
          short-label=examples::EBT::Port_Example_S32K342::TresosProject::Port_Example_S32K342::config::Base.xdm, category=SWCFG
          short-label=examples::EBT::Port_Example_S32K342::TresosProject::Port_Example_S32K342::config::Dem.xdm, category=SWCFG
          short-label=examples::EBT::Port_Example_S32K342::TresosProject::Port_Example_S32K342::config::Dio.xdm, category=SWCFG
          short-label=examples::EBT::Port_Example_S32K342::TresosProject::Port_Example_S32K342::config::EcuC.xdm, category=SWCFG
          short-label=examples::EBT::Port_Example_S32K342::TresosProject::Port_Example_S32K342::config::Mcu.xdm, category=SWCFG
          short-label=examples::EBT::Port_Example_S32K342::TresosProject::Port_Example_S32K342::config::Os.xdm, category=SWCFG
          short-label=examples::EBT::Port_Example_S32K342::TresosProject::Port_Example_S32K342::config::Platform.xdm, category=SWCFG
          short-label=examples::EBT::Port_Example_S32K342::TresosProject::Port_Example_S32K342::config::Port.xdm, category=SWCFG
          short-label=examples::EBT::Port_Example_S32K342::TresosProject::Port_Example_S32K342::config::Resource.xdm, category=SWCFG
          short-label=examples::EBT::Port_Example_S32K344::generate::epc::Base.xdm, category=SWCFG
          short-label=examples::EBT::Port_Example_S32K344::generate::epc::Dem.xdm, category=SWCFG
          short-label=examples::EBT::Port_Example_S32K344::generate::epc::Dio.xdm, category=SWCFG
          short-label=examples::EBT::Port_Example_S32K344::generate::epc::Mcu.xdm, category=SWCFG
          short-label=examples::EBT::Port_Example_S32K344::generate::epc::Os.xdm, category=SWCFG
          short-label=examples::EBT::Port_Example_S32K344::generate::epc::Platform.xdm, category=SWCFG
          short-label=examples::EBT::Port_Example_S32K344::generate::epc::Port.xdm, category=SWCFG
          short-label=examples::EBT::Port_Example_S32K344::generate::epc::Resource.xdm, category=SWCFG
          short-label=examples::EBT::Port_Example_S32K344::include::check_example.h, category=SWHDR
          short-label=examples::EBT::Port_Example_S32K344::src::main.c, category=SWSRC
          short-label=examples::EBT::Port_Example_S32K344::TresosProject::Port_Example_S32K344::.prefs::preferences.xdm, category=SWCFG
          short-label=examples::EBT::Port_Example_S32K344::TresosProject::Port_Example_S32K344::config::Base.xdm, category=SWCFG
          short-label=examples::EBT::Port_Example_S32K344::TresosProject::Port_Example_S32K344::config::Dem.xdm, category=SWCFG
          short-label=examples::EBT::Port_Example_S32K344::TresosProject::Port_Example_S32K344::config::Dio.xdm, category=SWCFG
          short-label=examples::EBT::Port_Example_S32K344::TresosProject::Port_Example_S32K344::config::EcuC.xdm, category=SWCFG
          short-label=examples::EBT::Port_Example_S32K344::TresosProject::Port_Example_S32K344::config::Mcu.xdm, category=SWCFG
          short-label=examples::EBT::Port_Example_S32K344::TresosProject::Port_Example_S32K344::config::Os.xdm, category=SWCFG
          short-label=examples::EBT::Port_Example_S32K344::TresosProject::Port_Example_S32K344::config::Platform.xdm, category=SWCFG
          short-label=examples::EBT::Port_Example_S32K344::TresosProject::Port_Example_S32K344::config::Port.xdm, category=SWCFG
          short-label=examples::EBT::Port_Example_S32K344::TresosProject::Port_Example_S32K344::config::Resource.xdm, category=SWCFG
          short-label=examples::S32DS::Port_Example_S32K312::include::check_example.h, category=SWHDR
          short-label=examples::S32DS::Port_Example_S32K312::Project_Settings::Startup_Code::exceptions.c, category=SWSRC
          short-label=examples::S32DS::Port_Example_S32K312::Project_Settings::Startup_Code::nvic.c, category=SWSRC
          short-label=examples::S32DS::Port_Example_S32K312::Project_Settings::Startup_Code::startup.c, category=SWSRC
          short-label=examples::S32DS::Port_Example_S32K312::Project_Settings::Startup_Code::system.c, category=SWSRC
          short-label=examples::S32DS::Port_Example_S32K312::src::main.c, category=SWSRC
          short-label=examples::S32DS::Port_Example_S32K342::include::check_example.h, category=SWHDR
          short-label=examples::S32DS::Port_Example_S32K342::Project_Settings::Startup_Code::exceptions.c, category=SWSRC
          short-label=examples::S32DS::Port_Example_S32K342::Project_Settings::Startup_Code::nvic.c, category=SWSRC
          short-label=examples::S32DS::Port_Example_S32K342::Project_Settings::Startup_Code::startup.c, category=SWSRC
          short-label=examples::S32DS::Port_Example_S32K342::Project_Settings::Startup_Code::system.c, category=SWSRC
          short-label=examples::S32DS::Port_Example_S32K342::src::main.c, category=SWSRC
          short-label=examples::S32DS::Port_Example_S32K344::include::check_example.h, category=SWHDR
          short-label=examples::S32DS::Port_Example_S32K344::Project_Settings::Startup_Code::exceptions.c, category=SWSRC
          short-label=examples::S32DS::Port_Example_S32K344::Project_Settings::Startup_Code::nvic.c, category=SWSRC
          short-label=examples::S32DS::Port_Example_S32K344::Project_Settings::Startup_Code::startup.c, category=SWSRC
          short-label=examples::S32DS::Port_Example_S32K344::Project_Settings::Startup_Code::system.c, category=SWSRC
          short-label=examples::S32DS::Port_Example_S32K344::src::main.c, category=SWSRC
          short-label=examples::S32DS::Siul2_Port_Ip_Example_S32K312::include::check_example.h, category=SWHDR
          short-label=examples::S32DS::Siul2_Port_Ip_Example_S32K312::Project_Settings::Startup_Code::exceptions.c, category=SWSRC
          short-label=examples::S32DS::Siul2_Port_Ip_Example_S32K312::Project_Settings::Startup_Code::nvic.c, category=SWSRC
          short-label=examples::S32DS::Siul2_Port_Ip_Example_S32K312::Project_Settings::Startup_Code::startup.c, category=SWSRC
          short-label=examples::S32DS::Siul2_Port_Ip_Example_S32K312::Project_Settings::Startup_Code::system.c, category=SWSRC
          short-label=examples::S32DS::Siul2_Port_Ip_Example_S32K312::src::main.c, category=SWSRC
          short-label=examples::S32DS::Siul2_Port_Ip_Example_S32K342::include::check_example.h, category=SWHDR
          short-label=examples::S32DS::Siul2_Port_Ip_Example_S32K342::Project_Settings::Startup_Code::exceptions.c, category=SWSRC
          short-label=examples::S32DS::Siul2_Port_Ip_Example_S32K342::Project_Settings::Startup_Code::nvic.c, category=SWSRC
          short-label=examples::S32DS::Siul2_Port_Ip_Example_S32K342::Project_Settings::Startup_Code::startup.c, category=SWSRC
          short-label=examples::S32DS::Siul2_Port_Ip_Example_S32K342::Project_Settings::Startup_Code::system.c, category=SWSRC
          short-label=examples::S32DS::Siul2_Port_Ip_Example_S32K342::src::main.c, category=SWSRC
          short-label=examples::S32DS::Siul2_Port_Ip_Example_S32K344::include::check_example.h, category=SWHDR
          short-label=examples::S32DS::Siul2_Port_Ip_Example_S32K344::Project_Settings::Startup_Code::exceptions.c, category=SWSRC
          short-label=examples::S32DS::Siul2_Port_Ip_Example_S32K344::Project_Settings::Startup_Code::nvic.c, category=SWSRC
          short-label=examples::S32DS::Siul2_Port_Ip_Example_S32K344::Project_Settings::Startup_Code::startup.c, category=SWSRC
          short-label=examples::S32DS::Siul2_Port_Ip_Example_S32K344::Project_Settings::Startup_Code::system.c, category=SWSRC
          short-label=examples::S32DS::Siul2_Port_Ip_Example_S32K344::src::main.c, category=SWSRC
          short-label=include::Port.h, category=SWHDR
          short-label=include::Port_Ipw.h, category=SWHDR
          short-label=include::Siul2_Port_Ip.h, category=SWHDR
          short-label=include::Siul2_Port_Ip_TrustedFunctions.h, category=SWHDR
          short-label=include::Siul2_Port_Ip_Types.h, category=SWHDR
          short-label=include::Tspc_Port_Ip.h, category=SWHDR
          short-label=include::Tspc_Port_Ip_Types.h, category=SWHDR
          short-label=src::Port.c, category=SWSRC
          short-label=src::Port_Ipw.c, category=SWSRC
          short-label=src::Siul2_Port_Ip.c, category=SWSRC
          short-label=src::Tspc_Port_Ip.c, category=SWSRC
    compiler GCC_Compiler:
      name=GCC Compiler
      options=-mcpu=cortex-m7 -mthumb -mlittle-endian -mfpu=fpv5-sp-d16 -mfloat-abi=hard -std=c99 -Os -ggdb3 -Wall -Wextra -pedantic -Wstrict-prototypes -Wundef -Wunused -Werror=implicit-function-declaration -Wsign-compare -Wdouble-promotion -fno-short-enums -funsigned-char -funsigned-bitfields -fomit-frame-pointer -fno-common -fstack-usage -fdump-ipa-all -c -DS32K3XX -DS32K344 -DGCC -DUSE_SW_VECTOR_MODE -DD_CACHE_ENABLE -DI_CACHE_ENABLE -DENABLE_FPU -DMCAL_ENABLE_USER_MODE_SUPPORT
      vendor=GCC Systems
      version=NXP GCC 10.2.0 20200723 (Build 1728 Revision g5963bc8)
    compiler GHS_Compiler:
      name=Green Hills
      options=-cpu=cortexm7 -thumb -fpu=vfpv5_d16 -fsingle -C99 --ghstd=last -Osize --gnu_asm -dual_debug -G -keeptempfiles -Wimplicit-int -Wshadow -Wtrigraphs -Wundef --unsigned_chars --unsigned_fields --no_commons --no_exceptions --no_slash_comment --prototype_errors --incorrect_pragma_warnings -c -DS32K3XX -DS32K344 -DGHS -DUSE_SW_VECTOR_MODE -DD_CACHE_ENABLE -DI_CACHE_ENABLE -DENABLE_FPU -DMCAL_ENABLE_USER_MODE_SUPPORT
      vendor=Green Hills
      version=Green Hills Multi 7.1.6d / Compiler 2021.1.4
    compiler IAR_Compiler:
      name=IAR Compiler
      options=--cpu=Cortex-M7 --cpu_mode=thumb --endian=little --fpu=FPv5-SP -e -Ohz --debug --no_clustering --no_mem_idioms --do_explicit_zero_opt_in_named_sections --require_prototypes --no_wrap_diagnostics --diag_suppress=Pa050 -DS32K3XX -DS32K344 -DIAR -DUSE_SW_VECTOR_MODE -DD_CACHE_ENABLE -DI_CACHE_ENABLE -DENABLE_FPU -DMCAL_ENABLE_USER_MODE_SUPPORT
      vendor=IAR Systems
      version=IAR ANSI C/C++ Compiler v.8.50.10 (safety version)
    generated-artifacts:
      11 x dependency on artifact:
        Port_PBcfg_h: artifact-descriptor={short-label=generate_PB::include::Port_PBcfg.h, category=SWHDR}, usages=EXECUTE
        Siul2_Port_Ip_PBcfg_h: artifact-descriptor={short-label=generate_PB::include::Siul2_Port_Ip_PBcfg.h, category=SWHDR}, usages=EXECUTE
        Tspc_Port_Ip_PBcfg_h: artifact-descriptor={short-label=generate_PB::include::Tspc_Port_Ip_PBcfg.h, category=SWHDR}, usages=EXECUTE
        Port_PBcfg_c: artifact-descriptor={short-label=generate_PB::src::Port_PBcfg.c, category=SWSRC}, usages=EXECUTE
        Siul2_Port_Ip_PBcfg_c: artifact-descriptor={short-label=generate_PB::src::Siul2_Port_Ip_PBcfg.c, category=SWSRC}, usages=EXECUTE
        Tspc_Port_Ip_PBcfg_c: artifact-descriptor={short-label=generate_PB::src::Tspc_Port_Ip_PBcfg.c, category=SWSRC}, usages=EXECUTE
        Port_Cfg_h: artifact-descriptor={short-label=generate_PC::include::Port_Cfg.h, category=SWHDR}, usages=COMPILE
        Siul2_Port_Ip_Cfg_h: artifact-descriptor={short-label=generate_PC::include::Siul2_Port_Ip_Cfg.h, category=SWHDR}, usages=COMPILE
        Siul2_Port_Ip_Defines_h: artifact-descriptor={short-label=generate_PC::include::Siul2_Port_Ip_Defines.h, category=SWHDR}, usages=COMPILE
        Tspc_Port_Ip_Cfg_h: artifact-descriptor={short-label=generate_PC::include::Tspc_Port_Ip_Cfg.h, category=SWHDR}, usages=COMPILE
        Port_Cfg_c: artifact-descriptor={short-label=generate_PC::src::Port_Cfg.c, category=SWSRC}, usages=COMPILE
    linker GCC_Linker: name=GCC Compiler, options=-Wl,-Map,filename -T linkerfile --entry=Reset_Handler -nostartfiles -mcpu=cortexm7 -mthumb -mfpu=fpv5-sp-d16 -mfloat-abi=hard -mlittle-endian -ggdb3 -lc -lm -lgcc, vendor=GCC Systems, version=NXP GCC 10.2.0 20200723 (Build 1728 Revision g5963bc8)
    linker GHS_Linker: name=Green Hills, options=-e Reset_Handler -T linker_script_file.ld -map -keepmap -Mn -delete -ignore_debug_references -Llibrary_path -larch -lstartup -lind_sd -v -keep=C40_Ip_AccessCode -nostartfiles, vendor=Green Hills, version=Green Hills Multi 7.1.6d / Compiler 2021.1.4
    linker IAR_Linker: name=IAR Compiler, options=--map filename --config linkerfile --cpu=Cortex-M7 --fpu=FPv5-SP --entry _start --enable_stack_usage --skip_dynamic_initialization --no_wrap_diagnostics, vendor=IAR Systems, version=IAR ANSI C/C++ Compiler v.8.50.10 (safety version)
    resource consumption ResourceConsumption
      12 x memory section:
        PORT_CODE: alignment=UNSPECIFIED, sw-addrmethod=CODE, symbol=CODE
        PORT_CONFIG_DATA_16: alignment=16, sw-addrmethod=CONFIG_DATA, symbol=CONFIG_DATA_16
        PORT_CONFIG_DATA_32: alignment=32, sw-addrmethod=CONFIG_DATA, symbol=CONFIG_DATA_32
        PORT_CONFIG_DATA_8: alignment=8, sw-addrmethod=CONFIG_DATA, symbol=CONFIG_DATA_8
        PORT_CONFIG_DATA_UNSPECIFIED: alignment=UNSPECIFIED, sw-addrmethod=CONFIG_DATA, symbol=CONFIG_DATA_UNSPECIFIED
        PORT_CONST_16: alignment=16, sw-addrmethod=CONST, symbol=CONST_16
        PORT_CONST_32: alignment=32, sw-addrmethod=CONST, symbol=CONST_32
        PORT_CONST_UNSPECIFIED: alignment=UNSPECIFIED, sw-addrmethod=CONST, symbol=CONST_UNSPECIFIED
        PORT_VAR_CLEARED_16_NO_CACHEABLE: alignment=UNSPECIFIED, sw-addrmethod=VAR_CLEARED_16_NO, symbol=VAR_CLEARED_16_NO_CACHEABLE
        PORT_VAR_CLEARED_32: alignment=32, sw-addrmethod=VAR_CLEARED, symbol=VAR_CLEARED_32
        PORT_VAR_CLEARED_UNSPECIFIED: alignment=UNSPECIFIED, sw-addrmethod=VAR_CLEARED, symbol=VAR_CLEARED_UNSPECIFIED
        PORT_VAR_CLEARED_UNSPECIFIED_NO_CACHEABLE: alignment=UNSPECIFIED, sw-addrmethod=VAR_CLEARED_UNSPECIFIED_NO, symbol=VAR_CLEARED_UNSPECIFIED_NO_CACHEABLE
