AUTOSAR XML (schema 00046)
package /AUTOSAR_I2s/BswModuleDescriptions
  bsw module description I2s: module-id=255
    provided-entrys:
      I2s_AsyncTransmit
      I2s_DeInit
      I2s_GetStatus
      I2s_GetVersionInfo
      I2s_Init
      I2s_SyncTransmit
      SAI0_IRQHandler
      SAI1_IRQHandler
    bsw internal behavior InternalBehavior_0
      14 x exclusive area:
        I2S_EXCLUSIVE_AREA_{00..04}
        I2S_EXCLUSIVE_AREA_{06..09}
        I2S_EXCLUSIVE_AREA_12
        I2S_EXCLUSIVE_AREA_13
        I2S_EXCLUSIVE_AREA_{15..17}
      6 x bsw called entity:
        I2s_AsyncTransmit: can-enter-exclusive-area=[I2S_EXCLUSIVE_AREA_00, I2S_EXCLUSIVE_AREA_01, I2S_EXCLUSIVE_AREA_02, I2S_EXCLUSIVE_AREA_03, I2S_EXCLUSIVE_AREA_04, I2S_EXCLUSIVE_AREA_06, I2S_EXCLUSIVE_AREA_07, I2S_EXCLUSIVE_AREA_08, I2S_EXCLUSIVE_AREA_09, I2S_EXCLUSIVE_AREA_12, I2S_EXCLUSIVE_AREA_13, I2S_EXCLUSIVE_AREA_15, I2S_EXCLUSIVE_AREA_16, I2S_EXCLUSIVE_AREA_17], implemented-entry=I2s_AsyncTransmit
        I2s_DeInit: implemented-entry=I2s_DeInit
        I2s_GetStatus: implemented-entry=I2s_GetStatus
        I2s_GetVersionInfo: implemented-entry=I2s_GetVersionInfo
        I2s_Init: implemented-entry=I2s_Init
        I2s_SyncTransmit: can-enter-exclusive-area=[I2S_EXCLUSIVE_AREA_00, I2S_EXCLUSIVE_AREA_01, I2S_EXCLUSIVE_AREA_02, I2S_EXCLUSIVE_AREA_03, I2S_EXCLUSIVE_AREA_04, I2S_EXCLUSIVE_AREA_06, I2S_EXCLUSIVE_AREA_07, I2S_EXCLUSIVE_AREA_08, I2S_EXCLUSIVE_AREA_09, I2S_EXCLUSIVE_AREA_12, I2S_EXCLUSIVE_AREA_13, I2S_EXCLUSIVE_AREA_15, I2S_EXCLUSIVE_AREA_16, I2S_EXCLUSIVE_AREA_17], implemented-entry=I2s_SyncTransmit
      bsw interrupt entity SAI0_IRQHandler: implemented-entry=SAI0_IRQHandler, interrupt-category=CAT-2, interrupt-source=Hardware
      bsw interrupt entity SAI1_IRQHandler: implemented-entry=SAI1_IRQHandler, interrupt-category=CAT-2, interrupt-source=Hardware
package /AUTOSAR_I2s/BswModuleEntrys
  8 x bsw module entry, all with is-reentrant=false, is-synchronous=true, sw-service-impl-policy=STANDARD:
    I2s_AsyncTransmit: service-id=0x03, call-type=REGULAR, execution-context=UNSPECIFIED
    I2s_DeInit: service-id=0x01, call-type=REGULAR, execution-context=UNSPECIFIED
    I2s_GetStatus: service-id=0x04, call-type=REGULAR, execution-context=UNSPECIFIED
    I2s_GetVersionInfo: service-id=0x06, call-type=REGULAR, execution-context=UNSPECIFIED
    I2s_Init: service-id=0x00, call-type=REGULAR, execution-context=UNSPECIFIED
    I2s_SyncTransmit: service-id=0x02, call-type=REGULAR, execution-context=UNSPECIFIED
    SAI0_IRQHandler: service-id=0, call-type=INTERRUPT, execution-context=INTERRUPT-CAT-2
    SAI1_IRQHandler: service-id=0, call-type=INTERRUPT, execution-context=INTERRUPT-CAT-2
package /I2s_TS_T40D34M20I1R0/Implementations
  bsw implementation BswImplementation_0: programming-language=C, sw-version=2.0.1, vendor-id=43, ar-release-version=4.4.0, behavior=InternalBehavior_0, vendor-specific-module-def=I2s
    code-descriptors:
      code Files
        artifact-descriptors:
          short-label=config::I2s.xdm, category=SWCFG
          short-label=doc::RTD_I2S_IM.pdf, category=SWDOC
          short-label=doc::RTD_I2S_UM.pdf, category=SWDOC
          short-label=examples::EBT::I2s_Flexio_example_S32K312::generate::epc::Base.xdm, category=SWCFG
          short-label=examples::EBT::I2s_Flexio_example_S32K312::generate::epc::Dem.xdm, category=SWCFG
          short-label=examples::EBT::I2s_Flexio_example_S32K312::generate::epc::EcuC.xdm, category=SWCFG
          short-label=examples::EBT::I2s_Flexio_example_S32K312::generate::epc::I2s.xdm, category=SWCFG
          short-label=examples::EBT::I2s_Flexio_example_S32K312::generate::epc::Mcl.xdm, category=SWCFG
          short-label=examples::EBT::I2s_Flexio_example_S32K312::generate::epc::Mcu.xdm, category=SWCFG
          short-label=examples::EBT::I2s_Flexio_example_S32K312::generate::epc::Platform.xdm, category=SWCFG
          short-label=examples::EBT::I2s_Flexio_example_S32K312::generate::epc::Port.xdm, category=SWCFG
          short-label=examples::EBT::I2s_Flexio_example_S32K312::generate::epc::Resource.xdm, category=SWCFG
          short-label=examples::EBT::I2s_Flexio_example_S32K312::include::check_example.h, category=SWHDR
          short-label=examples::EBT::I2s_Flexio_example_S32K312::src::main.c, category=SWSRC
          short-label=examples::EBT::I2s_Flexio_example_S32K312::TresosProject::I2s_Flexio_example_S32K312::.prefs::preferences.xdm, category=SWCFG
          short-label=examples::EBT::I2s_Flexio_example_S32K312::TresosProject::I2s_Flexio_example_S32K312::config::Base.xdm, category=SWCFG
          short-label=examples::EBT::I2s_Flexio_example_S32K312::TresosProject::I2s_Flexio_example_S32K312::config::Dem.xdm, category=SWCFG
          short-label=examples::EBT::I2s_Flexio_example_S32K312::TresosProject::I2s_Flexio_example_S32K312::config::EcuC.xdm, category=SWCFG
          short-label=examples::EBT::I2s_Flexio_example_S32K312::TresosProject::I2s_Flexio_example_S32K312::config::I2s.xdm, category=SWCFG
          short-label=examples::EBT::I2s_Flexio_example_S32K312::TresosProject::I2s_Flexio_example_S32K312::config::Mcl.xdm, category=SWCFG
          short-label=examples::EBT::I2s_Flexio_example_S32K312::TresosProject::I2s_Flexio_example_S32K312::config::Mcu.xdm, category=SWCFG
          short-label=examples::EBT::I2s_Flexio_example_S32K312::TresosProject::I2s_Flexio_example_S32K312::config::Platform.xdm, category=SWCFG
          short-label=examples::EBT::I2s_Flexio_example_S32K312::TresosProject::I2s_Flexio_example_S32K312::config::Port.xdm, category=SWCFG
          short-label=examples::EBT::I2s_Flexio_example_S32K312::TresosProject::I2s_Flexio_example_S32K312::config::Resource.xdm, category=SWCFG
          short-label=examples::EBT::I2s_Flexio_example_S32K342::generate::epc::Base.xdm, category=SWCFG
          short-label=examples::EBT::I2s_Flexio_example_S32K342::generate::epc::Dem.xdm, category=SWCFG
          short-label=examples::EBT::I2s_Flexio_example_S32K342::generate::epc::EcuC.xdm, category=SWCFG
          short-label=examples::EBT::I2s_Flexio_example_S32K342::generate::epc::I2s.xdm, category=SWCFG
          short-label=examples::EBT::I2s_Flexio_example_S32K342::generate::epc::Mcl.xdm, category=SWCFG
          short-label=examples::EBT::I2s_Flexio_example_S32K342::generate::epc::Mcu.xdm, category=SWCFG
          short-label=examples::EBT::I2s_Flexio_example_S32K342::generate::epc::Platform.xdm, category=SWCFG
          short-label=examples::EBT::I2s_Flexio_example_S32K342::generate::epc::Port.xdm, category=SWCFG
          short-label=examples::EBT::I2s_Flexio_example_S32K342::generate::epc::Resource.xdm, category=SWCFG
          short-label=examples::EBT::I2s_Flexio_example_S32K342::include::check_example.h, category=SWHDR
          short-label=examples::EBT::I2s_Flexio_example_S32K342::src::main.c, category=SWSRC
          short-label=examples::EBT::I2s_Flexio_example_S32K342::TresosProject::I2s_Flexio_example_S32K342::.prefs::preferences.xdm, category=SWCFG
          short-label=examples::EBT::I2s_Flexio_example_S32K342::TresosProject::I2s_Flexio_example_S32K342::config::Base.xdm, category=SWCFG
          short-label=examples::EBT::I2s_Flexio_example_S32K342::TresosProject::I2s_Flexio_example_S32K342::config::Dem.xdm, category=SWCFG
          short-label=examples::EBT::I2s_Flexio_example_S32K342::TresosProject::I2s_Flexio_example_S32K342::config::EcuC.xdm, category=SWCFG
          short-label=examples::EBT::I2s_Flexio_example_S32K342::TresosProject::I2s_Flexio_example_S32K342::config::I2s.xdm, category=SWCFG
          short-label=examples::EBT::I2s_Flexio_example_S32K342::TresosProject::I2s_Flexio_example_S32K342::config::Mcl.xdm, category=SWCFG
          short-label=examples::EBT::I2s_Flexio_example_S32K342::TresosProject::I2s_Flexio_example_S32K342::config::Mcu.xdm, category=SWCFG
          short-label=examples::EBT::I2s_Flexio_example_S32K342::TresosProject::I2s_Flexio_example_S32K342::config::Platform.xdm, category=SWCFG
          short-label=examples::EBT::I2s_Flexio_example_S32K342::TresosProject::I2s_Flexio_example_S32K342::config::Port.xdm, category=SWCFG
          short-label=examples::EBT::I2s_Flexio_example_S32K342::TresosProject::I2s_Flexio_example_S32K342::config::Resource.xdm, category=SWCFG
          short-label=examples::EBT::I2s_Flexio_example_S32K344::generate::epc::Base.xdm, category=SWCFG
          short-label=examples::EBT::I2s_Flexio_example_S32K344::generate::epc::Dem.xdm, category=SWCFG
          short-label=examples::EBT::I2s_Flexio_example_S32K344::generate::epc::EcuC.xdm, category=SWCFG
          short-label=examples::EBT::I2s_Flexio_example_S32K344::generate::epc::I2s.xdm, category=SWCFG
          short-label=examples::EBT::I2s_Flexio_example_S32K344::generate::epc::Mcl.xdm, category=SWCFG
          short-label=examples::EBT::I2s_Flexio_example_S32K344::generate::epc::Mcu.xdm, category=SWCFG
          short-label=examples::EBT::I2s_Flexio_example_S32K344::generate::epc::Platform.xdm, category=SWCFG
          short-label=examples::EBT::I2s_Flexio_example_S32K344::generate::epc::Port.xdm, category=SWCFG
          short-label=examples::EBT::I2s_Flexio_example_S32K344::generate::epc::Resource.xdm, category=SWCFG
          short-label=examples::EBT::I2s_Flexio_example_S32K344::include::check_example.h, category=SWHDR
          short-label=examples::EBT::I2s_Flexio_example_S32K344::src::main.c, category=SWSRC
          short-label=examples::EBT::I2s_Flexio_example_S32K344::TresosProject::I2s_Flexio_example_S32K344::.prefs::preferences.xdm, category=SWCFG
          short-label=examples::EBT::I2s_Flexio_example_S32K344::TresosProject::I2s_Flexio_example_S32K344::config::Base.xdm, category=SWCFG
          short-label=examples::EBT::I2s_Flexio_example_S32K344::TresosProject::I2s_Flexio_example_S32K344::config::Dem.xdm, category=SWCFG
          short-label=examples::EBT::I2s_Flexio_example_S32K344::TresosProject::I2s_Flexio_example_S32K344::config::EcuC.xdm, category=SWCFG
          short-label=examples::EBT::I2s_Flexio_example_S32K344::TresosProject::I2s_Flexio_example_S32K344::config::I2s.xdm, category=SWCFG
          short-label=examples::EBT::I2s_Flexio_example_S32K344::TresosProject::I2s_Flexio_example_S32K344::config::Mcl.xdm, category=SWCFG
          short-label=examples::EBT::I2s_Flexio_example_S32K344::TresosProject::I2s_Flexio_example_S32K344::config::Mcu.xdm, category=SWCFG
          short-label=examples::EBT::I2s_Flexio_example_S32K344::TresosProject::I2s_Flexio_example_S32K344::config::Platform.xdm, category=SWCFG
          short-label=examples::EBT::I2s_Flexio_example_S32K344::TresosProject::I2s_Flexio_example_S32K344::config::Port.xdm, category=SWCFG
          short-label=examples::EBT::I2s_Flexio_example_S32K344::TresosProject::I2s_Flexio_example_S32K344::config::Resource.xdm, category=SWCFG
          short-label=examples::EBT::I2s_Sai_example_S32K342::generate::epc::Base.xdm, category=SWCFG
          short-label=examples::EBT::I2s_Sai_example_S32K342::generate::epc::Dem.xdm, category=SWCFG
          short-label=examples::EBT::I2s_Sai_example_S32K342::generate::epc::EcuC.xdm, category=SWCFG
          short-label=examples::EBT::I2s_Sai_example_S32K342::generate::epc::I2s.xdm, category=SWCFG
          short-label=examples::EBT::I2s_Sai_example_S32K342::generate::epc::Mcu.xdm, category=SWCFG
          short-label=examples::EBT::I2s_Sai_example_S32K342::generate::epc::Platform.xdm, category=SWCFG
          short-label=examples::EBT::I2s_Sai_example_S32K342::generate::epc::Port.xdm, category=SWCFG
          short-label=examples::EBT::I2s_Sai_example_S32K342::generate::epc::Resource.xdm, category=SWCFG
          short-label=examples::EBT::I2s_Sai_example_S32K342::include::check_example.h, category=SWHDR
          short-label=examples::EBT::I2s_Sai_example_S32K342::src::main.c, category=SWSRC
          short-label=examples::EBT::I2s_Sai_example_S32K342::TresosProject::I2s_Sai_example_S32K342::.prefs::preferences.xdm, category=SWCFG
          short-label=examples::EBT::I2s_Sai_example_S32K342::TresosProject::I2s_Sai_example_S32K342::config::Base.xdm, category=SWCFG
          short-label=examples::EBT::I2s_Sai_example_S32K342::TresosProject::I2s_Sai_example_S32K342::config::Dem.xdm, category=SWCFG
          short-label=examples::EBT::I2s_Sai_example_S32K342::TresosProject::I2s_Sai_example_S32K342::config::EcuC.xdm, category=SWCFG
          short-label=examples::EBT::I2s_Sai_example_S32K342::TresosProject::I2s_Sai_example_S32K342::config::I2s.xdm, category=SWCFG
          short-label=examples::EBT::I2s_Sai_example_S32K342::TresosProject::I2s_Sai_example_S32K342::config::Mcu.xdm, category=SWCFG
          short-label=examples::EBT::I2s_Sai_example_S32K342::TresosProject::I2s_Sai_example_S32K342::config::Platform.xdm, category=SWCFG
          short-label=examples::EBT::I2s_Sai_example_S32K342::TresosProject::I2s_Sai_example_S32K342::config::Port.xdm, category=SWCFG
          short-label=examples::EBT::I2s_Sai_example_S32K342::TresosProject::I2s_Sai_example_S32K342::config::Resource.xdm, category=SWCFG
          short-label=examples::EBT::I2s_Sai_example_S32K344::generate::epc::Base.xdm, category=SWCFG
          short-label=examples::EBT::I2s_Sai_example_S32K344::generate::epc::Dem.xdm, category=SWCFG
          short-label=examples::EBT::I2s_Sai_example_S32K344::generate::epc::EcuC.xdm, category=SWCFG
          short-label=examples::EBT::I2s_Sai_example_S32K344::generate::epc::I2s.xdm, category=SWCFG
          short-label=examples::EBT::I2s_Sai_example_S32K344::generate::epc::Mcu.xdm, category=SWCFG
          short-label=examples::EBT::I2s_Sai_example_S32K344::generate::epc::Platform.xdm, category=SWCFG
          short-label=examples::EBT::I2s_Sai_example_S32K344::generate::epc::Port.xdm, category=SWCFG
          short-label=examples::EBT::I2s_Sai_example_S32K344::generate::epc::Resource.xdm, category=SWCFG
          short-label=examples::EBT::I2s_Sai_example_S32K344::include::check_example.h, category=SWHDR
          short-label=examples::EBT::I2s_Sai_example_S32K344::src::main.c, category=SWSRC
          short-label=examples::EBT::I2s_Sai_example_S32K344::TresosProject::I2s_Sai_example_S32K344::.prefs::preferences.xdm, category=SWCFG
          short-label=examples::EBT::I2s_Sai_example_S32K344::TresosProject::I2s_Sai_example_S32K344::config::Base.xdm, category=SWCFG
          short-label=examples::EBT::I2s_Sai_example_S32K344::TresosProject::I2s_Sai_example_S32K344::config::Dem.xdm, category=SWCFG
          short-label=examples::EBT::I2s_Sai_example_S32K344::TresosProject::I2s_Sai_example_S32K344::config::EcuC.xdm, category=SWCFG
          short-label=examples::EBT::I2s_Sai_example_S32K344::TresosProject::I2s_Sai_example_S32K344::config::I2s.xdm, category=SWCFG
          short-label=examples::EBT::I2s_Sai_example_S32K344::TresosProject::I2s_Sai_example_S32K344::config::Mcu.xdm, category=SWCFG
          short-label=examples::EBT::I2s_Sai_example_S32K344::TresosProject::I2s_Sai_example_S32K344::config::Platform.xdm, category=SWCFG
          short-label=examples::EBT::I2s_Sai_example_S32K344::TresosProject::I2s_Sai_example_S32K344::config::Port.xdm, category=SWCFG
          short-label=examples::EBT::I2s_Sai_example_S32K344::TresosProject::I2s_Sai_example_S32K344::config::Resource.xdm, category=SWCFG
          short-label=examples::S32DS::Flexio_I2s_Ip_example_S32K312::include::check_example.h, category=SWHDR
          short-label=examples::S32DS::Flexio_I2s_Ip_example_S32K312::Project_Settings::Startup_Code::exceptions.c, category=SWSRC
          short-label=examples::S32DS::Flexio_I2s_Ip_example_S32K312::Project_Settings::Startup_Code::nvic.c, category=SWSRC
          short-label=examples::S32DS::Flexio_I2s_Ip_example_S32K312::Project_Settings::Startup_Code::startup.c, category=SWSRC
          short-label=examples::S32DS::Flexio_I2s_Ip_example_S32K312::Project_Settings::Startup_Code::system.c, category=SWSRC
          short-label=examples::S32DS::Flexio_I2s_Ip_example_S32K312::src::main.c, category=SWSRC
          short-label=examples::S32DS::Flexio_I2s_Ip_example_S32K342::include::check_example.h, category=SWHDR
          short-label=examples::S32DS::Flexio_I2s_Ip_example_S32K342::Project_Settings::Startup_Code::exceptions.c, category=SWSRC
          short-label=examples::S32DS::Flexio_I2s_Ip_example_S32K342::Project_Settings::Startup_Code::nvic.c, category=SWSRC
          short-label=examples::S32DS::Flexio_I2s_Ip_example_S32K342::Project_Settings::Startup_Code::startup.c, category=SWSRC
          short-label=examples::S32DS::Flexio_I2s_Ip_example_S32K342::Project_Settings::Startup_Code::system.c, category=SWSRC
          short-label=examples::S32DS::Flexio_I2s_Ip_example_S32K342::src::main.c, category=SWSRC
          short-label=examples::S32DS::Flexio_I2s_Ip_example_S32K344::include::check_example.h, category=SWHDR
          short-label=examples::S32DS::Flexio_I2s_Ip_example_S32K344::Project_Settings::Startup_Code::exceptions.c, category=SWSRC
          short-label=examples::S32DS::Flexio_I2s_Ip_example_S32K344::Project_Settings::Startup_Code::nvic.c, category=SWSRC
          short-label=examples::S32DS::Flexio_I2s_Ip_example_S32K344::Project_Settings::Startup_Code::startup.c, category=SWSRC
          short-label=examples::S32DS::Flexio_I2s_Ip_example_S32K344::Project_Settings::Startup_Code::system.c, category=SWSRC
          short-label=examples::S32DS::Flexio_I2s_Ip_example_S32K344::src::main.c, category=SWSRC
          short-label=examples::S32DS::I2s_Flexio_example_S32K312::include::check_example.h, category=SWHDR
          short-label=examples::S32DS::I2s_Flexio_example_S32K312::Project_Settings::Startup_Code::exceptions.c, category=SWSRC
          short-label=examples::S32DS::I2s_Flexio_example_S32K312::Project_Settings::Startup_Code::nvic.c, category=SWSRC
          short-label=examples::S32DS::I2s_Flexio_example_S32K312::Project_Settings::Startup_Code::startup.c, category=SWSRC
          short-label=examples::S32DS::I2s_Flexio_example_S32K312::Project_Settings::Startup_Code::system.c, category=SWSRC
          short-label=examples::S32DS::I2s_Flexio_example_S32K312::src::main.c, category=SWSRC
          short-label=examples::S32DS::I2s_Flexio_example_S32K342::include::check_example.h, category=SWHDR
          short-label=examples::S32DS::I2s_Flexio_example_S32K342::Project_Settings::Startup_Code::exceptions.c, category=SWSRC
          short-label=examples::S32DS::I2s_Flexio_example_S32K342::Project_Settings::Startup_Code::nvic.c, category=SWSRC
          short-label=examples::S32DS::I2s_Flexio_example_S32K342::Project_Settings::Startup_Code::startup.c, category=SWSRC
          short-label=examples::S32DS::I2s_Flexio_example_S32K342::Project_Settings::Startup_Code::system.c, category=SWSRC
          short-label=examples::S32DS::I2s_Flexio_example_S32K342::src::main.c, category=SWSRC
          short-label=examples::S32DS::I2s_Flexio_example_S32K344::include::check_example.h, category=SWHDR
          short-label=examples::S32DS::I2s_Flexio_example_S32K344::Project_Settings::Startup_Code::exceptions.c, category=SWSRC
          short-label=examples::S32DS::I2s_Flexio_example_S32K344::Project_Settings::Startup_Code::nvic.c, category=SWSRC
          short-label=examples::S32DS::I2s_Flexio_example_S32K344::Project_Settings::Startup_Code::startup.c, category=SWSRC
          short-label=examples::S32DS::I2s_Flexio_example_S32K344::Project_Settings::Startup_Code::system.c, category=SWSRC
          short-label=examples::S32DS::I2s_Flexio_example_S32K344::src::main.c, category=SWSRC
          short-label=examples::S32DS::I2s_Sai_example_S32K342::include::check_example.h, category=SWHDR
          short-label=examples::S32DS::I2s_Sai_example_S32K342::Project_Settings::Startup_Code::exceptions.c, category=SWSRC
          short-label=examples::S32DS::I2s_Sai_example_S32K342::Project_Settings::Startup_Code::nvic.c, category=SWSRC
          short-label=examples::S32DS::I2s_Sai_example_S32K342::Project_Settings::Startup_Code::startup.c, category=SWSRC
          short-label=examples::S32DS::I2s_Sai_example_S32K342::Project_Settings::Startup_Code::system.c, category=SWSRC
          short-label=examples::S32DS::I2s_Sai_example_S32K342::src::main.c, category=SWSRC
          short-label=examples::S32DS::I2s_Sai_example_S32K344::include::check_example.h, category=SWHDR
          short-label=examples::S32DS::I2s_Sai_example_S32K344::Project_Settings::Startup_Code::exceptions.c, category=SWSRC
          short-label=examples::S32DS::I2s_Sai_example_S32K344::Project_Settings::Startup_Code::nvic.c, category=SWSRC
          short-label=examples::S32DS::I2s_Sai_example_S32K344::Project_Settings::Startup_Code::startup.c, category=SWSRC
          short-label=examples::S32DS::I2s_Sai_example_S32K344::Project_Settings::Startup_Code::system.c, category=SWSRC
          short-label=examples::S32DS::I2s_Sai_example_S32K344::src::main.c, category=SWSRC
          short-label=examples::S32DS::Sai_Ip_example_S32K342::include::check_example.h, category=SWHDR
          short-label=examples::S32DS::Sai_Ip_example_S32K342::Project_Settings::Startup_Code::exceptions.c, category=SWSRC
          short-label=examples::S32DS::Sai_Ip_example_S32K342::Project_Settings::Startup_Code::nvic.c, category=SWSRC
          short-label=examples::S32DS::Sai_Ip_example_S32K342::Project_Settings::Startup_Code::startup.c, category=SWSRC
          short-label=examples::S32DS::Sai_Ip_example_S32K342::Project_Settings::Startup_Code::system.c, category=SWSRC
          short-label=examples::S32DS::Sai_Ip_example_S32K342::src::main.c, category=SWSRC
          short-label=examples::S32DS::Sai_Ip_example_S32K344::include::check_example.h, category=SWHDR
          short-label=examples::S32DS::Sai_Ip_example_S32K344::Project_Settings::Startup_Code::exceptions.c, category=SWSRC
          short-label=examples::S32DS::Sai_Ip_example_S32K344::Project_Settings::Startup_Code::nvic.c, category=SWSRC
          short-label=examples::S32DS::Sai_Ip_example_S32K344::Project_Settings::Startup_Code::startup.c, category=SWSRC
          short-label=examples::S32DS::Sai_Ip_example_S32K344::Project_Settings::Startup_Code::system.c, category=SWSRC
          short-label=examples::S32DS::Sai_Ip_example_S32K344::src::main.c, category=SWSRC
          short-label=include::CDD_I2s.h, category=SWHDR
          short-label=include::CDD_I2s_Types.h, category=SWHDR
          short-label=include::Flexio_I2s_Ip.h, category=SWHDR
          short-label=include::Flexio_I2s_Ip_HwAccess.h, category=SWHDR
          short-label=include::Flexio_I2s_Ip_Irq.h, category=SWHDR
          short-label=include::Flexio_I2s_Ip_Types.h, category=SWHDR
          short-label=include::I2s_Ipw.h, category=SWHDR
          short-label=include::I2s_Ipw_Types.h, category=SWHDR
          short-label=include::Sai_Ip.h, category=SWHDR
          short-label=include::Sai_Ip_DeviceRegisters.h, category=SWHDR
          short-label=include::Sai_Ip_FeatureDefines.h, category=SWHDR
          short-label=include::Sai_Ip_HwAccess.h, category=SWHDR
          short-label=include::Sai_Ip_Types.h, category=SWHDR
          short-label=src::CDD_I2s.c, category=SWSRC
          short-label=src::Flexio_I2s_Ip.c, category=SWSRC
          short-label=src::I2s_Ipw.c, category=SWSRC
          short-label=src::Sai_Ip.c, category=SWSRC
          short-label=src::Sai_Ip_Isr.c, category=SWSRC
    compiler GCC_Compiler:
      name=GCC Compiler
      options=-mcpu=cortex-m7 -mthumb -mlittle-endian -mfpu=fpv5-sp-d16 -mfloat-abi=hard -std=c99 -Os -ggdb3 -Wall -Wextra -pedantic -Wstrict-prototypes -Wundef -Wunused -Werror=implicit-function-declaration -Wsign-compare -Wdouble-promotion -fno-short-enums -funsigned-char -funsigned-bitfields -fomit-frame-pointer -fno-common -fstack-usage -fdump-ipa-all -c -DS32K3XX -DS32K344 -DGCC -DUSE_SW_VECTOR_MODE -DD_CACHE_ENABLE -DI_CACHE_ENABLE -DENABLE_FPU -DMCAL_ENABLE_USER_MODE_SUPPORT
      vendor=GCC Systems
      version=NXP GCC 10.2.0 20200723 (Build 1728 Revision g5963bc8)
    compiler GHS_Compiler:
      name=Green Hills
      options=-cpu=cortexm7 -thumb -fpu=vfpv5_d16 -fsingle -C99 --ghstd=last -Osize --gnu_asm -dual_debug -G -keeptempfiles -Wimplicit-int -Wshadow -Wtrigraphs -Wundef --unsigned_chars --unsigned_fields --no_commons --no_exceptions --no_slash_comment --prototype_errors --incorrect_pragma_warnings -c -DS32K3XX -DS32K344 -DGHS -DUSE_SW_VECTOR_MODE -DD_CACHE_ENABLE -DI_CACHE_ENABLE -DENABLE_FPU -DMCAL_ENABLE_USER_MODE_SUPPORT
      vendor=Green Hills
      version=Green Hills Multi 7.1.6d / Compiler 2021.1.4
    compiler IAR_Compiler:
      name=IAR Compiler
      options=--cpu=Cortex-M7 --cpu_mode=thumb --endian=little --fpu=FPv5-SP -e -Ohz --debug --no_clustering --no_mem_idioms --do_explicit_zero_opt_in_named_sections --require_prototypes --no_wrap_diagnostics --diag_suppress=Pa050 -DS32K3XX -DS32K344 -DIAR -DUSE_SW_VECTOR_MODE -DD_CACHE_ENABLE -DI_CACHE_ENABLE -DENABLE_FPU -DMCAL_ENABLE_USER_MODE_SUPPORT
      vendor=IAR Systems
      version=IAR ANSI C/C++ Compiler v.8.50.10 (safety version)
    generated-artifacts:
      16 x dependency on artifact:
        CDD_I2s_PBcfg_h: artifact-descriptor={short-label=generate_PB::include::CDD_I2s_PBcfg.h, category=SWHDR}, usages=EXECUTE
        Flexio_I2s_Ip_PBcfg_h: artifact-descriptor={short-label=generate_PB::include::Flexio_I2s_Ip_PBcfg.h, category=SWHDR}, usages=EXECUTE
        I2s_Ipw_PBcfg_h: artifact-descriptor={short-label=generate_PB::include::I2s_Ipw_PBcfg.h, category=SWHDR}, usages=EXECUTE
        Sai_Ip_PBcfg_h: artifact-descriptor={short-label=generate_PB::include::Sai_Ip_PBcfg.h, category=SWHDR}, usages=EXECUTE
        CDD_I2s_PBcfg_c: artifact-descriptor={short-label=generate_PB::src::CDD_I2s_PBcfg.c, category=SWSRC}, usages=EXECUTE
        Flexio_I2s_Ip_PBcfg_c: artifact-descriptor={short-label=generate_PB::src::Flexio_I2s_Ip_PBcfg.c, category=SWSRC}, usages=EXECUTE
        I2s_Ipw_PBcfg_c: artifact-descriptor={short-label=generate_PB::src::I2s_Ipw_PBcfg.c, category=SWSRC}, usages=EXECUTE
        Sai_Ip_PBcfg_c: artifact-descriptor={short-label=generate_PB::src::Sai_Ip_PBcfg.c, category=SWSRC}, usages=EXECUTE
        CDD_I2s_Cfg_h: artifact-descriptor={short-label=generate_PC::include::CDD_I2s_Cfg.h, category=SWHDR}, usages=COMPILE
        CDD_I2s_CfgDefines_h: artifact-descriptor={short-label=generate_PC::include::CDD_I2s_CfgDefines.h, category=SWHDR}, usages=COMPILE
        Flexio_I2s_Ip_Cfg_h: artifact-descriptor={short-label=generate_PC::include::Flexio_I2s_Ip_Cfg.h, category=SWHDR}, usages=COMPILE
        Flexio_I2s_Ip_CfgDefines_h: artifact-descriptor={short-label=generate_PC::include::Flexio_I2s_Ip_CfgDefines.h, category=SWHDR}, usages=COMPILE
        I2s_Ipw_Cfg_h: artifact-descriptor={short-label=generate_PC::include::I2s_Ipw_Cfg.h, category=SWHDR}, usages=COMPILE
        I2s_Ipw_CfgDefines_h: artifact-descriptor={short-label=generate_PC::include::I2s_Ipw_CfgDefines.h, category=SWHDR}, usages=COMPILE
        Sai_Ip_Cfg_h: artifact-descriptor={short-label=generate_PC::include::Sai_Ip_Cfg.h, category=SWHDR}, usages=COMPILE
        Sai_Ip_CfgDefines_h: artifact-descriptor={short-label=generate_PC::include::Sai_Ip_CfgDefines.h, category=SWHDR}, usages=COMPILE
    linker GCC_Linker: name=GCC Compiler, options=-Wl,-Map,filename -T linkerfile --entry=Reset_Handler -nostartfiles -mcpu=cortexm7 -mthumb -mfpu=fpv5-sp-d16 -mfloat-abi=hard -mlittle-endian -ggdb3 -lc -lm -lgcc, vendor=GCC Systems, version=NXP GCC 10.2.0 20200723 (Build 1728 Revision g5963bc8)
    linker GHS_Linker: name=Green Hills, options=-e Reset_Handler -T linker_script_file.ld -map -keepmap -Mn -delete -ignore_debug_references -Llibrary_path -larch -lstartup -lind_sd -v -keep=C40_Ip_AccessCode -nostartfiles, vendor=Green Hills, version=Green Hills Multi 7.1.6d / Compiler 2021.1.4
    linker IAR_Linker: name=IAR Compiler, options=--map filename --config linkerfile --cpu=Cortex-M7 --fpu=FPv5-SP --entry _start --enable_stack_usage --skip_dynamic_initialization --no_wrap_diagnostics, vendor=IAR Systems, version=IAR ANSI C/C++ Compiler v.8.50.10 (safety version)
    resource consumption ResourceConsumption
      8 x memory section:
        I2S_CODE: alignment=UNSPECIFIED, sw-addrmethod=CODE, symbol=CODE
        I2S_CONFIG_DATA_UNSPECIFIED: alignment=UNSPECIFIED, sw-addrmethod=CONFIG_DATA, symbol=CONFIG_DATA_UNSPECIFIED
        I2S_CONST_8: alignment=8, sw-addrmethod=CONST, symbol=CONST_8
        I2S_CONST_UNSPECIFIED: alignment=UNSPECIFIED, sw-addrmethod=CONST, symbol=CONST_UNSPECIFIED
        I2S_VAR_CLEARED_8: alignment=8, sw-addrmethod=VAR_CLEARED, symbol=VAR_CLEARED_8
        I2S_VAR_CLEARED_UNSPECIFIED: alignment=UNSPECIFIED, sw-addrmethod=VAR_CLEARED, symbol=VAR_CLEARED_UNSPECIFIED
        I2S_VAR_INIT_UNSPECIFIED: alignment=UNSPECIFIED, sw-addrmethod=VAR_INIT, symbol=VAR_INIT_UNSPECIFIED
        I2S_VAR_INIT_UNSPECIFIED_NO_CACHEABLE: alignment=UNSPECIFIED, sw-addrmethod=VAR_INIT, symbol=VAR_INIT_UNSPECIFIED_NO_CACHEABLE
