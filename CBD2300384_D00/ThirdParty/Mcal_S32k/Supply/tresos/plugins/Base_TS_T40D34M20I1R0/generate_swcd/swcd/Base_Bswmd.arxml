AUTOSAR XML (schema 00046)
package /AUTOSAR_Base/BswModuleDescriptions
  bsw module description Base: module-id=0
package /Base_TS_T40D34M20I1R0/Implementations
  bsw implementation BswImplementation_0: programming-language=C, sw-version=2.0.1, vendor-id=43, ar-release-version=4.4.0, behavior=InternalBehavior_0, vendor-specific-module-def=Base
    code-descriptors:
      code Files
        artifact-descriptors:
          short-label=config::Base.xdm, category=SWCFG
          short-label=doc::RTD_BASE_IM.pdf, category=SWDOC
          short-label=doc::RTD_BASE_UM.pdf, category=SWDOC
          short-label=header::S32K312.h, category=SWHDR
          short-label=header::S32K312_ADC.h, category=SWHDR
          short-label=header::S32K312_BCTU.h, category=SWHDR
          short-label=header::S32K312_CMU_FC.h, category=SWHDR
          short-label=header::S32K312_CMU_FM.h, category=SWHDR
          short-label=header::S32K312_COMMON.h, category=SWHDR
          short-label=header::S32K312_CONFIGURATION_GPR.h, category=SWHDR
          short-label=header::S32K312_CRC.h, category=SWHDR
          short-label=header::S32K312_DCM.h, category=SWHDR
          short-label=header::S32K312_DCM_GPR.h, category=SWHDR
          short-label=header::S32K312_DMA.h, category=SWHDR
          short-label=header::S32K312_DMAMUX.h, category=SWHDR
          short-label=header::S32K312_DMA_TCD.h, category=SWHDR
          short-label=header::S32K312_EIM.h, category=SWHDR
          short-label=header::S32K312_EMIOS.h, category=SWHDR
          short-label=header::S32K312_ERM.h, category=SWHDR
          short-label=header::S32K312_FCCU.h, category=SWHDR
          short-label=header::S32K312_FIRC.h, category=SWHDR
          short-label=header::S32K312_FLASH.h, category=SWHDR
          short-label=header::S32K312_FLEXCAN.h, category=SWHDR
          short-label=header::S32K312_FLEXIO.h, category=SWHDR
          short-label=header::S32K312_FXOSC.h, category=SWHDR
          short-label=header::S32K312_I3C.h, category=SWHDR
          short-label=header::S32K312_INTM.h, category=SWHDR
          short-label=header::S32K312_JDC.h, category=SWHDR
          short-label=header::S32K312_LCU.h, category=SWHDR
          short-label=header::S32K312_LPCMP.h, category=SWHDR
          short-label=header::S32K312_LPI2C.h, category=SWHDR
          short-label=header::S32K312_LPSPI.h, category=SWHDR
          short-label=header::S32K312_LPUART.h, category=SWHDR
          short-label=header::S32K312_MCM_CM7.h, category=SWHDR
          short-label=header::S32K312_MC_CGM.h, category=SWHDR
          short-label=header::S32K312_MC_ME.h, category=SWHDR
          short-label=header::S32K312_MC_RGM.h, category=SWHDR
          short-label=header::S32K312_MDM_AP.h, category=SWHDR
          short-label=header::S32K312_MPU.h, category=SWHDR
          short-label=header::S32K312_MSCM.h, category=SWHDR
          short-label=header::S32K312_MU.h, category=SWHDR
          short-label=header::S32K312_NVIC.h, category=SWHDR
          short-label=header::S32K312_PFLASH.h, category=SWHDR
          short-label=header::S32K312_PIT.h, category=SWHDR
          short-label=header::S32K312_PLL.h, category=SWHDR
          short-label=header::S32K312_PMC.h, category=SWHDR
          short-label=header::S32K312_PRAMC.h, category=SWHDR
          short-label=header::S32K312_RTC.h, category=SWHDR
          short-label=header::S32K312_SCB.h, category=SWHDR
          short-label=header::S32K312_SDA_AP.h, category=SWHDR
          short-label=header::S32K312_SIRC.h, category=SWHDR
          short-label=header::S32K312_SIUL2.h, category=SWHDR
          short-label=header::S32K312_STCU.h, category=SWHDR
          short-label=header::S32K312_STM.h, category=SWHDR
          short-label=header::S32K312_SWT.h, category=SWHDR
          short-label=header::S32K312_SXOSC.h, category=SWHDR
          short-label=header::S32K312_SYSTICK.h, category=SWHDR
          short-label=header::S32K312_TEMPSENSE.h, category=SWHDR
          short-label=header::S32K312_TRGMUX.h, category=SWHDR
          short-label=header::S32K312_TSPC.h, category=SWHDR
          short-label=header::S32K312_VIRT_WRAPPER.h, category=SWHDR
          short-label=header::S32K312_WKPU.h, category=SWHDR
          short-label=header::S32K312_XBIC.h, category=SWHDR
          short-label=header::S32K312_XRDC.h, category=SWHDR
          short-label=header::S32K314.h, category=SWHDR
          short-label=header::S32K314_ADC.h, category=SWHDR
          short-label=header::S32K314_AXBS_LITE.h, category=SWHDR
          short-label=header::S32K314_BCTU.h, category=SWHDR
          short-label=header::S32K314_CMU_FC.h, category=SWHDR
          short-label=header::S32K314_CMU_FM.h, category=SWHDR
          short-label=header::S32K314_COMMON.h, category=SWHDR
          short-label=header::S32K314_CONFIGURATION_GPR.h, category=SWHDR
          short-label=header::S32K314_CRC.h, category=SWHDR
          short-label=header::S32K314_DCM.h, category=SWHDR
          short-label=header::S32K314_DCM_GPR.h, category=SWHDR
          short-label=header::S32K314_DMA.h, category=SWHDR
          short-label=header::S32K314_DMAMUX.h, category=SWHDR
          short-label=header::S32K314_DMA_TCD.h, category=SWHDR
          short-label=header::S32K314_EIM.h, category=SWHDR
          short-label=header::S32K314_EMAC.h, category=SWHDR
          short-label=header::S32K314_EMIOS.h, category=SWHDR
          short-label=header::S32K314_ERM.h, category=SWHDR
          short-label=header::S32K314_FCCU.h, category=SWHDR
          short-label=header::S32K314_FIRC.h, category=SWHDR
          short-label=header::S32K314_FLASH.h, category=SWHDR
          short-label=header::S32K314_FLEXCAN.h, category=SWHDR
          short-label=header::S32K314_FLEXIO.h, category=SWHDR
          short-label=header::S32K314_FXOSC.h, category=SWHDR
          short-label=header::S32K314_INTM.h, category=SWHDR
          short-label=header::S32K314_JDC.h, category=SWHDR
          short-label=header::S32K314_LCU.h, category=SWHDR
          short-label=header::S32K314_LPCMP.h, category=SWHDR
          short-label=header::S32K314_LPI2C.h, category=SWHDR
          short-label=header::S32K314_LPSPI.h, category=SWHDR
          short-label=header::S32K314_LPUART.h, category=SWHDR
          short-label=header::S32K314_MCM_CM7.h, category=SWHDR
          short-label=header::S32K314_MC_CGM.h, category=SWHDR
          short-label=header::S32K314_MC_ME.h, category=SWHDR
          short-label=header::S32K314_MC_RGM.h, category=SWHDR
          short-label=header::S32K314_MDM_AP.h, category=SWHDR
          short-label=header::S32K314_MPU.h, category=SWHDR
          short-label=header::S32K314_MSCM.h, category=SWHDR
          short-label=header::S32K314_MU.h, category=SWHDR
          short-label=header::S32K314_NVIC.h, category=SWHDR
          short-label=header::S32K314_PFLASH.h, category=SWHDR
          short-label=header::S32K314_PIT.h, category=SWHDR
          short-label=header::S32K314_PLL.h, category=SWHDR
          short-label=header::S32K314_PMC.h, category=SWHDR
          short-label=header::S32K314_PRAMC.h, category=SWHDR
          short-label=header::S32K314_QUADSPI.h, category=SWHDR
          short-label=header::S32K314_QUADSPI_ARDB.h, category=SWHDR
          short-label=header::S32K314_RTC.h, category=SWHDR
          short-label=header::S32K314_SAI.h, category=SWHDR
          short-label=header::S32K314_SCB.h, category=SWHDR
          short-label=header::S32K314_SDA_AP.h, category=SWHDR
          short-label=header::S32K314_SELFTEST_GPR.h, category=SWHDR
          short-label=header::S32K314_SEMA42.h, category=SWHDR
          short-label=header::S32K314_SIRC.h, category=SWHDR
          short-label=header::S32K314_SIUL2.h, category=SWHDR
          short-label=header::S32K314_STCU.h, category=SWHDR
          short-label=header::S32K314_STM.h, category=SWHDR
          short-label=header::S32K314_SWT.h, category=SWHDR
          short-label=header::S32K314_SXOSC.h, category=SWHDR
          short-label=header::S32K314_SYSTICK.h, category=SWHDR
          short-label=header::S32K314_TEMPSENSE.h, category=SWHDR
          short-label=header::S32K314_TRGMUX.h, category=SWHDR
          short-label=header::S32K314_TSPC.h, category=SWHDR
          short-label=header::S32K314_VIRT_WRAPPER.h, category=SWHDR
          short-label=header::S32K314_WKPU.h, category=SWHDR
          short-label=header::S32K314_XBIC.h, category=SWHDR
          short-label=header::S32K314_XRDC.h, category=SWHDR
          short-label=header::S32K322.h, category=SWHDR
          short-label=header::S32K322_ADC.h, category=SWHDR
          short-label=header::S32K322_AXBS_LITE.h, category=SWHDR
          short-label=header::S32K322_BCTU.h, category=SWHDR
          short-label=header::S32K322_CMU_FC.h, category=SWHDR
          short-label=header::S32K322_CMU_FM.h, category=SWHDR
          short-label=header::S32K322_COMMON.h, category=SWHDR
          short-label=header::S32K322_CONFIGURATION_GPR.h, category=SWHDR
          short-label=header::S32K322_CRC.h, category=SWHDR
          short-label=header::S32K322_DCM.h, category=SWHDR
          short-label=header::S32K322_DCM_GPR.h, category=SWHDR
          short-label=header::S32K322_DMA.h, category=SWHDR
          short-label=header::S32K322_DMAMUX.h, category=SWHDR
          short-label=header::S32K322_DMA_TCD.h, category=SWHDR
          short-label=header::S32K322_EIM.h, category=SWHDR
          short-label=header::S32K322_EMAC.h, category=SWHDR
          short-label=header::S32K322_EMIOS.h, category=SWHDR
          short-label=header::S32K322_ERM.h, category=SWHDR
          short-label=header::S32K322_FCCU.h, category=SWHDR
          short-label=header::S32K322_FIRC.h, category=SWHDR
          short-label=header::S32K322_FLASH.h, category=SWHDR
          short-label=header::S32K322_FLEXCAN.h, category=SWHDR
          short-label=header::S32K322_FLEXIO.h, category=SWHDR
          short-label=header::S32K322_FXOSC.h, category=SWHDR
          short-label=header::S32K322_I3C.h, category=SWHDR
          short-label=header::S32K322_INTM.h, category=SWHDR
          short-label=header::S32K322_JDC.h, category=SWHDR
          short-label=header::S32K322_LCU.h, category=SWHDR
          short-label=header::S32K322_LPCMP.h, category=SWHDR
          short-label=header::S32K322_LPI2C.h, category=SWHDR
          short-label=header::S32K322_LPSPI.h, category=SWHDR
          short-label=header::S32K322_LPUART.h, category=SWHDR
          short-label=header::S32K322_MCM_CM7.h, category=SWHDR
          short-label=header::S32K322_MC_CGM.h, category=SWHDR
          short-label=header::S32K322_MC_ME.h, category=SWHDR
          short-label=header::S32K322_MC_RGM.h, category=SWHDR
          short-label=header::S32K322_MDM_AP.h, category=SWHDR
          short-label=header::S32K322_MPU.h, category=SWHDR
          short-label=header::S32K322_MSCM.h, category=SWHDR
          short-label=header::S32K322_MU.h, category=SWHDR
          short-label=header::S32K322_NVIC.h, category=SWHDR
          short-label=header::S32K322_PFLASH.h, category=SWHDR
          short-label=header::S32K322_PIT.h, category=SWHDR
          short-label=header::S32K322_PLL.h, category=SWHDR
          short-label=header::S32K322_PMC.h, category=SWHDR
          short-label=header::S32K322_PRAMC.h, category=SWHDR
          short-label=header::S32K322_QUADSPI.h, category=SWHDR
          short-label=header::S32K322_QUADSPI_ARDB.h, category=SWHDR
          short-label=header::S32K322_RTC.h, category=SWHDR
          short-label=header::S32K322_SAI.h, category=SWHDR
          short-label=header::S32K322_SCB.h, category=SWHDR
          short-label=header::S32K322_SDA_AP.h, category=SWHDR
          short-label=header::S32K322_SEMA42.h, category=SWHDR
          short-label=header::S32K322_SIRC.h, category=SWHDR
          short-label=header::S32K322_SIUL2.h, category=SWHDR
          short-label=header::S32K322_STCU.h, category=SWHDR
          short-label=header::S32K322_STM.h, category=SWHDR
          short-label=header::S32K322_SWT.h, category=SWHDR
          short-label=header::S32K322_SXOSC.h, category=SWHDR
          short-label=header::S32K322_SYSTICK.h, category=SWHDR
          short-label=header::S32K322_TEMPSENSE.h, category=SWHDR
          short-label=header::S32K322_TRGMUX.h, category=SWHDR
          short-label=header::S32K322_TSPC.h, category=SWHDR
          short-label=header::S32K322_VIRT_WRAPPER.h, category=SWHDR
          short-label=header::S32K322_WKPU.h, category=SWHDR
          short-label=header::S32K322_XBIC.h, category=SWHDR
          short-label=header::S32K322_XRDC.h, category=SWHDR
          short-label=header::S32K324.h, category=SWHDR
          short-label=header::S32K324_ADC.h, category=SWHDR
          short-label=header::S32K324_AXBS_LITE.h, category=SWHDR
          short-label=header::S32K324_BCTU.h, category=SWHDR
          short-label=header::S32K324_CMU_FC.h, category=SWHDR
          short-label=header::S32K324_CMU_FM.h, category=SWHDR
          short-label=header::S32K324_COMMON.h, category=SWHDR
          short-label=header::S32K324_CONFIGURATION_GPR.h, category=SWHDR
          short-label=header::S32K324_CRC.h, category=SWHDR
          short-label=header::S32K324_DCM.h, category=SWHDR
          short-label=header::S32K324_DCM_GPR.h, category=SWHDR
          short-label=header::S32K324_DMA.h, category=SWHDR
          short-label=header::S32K324_DMAMUX.h, category=SWHDR
          short-label=header::S32K324_DMA_TCD.h, category=SWHDR
          short-label=header::S32K324_EIM.h, category=SWHDR
          short-label=header::S32K324_EMAC.h, category=SWHDR
          short-label=header::S32K324_EMIOS.h, category=SWHDR
          short-label=header::S32K324_ERM.h, category=SWHDR
          short-label=header::S32K324_FCCU.h, category=SWHDR
          short-label=header::S32K324_FIRC.h, category=SWHDR
          short-label=header::S32K324_FLASH.h, category=SWHDR
          short-label=header::S32K324_FLEXCAN.h, category=SWHDR
          short-label=header::S32K324_FLEXIO.h, category=SWHDR
          short-label=header::S32K324_FXOSC.h, category=SWHDR
          short-label=header::S32K324_INTM.h, category=SWHDR
          short-label=header::S32K324_JDC.h, category=SWHDR
          short-label=header::S32K324_LCU.h, category=SWHDR
          short-label=header::S32K324_LPCMP.h, category=SWHDR
          short-label=header::S32K324_LPI2C.h, category=SWHDR
          short-label=header::S32K324_LPSPI.h, category=SWHDR
          short-label=header::S32K324_LPUART.h, category=SWHDR
          short-label=header::S32K324_MCM_CM7.h, category=SWHDR
          short-label=header::S32K324_MC_CGM.h, category=SWHDR
          short-label=header::S32K324_MC_ME.h, category=SWHDR
          short-label=header::S32K324_MC_RGM.h, category=SWHDR
          short-label=header::S32K324_MDM_AP.h, category=SWHDR
          short-label=header::S32K324_MPU.h, category=SWHDR
          short-label=header::S32K324_MSCM.h, category=SWHDR
          short-label=header::S32K324_MU.h, category=SWHDR
          short-label=header::S32K324_NVIC.h, category=SWHDR
          short-label=header::S32K324_PFLASH.h, category=SWHDR
          short-label=header::S32K324_PIT.h, category=SWHDR
          short-label=header::S32K324_PLL.h, category=SWHDR
          short-label=header::S32K324_PMC.h, category=SWHDR
          short-label=header::S32K324_PRAMC.h, category=SWHDR
          short-label=header::S32K324_QUADSPI.h, category=SWHDR
          short-label=header::S32K324_QUADSPI_ARDB.h, category=SWHDR
          short-label=header::S32K324_RTC.h, category=SWHDR
          short-label=header::S32K324_SAI.h, category=SWHDR
          short-label=header::S32K324_SCB.h, category=SWHDR
          short-label=header::S32K324_SDA_AP.h, category=SWHDR
          short-label=header::S32K324_SELFTEST_GPR.h, category=SWHDR
          short-label=header::S32K324_SEMA42.h, category=SWHDR
          short-label=header::S32K324_SIRC.h, category=SWHDR
          short-label=header::S32K324_SIUL2.h, category=SWHDR
          short-label=header::S32K324_STCU.h, category=SWHDR
          short-label=header::S32K324_STM.h, category=SWHDR
          short-label=header::S32K324_SWT.h, category=SWHDR
          short-label=header::S32K324_SXOSC.h, category=SWHDR
          short-label=header::S32K324_SYSTICK.h, category=SWHDR
          short-label=header::S32K324_TEMPSENSE.h, category=SWHDR
          short-label=header::S32K324_TRGMUX.h, category=SWHDR
          short-label=header::S32K324_TSPC.h, category=SWHDR
          short-label=header::S32K324_VIRT_WRAPPER.h, category=SWHDR
          short-label=header::S32K324_WKPU.h, category=SWHDR
          short-label=header::S32K324_XBIC.h, category=SWHDR
          short-label=header::S32K324_XRDC.h, category=SWHDR
          short-label=header::S32K342.h, category=SWHDR
          short-label=header::S32K342_ADC.h, category=SWHDR
          short-label=header::S32K342_AXBS_LITE.h, category=SWHDR
          short-label=header::S32K342_BCTU.h, category=SWHDR
          short-label=header::S32K342_CMU_FC.h, category=SWHDR
          short-label=header::S32K342_CMU_FM.h, category=SWHDR
          short-label=header::S32K342_COMMON.h, category=SWHDR
          short-label=header::S32K342_CONFIGURATION_GPR.h, category=SWHDR
          short-label=header::S32K342_CRC.h, category=SWHDR
          short-label=header::S32K342_DCM.h, category=SWHDR
          short-label=header::S32K342_DCM_GPR.h, category=SWHDR
          short-label=header::S32K342_DMA.h, category=SWHDR
          short-label=header::S32K342_DMAMUX.h, category=SWHDR
          short-label=header::S32K342_DMA_TCD.h, category=SWHDR
          short-label=header::S32K342_EIM.h, category=SWHDR
          short-label=header::S32K342_EMAC.h, category=SWHDR
          short-label=header::S32K342_EMIOS.h, category=SWHDR
          short-label=header::S32K342_ERM.h, category=SWHDR
          short-label=header::S32K342_FCCU.h, category=SWHDR
          short-label=header::S32K342_FIRC.h, category=SWHDR
          short-label=header::S32K342_FLASH.h, category=SWHDR
          short-label=header::S32K342_FLEXCAN.h, category=SWHDR
          short-label=header::S32K342_FLEXIO.h, category=SWHDR
          short-label=header::S32K342_FXOSC.h, category=SWHDR
          short-label=header::S32K342_I3C.h, category=SWHDR
          short-label=header::S32K342_INTM.h, category=SWHDR
          short-label=header::S32K342_JDC.h, category=SWHDR
          short-label=header::S32K342_LCU.h, category=SWHDR
          short-label=header::S32K342_LPCMP.h, category=SWHDR
          short-label=header::S32K342_LPI2C.h, category=SWHDR
          short-label=header::S32K342_LPSPI.h, category=SWHDR
          short-label=header::S32K342_LPUART.h, category=SWHDR
          short-label=header::S32K342_MCM_CM7.h, category=SWHDR
          short-label=header::S32K342_MC_CGM.h, category=SWHDR
          short-label=header::S32K342_MC_ME.h, category=SWHDR
          short-label=header::S32K342_MC_RGM.h, category=SWHDR
          short-label=header::S32K342_MDM_AP.h, category=SWHDR
          short-label=header::S32K342_MPU.h, category=SWHDR
          short-label=header::S32K342_MSCM.h, category=SWHDR
          short-label=header::S32K342_MU.h, category=SWHDR
          short-label=header::S32K342_NVIC.h, category=SWHDR
          short-label=header::S32K342_PFLASH.h, category=SWHDR
          short-label=header::S32K342_PIT.h, category=SWHDR
          short-label=header::S32K342_PLL.h, category=SWHDR
          short-label=header::S32K342_PMC.h, category=SWHDR
          short-label=header::S32K342_PRAMC.h, category=SWHDR
          short-label=header::S32K342_QUADSPI.h, category=SWHDR
          short-label=header::S32K342_QUADSPI_ARDB.h, category=SWHDR
          short-label=header::S32K342_RTC.h, category=SWHDR
          short-label=header::S32K342_SAI.h, category=SWHDR
          short-label=header::S32K342_SCB.h, category=SWHDR
          short-label=header::S32K342_SDA_AP.h, category=SWHDR
          short-label=header::S32K342_SEMA42.h, category=SWHDR
          short-label=header::S32K342_SIRC.h, category=SWHDR
          short-label=header::S32K342_SIUL2.h, category=SWHDR
          short-label=header::S32K342_STCU.h, category=SWHDR
          short-label=header::S32K342_STM.h, category=SWHDR
          short-label=header::S32K342_SWT.h, category=SWHDR
          short-label=header::S32K342_SXOSC.h, category=SWHDR
          short-label=header::S32K342_SYSTICK.h, category=SWHDR
          short-label=header::S32K342_TEMPSENSE.h, category=SWHDR
          short-label=header::S32K342_TRGMUX.h, category=SWHDR
          short-label=header::S32K342_TSPC.h, category=SWHDR
          short-label=header::S32K342_VIRT_WRAPPER.h, category=SWHDR
          short-label=header::S32K342_WKPU.h, category=SWHDR
          short-label=header::S32K342_XBIC.h, category=SWHDR
          short-label=header::S32K342_XRDC.h, category=SWHDR
          short-label=header::S32K344.h, category=SWHDR
          short-label=header::S32K344_ADC.h, category=SWHDR
          short-label=header::S32K344_AXBS_LITE.h, category=SWHDR
          short-label=header::S32K344_BCTU.h, category=SWHDR
          short-label=header::S32K344_CMU_FC.h, category=SWHDR
          short-label=header::S32K344_CMU_FM.h, category=SWHDR
          short-label=header::S32K344_COMMON.h, category=SWHDR
          short-label=header::S32K344_CONFIGURATION_GPR.h, category=SWHDR
          short-label=header::S32K344_CRC.h, category=SWHDR
          short-label=header::S32K344_DCM.h, category=SWHDR
          short-label=header::S32K344_DCM_GPR.h, category=SWHDR
          short-label=header::S32K344_DMA.h, category=SWHDR
          short-label=header::S32K344_DMAMUX.h, category=SWHDR
          short-label=header::S32K344_DMA_TCD.h, category=SWHDR
          short-label=header::S32K344_EIM.h, category=SWHDR
          short-label=header::S32K344_EMAC.h, category=SWHDR
          short-label=header::S32K344_EMIOS.h, category=SWHDR
          short-label=header::S32K344_ERM.h, category=SWHDR
          short-label=header::S32K344_FCCU.h, category=SWHDR
          short-label=header::S32K344_FIRC.h, category=SWHDR
          short-label=header::S32K344_FLASH.h, category=SWHDR
          short-label=header::S32K344_FLEXCAN.h, category=SWHDR
          short-label=header::S32K344_FLEXIO.h, category=SWHDR
          short-label=header::S32K344_FXOSC.h, category=SWHDR
          short-label=header::S32K344_INTM.h, category=SWHDR
          short-label=header::S32K344_JDC.h, category=SWHDR
          short-label=header::S32K344_LCU.h, category=SWHDR
          short-label=header::S32K344_LPCMP.h, category=SWHDR
          short-label=header::S32K344_LPI2C.h, category=SWHDR
          short-label=header::S32K344_LPSPI.h, category=SWHDR
          short-label=header::S32K344_LPUART.h, category=SWHDR
          short-label=header::S32K344_MCM_CM7.h, category=SWHDR
          short-label=header::S32K344_MC_CGM.h, category=SWHDR
          short-label=header::S32K344_MC_ME.h, category=SWHDR
          short-label=header::S32K344_MC_RGM.h, category=SWHDR
          short-label=header::S32K344_MDM_AP.h, category=SWHDR
          short-label=header::S32K344_MPU.h, category=SWHDR
          short-label=header::S32K344_MSCM.h, category=SWHDR
          short-label=header::S32K344_MU.h, category=SWHDR
          short-label=header::S32K344_NVIC.h, category=SWHDR
          short-label=header::S32K344_PFLASH.h, category=SWHDR
          short-label=header::S32K344_PIT.h, category=SWHDR
          short-label=header::S32K344_PLL.h, category=SWHDR
          short-label=header::S32K344_PMC.h, category=SWHDR
          short-label=header::S32K344_PRAMC.h, category=SWHDR
          short-label=header::S32K344_QUADSPI.h, category=SWHDR
          short-label=header::S32K344_QUADSPI_ARDB.h, category=SWHDR
          short-label=header::S32K344_RTC.h, category=SWHDR
          short-label=header::S32K344_SAI.h, category=SWHDR
          short-label=header::S32K344_SCB.h, category=SWHDR
          short-label=header::S32K344_SDA_AP.h, category=SWHDR
          short-label=header::S32K344_SELFTEST_GPR.h, category=SWHDR
          short-label=header::S32K344_SEMA42.h, category=SWHDR
          short-label=header::S32K344_SIRC.h, category=SWHDR
          short-label=header::S32K344_SIUL2.h, category=SWHDR
          short-label=header::S32K344_STCU.h, category=SWHDR
          short-label=header::S32K344_STM.h, category=SWHDR
          short-label=header::S32K344_SWT.h, category=SWHDR
          short-label=header::S32K344_SXOSC.h, category=SWHDR
          short-label=header::S32K344_SYSTICK.h, category=SWHDR
          short-label=header::S32K344_TEMPSENSE.h, category=SWHDR
          short-label=header::S32K344_TRGMUX.h, category=SWHDR
          short-label=header::S32K344_TSPC.h, category=SWHDR
          short-label=header::S32K344_VIRT_WRAPPER.h, category=SWHDR
          short-label=header::S32K344_WKPU.h, category=SWHDR
          short-label=header::S32K344_XBIC.h, category=SWHDR
          short-label=header::S32K344_XRDC.h, category=SWHDR
          short-label=include::Adc_MemMap.h, category=SWHDR
          short-label=include::Base_MemMap.h, category=SWHDR
          short-label=include::BasicTypes.h, category=SWHDR
          short-label=include::Bcc_775a_MemMap.h, category=SWHDR
          short-label=include::Can_43_FLEXCAN_MemMap.h, category=SWHDR
          short-label=include::Can_43_LLCE_MemMap.h, category=SWHDR
          short-label=include::Can_GeneralTypes.h, category=SWHDR
          short-label=include::Can_MemMap.h, category=SWHDR
          short-label=include::Compiler.h, category=SWHDR
          short-label=include::CompilerDefinition.h, category=SWHDR
          short-label=include::Compiler_Cfg.h, category=SWHDR
          short-label=include::ComStackTypes.h, category=SWHDR
          short-label=include::ComStack_Cfg.h, category=SWHDR
          short-label=include::ComStack_Types.h, category=SWHDR
          short-label=include::Crc_MemMap.h, category=SWHDR
          short-label=include::Crypto_MemMap.h, category=SWHDR
          short-label=include::Csec_MemMap.h, category=SWHDR
          short-label=include::Dem_MemMap.h, category=SWHDR
          short-label=include::Det_MemMap.h, category=SWHDR
          short-label=include::Devassert.h, category=SWHDR
          short-label=include::Dio_MemMap.h, category=SWHDR
          short-label=include::Ecum_MemMap.h, category=SWHDR
          short-label=include::Eep_MemMap.h, category=SWHDR
          short-label=include::EthSwitch_43_SJA1105P_MemMap.h, category=SWHDR
          short-label=include::EthSwt_43_SJA11XX_MemMap.h, category=SWHDR
          short-label=include::EthTrcv_43_PHY_MemMap.h, category=SWHDR
          short-label=include::EthTrcv_43_TJA110X_MemMap.h, category=SWHDR
          short-label=include::Eth_43_PFE_MemMap.h, category=SWHDR
          short-label=include::Eth_GeneralTypes.h, category=SWHDR
          short-label=include::Eth_MemMap.h, category=SWHDR
          short-label=include::Fee_MemMap.h, category=SWHDR
          short-label=include::Fls_MemMap.h, category=SWHDR
          short-label=include::Fr_43_LLCE_MemMap.h, category=SWHDR
          short-label=include::Fr_GeneralTypes.h, category=SWHDR
          short-label=include::Fr_MemMap.h, category=SWHDR
          short-label=include::Gpt_MemMap.h, category=SWHDR
          short-label=include::I2c_MemMap.h, category=SWHDR
          short-label=include::I2s_MemMap.h, category=SWHDR
          short-label=include::I3c_MemMap.h, category=SWHDR
          short-label=include::Icu_MemMap.h, category=SWHDR
          short-label=include::IpVersionMacros.h, category=SWHDR
          short-label=include::Iseled_MemMap.h, category=SWHDR
          short-label=include::Lin_43_LLCE_MemMap.h, category=SWHDR
          short-label=include::Lin_GeneralTypes.h, category=SWHDR
          short-label=include::Lin_MemMap.h, category=SWHDR
          short-label=include::Mcal.h, category=SWHDR
          short-label=include::Mcem_MemMap.h, category=SWHDR
          short-label=include::Mcl_MemMap.h, category=SWHDR
          short-label=include::Mcu_MemMap.h, category=SWHDR
          short-label=include::Ocu_MemMap.h, category=SWHDR
          short-label=include::OsIf.h, category=SWHDR
          short-label=include::OsIf_Cfg_TypesDef.h, category=SWHDR
          short-label=include::OsIf_DeviceRegisters.h, category=SWHDR
          short-label=include::OsIf_Internal.h, category=SWHDR
          short-label=include::OsIf_Interrupts.h, category=SWHDR
          short-label=include::OsIf_Timer_Custom.h, category=SWHDR
          short-label=include::OsIf_Timer_System.h, category=SWHDR
          short-label=include::OsIf_Timer_System_Internal_Systick.h, category=SWHDR
          short-label=include::PlatformTypes.h, category=SWHDR
          short-label=include::Platform_MemMap.h, category=SWHDR
          short-label=include::Platform_Types.h, category=SWHDR
          short-label=include::Pmic_MemMap.h, category=SWHDR
          short-label=include::Port_MemMap.h, category=SWHDR
          short-label=include::Pwm_MemMap.h, category=SWHDR
          short-label=include::RegLockMacros.h, category=SWHDR
          short-label=include::Reg_eSys.h, category=SWHDR
          short-label=include::Rm_MemMap.h, category=SWHDR
          short-label=include::Rte_MemMap.h, category=SWHDR
          short-label=include::Sbc_fs26_MemMap.h, category=SWHDR
          short-label=include::Sbc_fs8x_MemMap.h, category=SWHDR
          short-label=include::Sent_MemMap.h, category=SWHDR
          short-label=include::Soc_Ips.h, category=SWHDR
          short-label=include::Spi_MemMap.h, category=SWHDR
          short-label=include::StandardTypes.h, category=SWHDR
          short-label=include::Std_Types.h, category=SWHDR
          short-label=include::Uart_MemMap.h, category=SWHDR
          short-label=include::Wdg_43_fs26_MemMap.h, category=SWHDR
          short-label=include::Wdg_43_fs8x_MemMap.h, category=SWHDR
          short-label=include::Wdg_MemMap.h, category=SWHDR
          short-label=src::OsIf_Interrupts.c, category=SWSRC
          short-label=src::OsIf_Timer.c, category=SWSRC
          short-label=src::OsIf_Timer_System.c, category=SWSRC
          short-label=src::OsIf_Timer_System_Internal_Systick.c, category=SWSRC
          short-label=wizard_data::main.c, category=SWSRC
          short-label=wizard_data::modules.h, category=SWHDR
          short-label=wizard_data::OsIf_Cfg.c, category=SWSRC
          short-label=wizard_data::S32K312::Clock_Ip_Cfg.c, category=SWSRC
          short-label=wizard_data::S32K312::Clock_Ip_Cfg.h, category=SWHDR
          short-label=wizard_data::S32K312::Clock_Ip_Cfg_Defines.h, category=SWHDR
          short-label=wizard_data::S32K312::OsIf_ArchCfg.h, category=SWHDR
          short-label=wizard_data::S32K312::OsIf_Cfg.h, category=SWHDR
          short-label=wizard_data::S32K312::Siul2_Port_Ip_Cfg.c, category=SWSRC
          short-label=wizard_data::S32K312::Siul2_Port_Ip_Cfg.h, category=SWHDR
          short-label=wizard_data::S32K312::Siul2_Port_Ip_Defines.h, category=SWHDR
          short-label=wizard_data::S32K312::Tspc_Port_Ip_Cfg.c, category=SWSRC
          short-label=wizard_data::S32K312::Tspc_Port_Ip_Cfg.h, category=SWHDR
          short-label=wizard_data::S32K314::Clock_Ip_Cfg.c, category=SWSRC
          short-label=wizard_data::S32K314::Clock_Ip_Cfg.h, category=SWHDR
          short-label=wizard_data::S32K314::Clock_Ip_Cfg_Defines.h, category=SWHDR
          short-label=wizard_data::S32K314::OsIf_ArchCfg.h, category=SWHDR
          short-label=wizard_data::S32K314::OsIf_Cfg.h, category=SWHDR
          short-label=wizard_data::S32K314::Siul2_Port_Ip_Cfg.c, category=SWSRC
          short-label=wizard_data::S32K314::Siul2_Port_Ip_Cfg.h, category=SWHDR
          short-label=wizard_data::S32K314::Siul2_Port_Ip_Defines.h, category=SWHDR
          short-label=wizard_data::S32K314::Tspc_Port_Ip_Cfg.c, category=SWSRC
          short-label=wizard_data::S32K314::Tspc_Port_Ip_Cfg.h, category=SWHDR
          short-label=wizard_data::S32K322::Clock_Ip_Cfg.c, category=SWSRC
          short-label=wizard_data::S32K322::Clock_Ip_Cfg.h, category=SWHDR
          short-label=wizard_data::S32K322::Clock_Ip_Cfg_Defines.h, category=SWHDR
          short-label=wizard_data::S32K322::OsIf_ArchCfg.h, category=SWHDR
          short-label=wizard_data::S32K322::OsIf_Cfg.h, category=SWHDR
          short-label=wizard_data::S32K322::Siul2_Port_Ip_Cfg.c, category=SWSRC
          short-label=wizard_data::S32K322::Siul2_Port_Ip_Cfg.h, category=SWHDR
          short-label=wizard_data::S32K322::Siul2_Port_Ip_Defines.h, category=SWHDR
          short-label=wizard_data::S32K322::Tspc_Port_Ip_Cfg.c, category=SWSRC
          short-label=wizard_data::S32K322::Tspc_Port_Ip_Cfg.h, category=SWHDR
          short-label=wizard_data::S32K324::Clock_Ip_Cfg.c, category=SWSRC
          short-label=wizard_data::S32K324::Clock_Ip_Cfg.h, category=SWHDR
          short-label=wizard_data::S32K324::Clock_Ip_Cfg_Defines.h, category=SWHDR
          short-label=wizard_data::S32K324::OsIf_ArchCfg.h, category=SWHDR
          short-label=wizard_data::S32K324::OsIf_Cfg.h, category=SWHDR
          short-label=wizard_data::S32K324::Siul2_Port_Ip_Cfg.c, category=SWSRC
          short-label=wizard_data::S32K324::Siul2_Port_Ip_Cfg.h, category=SWHDR
          short-label=wizard_data::S32K324::Siul2_Port_Ip_Defines.h, category=SWHDR
          short-label=wizard_data::S32K324::Tspc_Port_Ip_Cfg.c, category=SWSRC
          short-label=wizard_data::S32K324::Tspc_Port_Ip_Cfg.h, category=SWHDR
          short-label=wizard_data::S32K341::Clock_Ip_Cfg.c, category=SWSRC
          short-label=wizard_data::S32K341::Clock_Ip_Cfg.h, category=SWHDR
          short-label=wizard_data::S32K341::Clock_Ip_Cfg_Defines.h, category=SWHDR
          short-label=wizard_data::S32K341::OsIf_ArchCfg.h, category=SWHDR
          short-label=wizard_data::S32K341::OsIf_Cfg.h, category=SWHDR
          short-label=wizard_data::S32K341::Siul2_Port_Ip_Cfg.c, category=SWSRC
          short-label=wizard_data::S32K341::Siul2_Port_Ip_Cfg.h, category=SWHDR
          short-label=wizard_data::S32K341::Siul2_Port_Ip_Defines.h, category=SWHDR
          short-label=wizard_data::S32K341::Tspc_Port_Ip_Cfg.c, category=SWSRC
          short-label=wizard_data::S32K341::Tspc_Port_Ip_Cfg.h, category=SWHDR
          short-label=wizard_data::S32K342::Clock_Ip_Cfg.c, category=SWSRC
          short-label=wizard_data::S32K342::Clock_Ip_Cfg.h, category=SWHDR
          short-label=wizard_data::S32K342::Clock_Ip_Cfg_Defines.h, category=SWHDR
          short-label=wizard_data::S32K342::OsIf_ArchCfg.h, category=SWHDR
          short-label=wizard_data::S32K342::OsIf_Cfg.h, category=SWHDR
          short-label=wizard_data::S32K342::Siul2_Port_Ip_Cfg.c, category=SWSRC
          short-label=wizard_data::S32K342::Siul2_Port_Ip_Cfg.h, category=SWHDR
          short-label=wizard_data::S32K342::Siul2_Port_Ip_Defines.h, category=SWHDR
          short-label=wizard_data::S32K342::Tspc_Port_Ip_Cfg.c, category=SWSRC
          short-label=wizard_data::S32K342::Tspc_Port_Ip_Cfg.h, category=SWHDR
          short-label=wizard_data::S32K344::Clock_Ip_Cfg.c, category=SWSRC
          short-label=wizard_data::S32K344::Clock_Ip_Cfg.h, category=SWHDR
          short-label=wizard_data::S32K344::Clock_Ip_Cfg_Defines.h, category=SWHDR
          short-label=wizard_data::S32K344::OsIf_ArchCfg.h, category=SWHDR
          short-label=wizard_data::S32K344::OsIf_Cfg.h, category=SWHDR
          short-label=wizard_data::S32K344::Siul2_Port_Ip_Cfg.c, category=SWSRC
          short-label=wizard_data::S32K344::Siul2_Port_Ip_Cfg.h, category=SWHDR
          short-label=wizard_data::S32K344::Siul2_Port_Ip_Defines.h, category=SWHDR
          short-label=wizard_data::S32K344::Tspc_Port_Ip_Cfg.c, category=SWSRC
          short-label=wizard_data::S32K344::Tspc_Port_Ip_Cfg.h, category=SWHDR
    compiler GCC_Compiler:
      name=GCC Compiler
      options=-mcpu=cortex-m7 -mthumb -mlittle-endian -mfpu=fpv5-sp-d16 -mfloat-abi=hard -std=c99 -Os -ggdb3 -Wall -Wextra -pedantic -Wstrict-prototypes -Wundef -Wunused -Werror=implicit-function-declaration -Wsign-compare -Wdouble-promotion -fno-short-enums -funsigned-char -funsigned-bitfields -fomit-frame-pointer -fno-common -fstack-usage -fdump-ipa-all -c -DS32K3XX -DS32K344 -DGCC -DUSE_SW_VECTOR_MODE -DD_CACHE_ENABLE -DI_CACHE_ENABLE -DENABLE_FPU -DMCAL_ENABLE_USER_MODE_SUPPORT
      vendor=GCC Systems
      version=NXP GCC 10.2.0 20200723 (Build 1728 Revision g5963bc8)
    compiler GHS_Compiler:
      name=Green Hills
      options=-cpu=cortexm7 -thumb -fpu=vfpv5_d16 -fsingle -C99 --ghstd=last -Osize --gnu_asm -dual_debug -G -keeptempfiles -Wimplicit-int -Wshadow -Wtrigraphs -Wundef --unsigned_chars --unsigned_fields --no_commons --no_exceptions --no_slash_comment --prototype_errors --incorrect_pragma_warnings -c -DS32K3XX -DS32K344 -DGHS -DUSE_SW_VECTOR_MODE -DD_CACHE_ENABLE -DI_CACHE_ENABLE -DENABLE_FPU -DMCAL_ENABLE_USER_MODE_SUPPORT
      vendor=Green Hills
      version=Green Hills Multi 7.1.6d / Compiler 2021.1.4
    compiler IAR_Compiler:
      name=IAR Compiler
      options=--cpu=Cortex-M7 --cpu_mode=thumb --endian=little --fpu=FPv5-SP -e -Ohz --debug --no_clustering --no_mem_idioms --do_explicit_zero_opt_in_named_sections --require_prototypes --no_wrap_diagnostics --diag_suppress=Pa050 -DS32K3XX -DS32K344 -DIAR -DUSE_SW_VECTOR_MODE -DD_CACHE_ENABLE -DI_CACHE_ENABLE -DENABLE_FPU -DMCAL_ENABLE_USER_MODE_SUPPORT
      vendor=IAR Systems
      version=IAR ANSI C/C++ Compiler v.8.50.10 (safety version)
    generated-artifacts:
      4 x dependency on artifact, all with usages=COMPILE:
        modules_h: artifact-descriptor={short-label=generate_PC::include::modules.h, category=SWHDR}
        OsIf_ArchCfg_h: artifact-descriptor={short-label=generate_PC::include::OsIf_ArchCfg.h, category=SWHDR}
        OsIf_Cfg_h: artifact-descriptor={short-label=generate_PC::include::OsIf_Cfg.h, category=SWHDR}
        OsIf_Cfg_c: artifact-descriptor={short-label=generate_PC::src::OsIf_Cfg.c, category=SWSRC}
    linker GCC_Linker: name=GCC Compiler, options=-Wl,-Map,filename -T linkerfile --entry=Reset_Handler -nostartfiles -mcpu=cortexm7 -mthumb -mfpu=fpv5-sp-d16 -mfloat-abi=hard -mlittle-endian -ggdb3 -lc -lm -lgcc, vendor=GCC Systems, version=NXP GCC 10.2.0 20200723 (Build 1728 Revision g5963bc8)
    linker GHS_Linker: name=Green Hills, options=-e Reset_Handler -T linker_script_file.ld -map -keepmap -Mn -delete -ignore_debug_references -Llibrary_path -larch -lstartup -lind_sd -v -keep=C40_Ip_AccessCode -nostartfiles, vendor=Green Hills, version=Green Hills Multi 7.1.6d / Compiler 2021.1.4
    linker IAR_Linker: name=IAR Compiler, options=--map filename --config linkerfile --cpu=Cortex-M7 --fpu=FPv5-SP --entry _start --enable_stack_usage --skip_dynamic_initialization --no_wrap_diagnostics, vendor=IAR Systems, version=IAR ANSI C/C++ Compiler v.8.50.10 (safety version)
    resource consumption ResourceConsumption
      5 x memory section:
        BASE_CODE: alignment=UNSPECIFIED, sw-addrmethod=CODE, symbol=CODE
        BASE_CONFIG_DATA_UNSPECIFIED: alignment=UNSPECIFIED, sw-addrmethod=CONFIG_DATA, symbol=CONFIG_DATA_UNSPECIFIED
        BASE_VAR_CLEARED_32: alignment=32, sw-addrmethod=VAR_CLEARED, symbol=VAR_CLEARED_32
        BASE_VAR_CLEARED_BOOLEAN: alignment=BOOLEAN, sw-addrmethod=VAR_CLEARED, symbol=VAR_CLEARED_BOOLEAN
        BASE_VAR_CLEARED_UNSPECIFIED: alignment=UNSPECIFIED, sw-addrmethod=VAR_CLEARED, symbol=VAR_CLEARED_UNSPECIFIED
