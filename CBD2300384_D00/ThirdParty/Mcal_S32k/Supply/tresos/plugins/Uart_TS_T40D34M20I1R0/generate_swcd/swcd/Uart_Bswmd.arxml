AUTOSAR XML (schema 00046)
package /AUTOSAR_Uart/BswModuleDescriptions
  bsw module description Uart: module-id=255
    provided-entrys:
      Uart_Abort
      Uart_AsyncReceive
      Uart_AsyncSend
      Uart_Deinit
      Uart_GetBaudrate
      Uart_GetStatus
      Uart_GetVersionInfo
      Uart_Init
      Uart_SetBaudrate
      Uart_SetBuffer
      Uart_SyncReceive
      Uart_SyncSend
      LPUART_UART_IP_0_IRQHandler
      LPUART_UART_IP_{10..15}_IRQHandler
      LPUART_UART_IP_{1..9}_IRQHandler
    bsw internal behavior InternalBehavior_0
      8 x exclusive area:
        UART_EXCLUSIVE_AREA_{00..07}
      12 x bsw called entity:
        Uart_Abort: implemented-entry=Uart_Abort
        Uart_AsyncReceive: can-enter-exclusive-area=[UART_EXCLUSIVE_AREA_03, UART_EXCLUSIVE_AREA_06], implemented-entry=Uart_AsyncReceive
        Uart_AsyncSend: can-enter-exclusive-area=[UART_EXCLUSIVE_AREA_01, UART_EXCLUSIVE_AREA_04], implemented-entry=Uart_AsyncSend
        Uart_Deinit: implemented-entry=Uart_Deinit
        Uart_GetBaudrate: implemented-entry=Uart_GetBaudrate
        Uart_GetStatus: implemented-entry=Uart_GetStatus
        Uart_GetVersionInfo: implemented-entry=Uart_GetVersionInfo
        Uart_Init: implemented-entry=Uart_Init
        Uart_SetBaudrate: implemented-entry=Uart_SetBaudrate
        Uart_SetBuffer: implemented-entry=Uart_SetBuffer
        Uart_SyncReceive: can-enter-exclusive-area=[UART_EXCLUSIVE_AREA_02, UART_EXCLUSIVE_AREA_07], implemented-entry=Uart_SyncReceive
        Uart_SyncSend: can-enter-exclusive-area=[UART_EXCLUSIVE_AREA_00, UART_EXCLUSIVE_AREA_05], implemented-entry=Uart_SyncSend
      16 x bsw interrupt entity, all with interrupt-category=CAT-2, interrupt-source=Hardware:
        LPUART_UART_IP_0_IRQHandler: implemented-entry=LPUART_UART_IP_0_IRQHandler
        LPUART_UART_IP_{10..15}_IRQHandler: implemented-entry=LPUART_UART_IP_{10..15}_IRQHandler
        LPUART_UART_IP_{1..9}_IRQHandler: implemented-entry=LPUART_UART_IP_{1..9}_IRQHandler
package /AUTOSAR_Uart/BswModuleEntrys
  28 x bsw module entry, all with sw-service-impl-policy=STANDARD:
    Uart_Abort: service-id=0x04, is-reentrant=true, is-synchronous=true, call-type=REGULAR, execution-context=UNSPECIFIED
    Uart_AsyncReceive: service-id=0x08, is-reentrant=false, is-synchronous=false, call-type=REGULAR, execution-context=UNSPECIFIED
    Uart_AsyncSend: service-id=0x09, is-reentrant=true, is-synchronous=false, call-type=REGULAR, execution-context=UNSPECIFIED
    Uart_Deinit: service-id=0x01, is-reentrant=false, is-synchronous=true, call-type=REGULAR, execution-context=UNSPECIFIED
    Uart_GetBaudrate: service-id=0x03, is-reentrant=false, is-synchronous=true, call-type=REGULAR, execution-context=UNSPECIFIED
    Uart_GetStatus: service-id=0x0a, is-reentrant=true, is-synchronous=true, call-type=REGULAR, execution-context=UNSPECIFIED
    Uart_GetVersionInfo: service-id=0x0b, is-reentrant=false, is-synchronous=true, call-type=REGULAR, execution-context=UNSPECIFIED
    Uart_Init: service-id=0x00, is-reentrant=false, is-synchronous=true, call-type=REGULAR, execution-context=UNSPECIFIED
    Uart_SetBaudrate: service-id=0x02, is-reentrant=false, is-synchronous=true, call-type=REGULAR, execution-context=UNSPECIFIED
    Uart_SetBuffer: service-id=0x05, is-reentrant=true, is-synchronous=true, call-type=REGULAR, execution-context=UNSPECIFIED
    Uart_SyncReceive: service-id=0x07, is-reentrant=true, is-synchronous=true, call-type=REGULAR, execution-context=UNSPECIFIED
    Uart_SyncSend: service-id=0x06, is-reentrant=true, is-synchronous=true, call-type=REGULAR, execution-context=UNSPECIFIED
    LPUART_UART_IP_0_IRQHandler: service-id=0, is-reentrant=false, is-synchronous=true, call-type=INTERRUPT, execution-context=INTERRUPT-CAT-2
    LPUART_UART_IP_{10..15}_IRQHandler: service-id=0, is-reentrant=false, is-synchronous=true, call-type=INTERRUPT, execution-context=INTERRUPT-CAT-2
    LPUART_UART_IP_{1..9}_IRQHandler: service-id=0, is-reentrant=false, is-synchronous=true, call-type=INTERRUPT, execution-context=INTERRUPT-CAT-2
package /Uart_TS_T40D34M20I1R0/Implementations
  bsw implementation BswImplementation_0: programming-language=C, sw-version=2.0.1, vendor-id=43, ar-release-version=4.4.0, behavior=InternalBehavior_0, vendor-specific-module-def=Uart
    code-descriptors:
      code Files
        artifact-descriptors:
          short-label=config::Uart.xdm, category=SWCFG
          short-label=doc::RTD_UART_IM.pdf, category=SWDOC
          short-label=doc::RTD_UART_UM.pdf, category=SWDOC
          short-label=examples::EBT::Uart_Example_S32K312::generate::epc::Base.xdm, category=SWCFG
          short-label=examples::EBT::Uart_Example_S32K312::generate::epc::Dem.xdm, category=SWCFG
          short-label=examples::EBT::Uart_Example_S32K312::generate::epc::EcuC.xdm, category=SWCFG
          short-label=examples::EBT::Uart_Example_S32K312::generate::epc::Mcl.xdm, category=SWCFG
          short-label=examples::EBT::Uart_Example_S32K312::generate::epc::Mcu.xdm, category=SWCFG
          short-label=examples::EBT::Uart_Example_S32K312::generate::epc::Os.xdm, category=SWCFG
          short-label=examples::EBT::Uart_Example_S32K312::generate::epc::Platform.xdm, category=SWCFG
          short-label=examples::EBT::Uart_Example_S32K312::generate::epc::Port.xdm, category=SWCFG
          short-label=examples::EBT::Uart_Example_S32K312::generate::epc::Resource.xdm, category=SWCFG
          short-label=examples::EBT::Uart_Example_S32K312::generate::epc::Uart.xdm, category=SWCFG
          short-label=examples::EBT::Uart_Example_S32K312::include::check_example.h, category=SWHDR
          short-label=examples::EBT::Uart_Example_S32K312::src::main.c, category=SWSRC
          short-label=examples::EBT::Uart_Example_S32K312::TresosProject::Uart_Example_S32K312::.prefs::preferences.xdm, category=SWCFG
          short-label=examples::EBT::Uart_Example_S32K312::TresosProject::Uart_Example_S32K312::config::Base.xdm, category=SWCFG
          short-label=examples::EBT::Uart_Example_S32K312::TresosProject::Uart_Example_S32K312::config::Dem.xdm, category=SWCFG
          short-label=examples::EBT::Uart_Example_S32K312::TresosProject::Uart_Example_S32K312::config::EcuC.xdm, category=SWCFG
          short-label=examples::EBT::Uart_Example_S32K312::TresosProject::Uart_Example_S32K312::config::Mcl.xdm, category=SWCFG
          short-label=examples::EBT::Uart_Example_S32K312::TresosProject::Uart_Example_S32K312::config::Mcu.xdm, category=SWCFG
          short-label=examples::EBT::Uart_Example_S32K312::TresosProject::Uart_Example_S32K312::config::Os.xdm, category=SWCFG
          short-label=examples::EBT::Uart_Example_S32K312::TresosProject::Uart_Example_S32K312::config::Platform.xdm, category=SWCFG
          short-label=examples::EBT::Uart_Example_S32K312::TresosProject::Uart_Example_S32K312::config::Port.xdm, category=SWCFG
          short-label=examples::EBT::Uart_Example_S32K312::TresosProject::Uart_Example_S32K312::config::Resource.xdm, category=SWCFG
          short-label=examples::EBT::Uart_Example_S32K312::TresosProject::Uart_Example_S32K312::config::Uart.xdm, category=SWCFG
          short-label=examples::EBT::Uart_Example_S32K342::generate::epc::Base.xdm, category=SWCFG
          short-label=examples::EBT::Uart_Example_S32K342::generate::epc::Dem.xdm, category=SWCFG
          short-label=examples::EBT::Uart_Example_S32K342::generate::epc::EcuC.xdm, category=SWCFG
          short-label=examples::EBT::Uart_Example_S32K342::generate::epc::Mcl.xdm, category=SWCFG
          short-label=examples::EBT::Uart_Example_S32K342::generate::epc::Mcu.xdm, category=SWCFG
          short-label=examples::EBT::Uart_Example_S32K342::generate::epc::Os.xdm, category=SWCFG
          short-label=examples::EBT::Uart_Example_S32K342::generate::epc::Platform.xdm, category=SWCFG
          short-label=examples::EBT::Uart_Example_S32K342::generate::epc::Port.xdm, category=SWCFG
          short-label=examples::EBT::Uart_Example_S32K342::generate::epc::Resource.xdm, category=SWCFG
          short-label=examples::EBT::Uart_Example_S32K342::generate::epc::Uart.xdm, category=SWCFG
          short-label=examples::EBT::Uart_Example_S32K342::include::check_example.h, category=SWHDR
          short-label=examples::EBT::Uart_Example_S32K342::src::main.c, category=SWSRC
          short-label=examples::EBT::Uart_Example_S32K342::TresosProject::Uart_Example_S32K342::.prefs::preferences.xdm, category=SWCFG
          short-label=examples::EBT::Uart_Example_S32K342::TresosProject::Uart_Example_S32K342::config::Base.xdm, category=SWCFG
          short-label=examples::EBT::Uart_Example_S32K342::TresosProject::Uart_Example_S32K342::config::Dem.xdm, category=SWCFG
          short-label=examples::EBT::Uart_Example_S32K342::TresosProject::Uart_Example_S32K342::config::EcuC.xdm, category=SWCFG
          short-label=examples::EBT::Uart_Example_S32K342::TresosProject::Uart_Example_S32K342::config::Mcl.xdm, category=SWCFG
          short-label=examples::EBT::Uart_Example_S32K342::TresosProject::Uart_Example_S32K342::config::Mcu.xdm, category=SWCFG
          short-label=examples::EBT::Uart_Example_S32K342::TresosProject::Uart_Example_S32K342::config::Os.xdm, category=SWCFG
          short-label=examples::EBT::Uart_Example_S32K342::TresosProject::Uart_Example_S32K342::config::Platform.xdm, category=SWCFG
          short-label=examples::EBT::Uart_Example_S32K342::TresosProject::Uart_Example_S32K342::config::Port.xdm, category=SWCFG
          short-label=examples::EBT::Uart_Example_S32K342::TresosProject::Uart_Example_S32K342::config::Resource.xdm, category=SWCFG
          short-label=examples::EBT::Uart_Example_S32K342::TresosProject::Uart_Example_S32K342::config::Uart.xdm, category=SWCFG
          short-label=examples::EBT::Uart_Example_S32K344::generate::epc::Base.xdm, category=SWCFG
          short-label=examples::EBT::Uart_Example_S32K344::generate::epc::Dem.xdm, category=SWCFG
          short-label=examples::EBT::Uart_Example_S32K344::generate::epc::EcuC.xdm, category=SWCFG
          short-label=examples::EBT::Uart_Example_S32K344::generate::epc::Mcl.xdm, category=SWCFG
          short-label=examples::EBT::Uart_Example_S32K344::generate::epc::Mcu.xdm, category=SWCFG
          short-label=examples::EBT::Uart_Example_S32K344::generate::epc::Os.xdm, category=SWCFG
          short-label=examples::EBT::Uart_Example_S32K344::generate::epc::Platform.xdm, category=SWCFG
          short-label=examples::EBT::Uart_Example_S32K344::generate::epc::Port.xdm, category=SWCFG
          short-label=examples::EBT::Uart_Example_S32K344::generate::epc::Resource.xdm, category=SWCFG
          short-label=examples::EBT::Uart_Example_S32K344::generate::epc::Uart.xdm, category=SWCFG
          short-label=examples::EBT::Uart_Example_S32K344::include::check_example.h, category=SWHDR
          short-label=examples::EBT::Uart_Example_S32K344::src::main.c, category=SWSRC
          short-label=examples::EBT::Uart_Example_S32K344::TresosProject::Uart_Example_S32K344::.prefs::preferences.xdm, category=SWCFG
          short-label=examples::EBT::Uart_Example_S32K344::TresosProject::Uart_Example_S32K344::config::Base.xdm, category=SWCFG
          short-label=examples::EBT::Uart_Example_S32K344::TresosProject::Uart_Example_S32K344::config::Dem.xdm, category=SWCFG
          short-label=examples::EBT::Uart_Example_S32K344::TresosProject::Uart_Example_S32K344::config::EcuC.xdm, category=SWCFG
          short-label=examples::EBT::Uart_Example_S32K344::TresosProject::Uart_Example_S32K344::config::Mcl.xdm, category=SWCFG
          short-label=examples::EBT::Uart_Example_S32K344::TresosProject::Uart_Example_S32K344::config::Mcu.xdm, category=SWCFG
          short-label=examples::EBT::Uart_Example_S32K344::TresosProject::Uart_Example_S32K344::config::Os.xdm, category=SWCFG
          short-label=examples::EBT::Uart_Example_S32K344::TresosProject::Uart_Example_S32K344::config::Platform.xdm, category=SWCFG
          short-label=examples::EBT::Uart_Example_S32K344::TresosProject::Uart_Example_S32K344::config::Port.xdm, category=SWCFG
          short-label=examples::EBT::Uart_Example_S32K344::TresosProject::Uart_Example_S32K344::config::Resource.xdm, category=SWCFG
          short-label=examples::EBT::Uart_Example_S32K344::TresosProject::Uart_Example_S32K344::config::Uart.xdm, category=SWCFG
          short-label=examples::S32DS::LpuartFlexio_Uart_Ip_Example_S32K312::include::check_example.h, category=SWHDR
          short-label=examples::S32DS::LpuartFlexio_Uart_Ip_Example_S32K312::Project_Settings::Startup_Code::exceptions.c, category=SWSRC
          short-label=examples::S32DS::LpuartFlexio_Uart_Ip_Example_S32K312::Project_Settings::Startup_Code::nvic.c, category=SWSRC
          short-label=examples::S32DS::LpuartFlexio_Uart_Ip_Example_S32K312::Project_Settings::Startup_Code::startup.c, category=SWSRC
          short-label=examples::S32DS::LpuartFlexio_Uart_Ip_Example_S32K312::Project_Settings::Startup_Code::system.c, category=SWSRC
          short-label=examples::S32DS::LpuartFlexio_Uart_Ip_Example_S32K312::src::main.c, category=SWSRC
          short-label=examples::S32DS::LpuartFlexio_Uart_Ip_Example_S32K342::include::check_example.h, category=SWHDR
          short-label=examples::S32DS::LpuartFlexio_Uart_Ip_Example_S32K342::Project_Settings::Startup_Code::exceptions.c, category=SWSRC
          short-label=examples::S32DS::LpuartFlexio_Uart_Ip_Example_S32K342::Project_Settings::Startup_Code::nvic.c, category=SWSRC
          short-label=examples::S32DS::LpuartFlexio_Uart_Ip_Example_S32K342::Project_Settings::Startup_Code::startup.c, category=SWSRC
          short-label=examples::S32DS::LpuartFlexio_Uart_Ip_Example_S32K342::Project_Settings::Startup_Code::system.c, category=SWSRC
          short-label=examples::S32DS::LpuartFlexio_Uart_Ip_Example_S32K342::src::main.c, category=SWSRC
          short-label=examples::S32DS::LpuartFlexio_Uart_Ip_Example_S32K344::include::check_example.h, category=SWHDR
          short-label=examples::S32DS::LpuartFlexio_Uart_Ip_Example_S32K344::Project_Settings::Startup_Code::exceptions.c, category=SWSRC
          short-label=examples::S32DS::LpuartFlexio_Uart_Ip_Example_S32K344::Project_Settings::Startup_Code::nvic.c, category=SWSRC
          short-label=examples::S32DS::LpuartFlexio_Uart_Ip_Example_S32K344::Project_Settings::Startup_Code::startup.c, category=SWSRC
          short-label=examples::S32DS::LpuartFlexio_Uart_Ip_Example_S32K344::Project_Settings::Startup_Code::system.c, category=SWSRC
          short-label=examples::S32DS::LpuartFlexio_Uart_Ip_Example_S32K344::src::main.c, category=SWSRC
          short-label=examples::S32DS::Uart_Example_S32K312::include::check_example.h, category=SWHDR
          short-label=examples::S32DS::Uart_Example_S32K312::Project_Settings::Startup_Code::exceptions.c, category=SWSRC
          short-label=examples::S32DS::Uart_Example_S32K312::Project_Settings::Startup_Code::nvic.c, category=SWSRC
          short-label=examples::S32DS::Uart_Example_S32K312::Project_Settings::Startup_Code::startup.c, category=SWSRC
          short-label=examples::S32DS::Uart_Example_S32K312::Project_Settings::Startup_Code::system.c, category=SWSRC
          short-label=examples::S32DS::Uart_Example_S32K312::src::main.c, category=SWSRC
          short-label=examples::S32DS::Uart_Example_S32K342::include::check_example.h, category=SWHDR
          short-label=examples::S32DS::Uart_Example_S32K342::Project_Settings::Startup_Code::exceptions.c, category=SWSRC
          short-label=examples::S32DS::Uart_Example_S32K342::Project_Settings::Startup_Code::nvic.c, category=SWSRC
          short-label=examples::S32DS::Uart_Example_S32K342::Project_Settings::Startup_Code::startup.c, category=SWSRC
          short-label=examples::S32DS::Uart_Example_S32K342::Project_Settings::Startup_Code::system.c, category=SWSRC
          short-label=examples::S32DS::Uart_Example_S32K342::src::main.c, category=SWSRC
          short-label=examples::S32DS::Uart_Example_S32K344::include::check_example.h, category=SWHDR
          short-label=examples::S32DS::Uart_Example_S32K344::Project_Settings::Startup_Code::exceptions.c, category=SWSRC
          short-label=examples::S32DS::Uart_Example_S32K344::Project_Settings::Startup_Code::nvic.c, category=SWSRC
          short-label=examples::S32DS::Uart_Example_S32K344::Project_Settings::Startup_Code::startup.c, category=SWSRC
          short-label=examples::S32DS::Uart_Example_S32K344::Project_Settings::Startup_Code::system.c, category=SWSRC
          short-label=examples::S32DS::Uart_Example_S32K344::src::main.c, category=SWSRC
          short-label=include::Flexio_Uart_Ip.h, category=SWHDR
          short-label=include::Flexio_Uart_Ip_HwAccess.h, category=SWHDR
          short-label=include::Flexio_Uart_Ip_Irq.h, category=SWHDR
          short-label=include::Flexio_Uart_Ip_Types.h, category=SWHDR
          short-label=include::Lpuart_Uart_Ip.h, category=SWHDR
          short-label=include::Lpuart_Uart_Ip_HwAccess.h, category=SWHDR
          short-label=include::Lpuart_Uart_Ip_Irq.h, category=SWHDR
          short-label=include::Lpuart_Uart_Ip_Types.h, category=SWHDR
          short-label=include::Uart.h, category=SWHDR
          short-label=include::Uart_Ipw.h, category=SWHDR
          short-label=include::Uart_Ipw_Types.h, category=SWHDR
          short-label=include::Uart_Types.h, category=SWHDR
          short-label=src::Flexio_Uart_Ip.c, category=SWSRC
          short-label=src::Flexio_Uart_Ip_Irq.c, category=SWSRC
          short-label=src::Lpuart_Uart_Ip.c, category=SWSRC
          short-label=src::Lpuart_Uart_Ip_Irq.c, category=SWSRC
          short-label=src::Uart.c, category=SWSRC
          short-label=src::Uart_Ipw.c, category=SWSRC
    compiler GCC_Compiler:
      name=GCC Compiler
      options=-mcpu=cortex-m7 -mthumb -mlittle-endian -mfpu=fpv5-sp-d16 -mfloat-abi=hard -std=c99 -Os -ggdb3 -Wall -Wextra -pedantic -Wstrict-prototypes -Wundef -Wunused -Werror=implicit-function-declaration -Wsign-compare -Wdouble-promotion -fno-short-enums -funsigned-char -funsigned-bitfields -fomit-frame-pointer -fno-common -fstack-usage -fdump-ipa-all -c -DS32K3XX -DS32K344 -DGCC -DUSE_SW_VECTOR_MODE -DD_CACHE_ENABLE -DI_CACHE_ENABLE -DENABLE_FPU -DMCAL_ENABLE_USER_MODE_SUPPORT
      vendor=GCC Systems
      version=NXP GCC 10.2.0 20200723 (Build 1728 Revision g5963bc8)
    compiler GHS_Compiler:
      name=Green Hills
      options=-cpu=cortexm7 -thumb -fpu=vfpv5_d16 -fsingle -C99 --ghstd=last -Osize --gnu_asm -dual_debug -G -keeptempfiles -Wimplicit-int -Wshadow -Wtrigraphs -Wundef --unsigned_chars --unsigned_fields --no_commons --no_exceptions --no_slash_comment --prototype_errors --incorrect_pragma_warnings -c -DS32K3XX -DS32K344 -DGHS -DUSE_SW_VECTOR_MODE -DD_CACHE_ENABLE -DI_CACHE_ENABLE -DENABLE_FPU -DMCAL_ENABLE_USER_MODE_SUPPORT
      vendor=Green Hills
      version=Green Hills Multi 7.1.6d / Compiler 2021.1.4
    compiler IAR_Compiler:
      name=IAR Compiler
      options=--cpu=Cortex-M7 --cpu_mode=thumb --endian=little --fpu=FPv5-SP -e -Ohz --debug --no_clustering --no_mem_idioms --do_explicit_zero_opt_in_named_sections --require_prototypes --no_wrap_diagnostics --diag_suppress=Pa050 -DS32K3XX -DS32K344 -DIAR -DUSE_SW_VECTOR_MODE -DD_CACHE_ENABLE -DI_CACHE_ENABLE -DENABLE_FPU -DMCAL_ENABLE_USER_MODE_SUPPORT
      vendor=IAR Systems
      version=IAR ANSI C/C++ Compiler v.8.50.10 (safety version)
    generated-artifacts:
      16 x dependency on artifact:
        Flexio_Uart_Ip_PBcfg_h: artifact-descriptor={short-label=generate_PB::include::Flexio_Uart_Ip_PBcfg.h, category=SWHDR}, usages=EXECUTE
        Lpuart_Uart_Ip_PBcfg_h: artifact-descriptor={short-label=generate_PB::include::Lpuart_Uart_Ip_PBcfg.h, category=SWHDR}, usages=EXECUTE
        Uart_Ipw_PBcfg_h: artifact-descriptor={short-label=generate_PB::include::Uart_Ipw_PBcfg.h, category=SWHDR}, usages=EXECUTE
        Uart_PBcfg_h: artifact-descriptor={short-label=generate_PB::include::Uart_PBcfg.h, category=SWHDR}, usages=EXECUTE
        Flexio_Uart_Ip_PBcfg_c: artifact-descriptor={short-label=generate_PB::src::Flexio_Uart_Ip_PBcfg.c, category=SWSRC}, usages=EXECUTE
        Lpuart_Uart_Ip_PBcfg_c: artifact-descriptor={short-label=generate_PB::src::Lpuart_Uart_Ip_PBcfg.c, category=SWSRC}, usages=EXECUTE
        Uart_Ipw_PBcfg_c: artifact-descriptor={short-label=generate_PB::src::Uart_Ipw_PBcfg.c, category=SWSRC}, usages=EXECUTE
        Uart_PBcfg_c: artifact-descriptor={short-label=generate_PB::src::Uart_PBcfg.c, category=SWSRC}, usages=EXECUTE
        Flexio_Uart_Ip_Cfg_h: artifact-descriptor={short-label=generate_PC::include::Flexio_Uart_Ip_Cfg.h, category=SWHDR}, usages=COMPILE
        Flexio_Uart_Ip_CfgDefines_h: artifact-descriptor={short-label=generate_PC::include::Flexio_Uart_Ip_CfgDefines.h, category=SWHDR}, usages=COMPILE
        Flexio_Uart_Ip_Defines_h: artifact-descriptor={short-label=generate_PC::include::Flexio_Uart_Ip_Defines.h, category=SWHDR}, usages=COMPILE
        Lpuart_Uart_Ip_Cfg_h: artifact-descriptor={short-label=generate_PC::include::Lpuart_Uart_Ip_Cfg.h, category=SWHDR}, usages=COMPILE
        Lpuart_Uart_Ip_Defines_h: artifact-descriptor={short-label=generate_PC::include::Lpuart_Uart_Ip_Defines.h, category=SWHDR}, usages=COMPILE
        Uart_Cfg_h: artifact-descriptor={short-label=generate_PC::include::Uart_Cfg.h, category=SWHDR}, usages=COMPILE
        Uart_Defines_h: artifact-descriptor={short-label=generate_PC::include::Uart_Defines.h, category=SWHDR}, usages=COMPILE
        Uart_Ipw_Cfg_h: artifact-descriptor={short-label=generate_PC::include::Uart_Ipw_Cfg.h, category=SWHDR}, usages=COMPILE
    linker GCC_Linker: name=GCC Compiler, options=-Wl,-Map,filename -T linkerfile --entry=Reset_Handler -nostartfiles -mcpu=cortexm7 -mthumb -mfpu=fpv5-sp-d16 -mfloat-abi=hard -mlittle-endian -ggdb3 -lc -lm -lgcc, vendor=GCC Systems, version=NXP GCC 10.2.0 20200723 (Build 1728 Revision g5963bc8)
    linker GHS_Linker: name=Green Hills, options=-e Reset_Handler -T linker_script_file.ld -map -keepmap -Mn -delete -ignore_debug_references -Llibrary_path -larch -lstartup -lind_sd -v -keep=C40_Ip_AccessCode -nostartfiles, vendor=Green Hills, version=Green Hills Multi 7.1.6d / Compiler 2021.1.4
    linker IAR_Linker: name=IAR Compiler, options=--map filename --config linkerfile --cpu=Cortex-M7 --fpu=FPv5-SP --entry _start --enable_stack_usage --skip_dynamic_initialization --no_wrap_diagnostics, vendor=IAR Systems, version=IAR ANSI C/C++ Compiler v.8.50.10 (safety version)
    resource consumption ResourceConsumption
      8 x memory section:
        UART_CODE: alignment=UNSPECIFIED, sw-addrmethod=CODE, symbol=CODE
        UART_CONFIG_DATA_UNSPECIFIED: alignment=UNSPECIFIED, sw-addrmethod=CONFIG_DATA, symbol=CONFIG_DATA_UNSPECIFIED
        UART_CONST_BOOLEAN: alignment=BOOLEAN, sw-addrmethod=CONST, symbol=CONST_BOOLEAN
        UART_CONST_UNSPECIFIED: alignment=UNSPECIFIED, sw-addrmethod=CONST, symbol=CONST_UNSPECIFIED
        UART_VAR_CLEARED_32: alignment=32, sw-addrmethod=VAR_CLEARED, symbol=VAR_CLEARED_32
        UART_VAR_CLEARED_UNSPECIFIED: alignment=UNSPECIFIED, sw-addrmethod=VAR_CLEARED, symbol=VAR_CLEARED_UNSPECIFIED
        UART_VAR_CLEARED_UNSPECIFIED_NO_CACHEABLE: alignment=UNSPECIFIED, sw-addrmethod=VAR_CLEARED_UNSPECIFIED_NO, symbol=VAR_CLEARED_UNSPECIFIED_NO_CACHEABLE
        UART_VAR_INIT_8: alignment=8, sw-addrmethod=VAR_INIT, symbol=VAR_INIT_8
