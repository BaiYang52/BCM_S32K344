AUTOSAR XML (schema 00046)
package /AUTOSAR_Gpt/BswModuleDescriptions
  bsw module description Gpt: module-id=100
    provided-entrys:
      Gpt_ChangeNextTimeoutValue
      Gpt_Channel_DisableChainMode
      Gpt_Channel_EnableChainMode
      Gpt_CheckWakeup
      Gpt_DeInit
      Gpt_DisableNotification
      Gpt_DisableWakeup
      Gpt_EnableNotification
      Gpt_EnableWakeup
      Gpt_GetPredefTimerValue
      Gpt_GetTimeElapsed
      Gpt_GetTimeRemaining
      Gpt_GetVersionInfo
      Gpt_Init
      Gpt_SetClockMode
      Gpt_SetMode
      Gpt_StartTimer
      Gpt_StopTimer
      CE_PIT_{0..5}_ISR
      PIT_{0..2}_ISR
      PIT_4_ISR
      PIT_5_ISR
      RTC_0_Ch_0_ISR
      RTU_PIT_0_ISR
      RTU_PIT_1_ISR
      STM_0_ISR
      STM_{10..12}_ISR
      STM_{1..9}_ISR
    bsw internal behavior InternalBehavior_0
      17 x exclusive area:
        GPT_EXCLUSIVE_AREA_{00..07}
        GPT_EXCLUSIVE_AREA_{10..12}
        GPT_EXCLUSIVE_AREA_{29..31}
        GPT_EXCLUSIVE_AREA_35
        GPT_EXCLUSIVE_AREA_36
        GPT_EXCLUSIVE_AREA_38
      18 x bsw called entity:
        Gpt_ChangeNextTimeoutValue: implemented-entry=Gpt_ChangeNextTimeoutValue
        Gpt_Channel_DisableChainMode: can-enter-exclusive-area=GPT_EXCLUSIVE_AREA_01, implemented-entry=Gpt_Channel_DisableChainMode
        Gpt_Channel_EnableChainMode: can-enter-exclusive-area=GPT_EXCLUSIVE_AREA_01, implemented-entry=Gpt_Channel_EnableChainMode
        Gpt_CheckWakeup: implemented-entry=Gpt_CheckWakeup
        Gpt_DeInit: can-enter-exclusive-area=[GPT_EXCLUSIVE_AREA_05, GPT_EXCLUSIVE_AREA_30, GPT_EXCLUSIVE_AREA_31], implemented-entry=Gpt_DeInit
        Gpt_DisableNotification: can-enter-exclusive-area=[GPT_EXCLUSIVE_AREA_02, GPT_EXCLUSIVE_AREA_03, GPT_EXCLUSIVE_AREA_10, GPT_EXCLUSIVE_AREA_11, GPT_EXCLUSIVE_AREA_35], implemented-entry=Gpt_DisableNotification
        Gpt_DisableWakeup: implemented-entry=Gpt_DisableWakeup
        Gpt_EnableNotification: can-enter-exclusive-area=[GPT_EXCLUSIVE_AREA_02, GPT_EXCLUSIVE_AREA_03, GPT_EXCLUSIVE_AREA_10, GPT_EXCLUSIVE_AREA_11, GPT_EXCLUSIVE_AREA_35], implemented-entry=Gpt_EnableNotification
        Gpt_EnableWakeup: can-enter-exclusive-area=[GPT_EXCLUSIVE_AREA_02, GPT_EXCLUSIVE_AREA_10], implemented-entry=Gpt_EnableWakeup
        Gpt_GetPredefTimerValue: implemented-entry=Gpt_GetPredefTimerValue
        Gpt_GetTimeElapsed: implemented-entry=Gpt_GetTimeElapsed
        Gpt_GetTimeRemaining: implemented-entry=Gpt_GetTimeRemaining
        Gpt_GetVersionInfo: implemented-entry=Gpt_GetVersionInfo
        Gpt_Init: can-enter-exclusive-area=[GPT_EXCLUSIVE_AREA_00, GPT_EXCLUSIVE_AREA_02, GPT_EXCLUSIVE_AREA_03, GPT_EXCLUSIVE_AREA_05, GPT_EXCLUSIVE_AREA_12, GPT_EXCLUSIVE_AREA_29, GPT_EXCLUSIVE_AREA_30, GPT_EXCLUSIVE_AREA_31, GPT_EXCLUSIVE_AREA_35, GPT_EXCLUSIVE_AREA_36], implemented-entry=Gpt_Init
        Gpt_SetClockMode: implemented-entry=Gpt_SetClockMode
        Gpt_SetMode: can-enter-exclusive-area=[GPT_EXCLUSIVE_AREA_02, GPT_EXCLUSIVE_AREA_10, GPT_EXCLUSIVE_AREA_11], implemented-entry=Gpt_SetMode
        Gpt_StartTimer: can-enter-exclusive-area=[GPT_EXCLUSIVE_AREA_00, GPT_EXCLUSIVE_AREA_04, GPT_EXCLUSIVE_AREA_05, GPT_EXCLUSIVE_AREA_06, GPT_EXCLUSIVE_AREA_07, GPT_EXCLUSIVE_AREA_10, GPT_EXCLUSIVE_AREA_11, GPT_EXCLUSIVE_AREA_30, GPT_EXCLUSIVE_AREA_36, GPT_EXCLUSIVE_AREA_38], implemented-entry=Gpt_StartTimer
        Gpt_StopTimer: can-enter-exclusive-area=[GPT_EXCLUSIVE_AREA_00, GPT_EXCLUSIVE_AREA_05, GPT_EXCLUSIVE_AREA_06, GPT_EXCLUSIVE_AREA_07, GPT_EXCLUSIVE_AREA_30, GPT_EXCLUSIVE_AREA_36], implemented-entry=Gpt_StopTimer
      27 x bsw interrupt entity, all with interrupt-category=CAT-2, interrupt-source=Hardware:
        CE_PIT_{0..5}_ISR: implemented-entry=CE_PIT_{0..5}_ISR
        PIT_{0..2}_ISR: implemented-entry=PIT_{0..2}_ISR
        PIT_4_ISR: implemented-entry=PIT_4_ISR
        PIT_5_ISR: implemented-entry=PIT_5_ISR
        RTC_0_Ch_0_ISR: implemented-entry=RTC_0_Ch_0_ISR
        RTU_PIT_0_ISR: implemented-entry=RTU_PIT_0_ISR
        RTU_PIT_1_ISR: implemented-entry=RTU_PIT_1_ISR
        STM_0_ISR: implemented-entry=STM_0_ISR
        STM_{10..12}_ISR: implemented-entry=STM_{10..12}_ISR
        STM_{1..9}_ISR: implemented-entry=STM_{1..9}_ISR
package /AUTOSAR_Gpt/BswModuleEntrys
  45 x bsw module entry, all with is-synchronous=true, sw-service-impl-policy=STANDARD:
    Gpt_ChangeNextTimeoutValue: service-id=0x0f, is-reentrant=true, call-type=REGULAR, execution-context=UNSPECIFIED
    Gpt_Channel_DisableChainMode: service-id=0x22, is-reentrant=true, call-type=REGULAR, execution-context=UNSPECIFIED
    Gpt_Channel_EnableChainMode: service-id=0x21, is-reentrant=true, call-type=REGULAR, execution-context=UNSPECIFIED
    Gpt_CheckWakeup: service-id=0x0c, is-reentrant=true, call-type=REGULAR, execution-context=UNSPECIFIED
    Gpt_DeInit: service-id=0x02, is-reentrant=false, call-type=REGULAR, execution-context=UNSPECIFIED
    Gpt_DisableNotification: service-id=0x08, is-reentrant=false, call-type=REGULAR, execution-context=UNSPECIFIED
    Gpt_DisableWakeup: service-id=0x0a, is-reentrant=false, call-type=REGULAR, execution-context=UNSPECIFIED
    Gpt_EnableNotification: service-id=0x07, is-reentrant=false, call-type=REGULAR, execution-context=UNSPECIFIED
    Gpt_EnableWakeup: service-id=0x0b, is-reentrant=false, call-type=REGULAR, execution-context=UNSPECIFIED
    Gpt_GetPredefTimerValue: service-id=0x0d, is-reentrant=true, call-type=REGULAR, execution-context=UNSPECIFIED
    Gpt_GetTimeElapsed: service-id=0x03, is-reentrant=true, call-type=REGULAR, execution-context=UNSPECIFIED
    Gpt_GetTimeRemaining: service-id=0x04, is-reentrant=true, call-type=REGULAR, execution-context=UNSPECIFIED
    Gpt_GetVersionInfo: service-id=0x00, is-reentrant=true, call-type=REGULAR, execution-context=UNSPECIFIED
    Gpt_Init: service-id=0x01, is-reentrant=false, call-type=REGULAR, execution-context=UNSPECIFIED
    Gpt_SetClockMode: service-id=0x10, is-reentrant=false, call-type=REGULAR, execution-context=UNSPECIFIED
    Gpt_SetMode: service-id=0x09, is-reentrant=false, call-type=REGULAR, execution-context=UNSPECIFIED
    Gpt_StartTimer: service-id=0x05, is-reentrant=false, call-type=REGULAR, execution-context=UNSPECIFIED
    Gpt_StopTimer: service-id=0x06, is-reentrant=false, call-type=REGULAR, execution-context=UNSPECIFIED
    CE_PIT_{0..5}_ISR: service-id=0, is-reentrant=false, call-type=INTERRUPT, execution-context=INTERRUPT-CAT-2
    PIT_{0..2}_ISR: service-id=0, is-reentrant=false, call-type=INTERRUPT, execution-context=INTERRUPT-CAT-2
    PIT_4_ISR: service-id=0, is-reentrant=false, call-type=INTERRUPT, execution-context=INTERRUPT-CAT-2
    PIT_5_ISR: service-id=0, is-reentrant=false, call-type=INTERRUPT, execution-context=INTERRUPT-CAT-2
    RTC_0_Ch_0_ISR: service-id=0, is-reentrant=false, call-type=INTERRUPT, execution-context=INTERRUPT-CAT-2
    RTU_PIT_0_ISR: service-id=0, is-reentrant=false, call-type=INTERRUPT, execution-context=INTERRUPT-CAT-2
    RTU_PIT_1_ISR: service-id=0, is-reentrant=false, call-type=INTERRUPT, execution-context=INTERRUPT-CAT-2
    STM_0_ISR: service-id=0, is-reentrant=false, call-type=INTERRUPT, execution-context=INTERRUPT-CAT-2
    STM_{10..12}_ISR: service-id=0, is-reentrant=false, call-type=INTERRUPT, execution-context=INTERRUPT-CAT-2
    STM_{1..9}_ISR: service-id=0, is-reentrant=false, call-type=INTERRUPT, execution-context=INTERRUPT-CAT-2
package /Gpt_TS_T40D34M20I1R0/Implementations
  bsw implementation BswImplementation_0: programming-language=C, sw-version=2.0.1, vendor-id=43, ar-release-version=4.4.0, behavior=InternalBehavior_0, vendor-specific-module-def=Gpt
    code-descriptors:
      code Files
        artifact-descriptors:
          short-label=config::Gpt.xdm, category=SWCFG
          short-label=doc::RTD_GPT_IM.pdf, category=SWDOC
          short-label=doc::RTD_GPT_UM.pdf, category=SWDOC
          short-label=examples::EBT::Gpt_example_S32K312::generate::epc::Base.xdm, category=SWCFG
          short-label=examples::EBT::Gpt_example_S32K312::generate::epc::Dem.xdm, category=SWCFG
          short-label=examples::EBT::Gpt_example_S32K312::generate::epc::Dio.xdm, category=SWCFG
          short-label=examples::EBT::Gpt_example_S32K312::generate::epc::Gpt.xdm, category=SWCFG
          short-label=examples::EBT::Gpt_example_S32K312::generate::epc::Mcu.xdm, category=SWCFG
          short-label=examples::EBT::Gpt_example_S32K312::generate::epc::Os.xdm, category=SWCFG
          short-label=examples::EBT::Gpt_example_S32K312::generate::epc::Platform.xdm, category=SWCFG
          short-label=examples::EBT::Gpt_example_S32K312::generate::epc::Port.xdm, category=SWCFG
          short-label=examples::EBT::Gpt_example_S32K312::generate::epc::Resource.xdm, category=SWCFG
          short-label=examples::EBT::Gpt_example_S32K312::include::check_example.h, category=SWHDR
          short-label=examples::EBT::Gpt_example_S32K312::src::main.c, category=SWSRC
          short-label=examples::EBT::Gpt_example_S32K312::TresosProject::Gpt_example_S32K312::.prefs::preferences.xdm, category=SWCFG
          short-label=examples::EBT::Gpt_example_S32K312::TresosProject::Gpt_example_S32K312::config::Base.xdm, category=SWCFG
          short-label=examples::EBT::Gpt_example_S32K312::TresosProject::Gpt_example_S32K312::config::Dem.xdm, category=SWCFG
          short-label=examples::EBT::Gpt_example_S32K312::TresosProject::Gpt_example_S32K312::config::Dio.xdm, category=SWCFG
          short-label=examples::EBT::Gpt_example_S32K312::TresosProject::Gpt_example_S32K312::config::EcuC.xdm, category=SWCFG
          short-label=examples::EBT::Gpt_example_S32K312::TresosProject::Gpt_example_S32K312::config::Gpt.xdm, category=SWCFG
          short-label=examples::EBT::Gpt_example_S32K312::TresosProject::Gpt_example_S32K312::config::Mcu.xdm, category=SWCFG
          short-label=examples::EBT::Gpt_example_S32K312::TresosProject::Gpt_example_S32K312::config::Os.xdm, category=SWCFG
          short-label=examples::EBT::Gpt_example_S32K312::TresosProject::Gpt_example_S32K312::config::Platform.xdm, category=SWCFG
          short-label=examples::EBT::Gpt_example_S32K312::TresosProject::Gpt_example_S32K312::config::Port.xdm, category=SWCFG
          short-label=examples::EBT::Gpt_example_S32K312::TresosProject::Gpt_example_S32K312::config::Resource.xdm, category=SWCFG
          short-label=examples::EBT::Gpt_example_S32K342::generate::epc::Base.xdm, category=SWCFG
          short-label=examples::EBT::Gpt_example_S32K342::generate::epc::Dem.xdm, category=SWCFG
          short-label=examples::EBT::Gpt_example_S32K342::generate::epc::Dio.xdm, category=SWCFG
          short-label=examples::EBT::Gpt_example_S32K342::generate::epc::Gpt.xdm, category=SWCFG
          short-label=examples::EBT::Gpt_example_S32K342::generate::epc::Mcu.xdm, category=SWCFG
          short-label=examples::EBT::Gpt_example_S32K342::generate::epc::Os.xdm, category=SWCFG
          short-label=examples::EBT::Gpt_example_S32K342::generate::epc::Platform.xdm, category=SWCFG
          short-label=examples::EBT::Gpt_example_S32K342::generate::epc::Port.xdm, category=SWCFG
          short-label=examples::EBT::Gpt_example_S32K342::generate::epc::Resource.xdm, category=SWCFG
          short-label=examples::EBT::Gpt_example_S32K342::include::check_example.h, category=SWHDR
          short-label=examples::EBT::Gpt_example_S32K342::src::main.c, category=SWSRC
          short-label=examples::EBT::Gpt_example_S32K342::TresosProject::Gpt_example_S32K342::.prefs::preferences.xdm, category=SWCFG
          short-label=examples::EBT::Gpt_example_S32K342::TresosProject::Gpt_example_S32K342::config::Base.xdm, category=SWCFG
          short-label=examples::EBT::Gpt_example_S32K342::TresosProject::Gpt_example_S32K342::config::Dem.xdm, category=SWCFG
          short-label=examples::EBT::Gpt_example_S32K342::TresosProject::Gpt_example_S32K342::config::Dio.xdm, category=SWCFG
          short-label=examples::EBT::Gpt_example_S32K342::TresosProject::Gpt_example_S32K342::config::EcuC.xdm, category=SWCFG
          short-label=examples::EBT::Gpt_example_S32K342::TresosProject::Gpt_example_S32K342::config::Gpt.xdm, category=SWCFG
          short-label=examples::EBT::Gpt_example_S32K342::TresosProject::Gpt_example_S32K342::config::Mcu.xdm, category=SWCFG
          short-label=examples::EBT::Gpt_example_S32K342::TresosProject::Gpt_example_S32K342::config::Os.xdm, category=SWCFG
          short-label=examples::EBT::Gpt_example_S32K342::TresosProject::Gpt_example_S32K342::config::Platform.xdm, category=SWCFG
          short-label=examples::EBT::Gpt_example_S32K342::TresosProject::Gpt_example_S32K342::config::Port.xdm, category=SWCFG
          short-label=examples::EBT::Gpt_example_S32K342::TresosProject::Gpt_example_S32K342::config::Resource.xdm, category=SWCFG
          short-label=examples::EBT::Gpt_example_S32K344::generate::epc::Base.xdm, category=SWCFG
          short-label=examples::EBT::Gpt_example_S32K344::generate::epc::Dem.xdm, category=SWCFG
          short-label=examples::EBT::Gpt_example_S32K344::generate::epc::Dio.xdm, category=SWCFG
          short-label=examples::EBT::Gpt_example_S32K344::generate::epc::Gpt.xdm, category=SWCFG
          short-label=examples::EBT::Gpt_example_S32K344::generate::epc::Mcu.xdm, category=SWCFG
          short-label=examples::EBT::Gpt_example_S32K344::generate::epc::Os.xdm, category=SWCFG
          short-label=examples::EBT::Gpt_example_S32K344::generate::epc::Platform.xdm, category=SWCFG
          short-label=examples::EBT::Gpt_example_S32K344::generate::epc::Port.xdm, category=SWCFG
          short-label=examples::EBT::Gpt_example_S32K344::generate::epc::Resource.xdm, category=SWCFG
          short-label=examples::EBT::Gpt_example_S32K344::include::check_example.h, category=SWHDR
          short-label=examples::EBT::Gpt_example_S32K344::src::main.c, category=SWSRC
          short-label=examples::EBT::Gpt_example_S32K344::TresosProject::Gpt_example_S32K344::.prefs::preferences.xdm, category=SWCFG
          short-label=examples::EBT::Gpt_example_S32K344::TresosProject::Gpt_example_S32K344::config::Base.xdm, category=SWCFG
          short-label=examples::EBT::Gpt_example_S32K344::TresosProject::Gpt_example_S32K344::config::Dem.xdm, category=SWCFG
          short-label=examples::EBT::Gpt_example_S32K344::TresosProject::Gpt_example_S32K344::config::Dio.xdm, category=SWCFG
          short-label=examples::EBT::Gpt_example_S32K344::TresosProject::Gpt_example_S32K344::config::EcuC.xdm, category=SWCFG
          short-label=examples::EBT::Gpt_example_S32K344::TresosProject::Gpt_example_S32K344::config::Gpt.xdm, category=SWCFG
          short-label=examples::EBT::Gpt_example_S32K344::TresosProject::Gpt_example_S32K344::config::Mcu.xdm, category=SWCFG
          short-label=examples::EBT::Gpt_example_S32K344::TresosProject::Gpt_example_S32K344::config::Os.xdm, category=SWCFG
          short-label=examples::EBT::Gpt_example_S32K344::TresosProject::Gpt_example_S32K344::config::Platform.xdm, category=SWCFG
          short-label=examples::EBT::Gpt_example_S32K344::TresosProject::Gpt_example_S32K344::config::Port.xdm, category=SWCFG
          short-label=examples::EBT::Gpt_example_S32K344::TresosProject::Gpt_example_S32K344::config::Resource.xdm, category=SWCFG
          short-label=examples::S32DS::Gpt_example_S32K312::include::check_example.h, category=SWHDR
          short-label=examples::S32DS::Gpt_example_S32K312::Project_Settings::Startup_Code::exceptions.c, category=SWSRC
          short-label=examples::S32DS::Gpt_example_S32K312::Project_Settings::Startup_Code::nvic.c, category=SWSRC
          short-label=examples::S32DS::Gpt_example_S32K312::Project_Settings::Startup_Code::startup.c, category=SWSRC
          short-label=examples::S32DS::Gpt_example_S32K312::Project_Settings::Startup_Code::system.c, category=SWSRC
          short-label=examples::S32DS::Gpt_example_S32K312::src::main.c, category=SWSRC
          short-label=examples::S32DS::Gpt_example_S32K342::include::check_example.h, category=SWHDR
          short-label=examples::S32DS::Gpt_example_S32K342::Project_Settings::Startup_Code::exceptions.c, category=SWSRC
          short-label=examples::S32DS::Gpt_example_S32K342::Project_Settings::Startup_Code::nvic.c, category=SWSRC
          short-label=examples::S32DS::Gpt_example_S32K342::Project_Settings::Startup_Code::startup.c, category=SWSRC
          short-label=examples::S32DS::Gpt_example_S32K342::Project_Settings::Startup_Code::system.c, category=SWSRC
          short-label=examples::S32DS::Gpt_example_S32K342::src::main.c, category=SWSRC
          short-label=examples::S32DS::Gpt_example_S32K344::include::check_example.h, category=SWHDR
          short-label=examples::S32DS::Gpt_example_S32K344::Project_Settings::Startup_Code::exceptions.c, category=SWSRC
          short-label=examples::S32DS::Gpt_example_S32K344::Project_Settings::Startup_Code::nvic.c, category=SWSRC
          short-label=examples::S32DS::Gpt_example_S32K344::Project_Settings::Startup_Code::startup.c, category=SWSRC
          short-label=examples::S32DS::Gpt_example_S32K344::Project_Settings::Startup_Code::system.c, category=SWSRC
          short-label=examples::S32DS::Gpt_example_S32K344::src::main.c, category=SWSRC
          short-label=examples::S32DS::Pit_Ip_example_S32K312::include::check_example.h, category=SWHDR
          short-label=examples::S32DS::Pit_Ip_example_S32K312::Project_Settings::Startup_Code::exceptions.c, category=SWSRC
          short-label=examples::S32DS::Pit_Ip_example_S32K312::Project_Settings::Startup_Code::nvic.c, category=SWSRC
          short-label=examples::S32DS::Pit_Ip_example_S32K312::Project_Settings::Startup_Code::startup.c, category=SWSRC
          short-label=examples::S32DS::Pit_Ip_example_S32K312::Project_Settings::Startup_Code::system.c, category=SWSRC
          short-label=examples::S32DS::Pit_Ip_example_S32K312::src::main.c, category=SWSRC
          short-label=examples::S32DS::Pit_Ip_example_S32K342::include::check_example.h, category=SWHDR
          short-label=examples::S32DS::Pit_Ip_example_S32K342::Project_Settings::Startup_Code::exceptions.c, category=SWSRC
          short-label=examples::S32DS::Pit_Ip_example_S32K342::Project_Settings::Startup_Code::nvic.c, category=SWSRC
          short-label=examples::S32DS::Pit_Ip_example_S32K342::Project_Settings::Startup_Code::startup.c, category=SWSRC
          short-label=examples::S32DS::Pit_Ip_example_S32K342::Project_Settings::Startup_Code::system.c, category=SWSRC
          short-label=examples::S32DS::Pit_Ip_example_S32K342::src::main.c, category=SWSRC
          short-label=examples::S32DS::Pit_Ip_example_S32K344::include::check_example.h, category=SWHDR
          short-label=examples::S32DS::Pit_Ip_example_S32K344::Project_Settings::Startup_Code::exceptions.c, category=SWSRC
          short-label=examples::S32DS::Pit_Ip_example_S32K344::Project_Settings::Startup_Code::nvic.c, category=SWSRC
          short-label=examples::S32DS::Pit_Ip_example_S32K344::Project_Settings::Startup_Code::startup.c, category=SWSRC
          short-label=examples::S32DS::Pit_Ip_example_S32K344::Project_Settings::Startup_Code::system.c, category=SWSRC
          short-label=examples::S32DS::Pit_Ip_example_S32K344::src::main.c, category=SWSRC
          short-label=include::Emios_Gpt_Ip.h, category=SWHDR
          short-label=include::Emios_Gpt_Ip_Types.h, category=SWHDR
          short-label=include::Gpt.h, category=SWHDR
          short-label=include::Gpt_EnvCfg.h, category=SWHDR
          short-label=include::Gpt_Ipw.h, category=SWHDR
          short-label=include::Gpt_Ipw_Irq.h, category=SWHDR
          short-label=include::Gpt_Ipw_Types.h, category=SWHDR
          short-label=include::Gpt_Irq.h, category=SWHDR
          short-label=include::Pit_Ip.h, category=SWHDR
          short-label=include::Pit_Ip_Types.h, category=SWHDR
          short-label=include::Rtc_Ip.h, category=SWHDR
          short-label=include::Rtc_Ip_Types.h, category=SWHDR
          short-label=include::Stm_Ip.h, category=SWHDR
          short-label=include::Stm_Ip_TrustedFunctions.h, category=SWHDR
          short-label=include::Stm_Ip_Types.h, category=SWHDR
          short-label=src::Emios_Gpt_Ip.c, category=SWSRC
          short-label=src::Gpt.c, category=SWSRC
          short-label=src::Gpt_Ipw.c, category=SWSRC
          short-label=src::Pit_Ip.c, category=SWSRC
          short-label=src::Rtc_Ip.c, category=SWSRC
          short-label=src::Stm_Ip.c, category=SWSRC
    compiler GCC_Compiler:
      name=GCC Compiler
      options=-mcpu=cortex-m7 -mthumb -mlittle-endian -mfpu=fpv5-sp-d16 -mfloat-abi=hard -std=c99 -Os -ggdb3 -Wall -Wextra -pedantic -Wstrict-prototypes -Wundef -Wunused -Werror=implicit-function-declaration -Wsign-compare -Wdouble-promotion -fno-short-enums -funsigned-char -funsigned-bitfields -fomit-frame-pointer -fno-common -fstack-usage -fdump-ipa-all -c -DS32K3XX -DS32K344 -DGCC -DUSE_SW_VECTOR_MODE -DD_CACHE_ENABLE -DI_CACHE_ENABLE -DENABLE_FPU -DMCAL_ENABLE_USER_MODE_SUPPORT
      vendor=GCC Systems
      version=NXP GCC 10.2.0 20200723 (Build 1728 Revision g5963bc8)
    compiler GHS_Compiler:
      name=Green Hills
      options=-cpu=cortexm7 -thumb -fpu=vfpv5_d16 -fsingle -C99 --ghstd=last -Osize --gnu_asm -dual_debug -G -keeptempfiles -Wimplicit-int -Wshadow -Wtrigraphs -Wundef --unsigned_chars --unsigned_fields --no_commons --no_exceptions --no_slash_comment --prototype_errors --incorrect_pragma_warnings -c -DS32K3XX -DS32K344 -DGHS -DUSE_SW_VECTOR_MODE -DD_CACHE_ENABLE -DI_CACHE_ENABLE -DENABLE_FPU -DMCAL_ENABLE_USER_MODE_SUPPORT
      vendor=Green Hills
      version=Green Hills Multi 7.1.6d / Compiler 2021.1.4
    compiler IAR_Compiler:
      name=IAR Compiler
      options=--cpu=Cortex-M7 --cpu_mode=thumb --endian=little --fpu=FPv5-SP -e -Ohz --debug --no_clustering --no_mem_idioms --do_explicit_zero_opt_in_named_sections --require_prototypes --no_wrap_diagnostics --diag_suppress=Pa050 -DS32K3XX -DS32K344 -DIAR -DUSE_SW_VECTOR_MODE -DD_CACHE_ENABLE -DI_CACHE_ENABLE -DENABLE_FPU -DMCAL_ENABLE_USER_MODE_SUPPORT
      vendor=IAR Systems
      version=IAR ANSI C/C++ Compiler v.8.50.10 (safety version)
    generated-artifacts:
      22 x dependency on artifact:
        Emios_Gpt_Ip_PBcfg_h: artifact-descriptor={short-label=generate_PB::include::Emios_Gpt_Ip_PBcfg.h, category=SWHDR}, usages=EXECUTE
        Gpt_Ipw_PBcfg_h: artifact-descriptor={short-label=generate_PB::include::Gpt_Ipw_PBcfg.h, category=SWHDR}, usages=EXECUTE
        Gpt_PBcfg_h: artifact-descriptor={short-label=generate_PB::include::Gpt_PBcfg.h, category=SWHDR}, usages=EXECUTE
        Pit_Ip_PBcfg_h: artifact-descriptor={short-label=generate_PB::include::Pit_Ip_PBcfg.h, category=SWHDR}, usages=EXECUTE
        Rtc_Ip_PBcfg_h: artifact-descriptor={short-label=generate_PB::include::Rtc_Ip_PBcfg.h, category=SWHDR}, usages=EXECUTE
        Stm_Ip_PBcfg_h: artifact-descriptor={short-label=generate_PB::include::Stm_Ip_PBcfg.h, category=SWHDR}, usages=EXECUTE
        Emios_Gpt_Ip_PBcfg_c: artifact-descriptor={short-label=generate_PB::src::Emios_Gpt_Ip_PBcfg.c, category=SWSRC}, usages=EXECUTE
        Gpt_Ipw_PBcfg_c: artifact-descriptor={short-label=generate_PB::src::Gpt_Ipw_PBcfg.c, category=SWSRC}, usages=EXECUTE
        Gpt_PBcfg_c: artifact-descriptor={short-label=generate_PB::src::Gpt_PBcfg.c, category=SWSRC}, usages=EXECUTE
        Pit_Ip_PBcfg_c: artifact-descriptor={short-label=generate_PB::src::Pit_Ip_PBcfg.c, category=SWSRC}, usages=EXECUTE
        Rtc_Ip_PBcfg_c: artifact-descriptor={short-label=generate_PB::src::Rtc_Ip_PBcfg.c, category=SWSRC}, usages=EXECUTE
        Stm_Ip_PBcfg_c: artifact-descriptor={short-label=generate_PB::src::Stm_Ip_PBcfg.c, category=SWSRC}, usages=EXECUTE
        Emios_Gpt_Ip_Cfg_h: artifact-descriptor={short-label=generate_PC::include::Emios_Gpt_Ip_Cfg.h, category=SWHDR}, usages=COMPILE
        Emios_Gpt_Ip_Cfg_Defines_h: artifact-descriptor={short-label=generate_PC::include::Emios_Gpt_Ip_Cfg_Defines.h, category=SWHDR}, usages=COMPILE
        Gpt_Cfg_h: artifact-descriptor={short-label=generate_PC::include::Gpt_Cfg.h, category=SWHDR}, usages=COMPILE
        Pit_Ip_Cfg_h: artifact-descriptor={short-label=generate_PC::include::Pit_Ip_Cfg.h, category=SWHDR}, usages=COMPILE
        Pit_Ip_Cfg_Defines_h: artifact-descriptor={short-label=generate_PC::include::Pit_Ip_Cfg_Defines.h, category=SWHDR}, usages=COMPILE
        Rtc_Ip_Cfg_h: artifact-descriptor={short-label=generate_PC::include::Rtc_Ip_Cfg.h, category=SWHDR}, usages=COMPILE
        Rtc_Ip_Cfg_Defines_h: artifact-descriptor={short-label=generate_PC::include::Rtc_Ip_Cfg_Defines.h, category=SWHDR}, usages=COMPILE
        Stm_Ip_Cfg_h: artifact-descriptor={short-label=generate_PC::include::Stm_Ip_Cfg.h, category=SWHDR}, usages=COMPILE
        Stm_Ip_Cfg_Defines_h: artifact-descriptor={short-label=generate_PC::include::Stm_Ip_Cfg_Defines.h, category=SWHDR}, usages=COMPILE
        Gpt_Cfg_c: artifact-descriptor={short-label=generate_PC::src::Gpt_Cfg.c, category=SWSRC}, usages=COMPILE
    linker GCC_Linker: name=GCC Compiler, options=-Wl,-Map,filename -T linkerfile --entry=Reset_Handler -nostartfiles -mcpu=cortexm7 -mthumb -mfpu=fpv5-sp-d16 -mfloat-abi=hard -mlittle-endian -ggdb3 -lc -lm -lgcc, vendor=GCC Systems, version=NXP GCC 10.2.0 20200723 (Build 1728 Revision g5963bc8)
    linker GHS_Linker: name=Green Hills, options=-e Reset_Handler -T linker_script_file.ld -map -keepmap -Mn -delete -ignore_debug_references -Llibrary_path -larch -lstartup -lind_sd -v -keep=C40_Ip_AccessCode -nostartfiles, vendor=Green Hills, version=Green Hills Multi 7.1.6d / Compiler 2021.1.4
    linker IAR_Linker: name=IAR Compiler, options=--map filename --config linkerfile --cpu=Cortex-M7 --fpu=FPv5-SP --entry _start --enable_stack_usage --skip_dynamic_initialization --no_wrap_diagnostics, vendor=IAR Systems, version=IAR ANSI C/C++ Compiler v.8.50.10 (safety version)
    resource consumption ResourceConsumption
      11 x memory section:
        GPT_CODE: alignment=UNSPECIFIED, sw-addrmethod=CODE, symbol=CODE
        GPT_CONFIG_DATA_UNSPECIFIED: alignment=UNSPECIFIED, sw-addrmethod=CONFIG_DATA, symbol=CONFIG_DATA_UNSPECIFIED
        GPT_CONST_16: alignment=16, sw-addrmethod=CONST, symbol=CONST_16
        GPT_CONST_8: alignment=8, sw-addrmethod=CONST, symbol=CONST_8
        GPT_CONST_UNSPECIFIED: alignment=UNSPECIFIED, sw-addrmethod=CONST, symbol=CONST_UNSPECIFIED
        GPT_VAR_CLEARED_32: alignment=32, sw-addrmethod=VAR_CLEARED, symbol=VAR_CLEARED_32
        GPT_VAR_CLEARED_BOOLEAN: alignment=BOOLEAN, sw-addrmethod=VAR_CLEARED, symbol=VAR_CLEARED_BOOLEAN
        GPT_VAR_CLEARED_UNSPECIFIED: alignment=UNSPECIFIED, sw-addrmethod=VAR_CLEARED, symbol=VAR_CLEARED_UNSPECIFIED
        GPT_VAR_INIT_32: alignment=32, sw-addrmethod=VAR_INIT, symbol=VAR_INIT_32
        GPT_VAR_INIT_BOOLEAN: alignment=BOOLEAN, sw-addrmethod=VAR_INIT, symbol=VAR_INIT_BOOLEAN
        GPT_VAR_INIT_UNSPECIFIED: alignment=UNSPECIFIED, sw-addrmethod=VAR_INIT, symbol=VAR_INIT_UNSPECIFIED
