AUTOSAR XML (schema 00046)
package /AUTOSAR_Adc/BswModuleDescriptions
  bsw module description Adc: module-id=123
    provided-entrys:
      Adc_Calibrate
      Adc_ConfigureThreshold
      Adc_CtuDisableHwTrigger
      Adc_CtuDisableNotification
      Adc_CtuEnableHwTrigger
      Adc_CtuEnableNotification
      Adc_CtuMasterReload
      Adc_CtuReadConvData
      Adc_CtuReadConvResult
      Adc_CtuReadFifoData
      Adc_CtuReadFifoResult
      Adc_CtuSetFifoWatermark
      Adc_CtuSetList
      Adc_CtuSetListPointer
      Adc_CtuSetPowerMode
      Adc_CtuSetTriggerAdcCmdAddress
      Adc_CtuSetTriggerCompare
      Adc_CtuSetTriggerEnable
      Adc_CtuStartConversion
      Adc_CtuStopLoopConversions
      Adc_CtuWriteTriggerEnableMask
      Adc_DeInit
      Adc_DisableCTUTrigger
      Adc_DisableChannel
      Adc_DisableCtuControlMode
      Adc_DisableGroupNotification
      Adc_DisableHardwareTrigger
      Adc_DisableWdgNotification
      Adc_EnableCTUTrigger
      Adc_EnableChannel
      Adc_EnableCtuControlMode
      Adc_EnableGroupNotification
      Adc_EnableHardwareTrigger
      Adc_EnableWdgNotification
      Adc_GetCurrentPowerState
      Adc_GetGroupStatus
      Adc_GetInjectedConversionStatus
      Adc_GetStreamLastPointer
      Adc_GetTargetPowerState
      Adc_GetVersionInfo
      Adc_HwResultReadGroup
      Adc_Init
      Adc_Main_PowerTransitionManager
      Adc_PreparePowerState
      Adc_ReadGroup
      Adc_ReadRawData
      Adc_Sar_Ip_AbortConversion
      Adc_Sar_Ip_DisableChannel
      Adc_Sar_Ip_DisableChannelPresampling
      Adc_Sar_Ip_DisablePresampleConversion
      Adc_Sar_Ip_EnableChannel
      Adc_Sar_Ip_EnableChannelPresampling
      Adc_Sar_Ip_EnablePresampleConversion
      Adc_SelfTest
      Adc_SetChannel
      Adc_SetClockMode
      Adc_SetHwUnitPowerMode
      Adc_SetPowerState
      Adc_SetupResultBuffer
      Adc_StartGroupConversion
      Adc_StopGroupConversion
      Adc_TempSenseCalculateTemp
      Adc_TempSenseGetTemp
      Adc_TempSenseSetPowerMode
      Adc_Sar_{0..2}_Isr
      Bctu_0_Isr
    bsw internal behavior InternalBehavior_0
      66 x exclusive area:
        ADC_EXCLUSIVE_AREA_{00..05}
        ADC_EXCLUSIVE_AREA_{10..51}
        ADC_EXCLUSIVE_AREA_{54..71}
      64 x bsw called entity:
        Adc_Calibrate: can-enter-exclusive-area=[ADC_EXCLUSIVE_AREA_12, ADC_EXCLUSIVE_AREA_13, ADC_EXCLUSIVE_AREA_14, ADC_EXCLUSIVE_AREA_36], implemented-entry=Adc_Calibrate
        Adc_ConfigureThreshold: can-enter-exclusive-area=ADC_EXCLUSIVE_AREA_32, implemented-entry=Adc_ConfigureThreshold
        Adc_CtuDisableHwTrigger: can-enter-exclusive-area=ADC_EXCLUSIVE_AREA_59, implemented-entry=Adc_CtuDisableHwTrigger
        Adc_CtuDisableNotification: can-enter-exclusive-area=[ADC_EXCLUSIVE_AREA_57, ADC_EXCLUSIVE_AREA_64], implemented-entry=Adc_CtuDisableNotification
        Adc_CtuEnableHwTrigger: can-enter-exclusive-area=ADC_EXCLUSIVE_AREA_58, implemented-entry=Adc_CtuEnableHwTrigger
        Adc_CtuEnableNotification: can-enter-exclusive-area=[ADC_EXCLUSIVE_AREA_56, ADC_EXCLUSIVE_AREA_63], implemented-entry=Adc_CtuEnableNotification
        Adc_CtuMasterReload: implemented-entry=Adc_CtuMasterReload
        Adc_CtuReadConvData: implemented-entry=Adc_CtuReadConvData
        Adc_CtuReadConvResult: implemented-entry=Adc_CtuReadConvResult
        Adc_CtuReadFifoData: implemented-entry=Adc_CtuReadFifoData
        Adc_CtuReadFifoResult: implemented-entry=Adc_CtuReadFifoResult
        Adc_CtuSetFifoWatermark: can-enter-exclusive-area=ADC_EXCLUSIVE_AREA_66, implemented-entry=Adc_CtuSetFifoWatermark
        Adc_CtuSetList: can-enter-exclusive-area=[ADC_EXCLUSIVE_AREA_67, ADC_EXCLUSIVE_AREA_68], implemented-entry=Adc_CtuSetList
        Adc_CtuSetListPointer: can-enter-exclusive-area=ADC_EXCLUSIVE_AREA_61, implemented-entry=Adc_CtuSetListPointer
        Adc_CtuSetPowerMode: can-enter-exclusive-area=ADC_EXCLUSIVE_AREA_55, implemented-entry=Adc_CtuSetPowerMode
        Adc_CtuSetTriggerAdcCmdAddress: implemented-entry=Adc_CtuSetTriggerAdcCmdAddress
        Adc_CtuSetTriggerCompare: implemented-entry=Adc_CtuSetTriggerCompare
        Adc_CtuSetTriggerEnable: implemented-entry=Adc_CtuSetTriggerEnable
        Adc_CtuStartConversion: can-enter-exclusive-area=ADC_EXCLUSIVE_AREA_71, implemented-entry=Adc_CtuStartConversion
        Adc_CtuStopLoopConversions: can-enter-exclusive-area=ADC_EXCLUSIVE_AREA_60, implemented-entry=Adc_CtuStopLoopConversions
        Adc_CtuWriteTriggerEnableMask: implemented-entry=Adc_CtuWriteTriggerEnableMask
        Adc_DeInit: can-enter-exclusive-area=[ADC_EXCLUSIVE_AREA_13, ADC_EXCLUSIVE_AREA_14, ADC_EXCLUSIVE_AREA_32, ADC_EXCLUSIVE_AREA_37, ADC_EXCLUSIVE_AREA_38, ADC_EXCLUSIVE_AREA_62, ADC_EXCLUSIVE_AREA_65, ADC_EXCLUSIVE_AREA_66, ADC_EXCLUSIVE_AREA_67, ADC_EXCLUSIVE_AREA_68, ADC_EXCLUSIVE_AREA_70], implemented-entry=Adc_DeInit
        Adc_DisableCTUTrigger: can-enter-exclusive-area=[ADC_EXCLUSIVE_AREA_05, ADC_EXCLUSIVE_AREA_34, ADC_EXCLUSIVE_AREA_59, ADC_EXCLUSIVE_AREA_70], implemented-entry=Adc_DisableCTUTrigger
        Adc_DisableChannel: implemented-entry=Adc_DisableChannel
        Adc_DisableCtuControlMode: can-enter-exclusive-area=[ADC_EXCLUSIVE_AREA_20, ADC_EXCLUSIVE_AREA_61, ADC_EXCLUSIVE_AREA_62, ADC_EXCLUSIVE_AREA_65, ADC_EXCLUSIVE_AREA_66, ADC_EXCLUSIVE_AREA_67, ADC_EXCLUSIVE_AREA_68, ADC_EXCLUSIVE_AREA_70], implemented-entry=Adc_DisableCtuControlMode
        Adc_DisableGroupNotification: implemented-entry=Adc_DisableGroupNotification
        Adc_DisableHardwareTrigger: can-enter-exclusive-area=[ADC_EXCLUSIVE_AREA_21, ADC_EXCLUSIVE_AREA_34, ADC_EXCLUSIVE_AREA_47, ADC_EXCLUSIVE_AREA_59, ADC_EXCLUSIVE_AREA_70], implemented-entry=Adc_DisableHardwareTrigger
        Adc_DisableWdgNotification: can-enter-exclusive-area=[ADC_EXCLUSIVE_AREA_29, ADC_EXCLUSIVE_AREA_31], implemented-entry=Adc_DisableWdgNotification
        Adc_EnableCTUTrigger: can-enter-exclusive-area=[ADC_EXCLUSIVE_AREA_04, ADC_EXCLUSIVE_AREA_16, ADC_EXCLUSIVE_AREA_34, ADC_EXCLUSIVE_AREA_54, ADC_EXCLUSIVE_AREA_56, ADC_EXCLUSIVE_AREA_57, ADC_EXCLUSIVE_AREA_61, ADC_EXCLUSIVE_AREA_63, ADC_EXCLUSIVE_AREA_64, ADC_EXCLUSIVE_AREA_67, ADC_EXCLUSIVE_AREA_68], implemented-entry=Adc_EnableCTUTrigger
        Adc_EnableChannel: implemented-entry=Adc_EnableChannel
        Adc_EnableCtuControlMode: can-enter-exclusive-area=[ADC_EXCLUSIVE_AREA_20, ADC_EXCLUSIVE_AREA_61, ADC_EXCLUSIVE_AREA_62, ADC_EXCLUSIVE_AREA_65, ADC_EXCLUSIVE_AREA_66, ADC_EXCLUSIVE_AREA_67, ADC_EXCLUSIVE_AREA_68, ADC_EXCLUSIVE_AREA_70], implemented-entry=Adc_EnableCtuControlMode
        Adc_EnableGroupNotification: implemented-entry=Adc_EnableGroupNotification
        Adc_EnableHardwareTrigger: can-enter-exclusive-area=[ADC_EXCLUSIVE_AREA_16, ADC_EXCLUSIVE_AREA_19, ADC_EXCLUSIVE_AREA_20, ADC_EXCLUSIVE_AREA_21, ADC_EXCLUSIVE_AREA_33, ADC_EXCLUSIVE_AREA_34, ADC_EXCLUSIVE_AREA_43, ADC_EXCLUSIVE_AREA_44, ADC_EXCLUSIVE_AREA_45, ADC_EXCLUSIVE_AREA_46, ADC_EXCLUSIVE_AREA_48, ADC_EXCLUSIVE_AREA_54, ADC_EXCLUSIVE_AREA_56, ADC_EXCLUSIVE_AREA_57, ADC_EXCLUSIVE_AREA_61, ADC_EXCLUSIVE_AREA_63, ADC_EXCLUSIVE_AREA_64, ADC_EXCLUSIVE_AREA_67, ADC_EXCLUSIVE_AREA_68], implemented-entry=Adc_EnableHardwareTrigger
        Adc_EnableWdgNotification: can-enter-exclusive-area=[ADC_EXCLUSIVE_AREA_28, ADC_EXCLUSIVE_AREA_30], implemented-entry=Adc_EnableWdgNotification
        Adc_GetCurrentPowerState: implemented-entry=Adc_GetCurrentPowerState
        Adc_GetGroupStatus: implemented-entry=Adc_GetGroupStatus
        Adc_GetInjectedConversionStatus: implemented-entry=Adc_GetInjectedConversionStatus
        Adc_GetStreamLastPointer: implemented-entry=Adc_GetStreamLastPointer
        Adc_GetTargetPowerState: implemented-entry=Adc_GetTargetPowerState
        Adc_GetVersionInfo: implemented-entry=Adc_GetVersionInfo
        Adc_HwResultReadGroup: implemented-entry=Adc_HwResultReadGroup
        Adc_Init: can-enter-exclusive-area=[ADC_EXCLUSIVE_AREA_13, ADC_EXCLUSIVE_AREA_14, ADC_EXCLUSIVE_AREA_32, ADC_EXCLUSIVE_AREA_37, ADC_EXCLUSIVE_AREA_38, ADC_EXCLUSIVE_AREA_61, ADC_EXCLUSIVE_AREA_65, ADC_EXCLUSIVE_AREA_66, ADC_EXCLUSIVE_AREA_67, ADC_EXCLUSIVE_AREA_68], implemented-entry=Adc_Init
        Adc_Main_PowerTransitionManager: implemented-entry=Adc_Main_PowerTransitionManager
        Adc_PreparePowerState: implemented-entry=Adc_PreparePowerState
        Adc_ReadGroup: can-enter-exclusive-area=[ADC_EXCLUSIVE_AREA_00, ADC_EXCLUSIVE_AREA_03, ADC_EXCLUSIVE_AREA_10, ADC_EXCLUSIVE_AREA_16, ADC_EXCLUSIVE_AREA_19, ADC_EXCLUSIVE_AREA_33, ADC_EXCLUSIVE_AREA_43, ADC_EXCLUSIVE_AREA_45, ADC_EXCLUSIVE_AREA_46, ADC_EXCLUSIVE_AREA_48], implemented-entry=Adc_ReadGroup
        Adc_ReadRawData: implemented-entry=Adc_ReadRawData
        Adc_Sar_Ip_AbortConversion: can-enter-exclusive-area=ADC_EXCLUSIVE_AREA_17, implemented-entry=Adc_Sar_Ip_AbortConversion
        Adc_Sar_Ip_DisableChannel: can-enter-exclusive-area=[ADC_EXCLUSIVE_AREA_24, ADC_EXCLUSIVE_AREA_27], implemented-entry=Adc_Sar_Ip_DisableChannel
        Adc_Sar_Ip_DisableChannelPresampling: can-enter-exclusive-area=ADC_EXCLUSIVE_AREA_42, implemented-entry=Adc_Sar_Ip_DisableChannelPresampling
        Adc_Sar_Ip_DisablePresampleConversion: can-enter-exclusive-area=ADC_EXCLUSIVE_AREA_40, implemented-entry=Adc_Sar_Ip_DisablePresampleConversion
        Adc_Sar_Ip_EnableChannel: can-enter-exclusive-area=[ADC_EXCLUSIVE_AREA_23, ADC_EXCLUSIVE_AREA_26], implemented-entry=Adc_Sar_Ip_EnableChannel
        Adc_Sar_Ip_EnableChannelPresampling: can-enter-exclusive-area=ADC_EXCLUSIVE_AREA_41, implemented-entry=Adc_Sar_Ip_EnableChannelPresampling
        Adc_Sar_Ip_EnablePresampleConversion: can-enter-exclusive-area=ADC_EXCLUSIVE_AREA_39, implemented-entry=Adc_Sar_Ip_EnablePresampleConversion
        Adc_SelfTest: can-enter-exclusive-area=[ADC_EXCLUSIVE_AREA_11, ADC_EXCLUSIVE_AREA_13, ADC_EXCLUSIVE_AREA_14, ADC_EXCLUSIVE_AREA_25, ADC_EXCLUSIVE_AREA_35], implemented-entry=Adc_SelfTest
        Adc_SetChannel: implemented-entry=Adc_SetChannel
        Adc_SetClockMode: can-enter-exclusive-area=[ADC_EXCLUSIVE_AREA_13, ADC_EXCLUSIVE_AREA_14, ADC_EXCLUSIVE_AREA_15, ADC_EXCLUSIVE_AREA_16, ADC_EXCLUSIVE_AREA_51], implemented-entry=Adc_SetClockMode
        Adc_SetHwUnitPowerMode: can-enter-exclusive-area=[ADC_EXCLUSIVE_AREA_13, ADC_EXCLUSIVE_AREA_14], implemented-entry=Adc_SetHwUnitPowerMode
        Adc_SetPowerState: can-enter-exclusive-area=[ADC_EXCLUSIVE_AREA_13, ADC_EXCLUSIVE_AREA_14, ADC_EXCLUSIVE_AREA_55], implemented-entry=Adc_SetPowerState
        Adc_SetupResultBuffer: implemented-entry=Adc_SetupResultBuffer
        Adc_StartGroupConversion: can-enter-exclusive-area=[ADC_EXCLUSIVE_AREA_01, ADC_EXCLUSIVE_AREA_10, ADC_EXCLUSIVE_AREA_16, ADC_EXCLUSIVE_AREA_18, ADC_EXCLUSIVE_AREA_19, ADC_EXCLUSIVE_AREA_33, ADC_EXCLUSIVE_AREA_34, ADC_EXCLUSIVE_AREA_43, ADC_EXCLUSIVE_AREA_44, ADC_EXCLUSIVE_AREA_45, ADC_EXCLUSIVE_AREA_46, ADC_EXCLUSIVE_AREA_47, ADC_EXCLUSIVE_AREA_48], implemented-entry=Adc_StartGroupConversion
        Adc_StopGroupConversion: can-enter-exclusive-area=[ADC_EXCLUSIVE_AREA_00, ADC_EXCLUSIVE_AREA_02, ADC_EXCLUSIVE_AREA_10, ADC_EXCLUSIVE_AREA_16, ADC_EXCLUSIVE_AREA_18, ADC_EXCLUSIVE_AREA_19, ADC_EXCLUSIVE_AREA_33, ADC_EXCLUSIVE_AREA_34, ADC_EXCLUSIVE_AREA_43, ADC_EXCLUSIVE_AREA_44, ADC_EXCLUSIVE_AREA_45, ADC_EXCLUSIVE_AREA_46, ADC_EXCLUSIVE_AREA_47, ADC_EXCLUSIVE_AREA_48], implemented-entry=Adc_StopGroupConversion
        Adc_TempSenseCalculateTemp: implemented-entry=Adc_TempSenseCalculateTemp
        Adc_TempSenseGetTemp: can-enter-exclusive-area=ADC_EXCLUSIVE_AREA_22, implemented-entry=Adc_TempSenseGetTemp
        Adc_TempSenseSetPowerMode: can-enter-exclusive-area=[ADC_EXCLUSIVE_AREA_49, ADC_EXCLUSIVE_AREA_50], implemented-entry=Adc_TempSenseSetPowerMode
      4 x bsw interrupt entity, all with interrupt-category=CAT-2, interrupt-source=Hardware:
        Adc_Sar_{0..2}_Isr: implemented-entry=Adc_Sar_{0..2}_Isr
        Bctu_0_Isr: can-enter-exclusive-area=ADC_EXCLUSIVE_AREA_69, implemented-entry=Bctu_0_Isr
package /AUTOSAR_Adc/BswModuleEntrys
  68 x bsw module entry, all with sw-service-impl-policy=STANDARD:
    Adc_Calibrate: service-id=0x29, is-reentrant=false, is-synchronous=true, call-type=REGULAR, execution-context=UNSPECIFIED
    Adc_ConfigureThreshold: service-id=0x2b, is-reentrant=false, is-synchronous=true, call-type=REGULAR, execution-context=UNSPECIFIED
    Adc_CtuDisableHwTrigger: service-id=0x35, is-reentrant=false, is-synchronous=true, call-type=REGULAR, execution-context=UNSPECIFIED
    Adc_CtuDisableNotification: service-id=0x3d, is-reentrant=false, is-synchronous=true, call-type=REGULAR, execution-context=UNSPECIFIED
    Adc_CtuEnableHwTrigger: service-id=0x34, is-reentrant=false, is-synchronous=true, call-type=REGULAR, execution-context=UNSPECIFIED
    Adc_CtuEnableNotification: service-id=0x3c, is-reentrant=false, is-synchronous=true, call-type=REGULAR, execution-context=UNSPECIFIED
    Adc_CtuMasterReload: service-id=0x41, is-reentrant=false, is-synchronous=true, call-type=REGULAR, execution-context=UNSPECIFIED
    Adc_CtuReadConvData: service-id=0x37, is-reentrant=false, is-synchronous=true, call-type=REGULAR, execution-context=UNSPECIFIED
    Adc_CtuReadConvResult: service-id=0x38, is-reentrant=false, is-synchronous=true, call-type=REGULAR, execution-context=UNSPECIFIED
    Adc_CtuReadFifoData: service-id=0x39, is-reentrant=false, is-synchronous=true, call-type=REGULAR, execution-context=UNSPECIFIED
    Adc_CtuReadFifoResult: service-id=0x3a, is-reentrant=false, is-synchronous=true, call-type=REGULAR, execution-context=UNSPECIFIED
    Adc_CtuSetFifoWatermark: service-id=0x3b, is-reentrant=false, is-synchronous=true, call-type=REGULAR, execution-context=UNSPECIFIED
    Adc_CtuSetList: service-id=0x3f, is-reentrant=false, is-synchronous=true, call-type=REGULAR, execution-context=UNSPECIFIED
    Adc_CtuSetListPointer: service-id=0x3e, is-reentrant=false, is-synchronous=true, call-type=REGULAR, execution-context=UNSPECIFIED
    Adc_CtuSetPowerMode: service-id=0x24, is-reentrant=false, is-synchronous=true, call-type=REGULAR, execution-context=UNSPECIFIED
    Adc_CtuSetTriggerAdcCmdAddress: service-id=0x2e, is-reentrant=false, is-synchronous=true, call-type=REGULAR, execution-context=UNSPECIFIED
    Adc_CtuSetTriggerCompare: service-id=0x2f, is-reentrant=false, is-synchronous=true, call-type=REGULAR, execution-context=UNSPECIFIED
    Adc_CtuSetTriggerEnable: service-id=0x2d, is-reentrant=false, is-synchronous=true, call-type=REGULAR, execution-context=UNSPECIFIED
    Adc_CtuStartConversion: service-id=0x36, is-reentrant=false, is-synchronous=true, call-type=REGULAR, execution-context=UNSPECIFIED
    Adc_CtuStopLoopConversions: service-id=0x40, is-reentrant=false, is-synchronous=true, call-type=REGULAR, execution-context=UNSPECIFIED
    Adc_CtuWriteTriggerEnableMask: service-id=0x2c, is-reentrant=false, is-synchronous=true, call-type=REGULAR, execution-context=UNSPECIFIED
    Adc_DeInit: service-id=0x01, is-reentrant=false, is-synchronous=true, call-type=REGULAR, execution-context=UNSPECIFIED
    Adc_DisableCTUTrigger: service-id=0x22, is-reentrant=false, is-synchronous=true, call-type=REGULAR, execution-context=UNSPECIFIED
    Adc_DisableChannel: service-id=0x27, is-reentrant=false, is-synchronous=true, call-type=REGULAR, execution-context=UNSPECIFIED
    Adc_DisableCtuControlMode: service-id=0x33, is-reentrant=false, is-synchronous=true, call-type=REGULAR, execution-context=UNSPECIFIED
    Adc_DisableGroupNotification: service-id=0x08, is-reentrant=true, is-synchronous=false, call-type=REGULAR, execution-context=UNSPECIFIED
    Adc_DisableHardwareTrigger: service-id=0x06, is-reentrant=true, is-synchronous=false, call-type=REGULAR, execution-context=UNSPECIFIED
    Adc_DisableWdgNotification: service-id=0x44, is-reentrant=false, is-synchronous=true, call-type=REGULAR, execution-context=UNSPECIFIED
    Adc_EnableCTUTrigger: service-id=0x21, is-reentrant=false, is-synchronous=true, call-type=REGULAR, execution-context=UNSPECIFIED
    Adc_EnableChannel: service-id=0x26, is-reentrant=false, is-synchronous=true, call-type=REGULAR, execution-context=UNSPECIFIED
    Adc_EnableCtuControlMode: service-id=0x32, is-reentrant=false, is-synchronous=true, call-type=REGULAR, execution-context=UNSPECIFIED
    Adc_EnableGroupNotification: service-id=0x07, is-reentrant=true, is-synchronous=false, call-type=REGULAR, execution-context=UNSPECIFIED
    Adc_EnableHardwareTrigger: service-id=0x05, is-reentrant=true, is-synchronous=false, call-type=REGULAR, execution-context=UNSPECIFIED
    Adc_EnableWdgNotification: service-id=0x43, is-reentrant=false, is-synchronous=true, call-type=REGULAR, execution-context=UNSPECIFIED
    Adc_GetCurrentPowerState: service-id=0x11, is-reentrant=false, is-synchronous=true, call-type=REGULAR, execution-context=UNSPECIFIED
    Adc_GetGroupStatus: service-id=0x09, is-reentrant=true, is-synchronous=true, call-type=REGULAR, execution-context=UNSPECIFIED
    Adc_GetInjectedConversionStatus: service-id=0x28, is-reentrant=false, is-synchronous=true, call-type=REGULAR, execution-context=UNSPECIFIED
    Adc_GetStreamLastPointer: service-id=0x0b, is-reentrant=true, is-synchronous=true, call-type=REGULAR, execution-context=UNSPECIFIED
    Adc_GetTargetPowerState: service-id=0x12, is-reentrant=false, is-synchronous=true, call-type=REGULAR, execution-context=UNSPECIFIED
    Adc_GetVersionInfo: service-id=0x0a, is-reentrant=true, is-synchronous=true, call-type=REGULAR, execution-context=UNSPECIFIED
    Adc_HwResultReadGroup: service-id=0x20, is-reentrant=false, is-synchronous=true, call-type=REGULAR, execution-context=UNSPECIFIED
    Adc_Init: service-id=0x00, is-reentrant=false, is-synchronous=true, call-type=REGULAR, execution-context=UNSPECIFIED
    Adc_Main_PowerTransitionManager: service-id=0x14, is-reentrant=false, is-synchronous=true, call-type=REGULAR, execution-context=UNSPECIFIED
    Adc_PreparePowerState: service-id=0x13, is-reentrant=false, is-synchronous=true, call-type=REGULAR, execution-context=UNSPECIFIED
    Adc_ReadGroup: service-id=0x04, is-reentrant=true, is-synchronous=true, call-type=REGULAR, execution-context=UNSPECIFIED
    Adc_ReadRawData: service-id=0x42, is-reentrant=false, is-synchronous=true, call-type=REGULAR, execution-context=UNSPECIFIED
    Adc_Sar_Ip_AbortConversion: service-id=0xfa, is-reentrant=false, is-synchronous=true, call-type=REGULAR, execution-context=UNSPECIFIED
    Adc_Sar_Ip_DisableChannel: service-id=0xfd, is-reentrant=false, is-synchronous=true, call-type=REGULAR, execution-context=UNSPECIFIED
    Adc_Sar_Ip_DisableChannelPresampling: service-id=0xf8, is-reentrant=false, is-synchronous=true, call-type=REGULAR, execution-context=UNSPECIFIED
    Adc_Sar_Ip_DisablePresampleConversion: service-id=0xfb, is-reentrant=false, is-synchronous=true, call-type=REGULAR, execution-context=UNSPECIFIED
    Adc_Sar_Ip_EnableChannel: service-id=0xfe, is-reentrant=false, is-synchronous=true, call-type=REGULAR, execution-context=UNSPECIFIED
    Adc_Sar_Ip_EnableChannelPresampling: service-id=0xf9, is-reentrant=false, is-synchronous=true, call-type=REGULAR, execution-context=UNSPECIFIED
    Adc_Sar_Ip_EnablePresampleConversion: service-id=0xfc, is-reentrant=false, is-synchronous=true, call-type=REGULAR, execution-context=UNSPECIFIED
    Adc_SelfTest: service-id=0x2a, is-reentrant=false, is-synchronous=true, call-type=REGULAR, execution-context=UNSPECIFIED
    Adc_SetChannel: service-id=0x30, is-reentrant=false, is-synchronous=true, call-type=REGULAR, execution-context=UNSPECIFIED
    Adc_SetClockMode: service-id=0x25, is-reentrant=false, is-synchronous=true, call-type=REGULAR, execution-context=UNSPECIFIED
    Adc_SetHwUnitPowerMode: service-id=0x23, is-reentrant=false, is-synchronous=true, call-type=REGULAR, execution-context=UNSPECIFIED
    Adc_SetPowerState: service-id=0x10, is-reentrant=false, is-synchronous=true, call-type=REGULAR, execution-context=UNSPECIFIED
    Adc_SetupResultBuffer: service-id=0x0c, is-reentrant=true, is-synchronous=false, call-type=REGULAR, execution-context=UNSPECIFIED
    Adc_StartGroupConversion: service-id=0x02, is-reentrant=true, is-synchronous=false, call-type=REGULAR, execution-context=UNSPECIFIED
    Adc_StopGroupConversion: service-id=0x03, is-reentrant=true, is-synchronous=true, call-type=REGULAR, execution-context=UNSPECIFIED
    Adc_TempSenseCalculateTemp: service-id=0x4a, is-reentrant=false, is-synchronous=true, call-type=REGULAR, execution-context=UNSPECIFIED
    Adc_TempSenseGetTemp: service-id=0x4b, is-reentrant=false, is-synchronous=true, call-type=REGULAR, execution-context=UNSPECIFIED
    Adc_TempSenseSetPowerMode: service-id=0x4c, is-reentrant=false, is-synchronous=true, call-type=REGULAR, execution-context=UNSPECIFIED
    Adc_Sar_{0..2}_Isr: service-id=0, is-reentrant=false, is-synchronous=true, call-type=INTERRUPT, execution-context=INTERRUPT-CAT-2
    Bctu_0_Isr: service-id=0, is-reentrant=false, is-synchronous=true, call-type=INTERRUPT, execution-context=INTERRUPT-CAT-2
package /Adc_TS_T40D34M20I1R0/Implementations
  bsw implementation BswImplementation_0: programming-language=C, sw-version=2.0.1, vendor-id=43, ar-release-version=4.4.0, behavior=InternalBehavior_0, vendor-specific-module-def=Adc
    code-descriptors:
      code Files
        artifact-descriptors:
          short-label=config::Adc.xdm, category=SWCFG
          short-label=doc::RTD_ADC_IM.pdf, category=SWDOC
          short-label=doc::RTD_ADC_UM.pdf, category=SWDOC
          short-label=examples::EBT::Adc_example_S32K312::generate::epc::Adc.xdm, category=SWCFG
          short-label=examples::EBT::Adc_example_S32K312::generate::epc::Base.xdm, category=SWCFG
          short-label=examples::EBT::Adc_example_S32K312::generate::epc::EcuC.xdm, category=SWCFG
          short-label=examples::EBT::Adc_example_S32K312::generate::epc::Mcl.xdm, category=SWCFG
          short-label=examples::EBT::Adc_example_S32K312::generate::epc::Mcu.xdm, category=SWCFG
          short-label=examples::EBT::Adc_example_S32K312::generate::epc::Os.xdm, category=SWCFG
          short-label=examples::EBT::Adc_example_S32K312::generate::epc::Platform.xdm, category=SWCFG
          short-label=examples::EBT::Adc_example_S32K312::generate::epc::Resource.xdm, category=SWCFG
          short-label=examples::EBT::Adc_example_S32K312::include::check_example.h, category=SWHDR
          short-label=examples::EBT::Adc_example_S32K312::src::main.c, category=SWSRC
          short-label=examples::EBT::Adc_example_S32K312::TresosProject::Adc_example_S32K312::.prefs::preferences.xdm, category=SWCFG
          short-label=examples::EBT::Adc_example_S32K312::TresosProject::Adc_example_S32K312::config::Adc.xdm, category=SWCFG
          short-label=examples::EBT::Adc_example_S32K312::TresosProject::Adc_example_S32K312::config::Base.xdm, category=SWCFG
          short-label=examples::EBT::Adc_example_S32K312::TresosProject::Adc_example_S32K312::config::EcuC.xdm, category=SWCFG
          short-label=examples::EBT::Adc_example_S32K312::TresosProject::Adc_example_S32K312::config::Mcl.xdm, category=SWCFG
          short-label=examples::EBT::Adc_example_S32K312::TresosProject::Adc_example_S32K312::config::Mcu.xdm, category=SWCFG
          short-label=examples::EBT::Adc_example_S32K312::TresosProject::Adc_example_S32K312::config::Os.xdm, category=SWCFG
          short-label=examples::EBT::Adc_example_S32K312::TresosProject::Adc_example_S32K312::config::Platform.xdm, category=SWCFG
          short-label=examples::EBT::Adc_example_S32K312::TresosProject::Adc_example_S32K312::config::Resource.xdm, category=SWCFG
          short-label=examples::EBT::Adc_example_S32K342::generate::epc::Adc.xdm, category=SWCFG
          short-label=examples::EBT::Adc_example_S32K342::generate::epc::Base.xdm, category=SWCFG
          short-label=examples::EBT::Adc_example_S32K342::generate::epc::EcuC.xdm, category=SWCFG
          short-label=examples::EBT::Adc_example_S32K342::generate::epc::Mcl.xdm, category=SWCFG
          short-label=examples::EBT::Adc_example_S32K342::generate::epc::Mcu.xdm, category=SWCFG
          short-label=examples::EBT::Adc_example_S32K342::generate::epc::Os.xdm, category=SWCFG
          short-label=examples::EBT::Adc_example_S32K342::generate::epc::Platform.xdm, category=SWCFG
          short-label=examples::EBT::Adc_example_S32K342::generate::epc::Resource.xdm, category=SWCFG
          short-label=examples::EBT::Adc_example_S32K342::include::check_example.h, category=SWHDR
          short-label=examples::EBT::Adc_example_S32K342::src::main.c, category=SWSRC
          short-label=examples::EBT::Adc_example_S32K342::TresosProject::Adc_example_S32K342::.prefs::preferences.xdm, category=SWCFG
          short-label=examples::EBT::Adc_example_S32K342::TresosProject::Adc_example_S32K342::config::Adc.xdm, category=SWCFG
          short-label=examples::EBT::Adc_example_S32K342::TresosProject::Adc_example_S32K342::config::Base.xdm, category=SWCFG
          short-label=examples::EBT::Adc_example_S32K342::TresosProject::Adc_example_S32K342::config::EcuC.xdm, category=SWCFG
          short-label=examples::EBT::Adc_example_S32K342::TresosProject::Adc_example_S32K342::config::Mcl.xdm, category=SWCFG
          short-label=examples::EBT::Adc_example_S32K342::TresosProject::Adc_example_S32K342::config::Mcu.xdm, category=SWCFG
          short-label=examples::EBT::Adc_example_S32K342::TresosProject::Adc_example_S32K342::config::Os.xdm, category=SWCFG
          short-label=examples::EBT::Adc_example_S32K342::TresosProject::Adc_example_S32K342::config::Platform.xdm, category=SWCFG
          short-label=examples::EBT::Adc_example_S32K342::TresosProject::Adc_example_S32K342::config::Resource.xdm, category=SWCFG
          short-label=examples::EBT::Adc_example_S32K344::generate::epc::Adc.xdm, category=SWCFG
          short-label=examples::EBT::Adc_example_S32K344::generate::epc::Base.xdm, category=SWCFG
          short-label=examples::EBT::Adc_example_S32K344::generate::epc::EcuC.xdm, category=SWCFG
          short-label=examples::EBT::Adc_example_S32K344::generate::epc::Mcl.xdm, category=SWCFG
          short-label=examples::EBT::Adc_example_S32K344::generate::epc::Mcu.xdm, category=SWCFG
          short-label=examples::EBT::Adc_example_S32K344::generate::epc::Os.xdm, category=SWCFG
          short-label=examples::EBT::Adc_example_S32K344::generate::epc::Platform.xdm, category=SWCFG
          short-label=examples::EBT::Adc_example_S32K344::generate::epc::Resource.xdm, category=SWCFG
          short-label=examples::EBT::Adc_example_S32K344::include::check_example.h, category=SWHDR
          short-label=examples::EBT::Adc_example_S32K344::src::main.c, category=SWSRC
          short-label=examples::EBT::Adc_example_S32K344::TresosProject::Adc_example_S32K344::.prefs::preferences.xdm, category=SWCFG
          short-label=examples::EBT::Adc_example_S32K344::TresosProject::Adc_example_S32K344::config::Adc.xdm, category=SWCFG
          short-label=examples::EBT::Adc_example_S32K344::TresosProject::Adc_example_S32K344::config::Base.xdm, category=SWCFG
          short-label=examples::EBT::Adc_example_S32K344::TresosProject::Adc_example_S32K344::config::EcuC.xdm, category=SWCFG
          short-label=examples::EBT::Adc_example_S32K344::TresosProject::Adc_example_S32K344::config::Mcl.xdm, category=SWCFG
          short-label=examples::EBT::Adc_example_S32K344::TresosProject::Adc_example_S32K344::config::Mcu.xdm, category=SWCFG
          short-label=examples::EBT::Adc_example_S32K344::TresosProject::Adc_example_S32K344::config::Os.xdm, category=SWCFG
          short-label=examples::EBT::Adc_example_S32K344::TresosProject::Adc_example_S32K344::config::Platform.xdm, category=SWCFG
          short-label=examples::EBT::Adc_example_S32K344::TresosProject::Adc_example_S32K344::config::Resource.xdm, category=SWCFG
          short-label=examples::S32DS::Adc_example_S32K312::include::check_example.h, category=SWHDR
          short-label=examples::S32DS::Adc_example_S32K312::Project_Settings::Startup_Code::exceptions.c, category=SWSRC
          short-label=examples::S32DS::Adc_example_S32K312::Project_Settings::Startup_Code::nvic.c, category=SWSRC
          short-label=examples::S32DS::Adc_example_S32K312::Project_Settings::Startup_Code::startup.c, category=SWSRC
          short-label=examples::S32DS::Adc_example_S32K312::Project_Settings::Startup_Code::system.c, category=SWSRC
          short-label=examples::S32DS::Adc_example_S32K312::src::main.c, category=SWSRC
          short-label=examples::S32DS::Adc_example_S32K342::include::check_example.h, category=SWHDR
          short-label=examples::S32DS::Adc_example_S32K342::Project_Settings::Startup_Code::exceptions.c, category=SWSRC
          short-label=examples::S32DS::Adc_example_S32K342::Project_Settings::Startup_Code::nvic.c, category=SWSRC
          short-label=examples::S32DS::Adc_example_S32K342::Project_Settings::Startup_Code::startup.c, category=SWSRC
          short-label=examples::S32DS::Adc_example_S32K342::Project_Settings::Startup_Code::system.c, category=SWSRC
          short-label=examples::S32DS::Adc_example_S32K342::src::main.c, category=SWSRC
          short-label=examples::S32DS::Adc_example_S32K344::include::check_example.h, category=SWHDR
          short-label=examples::S32DS::Adc_example_S32K344::Project_Settings::Startup_Code::exceptions.c, category=SWSRC
          short-label=examples::S32DS::Adc_example_S32K344::Project_Settings::Startup_Code::nvic.c, category=SWSRC
          short-label=examples::S32DS::Adc_example_S32K344::Project_Settings::Startup_Code::startup.c, category=SWSRC
          short-label=examples::S32DS::Adc_example_S32K344::Project_Settings::Startup_Code::system.c, category=SWSRC
          short-label=examples::S32DS::Adc_example_S32K344::src::main.c, category=SWSRC
          short-label=examples::S32DS::Adc_Sar_Bctu_Ip_example_S32K312::include::check_example.h, category=SWHDR
          short-label=examples::S32DS::Adc_Sar_Bctu_Ip_example_S32K312::Project_Settings::Startup_Code::exceptions.c, category=SWSRC
          short-label=examples::S32DS::Adc_Sar_Bctu_Ip_example_S32K312::Project_Settings::Startup_Code::nvic.c, category=SWSRC
          short-label=examples::S32DS::Adc_Sar_Bctu_Ip_example_S32K312::Project_Settings::Startup_Code::startup.c, category=SWSRC
          short-label=examples::S32DS::Adc_Sar_Bctu_Ip_example_S32K312::Project_Settings::Startup_Code::system.c, category=SWSRC
          short-label=examples::S32DS::Adc_Sar_Bctu_Ip_example_S32K312::src::main.c, category=SWSRC
          short-label=examples::S32DS::Adc_Sar_Bctu_Ip_example_S32K342::include::check_example.h, category=SWHDR
          short-label=examples::S32DS::Adc_Sar_Bctu_Ip_example_S32K342::Project_Settings::Startup_Code::exceptions.c, category=SWSRC
          short-label=examples::S32DS::Adc_Sar_Bctu_Ip_example_S32K342::Project_Settings::Startup_Code::nvic.c, category=SWSRC
          short-label=examples::S32DS::Adc_Sar_Bctu_Ip_example_S32K342::Project_Settings::Startup_Code::startup.c, category=SWSRC
          short-label=examples::S32DS::Adc_Sar_Bctu_Ip_example_S32K342::Project_Settings::Startup_Code::system.c, category=SWSRC
          short-label=examples::S32DS::Adc_Sar_Bctu_Ip_example_S32K342::src::main.c, category=SWSRC
          short-label=examples::S32DS::Adc_Sar_Bctu_Ip_example_S32K344::include::check_example.h, category=SWHDR
          short-label=examples::S32DS::Adc_Sar_Bctu_Ip_example_S32K344::Project_Settings::Startup_Code::exceptions.c, category=SWSRC
          short-label=examples::S32DS::Adc_Sar_Bctu_Ip_example_S32K344::Project_Settings::Startup_Code::nvic.c, category=SWSRC
          short-label=examples::S32DS::Adc_Sar_Bctu_Ip_example_S32K344::Project_Settings::Startup_Code::startup.c, category=SWSRC
          short-label=examples::S32DS::Adc_Sar_Bctu_Ip_example_S32K344::Project_Settings::Startup_Code::system.c, category=SWSRC
          short-label=examples::S32DS::Adc_Sar_Bctu_Ip_example_S32K344::src::main.c, category=SWSRC
          short-label=include::Adc.h, category=SWHDR
          short-label=include::Adc_Ipw.h, category=SWHDR
          short-label=include::Adc_Ipw_Irq.h, category=SWHDR
          short-label=include::Adc_Ipw_Types.h, category=SWHDR
          short-label=include::Adc_Sar_Ip.h, category=SWHDR
          short-label=include::Adc_Sar_Ip_HeaderWrapper_S32K3.h, category=SWHDR
          short-label=include::Adc_Sar_Ip_HwAccess.h, category=SWHDR
          short-label=include::Adc_Sar_Ip_Irq.h, category=SWHDR
          short-label=include::Adc_Sar_Ip_TrustedFunctions.h, category=SWHDR
          short-label=include::Adc_Sar_Ip_Types.h, category=SWHDR
          short-label=include::Adc_Types.h, category=SWHDR
          short-label=include::Bctu_Ip.h, category=SWHDR
          short-label=include::Bctu_Ip_Irq.h, category=SWHDR
          short-label=include::Bctu_Ip_Types.h, category=SWHDR
          short-label=src::Adc.c, category=SWSRC
          short-label=src::Adc_Ipw.c, category=SWSRC
          short-label=src::Adc_Ipw_Irq.c, category=SWSRC
          short-label=src::Adc_Sar_Ip.c, category=SWSRC
          short-label=src::Adc_Sar_Ip_Irq.c, category=SWSRC
          short-label=src::Bctu_Ip.c, category=SWSRC
          short-label=src::Bctu_Ip_Irq.c, category=SWSRC
    compiler GCC_Compiler:
      name=GCC Compiler
      options=-mcpu=cortex-m7 -mthumb -mlittle-endian -mfpu=fpv5-sp-d16 -mfloat-abi=hard -std=c99 -Os -ggdb3 -Wall -Wextra -pedantic -Wstrict-prototypes -Wundef -Wunused -Werror=implicit-function-declaration -Wsign-compare -Wdouble-promotion -fno-short-enums -funsigned-char -funsigned-bitfields -fomit-frame-pointer -fno-common -fstack-usage -fdump-ipa-all -c -DS32K3XX -DS32K344 -DGCC -DUSE_SW_VECTOR_MODE -DD_CACHE_ENABLE -DI_CACHE_ENABLE -DENABLE_FPU -DMCAL_ENABLE_USER_MODE_SUPPORT
      vendor=GCC Systems
      version=NXP GCC 10.2.0 20200723 (Build 1728 Revision g5963bc8)
    compiler GHS_Compiler:
      name=Green Hills
      options=-cpu=cortexm7 -thumb -fpu=vfpv5_d16 -fsingle -C99 --ghstd=last -Osize --gnu_asm -dual_debug -G -keeptempfiles -Wimplicit-int -Wshadow -Wtrigraphs -Wundef --unsigned_chars --unsigned_fields --no_commons --no_exceptions --no_slash_comment --prototype_errors --incorrect_pragma_warnings -c -DS32K3XX -DS32K344 -DGHS -DUSE_SW_VECTOR_MODE -DD_CACHE_ENABLE -DI_CACHE_ENABLE -DENABLE_FPU -DMCAL_ENABLE_USER_MODE_SUPPORT
      vendor=Green Hills
      version=Green Hills Multi 7.1.6d / Compiler 2021.1.4
    compiler IAR_Compiler:
      name=IAR Compiler
      options=--cpu=Cortex-M7 --cpu_mode=thumb --endian=little --fpu=FPv5-SP -e -Ohz --debug --no_clustering --no_mem_idioms --do_explicit_zero_opt_in_named_sections --require_prototypes --no_wrap_diagnostics --diag_suppress=Pa050 -DS32K3XX -DS32K344 -DIAR -DUSE_SW_VECTOR_MODE -DD_CACHE_ENABLE -DI_CACHE_ENABLE -DENABLE_FPU -DMCAL_ENABLE_USER_MODE_SUPPORT
      vendor=IAR Systems
      version=IAR ANSI C/C++ Compiler v.8.50.10 (safety version)
    generated-artifacts:
      17 x dependency on artifact:
        Adc_Ipw_PBcfg_h: artifact-descriptor={short-label=generate_PB::include::Adc_Ipw_PBcfg.h, category=SWHDR}, usages=EXECUTE
        Adc_PBcfg_h: artifact-descriptor={short-label=generate_PB::include::Adc_PBcfg.h, category=SWHDR}, usages=EXECUTE
        Adc_Sar_Ip_PBcfg_h: artifact-descriptor={short-label=generate_PB::include::Adc_Sar_Ip_PBcfg.h, category=SWHDR}, usages=EXECUTE
        Bctu_Ip_PBcfg_h: artifact-descriptor={short-label=generate_PB::include::Bctu_Ip_PBcfg.h, category=SWHDR}, usages=EXECUTE
        Adc_Ipw_PBcfg_c: artifact-descriptor={short-label=generate_PB::src::Adc_Ipw_PBcfg.c, category=SWSRC}, usages=EXECUTE
        Adc_PBcfg_c: artifact-descriptor={short-label=generate_PB::src::Adc_PBcfg.c, category=SWSRC}, usages=EXECUTE
        Adc_Sar_Ip_PBcfg_c: artifact-descriptor={short-label=generate_PB::src::Adc_Sar_Ip_PBcfg.c, category=SWSRC}, usages=EXECUTE
        Bctu_Ip_PBcfg_c: artifact-descriptor={short-label=generate_PB::src::Bctu_Ip_PBcfg.c, category=SWSRC}, usages=EXECUTE
        Adc_Cfg_h: artifact-descriptor={short-label=generate_PC::include::Adc_Cfg.h, category=SWHDR}, usages=COMPILE
        Adc_CfgDefines_h: artifact-descriptor={short-label=generate_PC::include::Adc_CfgDefines.h, category=SWHDR}, usages=COMPILE
        Adc_Ipw_Cfg_h: artifact-descriptor={short-label=generate_PC::include::Adc_Ipw_Cfg.h, category=SWHDR}, usages=COMPILE
        Adc_Ipw_CfgDefines_h: artifact-descriptor={short-label=generate_PC::include::Adc_Ipw_CfgDefines.h, category=SWHDR}, usages=COMPILE
        Adc_Sar_Ip_Cfg_h: artifact-descriptor={short-label=generate_PC::include::Adc_Sar_Ip_Cfg.h, category=SWHDR}, usages=COMPILE
        Adc_Sar_Ip_CfgDefines_h: artifact-descriptor={short-label=generate_PC::include::Adc_Sar_Ip_CfgDefines.h, category=SWHDR}, usages=COMPILE
        Bctu_Ip_Cfg_h: artifact-descriptor={short-label=generate_PC::include::Bctu_Ip_Cfg.h, category=SWHDR}, usages=COMPILE
        Bctu_Ip_CfgDefines_h: artifact-descriptor={short-label=generate_PC::include::Bctu_Ip_CfgDefines.h, category=SWHDR}, usages=COMPILE
        Adc_Cfg_c: artifact-descriptor={short-label=generate_PC::src::Adc_Cfg.c, category=SWSRC}, usages=COMPILE
    linker GCC_Linker: name=GCC Compiler, options=-Wl,-Map,filename -T linkerfile --entry=Reset_Handler -nostartfiles -mcpu=cortexm7 -mthumb -mfpu=fpv5-sp-d16 -mfloat-abi=hard -mlittle-endian -ggdb3 -lc -lm -lgcc, vendor=GCC Systems, version=NXP GCC 10.2.0 20200723 (Build 1728 Revision g5963bc8)
    linker GHS_Linker: name=Green Hills, options=-e Reset_Handler -T linker_script_file.ld -map -keepmap -Mn -delete -ignore_debug_references -Llibrary_path -larch -lstartup -lind_sd -v -keep=C40_Ip_AccessCode -nostartfiles, vendor=Green Hills, version=Green Hills Multi 7.1.6d / Compiler 2021.1.4
    linker IAR_Linker: name=IAR Compiler, options=--map filename --config linkerfile --cpu=Cortex-M7 --fpu=FPv5-SP --entry _start --enable_stack_usage --skip_dynamic_initialization --no_wrap_diagnostics, vendor=IAR Systems, version=IAR ANSI C/C++ Compiler v.8.50.10 (safety version)
    resource consumption ResourceConsumption
      15 x memory section:
        ADC_CODE: alignment=UNSPECIFIED, sw-addrmethod=CODE, symbol=CODE
        ADC_CONFIG_DATA_16: alignment=16, sw-addrmethod=CONFIG_DATA, symbol=CONFIG_DATA_16
        ADC_CONFIG_DATA_8: alignment=8, sw-addrmethod=CONFIG_DATA, symbol=CONFIG_DATA_8
        ADC_CONFIG_DATA_UNSPECIFIED: alignment=UNSPECIFIED, sw-addrmethod=CONFIG_DATA, symbol=CONFIG_DATA_UNSPECIFIED
        ADC_CONST_32: alignment=32, sw-addrmethod=CONST, symbol=CONST_32
        ADC_CONST_8: alignment=8, sw-addrmethod=CONST, symbol=CONST_8
        ADC_CONST_UNSPECIFIED: alignment=UNSPECIFIED, sw-addrmethod=CONST, symbol=CONST_UNSPECIFIED
        ADC_VAR_CLEARED_16_NO_CACHEABLE: alignment=UNSPECIFIED, sw-addrmethod=VAR_CLEARED_16_NO, symbol=VAR_CLEARED_16_NO_CACHEABLE
        ADC_VAR_CLEARED_32: alignment=32, sw-addrmethod=VAR_CLEARED, symbol=VAR_CLEARED_32
        ADC_VAR_CLEARED_32_NO_CACHEABLE: alignment=UNSPECIFIED, sw-addrmethod=VAR_CLEARED_32_NO, symbol=VAR_CLEARED_32_NO_CACHEABLE
        ADC_VAR_CLEARED_8: alignment=8, sw-addrmethod=VAR_CLEARED, symbol=VAR_CLEARED_8
        ADC_VAR_CLEARED_8_NO_CACHEABLE: alignment=UNSPECIFIED, sw-addrmethod=VAR_CLEARED_8_NO, symbol=VAR_CLEARED_8_NO_CACHEABLE
        ADC_VAR_CLEARED_BOOLEAN: alignment=BOOLEAN, sw-addrmethod=VAR_CLEARED, symbol=VAR_CLEARED_BOOLEAN
        ADC_VAR_CLEARED_UNSPECIFIED: alignment=UNSPECIFIED, sw-addrmethod=VAR_CLEARED, symbol=VAR_CLEARED_UNSPECIFIED
        ADC_VAR_INIT_UNSPECIFIED_NO_CACHEABLE: alignment=UNSPECIFIED, sw-addrmethod=VAR_INIT, symbol=VAR_INIT_UNSPECIFIED_NO_CACHEABLE
