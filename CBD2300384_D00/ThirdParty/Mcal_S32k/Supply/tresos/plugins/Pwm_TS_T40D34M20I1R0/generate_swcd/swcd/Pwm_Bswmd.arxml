AUTOSAR XML (schema 00046)
package /AUTOSAR_Pwm/BswModuleDescriptions
  bsw module description Pwm: module-id=121
    provided-entrys:
      Pwm_DeInit
      Pwm_DisableNotification
      Pwm_DisableTrigger
      Pwm_EnableNotification
      Pwm_EnableTrigger
      Pwm_ForceOutputToZero
      Pwm_GetChannelState
      Pwm_GetCurrentPowerState
      Pwm_GetOutputState
      Pwm_GetTargetPowerState
      Pwm_GetVersionInfo
      Pwm_Init
      Pwm_Main_PowerTransitionManager
      Pwm_MaskOutputs
      Pwm_PreparePowerState
      Pwm_ResetCounterDisable
      Pwm_ResetCounterEnable
      Pwm_SetChannelDeadTime
      Pwm_SetChannelOutput
      Pwm_SetClockMode
      Pwm_SetCounterBus
      Pwm_SetDutyCycle
      Pwm_SetDutyCycle_NoUpdate
      Pwm_SetDutyPhaseShift
      Pwm_SetOutputToIdle
      Pwm_SetPeriodAndDuty
      Pwm_SetPeriodAndDuty_NoUpdate
      Pwm_SetPhaseShift
      Pwm_SetPhaseShift_NoUpdate
      Pwm_SetPowerState
      Pwm_SetTriggerDelay
      Pwm_SyncUpdate
      Pwm_UnMaskOutputs
    bsw internal behavior InternalBehavior_0
      19 x exclusive area:
        PWM_EXCLUSIVE_AREA_{14..20}
        PWM_EXCLUSIVE_AREA_{23..34}
      33 x bsw called entity:
        Pwm_DeInit: implemented-entry=Pwm_DeInit
        Pwm_DisableNotification: can-enter-exclusive-area=[PWM_EXCLUSIVE_AREA_23, PWM_EXCLUSIVE_AREA_34], implemented-entry=Pwm_DisableNotification
        Pwm_DisableTrigger: implemented-entry=Pwm_DisableTrigger
        Pwm_EnableNotification: can-enter-exclusive-area=[PWM_EXCLUSIVE_AREA_23, PWM_EXCLUSIVE_AREA_34], implemented-entry=Pwm_EnableNotification
        Pwm_EnableTrigger: implemented-entry=Pwm_EnableTrigger
        Pwm_ForceOutputToZero: implemented-entry=Pwm_ForceOutputToZero
        Pwm_GetChannelState: implemented-entry=Pwm_GetChannelState
        Pwm_GetCurrentPowerState: implemented-entry=Pwm_GetCurrentPowerState
        Pwm_GetOutputState: implemented-entry=Pwm_GetOutputState
        Pwm_GetTargetPowerState: implemented-entry=Pwm_GetTargetPowerState
        Pwm_GetVersionInfo: implemented-entry=Pwm_GetVersionInfo
        Pwm_Init: implemented-entry=Pwm_Init
        Pwm_Main_PowerTransitionManager: implemented-entry=Pwm_Main_PowerTransitionManager
        Pwm_MaskOutputs: implemented-entry=Pwm_MaskOutputs
        Pwm_PreparePowerState: implemented-entry=Pwm_PreparePowerState
        Pwm_ResetCounterDisable: implemented-entry=Pwm_ResetCounterDisable
        Pwm_ResetCounterEnable: implemented-entry=Pwm_ResetCounterEnable
        Pwm_SetChannelDeadTime: can-enter-exclusive-area=PWM_EXCLUSIVE_AREA_19, implemented-entry=Pwm_SetChannelDeadTime
        Pwm_SetChannelOutput: can-enter-exclusive-area=[PWM_EXCLUSIVE_AREA_14, PWM_EXCLUSIVE_AREA_15], implemented-entry=Pwm_SetChannelOutput
        Pwm_SetClockMode: can-enter-exclusive-area=[PWM_EXCLUSIVE_AREA_28, PWM_EXCLUSIVE_AREA_31], implemented-entry=Pwm_SetClockMode
        Pwm_SetCounterBus: can-enter-exclusive-area=PWM_EXCLUSIVE_AREA_27, implemented-entry=Pwm_SetCounterBus
        Pwm_SetDutyCycle: can-enter-exclusive-area=[PWM_EXCLUSIVE_AREA_17, PWM_EXCLUSIVE_AREA_25, PWM_EXCLUSIVE_AREA_33], implemented-entry=Pwm_SetDutyCycle
        Pwm_SetDutyCycle_NoUpdate: can-enter-exclusive-area=[PWM_EXCLUSIVE_AREA_17, PWM_EXCLUSIVE_AREA_25, PWM_EXCLUSIVE_AREA_30], implemented-entry=Pwm_SetDutyCycle_NoUpdate
        Pwm_SetDutyPhaseShift: can-enter-exclusive-area=[PWM_EXCLUSIVE_AREA_17, PWM_EXCLUSIVE_AREA_18, PWM_EXCLUSIVE_AREA_29, PWM_EXCLUSIVE_AREA_30], implemented-entry=Pwm_SetDutyPhaseShift
        Pwm_SetOutputToIdle: can-enter-exclusive-area=[PWM_EXCLUSIVE_AREA_24, PWM_EXCLUSIVE_AREA_32], implemented-entry=Pwm_SetOutputToIdle
        Pwm_SetPeriodAndDuty: can-enter-exclusive-area=[PWM_EXCLUSIVE_AREA_16, PWM_EXCLUSIVE_AREA_17, PWM_EXCLUSIVE_AREA_25, PWM_EXCLUSIVE_AREA_33], implemented-entry=Pwm_SetPeriodAndDuty
        Pwm_SetPeriodAndDuty_NoUpdate: can-enter-exclusive-area=[PWM_EXCLUSIVE_AREA_16, PWM_EXCLUSIVE_AREA_17, PWM_EXCLUSIVE_AREA_25, PWM_EXCLUSIVE_AREA_30], implemented-entry=Pwm_SetPeriodAndDuty_NoUpdate
        Pwm_SetPhaseShift: implemented-entry=Pwm_SetPhaseShift
        Pwm_SetPhaseShift_NoUpdate: implemented-entry=Pwm_SetPhaseShift_NoUpdate
        Pwm_SetPowerState: can-enter-exclusive-area=PWM_EXCLUSIVE_AREA_26, implemented-entry=Pwm_SetPowerState
        Pwm_SetTriggerDelay: can-enter-exclusive-area=PWM_EXCLUSIVE_AREA_20, implemented-entry=Pwm_SetTriggerDelay
        Pwm_SyncUpdate: implemented-entry=Pwm_SyncUpdate
        Pwm_UnMaskOutputs: implemented-entry=Pwm_UnMaskOutputs
package /AUTOSAR_Pwm/BswModuleEntrys
  33 x bsw module entry, all with call-type=REGULAR, execution-context=UNSPECIFIED, sw-service-impl-policy=STANDARD:
    Pwm_DeInit: service-id=0x01, is-reentrant=false, is-synchronous=true
    Pwm_DisableNotification: service-id=0x06, is-reentrant=false, is-synchronous=false
    Pwm_DisableTrigger: service-id=0x2f, is-reentrant=true, is-synchronous=true
    Pwm_EnableNotification: service-id=0x07, is-reentrant=false, is-synchronous=false
    Pwm_EnableTrigger: service-id=0x2e, is-reentrant=true, is-synchronous=true
    Pwm_ForceOutputToZero: service-id=0x21, is-reentrant=true, is-synchronous=true
    Pwm_GetChannelState: service-id=0x20, is-reentrant=true, is-synchronous=true
    Pwm_GetCurrentPowerState: service-id=0x0a, is-reentrant=false, is-synchronous=true
    Pwm_GetOutputState: service-id=0x05, is-reentrant=false, is-synchronous=true
    Pwm_GetTargetPowerState: service-id=0x0b, is-reentrant=false, is-synchronous=true
    Pwm_GetVersionInfo: service-id=0x08, is-reentrant=true, is-synchronous=true
    Pwm_Init: service-id=0x00, is-reentrant=false, is-synchronous=true
    Pwm_Main_PowerTransitionManager: service-id=0x0d, is-reentrant=false, is-synchronous=true
    Pwm_MaskOutputs: service-id=0x32, is-reentrant=true, is-synchronous=true
    Pwm_PreparePowerState: service-id=0x0c, is-reentrant=false, is-synchronous=true
    Pwm_ResetCounterDisable: service-id=0x31, is-reentrant=true, is-synchronous=true
    Pwm_ResetCounterEnable: service-id=0x30, is-reentrant=true, is-synchronous=true
    Pwm_SetChannelDeadTime: service-id=0x2b, is-reentrant=true, is-synchronous=true
    Pwm_SetChannelOutput: service-id=0x23, is-reentrant=true, is-synchronous=true
    Pwm_SetClockMode: service-id=0x27, is-reentrant=true, is-synchronous=true
    Pwm_SetCounterBus: service-id=0x22, is-reentrant=true, is-synchronous=true
    Pwm_SetDutyCycle: service-id=0x02, is-reentrant=false, is-synchronous=false
    Pwm_SetDutyCycle_NoUpdate: service-id=0x2a, is-reentrant=true, is-synchronous=true
    Pwm_SetDutyPhaseShift: service-id=0x37, is-reentrant=true, is-synchronous=true
    Pwm_SetOutputToIdle: service-id=0x04, is-reentrant=false, is-synchronous=false
    Pwm_SetPeriodAndDuty: service-id=0x03, is-reentrant=false, is-synchronous=false
    Pwm_SetPeriodAndDuty_NoUpdate: service-id=0x29, is-reentrant=true, is-synchronous=true
    Pwm_SetPhaseShift: service-id=0x2c, is-reentrant=true, is-synchronous=true
    Pwm_SetPhaseShift_NoUpdate: service-id=0x2d, is-reentrant=true, is-synchronous=true
    Pwm_SetPowerState: service-id=0x09, is-reentrant=false, is-synchronous=true
    Pwm_SetTriggerDelay: service-id=0x24, is-reentrant=true, is-synchronous=true
    Pwm_SyncUpdate: service-id=0x28, is-reentrant=true, is-synchronous=true
    Pwm_UnMaskOutputs: service-id=0x33, is-reentrant=true, is-synchronous=true
package /Pwm_TS_T40D34M20I1R0/Implementations
  bsw implementation BswImplementation_0: programming-language=C, sw-version=2.0.1, vendor-id=43, ar-release-version=4.4.0, behavior=InternalBehavior_0, vendor-specific-module-def=Pwm
    code-descriptors:
      code Files
        artifact-descriptors:
          short-label=config::Pwm.xdm, category=SWCFG
          short-label=doc::RTD_PWM_IM.pdf, category=SWDOC
          short-label=doc::RTD_PWM_UM.pdf, category=SWDOC
          short-label=examples::EBT::Pwm_example_S32K312::generate::epc::Base.xdm, category=SWCFG
          short-label=examples::EBT::Pwm_example_S32K312::generate::epc::Dem.xdm, category=SWCFG
          short-label=examples::EBT::Pwm_example_S32K312::generate::epc::Dio.xdm, category=SWCFG
          short-label=examples::EBT::Pwm_example_S32K312::generate::epc::Ecuc.xdm, category=SWCFG
          short-label=examples::EBT::Pwm_example_S32K312::generate::epc::Mcl.xdm, category=SWCFG
          short-label=examples::EBT::Pwm_example_S32K312::generate::epc::Mcu.xdm, category=SWCFG
          short-label=examples::EBT::Pwm_example_S32K312::generate::epc::Platform.xdm, category=SWCFG
          short-label=examples::EBT::Pwm_example_S32K312::generate::epc::Port.xdm, category=SWCFG
          short-label=examples::EBT::Pwm_example_S32K312::generate::epc::Pwm.xdm, category=SWCFG
          short-label=examples::EBT::Pwm_example_S32K312::generate::epc::Resource.xdm, category=SWCFG
          short-label=examples::EBT::Pwm_example_S32K312::include::check_example.h, category=SWHDR
          short-label=examples::EBT::Pwm_example_S32K312::src::main.c, category=SWSRC
          short-label=examples::EBT::Pwm_example_S32K312::TresosProject::Pwm_example_S32K312::.prefs::preferences.xdm, category=SWCFG
          short-label=examples::EBT::Pwm_example_S32K312::TresosProject::Pwm_example_S32K312::config::Base.xdm, category=SWCFG
          short-label=examples::EBT::Pwm_example_S32K312::TresosProject::Pwm_example_S32K312::config::Dem.xdm, category=SWCFG
          short-label=examples::EBT::Pwm_example_S32K312::TresosProject::Pwm_example_S32K312::config::Dio.xdm, category=SWCFG
          short-label=examples::EBT::Pwm_example_S32K312::TresosProject::Pwm_example_S32K312::config::Ecuc.xdm, category=SWCFG
          short-label=examples::EBT::Pwm_example_S32K312::TresosProject::Pwm_example_S32K312::config::Mcl.xdm, category=SWCFG
          short-label=examples::EBT::Pwm_example_S32K312::TresosProject::Pwm_example_S32K312::config::Mcu.xdm, category=SWCFG
          short-label=examples::EBT::Pwm_example_S32K312::TresosProject::Pwm_example_S32K312::config::Platform.xdm, category=SWCFG
          short-label=examples::EBT::Pwm_example_S32K312::TresosProject::Pwm_example_S32K312::config::Port.xdm, category=SWCFG
          short-label=examples::EBT::Pwm_example_S32K312::TresosProject::Pwm_example_S32K312::config::Pwm.xdm, category=SWCFG
          short-label=examples::EBT::Pwm_example_S32K312::TresosProject::Pwm_example_S32K312::config::Resource.xdm, category=SWCFG
          short-label=examples::EBT::Pwm_example_S32K342::generate::epc::Base.xdm, category=SWCFG
          short-label=examples::EBT::Pwm_example_S32K342::generate::epc::Dem.xdm, category=SWCFG
          short-label=examples::EBT::Pwm_example_S32K342::generate::epc::Dio.xdm, category=SWCFG
          short-label=examples::EBT::Pwm_example_S32K342::generate::epc::Ecuc.xdm, category=SWCFG
          short-label=examples::EBT::Pwm_example_S32K342::generate::epc::Mcl.xdm, category=SWCFG
          short-label=examples::EBT::Pwm_example_S32K342::generate::epc::Mcu.xdm, category=SWCFG
          short-label=examples::EBT::Pwm_example_S32K342::generate::epc::Platform.xdm, category=SWCFG
          short-label=examples::EBT::Pwm_example_S32K342::generate::epc::Port.xdm, category=SWCFG
          short-label=examples::EBT::Pwm_example_S32K342::generate::epc::Pwm.xdm, category=SWCFG
          short-label=examples::EBT::Pwm_example_S32K342::generate::epc::Resource.xdm, category=SWCFG
          short-label=examples::EBT::Pwm_example_S32K342::include::check_example.h, category=SWHDR
          short-label=examples::EBT::Pwm_example_S32K342::src::main.c, category=SWSRC
          short-label=examples::EBT::Pwm_example_S32K342::TresosProject::Pwm_example_S32K342::.prefs::preferences.xdm, category=SWCFG
          short-label=examples::EBT::Pwm_example_S32K342::TresosProject::Pwm_example_S32K342::config::Base.xdm, category=SWCFG
          short-label=examples::EBT::Pwm_example_S32K342::TresosProject::Pwm_example_S32K342::config::Dem.xdm, category=SWCFG
          short-label=examples::EBT::Pwm_example_S32K342::TresosProject::Pwm_example_S32K342::config::Dio.xdm, category=SWCFG
          short-label=examples::EBT::Pwm_example_S32K342::TresosProject::Pwm_example_S32K342::config::Ecuc.xdm, category=SWCFG
          short-label=examples::EBT::Pwm_example_S32K342::TresosProject::Pwm_example_S32K342::config::Mcl.xdm, category=SWCFG
          short-label=examples::EBT::Pwm_example_S32K342::TresosProject::Pwm_example_S32K342::config::Mcu.xdm, category=SWCFG
          short-label=examples::EBT::Pwm_example_S32K342::TresosProject::Pwm_example_S32K342::config::Platform.xdm, category=SWCFG
          short-label=examples::EBT::Pwm_example_S32K342::TresosProject::Pwm_example_S32K342::config::Port.xdm, category=SWCFG
          short-label=examples::EBT::Pwm_example_S32K342::TresosProject::Pwm_example_S32K342::config::Pwm.xdm, category=SWCFG
          short-label=examples::EBT::Pwm_example_S32K342::TresosProject::Pwm_example_S32K342::config::Resource.xdm, category=SWCFG
          short-label=examples::EBT::Pwm_example_S32K344::generate::epc::Base.xdm, category=SWCFG
          short-label=examples::EBT::Pwm_example_S32K344::generate::epc::Dem.xdm, category=SWCFG
          short-label=examples::EBT::Pwm_example_S32K344::generate::epc::Dio.xdm, category=SWCFG
          short-label=examples::EBT::Pwm_example_S32K344::generate::epc::Ecuc.xdm, category=SWCFG
          short-label=examples::EBT::Pwm_example_S32K344::generate::epc::Mcl.xdm, category=SWCFG
          short-label=examples::EBT::Pwm_example_S32K344::generate::epc::Mcu.xdm, category=SWCFG
          short-label=examples::EBT::Pwm_example_S32K344::generate::epc::Platform.xdm, category=SWCFG
          short-label=examples::EBT::Pwm_example_S32K344::generate::epc::Port.xdm, category=SWCFG
          short-label=examples::EBT::Pwm_example_S32K344::generate::epc::Pwm.xdm, category=SWCFG
          short-label=examples::EBT::Pwm_example_S32K344::generate::epc::Resource.xdm, category=SWCFG
          short-label=examples::EBT::Pwm_example_S32K344::include::check_example.h, category=SWHDR
          short-label=examples::EBT::Pwm_example_S32K344::src::main.c, category=SWSRC
          short-label=examples::EBT::Pwm_example_S32K344::TresosProject::Pwm_example_S32K344::.prefs::preferences.xdm, category=SWCFG
          short-label=examples::EBT::Pwm_example_S32K344::TresosProject::Pwm_example_S32K344::config::Base.xdm, category=SWCFG
          short-label=examples::EBT::Pwm_example_S32K344::TresosProject::Pwm_example_S32K344::config::Dem.xdm, category=SWCFG
          short-label=examples::EBT::Pwm_example_S32K344::TresosProject::Pwm_example_S32K344::config::Dio.xdm, category=SWCFG
          short-label=examples::EBT::Pwm_example_S32K344::TresosProject::Pwm_example_S32K344::config::Ecuc.xdm, category=SWCFG
          short-label=examples::EBT::Pwm_example_S32K344::TresosProject::Pwm_example_S32K344::config::Mcl.xdm, category=SWCFG
          short-label=examples::EBT::Pwm_example_S32K344::TresosProject::Pwm_example_S32K344::config::Mcu.xdm, category=SWCFG
          short-label=examples::EBT::Pwm_example_S32K344::TresosProject::Pwm_example_S32K344::config::Platform.xdm, category=SWCFG
          short-label=examples::EBT::Pwm_example_S32K344::TresosProject::Pwm_example_S32K344::config::Port.xdm, category=SWCFG
          short-label=examples::EBT::Pwm_example_S32K344::TresosProject::Pwm_example_S32K344::config::Pwm.xdm, category=SWCFG
          short-label=examples::EBT::Pwm_example_S32K344::TresosProject::Pwm_example_S32K344::config::Resource.xdm, category=SWCFG
          short-label=examples::S32DS::Emios_Pwm_Ip_Example_S32K312::include::check_example.h, category=SWHDR
          short-label=examples::S32DS::Emios_Pwm_Ip_Example_S32K312::Project_Settings::Startup_Code::exceptions.c, category=SWSRC
          short-label=examples::S32DS::Emios_Pwm_Ip_Example_S32K312::Project_Settings::Startup_Code::nvic.c, category=SWSRC
          short-label=examples::S32DS::Emios_Pwm_Ip_Example_S32K312::Project_Settings::Startup_Code::startup.c, category=SWSRC
          short-label=examples::S32DS::Emios_Pwm_Ip_Example_S32K312::Project_Settings::Startup_Code::system.c, category=SWSRC
          short-label=examples::S32DS::Emios_Pwm_Ip_Example_S32K312::src::main.c, category=SWSRC
          short-label=examples::S32DS::Emios_Pwm_Ip_Example_S32K342::include::check_example.h, category=SWHDR
          short-label=examples::S32DS::Emios_Pwm_Ip_Example_S32K342::Project_Settings::Startup_Code::exceptions.c, category=SWSRC
          short-label=examples::S32DS::Emios_Pwm_Ip_Example_S32K342::Project_Settings::Startup_Code::nvic.c, category=SWSRC
          short-label=examples::S32DS::Emios_Pwm_Ip_Example_S32K342::Project_Settings::Startup_Code::startup.c, category=SWSRC
          short-label=examples::S32DS::Emios_Pwm_Ip_Example_S32K342::Project_Settings::Startup_Code::system.c, category=SWSRC
          short-label=examples::S32DS::Emios_Pwm_Ip_Example_S32K342::src::main.c, category=SWSRC
          short-label=examples::S32DS::Emios_Pwm_Ip_Example_S32K344::include::check_example.h, category=SWHDR
          short-label=examples::S32DS::Emios_Pwm_Ip_Example_S32K344::Project_Settings::Startup_Code::exceptions.c, category=SWSRC
          short-label=examples::S32DS::Emios_Pwm_Ip_Example_S32K344::Project_Settings::Startup_Code::nvic.c, category=SWSRC
          short-label=examples::S32DS::Emios_Pwm_Ip_Example_S32K344::Project_Settings::Startup_Code::startup.c, category=SWSRC
          short-label=examples::S32DS::Emios_Pwm_Ip_Example_S32K344::Project_Settings::Startup_Code::system.c, category=SWSRC
          short-label=examples::S32DS::Emios_Pwm_Ip_Example_S32K344::src::main.c, category=SWSRC
          short-label=examples::S32DS::Flexio_Pwm_Ip_Example_S32K312::include::check_example.h, category=SWHDR
          short-label=examples::S32DS::Flexio_Pwm_Ip_Example_S32K312::Project_Settings::Startup_Code::exceptions.c, category=SWSRC
          short-label=examples::S32DS::Flexio_Pwm_Ip_Example_S32K312::Project_Settings::Startup_Code::nvic.c, category=SWSRC
          short-label=examples::S32DS::Flexio_Pwm_Ip_Example_S32K312::Project_Settings::Startup_Code::startup.c, category=SWSRC
          short-label=examples::S32DS::Flexio_Pwm_Ip_Example_S32K312::Project_Settings::Startup_Code::system.c, category=SWSRC
          short-label=examples::S32DS::Flexio_Pwm_Ip_Example_S32K312::src::main.c, category=SWSRC
          short-label=examples::S32DS::Flexio_Pwm_Ip_Example_S32K342::include::check_example.h, category=SWHDR
          short-label=examples::S32DS::Flexio_Pwm_Ip_Example_S32K342::Project_Settings::Startup_Code::exceptions.c, category=SWSRC
          short-label=examples::S32DS::Flexio_Pwm_Ip_Example_S32K342::Project_Settings::Startup_Code::nvic.c, category=SWSRC
          short-label=examples::S32DS::Flexio_Pwm_Ip_Example_S32K342::Project_Settings::Startup_Code::startup.c, category=SWSRC
          short-label=examples::S32DS::Flexio_Pwm_Ip_Example_S32K342::Project_Settings::Startup_Code::system.c, category=SWSRC
          short-label=examples::S32DS::Flexio_Pwm_Ip_Example_S32K342::src::main.c, category=SWSRC
          short-label=examples::S32DS::Flexio_Pwm_Ip_Example_S32K344::include::check_example.h, category=SWHDR
          short-label=examples::S32DS::Flexio_Pwm_Ip_Example_S32K344::Project_Settings::Startup_Code::exceptions.c, category=SWSRC
          short-label=examples::S32DS::Flexio_Pwm_Ip_Example_S32K344::Project_Settings::Startup_Code::nvic.c, category=SWSRC
          short-label=examples::S32DS::Flexio_Pwm_Ip_Example_S32K344::Project_Settings::Startup_Code::startup.c, category=SWSRC
          short-label=examples::S32DS::Flexio_Pwm_Ip_Example_S32K344::Project_Settings::Startup_Code::system.c, category=SWSRC
          short-label=examples::S32DS::Flexio_Pwm_Ip_Example_S32K344::src::main.c, category=SWSRC
          short-label=examples::S32DS::Pwm_example_S32K312::include::check_example.h, category=SWHDR
          short-label=examples::S32DS::Pwm_example_S32K312::Project_Settings::Startup_Code::exceptions.c, category=SWSRC
          short-label=examples::S32DS::Pwm_example_S32K312::Project_Settings::Startup_Code::nvic.c, category=SWSRC
          short-label=examples::S32DS::Pwm_example_S32K312::Project_Settings::Startup_Code::startup.c, category=SWSRC
          short-label=examples::S32DS::Pwm_example_S32K312::Project_Settings::Startup_Code::system.c, category=SWSRC
          short-label=examples::S32DS::Pwm_example_S32K312::src::main.c, category=SWSRC
          short-label=examples::S32DS::Pwm_example_S32K342::include::check_example.h, category=SWHDR
          short-label=examples::S32DS::Pwm_example_S32K342::Project_Settings::Startup_Code::exceptions.c, category=SWSRC
          short-label=examples::S32DS::Pwm_example_S32K342::Project_Settings::Startup_Code::nvic.c, category=SWSRC
          short-label=examples::S32DS::Pwm_example_S32K342::Project_Settings::Startup_Code::startup.c, category=SWSRC
          short-label=examples::S32DS::Pwm_example_S32K342::Project_Settings::Startup_Code::system.c, category=SWSRC
          short-label=examples::S32DS::Pwm_example_S32K342::src::main.c, category=SWSRC
          short-label=examples::S32DS::Pwm_example_S32K344::include::check_example.h, category=SWHDR
          short-label=examples::S32DS::Pwm_example_S32K344::Project_Settings::Startup_Code::exceptions.c, category=SWSRC
          short-label=examples::S32DS::Pwm_example_S32K344::Project_Settings::Startup_Code::nvic.c, category=SWSRC
          short-label=examples::S32DS::Pwm_example_S32K344::Project_Settings::Startup_Code::startup.c, category=SWSRC
          short-label=examples::S32DS::Pwm_example_S32K344::Project_Settings::Startup_Code::system.c, category=SWSRC
          short-label=examples::S32DS::Pwm_example_S32K344::src::main.c, category=SWSRC
          short-label=include::Emios_Pwm_Ip.h, category=SWHDR
          short-label=include::Emios_Pwm_Ip_HwAccess.h, category=SWHDR
          short-label=include::Emios_Pwm_Ip_Irq.h, category=SWHDR
          short-label=include::Emios_Pwm_Ip_Types.h, category=SWHDR
          short-label=include::Flexio_Pwm_Ip.h, category=SWHDR
          short-label=include::Flexio_Pwm_Ip_HwAccess.h, category=SWHDR
          short-label=include::Flexio_Pwm_Ip_Irq.h, category=SWHDR
          short-label=include::Flexio_Pwm_Ip_Types.h, category=SWHDR
          short-label=include::Pwm.h, category=SWHDR
          short-label=include::Pwm_EnvCfg.h, category=SWHDR
          short-label=include::Pwm_Ipw.h, category=SWHDR
          short-label=include::Pwm_Ipw_Irq.h, category=SWHDR
          short-label=include::Pwm_Ipw_Types.h, category=SWHDR
          short-label=include::Pwm_Notif.h, category=SWHDR
          short-label=src::Emios_Pwm_Ip.c, category=SWSRC
          short-label=src::Emios_Pwm_Ip_Irq.c, category=SWSRC
          short-label=src::Flexio_Pwm_Ip.c, category=SWSRC
          short-label=src::Flexio_Pwm_Ip_Irq.c, category=SWSRC
          short-label=src::Pwm.c, category=SWSRC
          short-label=src::Pwm_Ipw.c, category=SWSRC
          short-label=src::Pwm_Ipw_Irq.c, category=SWSRC
    compiler GCC_Compiler:
      name=GCC Compiler
      options=-mcpu=cortex-m7 -mthumb -mlittle-endian -mfpu=fpv5-sp-d16 -mfloat-abi=hard -std=c99 -Os -ggdb3 -Wall -Wextra -pedantic -Wstrict-prototypes -Wundef -Wunused -Werror=implicit-function-declaration -Wsign-compare -Wdouble-promotion -fno-short-enums -funsigned-char -funsigned-bitfields -fomit-frame-pointer -fno-common -fstack-usage -fdump-ipa-all -c -DS32K3XX -DS32K344 -DGCC -DUSE_SW_VECTOR_MODE -DD_CACHE_ENABLE -DI_CACHE_ENABLE -DENABLE_FPU -DMCAL_ENABLE_USER_MODE_SUPPORT
      vendor=GCC Systems
      version=NXP GCC 10.2.0 20200723 (Build 1728 Revision g5963bc8)
    compiler GHS_Compiler:
      name=Green Hills
      options=-cpu=cortexm7 -thumb -fpu=vfpv5_d16 -fsingle -C99 --ghstd=last -Osize --gnu_asm -dual_debug -G -keeptempfiles -Wimplicit-int -Wshadow -Wtrigraphs -Wundef --unsigned_chars --unsigned_fields --no_commons --no_exceptions --no_slash_comment --prototype_errors --incorrect_pragma_warnings -c -DS32K3XX -DS32K344 -DGHS -DUSE_SW_VECTOR_MODE -DD_CACHE_ENABLE -DI_CACHE_ENABLE -DENABLE_FPU -DMCAL_ENABLE_USER_MODE_SUPPORT
      vendor=Green Hills
      version=Green Hills Multi 7.1.6d / Compiler 2021.1.4
    compiler IAR_Compiler:
      name=IAR Compiler
      options=--cpu=Cortex-M7 --cpu_mode=thumb --endian=little --fpu=FPv5-SP -e -Ohz --debug --no_clustering --no_mem_idioms --do_explicit_zero_opt_in_named_sections --require_prototypes --no_wrap_diagnostics --diag_suppress=Pa050 -DS32K3XX -DS32K344 -DIAR -DUSE_SW_VECTOR_MODE -DD_CACHE_ENABLE -DI_CACHE_ENABLE -DENABLE_FPU -DMCAL_ENABLE_USER_MODE_SUPPORT
      vendor=IAR Systems
      version=IAR ANSI C/C++ Compiler v.8.50.10 (safety version)
    generated-artifacts:
      12 x dependency on artifact:
        Emios_Pwm_Ip_PBcfg_h: artifact-descriptor={short-label=generate_PB::include::Emios_Pwm_Ip_PBcfg.h, category=SWHDR}, usages=EXECUTE
        Flexio_Pwm_Ip_PBcfg_h: artifact-descriptor={short-label=generate_PB::include::Flexio_Pwm_Ip_PBcfg.h, category=SWHDR}, usages=EXECUTE
        Pwm_PBcfg_h: artifact-descriptor={short-label=generate_PB::include::Pwm_PBcfg.h, category=SWHDR}, usages=EXECUTE
        Emios_Pwm_Ip_PBcfg_c: artifact-descriptor={short-label=generate_PB::src::Emios_Pwm_Ip_PBcfg.c, category=SWSRC}, usages=EXECUTE
        Flexio_Pwm_Ip_PBcfg_c: artifact-descriptor={short-label=generate_PB::src::Flexio_Pwm_Ip_PBcfg.c, category=SWSRC}, usages=EXECUTE
        Pwm_PBcfg_c: artifact-descriptor={short-label=generate_PB::src::Pwm_PBcfg.c, category=SWSRC}, usages=EXECUTE
        Emios_Pwm_Ip_Cfg_h: artifact-descriptor={short-label=generate_PC::include::Emios_Pwm_Ip_Cfg.h, category=SWHDR}, usages=COMPILE
        Emios_Pwm_Ip_CfgDefines_h: artifact-descriptor={short-label=generate_PC::include::Emios_Pwm_Ip_CfgDefines.h, category=SWHDR}, usages=COMPILE
        Flexio_Pwm_Ip_Cfg_h: artifact-descriptor={short-label=generate_PC::include::Flexio_Pwm_Ip_Cfg.h, category=SWHDR}, usages=COMPILE
        Flexio_Pwm_Ip_CfgDefines_h: artifact-descriptor={short-label=generate_PC::include::Flexio_Pwm_Ip_CfgDefines.h, category=SWHDR}, usages=COMPILE
        Pwm_Cfg_h: artifact-descriptor={short-label=generate_PC::include::Pwm_Cfg.h, category=SWHDR}, usages=COMPILE
        Pwm_Ipw_Cfg_h: artifact-descriptor={short-label=generate_PC::include::Pwm_Ipw_Cfg.h, category=SWHDR}, usages=COMPILE
    linker GCC_Linker: name=GCC Compiler, options=-Wl,-Map,filename -T linkerfile --entry=Reset_Handler -nostartfiles -mcpu=cortexm7 -mthumb -mfpu=fpv5-sp-d16 -mfloat-abi=hard -mlittle-endian -ggdb3 -lc -lm -lgcc, vendor=GCC Systems, version=NXP GCC 10.2.0 20200723 (Build 1728 Revision g5963bc8)
    linker GHS_Linker: name=Green Hills, options=-e Reset_Handler -T linker_script_file.ld -map -keepmap -Mn -delete -ignore_debug_references -Llibrary_path -larch -lstartup -lind_sd -v -keep=C40_Ip_AccessCode -nostartfiles, vendor=Green Hills, version=Green Hills Multi 7.1.6d / Compiler 2021.1.4
    linker IAR_Linker: name=IAR Compiler, options=--map filename --config linkerfile --cpu=Cortex-M7 --fpu=FPv5-SP --entry _start --enable_stack_usage --skip_dynamic_initialization --no_wrap_diagnostics, vendor=IAR Systems, version=IAR ANSI C/C++ Compiler v.8.50.10 (safety version)
    resource consumption ResourceConsumption
      9 x memory section:
        PWM_CODE: alignment=UNSPECIFIED, sw-addrmethod=CODE, symbol=CODE
        PWM_CONFIG_DATA_UNSPECIFIED: alignment=UNSPECIFIED, sw-addrmethod=CONFIG_DATA, symbol=CONFIG_DATA_UNSPECIFIED
        PWM_CONST_UNSPECIFIED: alignment=UNSPECIFIED, sw-addrmethod=CONST, symbol=CONST_UNSPECIFIED
        PWM_VAR_CLEARED_16: alignment=16, sw-addrmethod=VAR_CLEARED, symbol=VAR_CLEARED_16
        PWM_VAR_CLEARED_32: alignment=32, sw-addrmethod=VAR_CLEARED, symbol=VAR_CLEARED_32
        PWM_VAR_CLEARED_8: alignment=8, sw-addrmethod=VAR_CLEARED, symbol=VAR_CLEARED_8
        PWM_VAR_CLEARED_UNSPECIFIED: alignment=UNSPECIFIED, sw-addrmethod=VAR_CLEARED, symbol=VAR_CLEARED_UNSPECIFIED
        PWM_VAR_INIT_32: alignment=32, sw-addrmethod=VAR_INIT, symbol=VAR_INIT_32
        PWM_VAR_INIT_UNSPECIFIED: alignment=UNSPECIFIED, sw-addrmethod=VAR_INIT, symbol=VAR_INIT_UNSPECIFIED
