AUTOSAR XML
package /[Value_02_AR_Pckg_SN]/[Value_02_AR_Pckg_SN_2]
  module config [Value_03_Ecuc_Cfg_SN]: definition=[Value_05_Ecuc_Cfg_D_Ref_SN]
  bsw implementation [Value_06_Bsw_Impl_SN]: programming-language=C, behavior=[Value_11_Bsw_Impl_B_Ref], recommended-configuration=[Value_13_Bsw_Impl_R_Cfg_Ref], vendor-specific-module-def=[Value_15_Bsw_Impl_V_Ref_SN]
