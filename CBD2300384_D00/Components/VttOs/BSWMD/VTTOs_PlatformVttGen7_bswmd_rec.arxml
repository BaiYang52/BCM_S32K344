AUTOSAR XML (schema 4-2-1)
package /MICROSAR/VTT
  module config VTTOs_Rec: definition=VTTOs
    OsOS: OsStackMonitoring=0, OsStackUsageMeasurement=0
  module config VTTOs_Rec_Class1: definition=VTTOs
    OsIsr: OsIsrInterruptPriority=1, OsIsrInitialEnableInterruptSource=0
