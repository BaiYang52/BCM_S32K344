AUTOSAR XML (schema 00048)
# COPYRIGHT
# Copyright (c) 2022 by Vector Informatik GmbH. All rights reserved.
# This software is copyright protected and proprietary to Vector Informatik GmbH.
# Vector Informatik GmbH grants to you only those rights as set out in the license conditions.
package /MICROSAR
  bsw implementation vSecPrim_Impl
    resource consumption ResourceConsumption
      5 x memory section:
        VSECPRIM_CODE: sw-addrmethod=CODE, symbol=CODE
        VSECPRIM_CONST_8: alignment=8, sw-addrmethod=CONST, symbol=CONST_8BIT
        VSECPRIM_CONST_32: alignment=32, sw-addrmethod=CONST, symbol=CONST_32BIT
        VSECPRIM_CONST_64: alignment=64, sw-addrmethod=CONST, symbol=CONST_64BIT
        VSECPRIM_CONST_UNSPECIFIED: alignment=UNSPECIFIED, sw-addrmethod=CONST, symbol=CONST_UNSPECIFIED
