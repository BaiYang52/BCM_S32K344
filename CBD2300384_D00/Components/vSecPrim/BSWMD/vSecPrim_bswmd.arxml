AUTOSAR XML (schema 4-0-3)
# COPYRIGHT
# Copyright (c) 2023 by Vector Informatik GmbH. All rights reserved.
# This software is copyright protected and proprietary to Vector Informatik GmbH.
# Vector Informatik GmbH grants to you only those rights as set out in the license conditions.
package /MICROSAR
  bsw implementation vSecPrim_Impl: programming-language=C, sw-version=7.00.00, used-code-generator=DaVinci Configurator, vendor-id=30, behavior=vSecPrim, preconfigured-configuration=vSecPrim_Pre, recommended-configuration=vSecPrim_Rec, vendor-specific-module-def=vSecPrim
  module definition vSecPrim [0..1]: category=VENDOR_SPECIFIC_MODULE_DEFINITION, variants pre-compile/link-time  # The Software Crypto Library vSecPrim provides cryptographic algorithms and can be used within AUTOSAR or as a standalone library. If it is used within AUTOSAR, the module is only to be used in combination with the Crypto Driver. #Security #Cryptography #Library #Vector
    container vSecPrimBasicAlgorithms  # Container for basic algorithm configuration.
      container vSecPrimHash  # Container for hash algorithm configuration.
        boolean vSecPrimSHA1Enabled: set at pre-compile, origin=Vector Informatik, default-value=false  # If enabled, the following algorithm can be used: SHA1
        boolean vSecPrimRIPEMD160Enabled: set at pre-compile, origin=Vector Informatik, default-value=false  # If enabled, the following algorithm can be used: RIPEMD160
        boolean vSecPrimSHA2_256Enabled: set at pre-compile, origin=Vector Informatik, default-value=false  # If enabled, the following algorithms can be used: SHA2-224 SHA2-256
        boolean vSecPrimSHA2_512Enabled: set at pre-compile, origin=Vector Informatik, default-value=false  # If enabled, the following algorithms can be used: SHA2-384 SHA2-512 SHA2-512_224 SHA2-512_256
        boolean vSecPrimSHA3Enabled: set at pre-compile, origin=Vector Informatik, default-value=false  # If enabled, the following algorithms can be used: SHA3-224 SHA3-256 SHA3-384 SHA3-512 SHAKE128 SHAKE256
        boolean vSecPrimMD5Enabled: set at pre-compile, origin=Vector Informatik, default-value=false  # If enabled, the following algorithm can be used: MD5
      container vSecPrimRandomNumberGeneration  # Container for random number generation algorithm configuration.
        boolean vSecPrimFIPS186Enabled: set at pre-compile, origin=Vector Informatik, default-value=false  # If enabled, the following algorithm can be used: FIPS186-2
        boolean vSecPrimCtrDrbgEnabled: set at pre-compile, origin=Vector Informatik, default-value=false  # CTR DRBG Enabled | If enabled, the following algorithm can be used: CTR_DRBG based on AES
        boolean vSecPrimHashDrbgEnabled: set at pre-compile, origin=Vector Informatik, default-value=false  # HASH DRBG Enabled | If enabled, the following algorithm can be used: HASH_DRBG based on SHA2-512
    container vSecPrimSymmetricAlgorithms  # Container for symmetric algorithm configuration.
      container vSecPrimCipher  # Container for symmetric cipher algorithm configuration.
        boolean vSecPrimAes128Enabled: set at pre-compile, origin=Vector Informatik, default-value=false  # If enabled, the following algorithm can be used: AES128
        boolean vSecPrimAes192Enabled: set at pre-compile, origin=Vector Informatik, default-value=false  # If enabled, the following algorithm can be used: AES192
        boolean vSecPrimAes256Enabled: set at pre-compile, origin=Vector Informatik, default-value=false  # If enabled, the following algorithm can be used: AES256
        boolean vSecPrimGcmEnabled: set at pre-compile, origin=Vector Informatik, default-value=false  # If enabled, the following algorithms can be used: AES-GCM
        boolean vSecPrimAesCcmEnabled: set at pre-compile, origin=Vector Informatik, default-value=false  # If enabled, the following algorithms can be used: AES128-CCM
        boolean vSecPrimDesEnabled: set at pre-compile, origin=Vector Informatik, default-value=false  # If enabled, the following algorithm can be used: DES
        boolean vSecPrimRC2Enabled: set at pre-compile, origin=Vector Informatik, default-value=false  # If enabled, the following algorithm can be used: RC2 (ARC2)
        boolean vSecPrimTDesEnabled: set at pre-compile, origin=Vector Informatik, default-value=false  # If enabled, the following algorithm can be used: TDES (3DES)
        boolean vSecPrimChaCha20Enabled: set at pre-compile, origin=Vector Informatik, default-value=false  # ChaCha20 Enabled | If enabled, the following algorithm can be used: ChaCha20
        boolean vSecPrimAeadChaCha20Poly1305Enabled: set at pre-compile, origin=Vector Informatik, default-value=false  # Aead ChaCha20 and Poly1305 Enabled | If enabled, the following algorithm can be used: Aead with ChaCha20 and Poly1305
      container vSecPrimMac  # Container for Mac algorithm configuration.
        boolean vSecPrimSipHashEnabled: set at pre-compile, origin=Vector Informatik, default-value=false  # If enabled, the following algorithm can be used: SipHash
        boolean vSecPrimCmacEnabled: set at pre-compile, origin=Vector Informatik, default-value=false  # If enabled, the following algorithm can be used: CMAC
        boolean vSecPrimHMacSHA1Enabled: set at pre-compile, origin=Vector Informatik, default-value=false  # If enabled, the following algorithm can be used: HMac using SHA1 as hash algorithm
        boolean vSecPrimHMacRMD160Enabled: set at pre-compile, origin=Vector Informatik, default-value=false  # If enabled, the following algorithm can be used: HMac using RMD160 as hash algorithm
        boolean vSecPrimHMacSHA2_256Enabled: set at pre-compile, origin=Vector Informatik, default-value=false  # If enabled, the following algorithm can be used: HMac using SHA2_256 as hash algorithm
        boolean vSecPrimGMacEnabled: set at pre-compile, origin=Vector Informatik, default-value=false  # If enabled, the following algorithm can be used: GMac
        boolean vSecPrimPoly1305Enabled: set at pre-compile, origin=Vector Informatik, default-value=false  # Poly1305 Enabled | If enabled, the following algorithm can be used: Poly1305
        boolean vSecPrimHMacSHA2_384Enabled: set at pre-compile, origin=Vector Informatik, default-value=false  # If enabled, the following algorithm can be used: HMac using SHA2_384 as hash algorithm
    container vSecPrimAsymmetricAlgorithms  # Container for asymmetric algorithm configuration.
      container vSecPrimSignature  # Container for signature algorithm configuration.
        boolean vSecPrimRSA_PSS_RIPEMD160Enabled: set at pre-compile, origin=Vector Informatik, default-value=false  # If enabled, the following algorithm can be used: RSA Signature Generation / Verification according to PSS using RIPEMD160 as hash function
        boolean vSecPrimRSA_PSS_SHA1Enabled: set at pre-compile, origin=Vector Informatik, default-value=false  # If enabled, the following algorithm can be used: RSA Signature Generation / Verification according to PSS using SHA1 as hash function
        boolean vSecPrimRSA_PSS_SHA2_256Enabled: set at pre-compile, origin=Vector Informatik, default-value=false  # If enabled, the following algorithm can be used: RSA Signature Generation / Verification according to PSS using SHA2_256 as hash function
        boolean vSecPrimRSA_V15_RIPEMD160Enabled: set at pre-compile, origin=Vector Informatik, default-value=false  # If enabled, the following algorithm can be used: RSA Signature Generation / Verification according to RSASSA-PKCS1-v1_5 using RIPEMD160 as hash function
        boolean vSecPrimRSA_V15_SHA1Enabled: set at pre-compile, origin=Vector Informatik, default-value=false  # If enabled, the following algorithm can be used: RSA Signature Generation / Verification according to RSASSA-PKCS1-v1_5 using SHA1 as hash function
        boolean vSecPrimRSA_V15_SHA2_256Enabled: set at pre-compile, origin=Vector Informatik, default-value=false  # If enabled, the following algorithm can be used: RSA Signature Generation / Verification according to RSASSA-PKCS1-v1_5 using SHA2_256 as hash function
        boolean vSecPrimECDSA_25519Enabled: set at pre-compile, origin=Vector Informatik, default-value=false  # If enabled, the following algorithm can be used: ECDSA Signature Generation / Verification according to curve ED25519
        boolean vSecPrimECDSA_GenericEnabled: set at pre-compile, origin=Vector Informatik, default-value=false  # If enabled, the following algorithm can be used: ECDSA Signature Generation / Verification using generic curve
      container vSecPrimKeyExchange  # Container for key exchange algorithm configuration.
        boolean vSecPrimECDH_25519Enabled: set at pre-compile, origin=Vector Informatik, default-value=false  # If enabled, the following algorithm can be used: ECDH Key Exchange according to curve ED25519
        boolean vSecPrimECDH_GenericEnabled: set at pre-compile, origin=Vector Informatik, default-value=false  # If enabled, the following algorithm can be used: ECDH Key Exchange using generic curve
        boolean vSecPrimECBD_GenericEnabled: set at pre-compile, origin=Vector Informatik, default-value=false  # If enabled, the following algorithm can be used: EC Burmester Desmedt Key Exchange using generic curve
        boolean vSecPrimSPAKE2pEnabled: set at pre-compile, origin=Vector Informatik, default-value=false  # If enabled, the following algorithm can be used: SPAKE2+ preamble phase SPAKE2+ Key Exchange using curve SECP256r1, SHA256, HKDF HMAC SHA256 and CMAC AES128
      container vSecPrimKeyDerivation  # Container for key derivation algorithm configuration.
        boolean vSecPrimPKCS5Enabled: set at pre-compile, origin=Vector Informatik, default-value=false  # PKCS5 HMac SHA1 Enabled | If enabled, the following algorithm can be used: Key Derivation according to PKCS5 / KDF2 with underlying primitive HMAC SHA1.
        boolean vSecPrimANSI_X963Enabled: set at pre-compile, origin=Vector Informatik, default-value=false  # ANSI X9.63 SHA1 Enabled | If enabled, the following algorithm can be used: Key Derivation according to ANSI X963 SHA1
        boolean vSecPrimANSI_X963_SHA256Enabled: set at pre-compile, origin=Vector Informatik, default-value=false  # ANSI X9.63 SHA256 Enabled | If enabled, the following algorithm can be used: Key Derivation according to ANSI X963 SHA256
        boolean vSecPrimPKCS5HMacSHA256Enabled: set at pre-compile, origin=Vector Informatik, default-value=false  # If enabled, the following algorithm can be used: Key Derivation according to PKCS5 / KDF2 with underlying primitive HMAC SHA256.
        boolean vSecPrimANSI_X963_SHA512Enabled: set at pre-compile, origin=Vector Informatik, default-value=false  # ANSI X9.63 SHA512 Enabled | If enabled, the following algorithm can be used: Key Derivation according to ANSI X963 SHA512
        boolean vSecPrimHKDF_HMAC_SHA256Enabled: set at pre-compile, origin=Vector Informatik, default-value=false  # HKDF HMAC SHA256 Enabled | If enabled, the following algorithm can be used: Key Derivation according to HKDF HMAC SHA256 one step method (Option 2) and two step method
        boolean vSecPrimHKDF_HMAC_SHA384Enabled: set at pre-compile, origin=Vector Informatik, default-value=false  # HKDF HMAC SHA384 Enabled | If enabled, the following algorithm can be used: Key Derivation according to HKDF HMAC SHA384 one step method (Option 2) and two step method
        boolean vSecPrimHKDF_SHA2_256_OnestepEnabled: set at pre-compile, origin=Vector Informatik, default-value=false  # HKDF SHA2_256 One Step Enabled | If enabled, the following algorithm can be used: Key Derivation according to HKDF SHA2_256, one step method (Option 1)
      container vSecPrimCipher  # Container for asymmetric cipher algorithm configuration.
        boolean vSecPrimRSA_OAEP_SHA1Enabled: set at pre-compile, origin=Vector Informatik, default-value=false  # If enabled, the following algorithm can be used: RSA Asymmetric encryption according to OAEP using SHA1 as hash algorithm
        boolean vSecPrimRSA_OAEP_SHA2_256Enabled: set at pre-compile, origin=Vector Informatik, default-value=false  # If enabled, the following algorithm can be used: RSA Asymmetric encryption according to OAEP using SHA2_256 as hash algorithm
        boolean vSecPrimRSA_V15Enabled: set at pre-compile, origin=Vector Informatik, default-value=false  # If enabled, the following algorithm can be used: RSA Asymmetric encryption according to RSASSA-PKCS1-v1_5
      container vSecPrimKeyGeneration  # Container for key generation algorithm configuration.
        boolean vSecPrimECCEnabled: set at pre-compile, origin=Vector Informatik, default-value=false  # If enabled, the following algorithm can be used: Key Generation using elliptic curves
    container vSecPrimOptimization  # Container for optimization configuration options.
      enumeration vSecPrimAesSpeedUp: {SPEED_UP_LEVEL_0, SPEED_UP_LEVEL_1, SPEED_UP_LEVEL_2, SPEED_UP_LEVEL_3}, set at pre-compile, origin=Vector Informatik, default-value=SPEED_UP_LEVEL_3  # Defines the optimization level of the Aes algorithms. The higher the level, the faster the code will be executed at the cost of a higher memory consumption.
      enumeration vSecPrimSha1SpeedUp: {SPEED_UP_LEVEL_0, SPEED_UP_LEVEL_1, SPEED_UP_LEVEL_2, SPEED_UP_LEVEL_3}, set at pre-compile, origin=Vector Informatik, default-value=SPEED_UP_LEVEL_1  # Defines the optimization level of the SHA1 algorithms. The higher the level, the faster the code will be executed at the cost of a higher memory consumption.
      enumeration vSecPrimSha256SpeedUp: {SPEED_UP_LEVEL_0, SPEED_UP_LEVEL_1}, set at pre-compile, origin=Vector Informatik, default-value=SPEED_UP_LEVEL_0  # Defines the optimization level of the SHA2_256 algorithms. The higher the level, the faster the code will be executed at the cost of a higher memory consumption.
      enumeration vSecPrimSha512SpeedUp: {SPEED_UP_LEVEL_0, SPEED_UP_LEVEL_1}, set at pre-compile, origin=Vector Informatik, default-value=SPEED_UP_LEVEL_0  # Defines the optimization level of the SHA2_512 algorithms. The higher the level, the faster the code will be executed at the cost of a higher memory consumption.
      enumeration vSecPrimChaCha20SpeedUp: {SPEED_UP_LEVEL_0, SPEED_UP_LEVEL_1, SPEED_UP_LEVEL_2}, set at pre-compile, origin=Vector Informatik, default-value=SPEED_UP_LEVEL_1  # ChaCha20 Speed Up | Defines the optimization level of the ChaCha20 algorithms. The higher the level, the faster the code will be executed at the cost of a higher memory consumption.
    container vSecPrimGeneral  # Container for common configuration options.
      string vSecPrimUserConfigFile [0..1]: set at pre-compile, origin=Vector Informatik  # User configuration file that shall be part of the vSecPrim configuration. If you want to overwrite or provide own settings in the generated configuration file, you can specify a path to a user defined configuration file. The user defined configuration file will be included at the end of the generated file. Thus definitions in the user defined configuration file can overwrite definitions in the generated configuration file.
      enumeration vSecPrimRSAMaxKeySize: {RSA_MAX_KEY_SIZE_2048, RSA_MAX_KEY_SIZE_1024, RSA_MAX_KEY_SIZE_4096, RSA_MAX_KEY_SIZE_512, RSA_MAX_KEY_SIZE_1536, RSA_MAX_KEY_SIZE_3072}, set at pre-compile, origin=Vector Informatik, default-value=RSA_MAX_KEY_SIZE_2048  # Maximum key size in Bits which can be used for the RSA algorithms. The range is from 512 to 4096 Bit.
      enumeration vSecPrimECPMaxKeySize: {ECP_MAX_KEY_SIZE_160, ECP_MAX_KEY_SIZE_192, ECP_MAX_KEY_SIZE_224, ECP_MAX_KEY_SIZE_256, ECP_MAX_KEY_SIZE_320, ECP_MAX_KEY_SIZE_384, ECP_MAX_KEY_SIZE_512, ECP_MAX_KEY_SIZE_521}, set at pre-compile, origin=Vector Informatik, default-value=ECP_MAX_KEY_SIZE_256  # Maximum key size in Bits which can be used for the ECP algorithms. The range is from 160 to 521 Bit.
      boolean vSecPrimClearWorkspaceEnabled: set at pre-compile, origin=Vector Informatik, default-value=false  # If enabled, the workspace is cleared after the processing of any algorithm has finished.
      boolean vSecPrimSupportUInt64: set at pre-compile, origin=Vector Informatik, default-value=true  # Distinguish if uint64 is provided on the platform.
      boolean vSecPrimUseVstdLib: set at pre-compile, origin=Vector Informatik, default-value=true  # If enabled, the copy and memory set implementation of VStdLib is used instead of the vSecPrim implementation of these functions. Set this value to "false", if vSecPrim shall be built/delivered as library.
      enumeration vSecPrimWatchdogLevel: {WD_LEVEL_0, WD_LEVEL_1, WD_LEVEL_2, WD_LEVEL_3}, set at pre-compile, origin=Vector Informatik, default-value=WD_LEVEL_0  # Defines the level of watchdog call frequency. WD_LEVEL_0: WD is disabled WD_LEVEL_1: WD called from outer functions only WD_LEVEL_2: WD called from inner functions as well WD_LEVEL_3: WD also called in inner hash loops
      enumeration vSecPrimSizeOfEsltLength: {SIZE_UINT16, SIZE_UINT32}, set at pre-compile, origin=Vector Informatik, default-value=SIZE_UINT32  # Size Of eslt_Length | Decide which type is used for eslt_Length. If size is set to uint16 max input length for single update is limitied to 65535 bytes.
      enumeration vSecPrimCTRDRBGAES128SecurityStrength: {SECURITY_STRENGTH_112, SECURITY_STRENGTH_128}, set at pre-compile, origin=Vector Informatik, default-value=SECURITY_STRENGTH_128  # Security Strength of CTRDRBG AES128 | The security strength determines the minimum entropy input length for CTR DRBG AES128.
      integer vSecPrimDrbgReseedInterval: 1..4294967295, set at pre-compile, origin=Vector Informatik, default-value=4294967295  # Number of requests for random number generation with CTR DRBG without reseeding.
      integer vSecPrimSPAKE2pMaxAADSize: 1..8191, set at pre-compile, origin=Vector Informatik, default-value=16  # Maximum size of associated data for SPAKE2+ MAC key derivation in bytes. The range is between 0 and (2^13 - 1) bytes.
      integer vSecPrimSPAKE2pPreambleOKMLength: 1..65535, set at pre-compile, origin=Vector Informatik, default-value=64  # Maximum size of PBKDF output data for SPAKE2+ in the preamble phase in bytes.
  module config vSecPrim_Pre: definition=vSecPrim  # Software Crypto Library pre-configuration
  module config vSecPrim_Rec: definition=vSecPrim  # Software Crypto Library rec-configuration
