AUTOSAR XML (schema 4-0-3)
# COPYRIGHT
# Copyright (c) 2022 by Vector Informatik GmbH. All rights reserved.
# This software is copyright protected and proprietary to Vector Informatik GmbH.
# Vector Informatik GmbH grants to you only those rights as set out in the license conditions.
package /MICROSAR
  bsw implementation vDem42_Impl: programming-language=C, sw-version=2.0.0, vendor-id=30, ar-release-version=4.2.2, vendor-specific-module-def=vDem42
  module definition vDem42 [0..1]: category=VENDOR_SPECIFIC_MODULE_DEFINITION, variants pre-compile  # Diagnostic Software Component vDem42. vDem42 is an adapter component which translates certain DEM AUTOSAR 4.3 interfaces to AUTOSAR 4.2.2. #Diag #Vector #ServiceComponent
