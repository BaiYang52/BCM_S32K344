AUTOSAR XML (schema 4-0-3)
# COPYRIGHT
# Copyright (c) 2021 by Vector Informatik GmbH. All rights reserved.
# This software is copyright protected and proprietary to Vector Informatik GmbH.
# Vector Informatik GmbH grants to you only those rights as set out in the license conditions.
package /MICROSAR/CanTrcv_Tja1043
  module definition CanTrcv [0..1]: category=VENDOR_SPECIFIC_MODULE_DEFINITION, refined-module-def=CanTrcv, variants pre-compile/post-build-selectable  # CAN Transceiver Driver. Handles the CAN transceivers on an ECU. Upper layer is CanIf. #CAN #ISO11898 #TRANSCEIVER #Driver #AUTOSAR
    container CanTrcvConfigSet  # This is the multiple configuration set container for CAN transceiver driver.
      integer CanTrcvSPICommRetries [0..1]: 0..255, set at pre-compile, default-value=0  # Not used. This value specifies the maximum number of communication retries in case of a failed SPI communication (applies both to timed-out communication and to errors/NACK in the response data). (0 ... 255 times, 0 means no retry allowed, communication must succeed at first try) | If configured value is '0', no retry is allowed (communication is expected to succeed at first try).
      integer CanTrcvSPICommTimeout [0..1]: 0..100, set at pre-compile, default-value=0  # Not used. This value specifies the maximum time allowed to the CanTrcv for replying (either positively or negatively) to a SPI command. (value in ms, 0ms means no specific timeout is to be used, communication is executed at the best of the SPI HW capacity) | Timeout is configured in milliseconds. Timeout value of '0' means that no specific timeout is to be used by CanTrcv and the communication is executed at the best of the SPI HW capacity.
      container CanTrcvChannel [1..*]  # This container includes CAN transceiver driver information about a single CAN channel. | transceiver (channel).
        integer CanTrcvChannelId: 0..255, set at pre-compile, symbolic-name-value=true, default-value=0  # This value is an unique identifier of the CAN transceiver channel.
        boolean CanTrcvChannelUsed: set at post-build in variant post-build-selectable / pre-compile in variant pre-compile, default-value=true  # This parameter defines if this CAN transceiver channel is used.
        boolean CanTrcvControlsPowerSupply: set at pre-compile, default-value=false  # This parameter defines if the ECU power supply is controlled by this transceiver. TRUE = Controlled by transceiver. FALSE = Not controlled by transceiver. | TRUE = Controlled by transceiver. FALSE = Not controlled by transceiver.
        boolean CanTrcvHwPnSupport: set at pre-compile, default-value=false  # This parameter defines whether the CAN transceiver supports the selective wake-up function. TRUE = Selective wakeup feature is supported by the transceiver. FALSE = Selective wakeup functionality is not supported by the transceiver. | TRUE = Selective wakeup feature is supported by the transceiver FALSE = Selective wakeup functionality is not available in transceiver
        enumeration CanTrcvInitState: {CANTRCV_OP_MODE_NORMAL, CANTRCV_OP_MODE_SLEEP, CANTRCV_OP_MODE_STANDBY}, set at pre-compile, default-value=CANTRCV_OP_MODE_NORMAL  # Not used. The CanTrcv is always initialized to mode NORMAL. This parameter defines the state of the CAN transceiver after a call of CanTrcv_Init.
        integer CanTrcvMaxBaudrate: 0..1000, set at pre-compile, default-value=1000  # This value specifies the maximum baudrate for transceiver hardware type. The parameter is only used for validation purposes. Value shall be configured by configuration tool based on transceiver hardware type. | transceiver hardware type.
        boolean CanTrcvWakeupByBusUsed: set at post-build in variant post-build-selectable / pre-compile in variant pre-compile, default-value=false  # This parameter defines if wake up by bus is used. If CAN transceiver hardware does not support wake up by bus the value has to be FALSE. If CAN transceiver hardware supports wake up by bus the value is either TRUE or FALSE depending whether it is used or not. TRUE = Wakeup by bus is used. FALSE = Wakeup by bus is not used. | TRUE = Is used. FALSE = Is not used.
        enumeration CanTrcvHardwareVariantGroup: set at pre-compile, origin=Vector Informatik  # This parameter specifies which group of the supported hardware for this driver is used with this channel. See sub-chapter "Supported Hardware" of the Technical Reference to check in which category the used hardware belongs:
          TJA1043_REFERENCE_GROUP  # Tja1043 Reference Group
          TLE9252_REFERENCE_GROUP  # Tle9252 Reference Group
        reference CanTrcvWakeupSourceRef [0..1]: set at post-build in variant post-build-selectable / pre-compile in variant pre-compile, destination=EcuMWakeupSource  # Reference to a wakeup source in the EcuM configuration. This reference is only needed if CanTrcvWakeupByBusUsed is true. | This reference is only needed if CanTrcvWakeupByBusUsed is true.
        symbolic name reference CanTrcvIcuChannelRef [0..1]: set at pre-compile, origin=Vector Informatik, destination=IcuChannel  # Reference to the IcuChannel to enable/disable the interrupts for wakeups.
        symbolic name reference CanTrcvPorWakeupSourceRef [0..1]: set at post-build in variant post-build-selectable / pre-compile in variant pre-compile, origin=Vector Informatik, destination=EcuMWakeupSource  # Not used. Symbolic name reference to specify the wakeup sources that will be reported if the CAN transceiver driver detects a POR flag. | This reference is mandatory if the HW supports POR or SYSERR flags
        symbolic name reference CanTrcvSyserrWakeupSourceRef [0..1]: set at post-build in variant post-build-selectable / pre-compile in variant pre-compile, origin=Vector Informatik, destination=EcuMWakeupSource  # Not used. Symbolic name reference to specify the wakeup sources that will be reported if the CAN transceiver driver detects a SYSERR flag. | This reference is mandatory if the HW supports POR or SYSERR flags
        choice container CanTrcvAccess  # This container gives CAN transceiver driver information about access to a single CAN transceiver.
          container CanTrcvDioAccess [0..1]  # This container includes the CAN transceiver driver information about accessing ports and port pins. In addition relation between CAN transceiver hardware pin names and Dio port access information is given. If a CAN transceiver hardware has no Dio interface, there is no instance of this container. | If a CAN transceiver hardware has no Dio interface, there is no instance of this container.
            container CanTrcvDioChannelAccess [3..4]  # This container includes the DIO channel access by single CAN transceiver channel.
              string CanTrcvHardwareInterfaceName: set at pre-compile  # This parameter defines the CAN transceiver hardware interface name. It is typically the name of a pin. | CANTRCV_DIO_PORT_SYMBOLIC_NAME or CANTRCV_DIO_CHANNEL_SYMBOLIC_NAME or CANTRCV_DIO_CHANNEL_GROUP_SYMBOLIC_NAME shall reference a Dio configuration. The CAN transceiver driver implementation description shall list up this name for the appropriate CAN transceiver hardware.
              choice reference CanTrcvDioSymNameRef: set at pre-compile, destination=[DioChannel, DioChannelGroup, DioPort]  # Choice Reference to a DIO Port, DIO Channel or DIO Channel Group.
          container CanTrcvSpiSequence [0..1]  # Not used. This container includes the CAN transceiver driver information about one SPI sequence. One SPI sequence used by CAN transceiver driver is in exclusive use for it. No other driver is allowed to access this sequence. CAN transceiver driver may use one sequence to access n CAN transceiver hardwares chips of the same type or n sequences are used to access one single CAN transceiver hardware chip. If a CAN transceiver hardware has no SPI interface, there is no instance of this container. | One SPI sequence used by CAN transceiver driver is in exclusive use for it. No other driver is allowed to access this sequence. CAN transceiver driver may use one sequence to access n CAN transceiver hardwares chips of the same type or n sequences are used to access one single CAN transceiver hardware chip. If a CAN transceiver hardware has no SPI interface, there is no instance of this container.
            boolean CanTrcvSpiAccessSynchronous [0..1]: set at pre-compile, default-value=false  # Not used. This parameter is used to define whether the access to the Spi sequence is synchronous or asynchronous. true: SPI access is synchronous. false: SPI access is asynchronous. | true: SPI access is synchronous. false: SPI access is asynchronous.
            symbolic name reference CanTrcvSpiSequenceName [0..*]: set at pre-compile, destination=SpiSequence  # Not used. This parameter defines a reference to a Spi sequence configuration container.
            container CanTrcvSpiSequenceAccess [1..*]  # Not used.
              boolean CanTrcvSpiAccessSynchronous [0..1]: set at pre-compile, origin=Vector Informatik, default-value=false  # This parameter is used to define whether the access to the Spi sequence is synchronous or asynchronous. | true: SPI access is synchronous. false: SPI access is asynchronous.
              string CanTrcvSpiSequenceIdentifier: set at pre-compile, origin=Vector Informatik  # Specifies the name of the SPI sequence as used within the CanTrcv driver.
              symbolic name reference CanTrcvSpiSequenceName: set at pre-compile, origin=Vector Informatik, destination=SpiSequence  # This parameter defines a reference to a Spi sequence configuration container.
          container CanTrcvSbcAccess [0..1]  # Not used.
            choice reference CanTrcvSbcPeripheralIdRef: set at pre-compile, origin=Vector Informatik, destination=SbcCanTrcvPeripheral  # Reference to the SBC peripheral that is being used by this CanTrcv channel.
        container CanTrcvPartialNetwork [0..1]  # Not used. This container includes the CAN transceiver driver information about the configuration of Partial Networking functionality.
          integer CanTrcvBaudRate: 0..1000, set at post-build in variant post-build-selectable / pre-compile in variant pre-compile, default-value=500  # This value specifies the CAN Bus communication baud rate in kbps.
          boolean CanTrcvBusErrFlag: set at post-build in variant post-build-selectable / pre-compile in variant pre-compile, default-value=false  # This parameter defines if the Bus Error (BUSERR) flag is managed by the BSW. The transceiver has to set this flag if it detects a bus error. TRUE = Supported by transceiver and managed by BSW. FALSE = Not managed by BSW. | TRUE = Supported by transceiver and managed by BSW. FALSE = Not managed by BSW.
          boolean CanTrcvPnCanIdIsExtended: set at post-build in variant post-build-selectable / pre-compile in variant pre-compile, default-value=false  # This parameter defines whether extended or standard identifier is used for wake-up frames. TRUE = Extended CAN identifier is used. FALSE = Standard CAN identifier is used. | TRUE = Extended Can identifier is used. FALSE = Standard Can identifier is used
          boolean CanTrcvPnEnabled: set at post-build in variant post-build-selectable / pre-compile in variant pre-compile, default-value=false  # This parameter defines whether the selective wake-up function is enabled or disabled in HW. TRUE = Selective wakeup feature is enabled in the transceiver hardware. FALSE = Selective wakeup feature is disabled in the transceiver hardware. | TRUE = Selective wakeup feature is enabled in the transceiver hardware FALSE = Selective wakeup feature is disabled in the transceiver hardware
          integer CanTrcvPnFrameCanId: 0..4294967295, set at post-build in variant post-build-selectable / pre-compile in variant pre-compile, default-value=0  # This value specifies the CAN ID of the Wake-up Frame (WUF).
          integer CanTrcvPnFrameCanIdMask: 0..4294967295, set at post-build in variant post-build-selectable / pre-compile in variant pre-compile, default-value=0  # This value specifies the ID Mask for the selective activation of the transceiver. It is used to configure a Wake-up frame (WUF) which consists of a group of CAN identifiers.
          integer CanTrcvPnFrameDlc: 0..8, set at post-build in variant post-build-selectable / pre-compile in variant pre-compile, default-value=0  # This value specifies the data length of the Wake-up Frame (WUF).
          boolean CanTrcvPowerOnFlag: set at post-build in variant post-build-selectable / pre-compile in variant pre-compile, default-value=false  # This parameter defines if the Power On Reset (POR) flag is available and is managed by the transceiver. TRUE = Supported by Hardware. FALSE = Not supported by Hardware. | TRUE = Supported by Hardware. FALSE = Not supported by Hardware
          container CanTrcvPnFrameDataMaskSpec [0..8]  # Not used. This container includes the data payload mask to be used on the received payload in order to determine if the transceiver must be woken up by the received Wake-up Frame (WUF).
            integer CanTrcvPnFrameDataMask: 0..255, set at post-build in variant post-build-selectable / pre-compile in variant pre-compile, default-value=0  # This value specifies the n byte (Byte0 = LSB) of the data payload mask to be used on the received payload in order to determine if the transceiver must be woken up by the received Wake-up Frame (WUF).
            integer CanTrcvPnFrameDataMaskIndex: 0..7, set at pre-compile, default-value=0  # This value specifies the position n in frame of the mask-part.
      container CanTrcvDemEventParameterRefs [0..1]  # Not used. This container contains the references to DemEventParameter elements which shall be invoked using the API Dem_ReportErrorStatus API in case the corresponding error occurs. The EventId is taken from the referenced DemEventParameter's DemEventId value. The standardized errors are provided in the container and can be extended by vendor specific error references.
        symbolic name reference CANTRCV_E_BUS_ERROR [0..1]: set at pre-compile, origin=Vector Informatik, destination=DemEventParameter  # This value specifies a reference to the DemEventParameter which shall be issued when a Bus error was detected by the CAN transceiver hardware. Note: This event is only used if the CAN transceiver supports selective wakeup and the attribute CanTrcvBusErrFlag at least on one channel is set to true.
    container CanTrcvGeneral  # General configuration parameters of the CANTRCV.
      boolean CanTrcvDevErrorDetect: set at pre-compile, default-value=true  # This parameter switches the Development Error Detection and Notification ON or OFF. true: Development error detection is enabled. false: Development error detection is disabled. Note: In general, the development error detection is recommended during pre-test phase. It is not recommended to enable the development error detection in production code due to increased runtime and ROM consumption needs. | If switched on, #define CANTRCV_DEV _ERROR_DETECT ON shall be generated. If switched off, #define CANTRCV_DEV_ERROR _DETECT OFF shall be generated. Define shall be part of file CanTrcv_Cfg.h.
      boolean CanTrcvGetVersionInfo: set at pre-compile, default-value=false  # This parameter enables/disables the function CanTrcv_GetVersionInfo() to get major, minor and patch version information.
      integer CanTrcvSPICommRetries [0..1]: 0..255, set at pre-compile, default-value=0  # Not used. This value specifies the maximal number of communication retries in case of failed SPI communication (applies both to timed out communication and to errors/NACK in the response data). | (0 ... 255 times, 0 means no retry allowed, communication must succeed at first try)
      integer CanTrcvSPICommTimeout [0..1]: 0..100, set at pre-compile, default-value=0  # Not used. This value specifies the maximal time allowed to the transceiver in order to reply (either positively or negatively) to a SPI command. (value in ms, 0ms means no specific timeout is to be used, communication is executed at the best of the SPI HW capacity) | (either positively or negatively) to a SPI command. (value in ms, 0ms means no specific timeout is to be used, communication is executed at the best of the SPI HW capacity)
      integer CanTrcvWaitCount [0..1]: 0..4294967295, set at pre-compile, default-value=0  # Not used. This value specifies the number of wait states to change the transceiver operation mode. Transceiver hardware may need wait states for some transitions. Please refer to the technical reference of this module.
      enumeration CanTrcvWakeUpSupport: {CANTRCV_WAKEUP_BY_POLLING, CANTRCV_WAKEUP_NOT_SUPPORTED}, set at pre-compile, default-value=CANTRCV_WAKEUP_BY_POLLING  # This parameter defines whether wake up is supported by polling or not supported. In case no wakeup is supported by the hardware, the parameter is set to disabled. | wake up is supported by the hardware, setting has to be NOT_SUPPORTED. Only in the case of wake up supported by polling, function CanTrcv_MainFunction has to be present and to be invoked by the scheduler.
      string CanTrcvUserConfigFile [0..1]: set at pre-compile, origin=Vector Informatik  # Reference to an external text file that will be included during generation to <Module>_Cfg.h. The content of the user configuration file will be added at the end of the generated module configuration file and allows altering or extending the generated code. Caution: User configuration files can cause the software module to malfunction and must only be used with great care!
      integer CanTrcvIndex: 0..255, set at pre-compile, origin=Vector Informatik, default-value=0  # This value specifies the InstanceId of this module instance. If only one instance is present it shall have the Id 0.
      float CanTrcvMainFunctionPeriod: 0.001..1, set at pre-compile, origin=Vector Informatik, default-value=0.01  # This parameter specifies the period for cyclic call of CanTrcv_30_Tja1043_MainFunction. EcuC unit is seconds.
      integer CanTrcvWaitTime [0..1]: 0..255, set at pre-compile, origin=Vector Informatik, default-value=0  # Not required by CanTrcv. Hence not used. Wait time for transceiver state changes in seconds.
      enumeration CanTrcvTimerType [0..1]: {None, Timer_1us16bit}, set at pre-compile, origin=Vector Informatik  # Not required by CanTrcv. Hence not used. Type of the Time Service Predefined Timer.
      boolean CanTrcvSafeBswChecks: set at pre-compile, origin=Vector Informatik, default-value=false  # Selects if safety checks are used. These checks improve robustness as e.g. invalid parameters are checked before function is executed. This attribute has to be enabled for safety projects where this component is mapped to an ASIL partition.
  bsw implementation CanTrcv_Impl: programming-language=C, sw-version=4.04.00, used-code-generator=DaVinci Configurator5, vendor-id=30, ar-release-version=4.00.03, behavior=CanTrcv_Tja1043_Behavior, preconfigured-configuration=CanTrcv_Pre, recommended-configuration=CanTrcv_Rec, vendor-api-infix=Tja1043, vendor-specific-module-def=CanTrcv
  module config CanTrcv_Pre: definition=CanTrcv
  module config CanTrcv_Rec: definition=CanTrcv
  module config CanTrcv_Pre_Class1: definition=CanTrcv
    CanTrcvConfigSet
      CanTrcvChannel: CanTrcvHwPnSupport=0, CanTrcvInitState=CANTRCV_OP_MODE_NORMAL
        CanTrcvAccess
          CanTrcvDioAccess
            4 x CanTrcvDioChannelAccess:
              PinEN: CanTrcvHardwareInterfaceName=PinEN
              PinSTB: CanTrcvHardwareInterfaceName=PinSTB
              PinERR: CanTrcvHardwareInterfaceName=PinERR
              PinRXD: CanTrcvHardwareInterfaceName=PinRXD
