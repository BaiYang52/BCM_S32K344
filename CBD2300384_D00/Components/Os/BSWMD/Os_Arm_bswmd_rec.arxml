AUTOSAR XML (schema 4-2-1)
package /MICROSAR
  module config Os_Rec: definition=Os
    SystemTimer (OsCounter): OsCounterMaxAllowedValue=2147483647, OsCounterMinCycle=1, OsCounterType=HARDWARE, OsSecondsPerTick=0.001
      OsDriver: OsDriverHighResolution=0, OsDriverIsrRef=CounterIsr_SystemTimer
    OsOS: OsScalabilityClass=SC1, OsSystemTimer=SystemTimer
    CounterIsr_SystemTimer (OsIsr): OsIsrInterruptPriority=64, OsIsrInterruptSource=15, OsIsrInitialEnableInterruptSource=0
