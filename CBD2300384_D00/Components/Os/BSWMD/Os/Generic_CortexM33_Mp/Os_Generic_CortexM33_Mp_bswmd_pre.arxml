AUTOSAR XML (schema 4-2-1)
package /MICROSAR
  module config Os_Pre: definition=Os
    OsPublishedInformation
      Generic_CortexM33_Mp (OsDerivativeInformation):
        OsMpuAlignment = 0
        OsMpuEndAddressAccessible = 1
        OsHardwareManuals = Arm v8-M Architecture Reference Manual, DDI0553B.i (ID02102019), 02 October 2019 Arm Cortex-M33 Processor Technical Reference Manual, revision: r0p4, 18 April 2018
        OsStackAlignment = 0
        OsExceptionVectorTableAlignment = 0
        OsInterruptVectorTableAlignment = 2048
        OsMpuPrivilegedRegionsConfigurable = 1
        Core0 (OsPhysicalCore):
          OsPhysicalCoreId = 0
          OsPhysicalCoreExceptionSources = 8
          OsPhysicalCoreIsAutostart = 1
          OsPhysicalCoreMasterStartAllowed = 0
          OsPhysicalCorePrivelegedHwAccess = 1
          OsPhysicalCoreType = Cortex-M33
          OsPhysicalCoreDefaultEntrySymbol = _start
          OsPhysicalCoreStackProtectionUnit = Core0_MPU
          Core0_MPU (OsPhysicalCoreMpu): OsPhysicalCoreMpuMaxRegions=16, OsPhysicalCoreMpuId=0, OsPhysicalCoreMpuType=CoreMpuv8
        NVIC (OsSystemIntCtrl):
          OsSystemIntCtrlMaxPrios = 256
          OsSystemIntCtrlMaxSources = 496
          OsSystemIntCtrlPrioOrder = DESC
          OsSystemIntCtrlBaseAddress = 3758153728
          OsSystemIntCtrlType = NVIC
        SysTick (OsHardwareTimer): OsHardwareTimerBaseAddress=3758153744, OsHardwareTimerId=0, OsHardwareTimerSize=24, OsHardwareTimerUnit=PIT, OsHardwareTimerType=SysTick
          SysTick_Ch0 (OsHardwareTimerChannel): OsHardwareTimerChannelId=0, OsHardwareTimerChannelIntSource=15, OsHardwareTimerChannelOffset=0
        OsMemoryRegionSpecifics
          4 x OsMemoryRegionAccess, all with OsMemoryRegionAccessType=USERANDSUPERVISOR:
            SUPERVISOR_RW_USER_NONE: OsMemoryRegionAccessRights=S_RW_U_NONE
            SUPERVISOR_RW_USER_RW: OsMemoryRegionAccessRights=S_RW_U_RW
            SUPERVISOR_R_USER_NONE: OsMemoryRegionAccessRights=S_R_U_NONE
            SUPERVISOR_R_USER_R: OsMemoryRegionAccessRights=S_R_U_R
          TYPE_INNER_SHAREABLE (OsMemoryRegionFlag)
          TYPE_OUTER_SHAREABLE (OsMemoryRegionFlag)
          EXECUTE_ALLOWED (OsMemoryRegionAccess): OsMemoryRegionAccessRights=X, OsMemoryRegionAccessType=EXECUTION
          32 x OsMemoryRegionFlag:
            TYPE_DEVICE_GRE_MEMORY
            TYPE_DEVICE_nGRE_MEMORY
            TYPE_DEVICE_nGnRE_MEMORY
            TYPE_DEVICE_nGnRnE_MEMORY
            TYPE_NORMAL_MEMORY_OUTER_WRITETHROUGH_TRANSIENT_READALLOCATE
            TYPE_NORMAL_MEMORY_OUTER_WRITETHROUGH_TRANSIENT_WRITEALLOCATE
            TYPE_NORMAL_MEMORY_OUTER_WRITETHROUGH_TRANSIENT_READALLOCATE_WRITEALLOCATE
            TYPE_NORMAL_MEMORY_OUTER_NON_CACHEABLE
            TYPE_NORMAL_MEMORY_OUTER_WRITEBACK_TRANSIENT_READALLOCATE
            TYPE_NORMAL_MEMORY_OUTER_WRITEBACK_TRANSIENT_WRITEALLOCATE
            TYPE_NORMAL_MEMORY_OUTER_WRITEBACK_TRANSIENT_READALLOCATE_WRITEALLOCATE
            TYPE_NORMAL_MEMORY_OUTER_WRITETHROUGH_NONTRANSIENT_READALLOCATE
            TYPE_NORMAL_MEMORY_OUTER_WRITETHROUGH_NONTRANSIENT_WRITEALLOCATE
            TYPE_NORMAL_MEMORY_OUTER_WRITETHROUGH_NONTRANSIENT_READALLOCATE_WRITEALLOCATE
            TYPE_NORMAL_MEMORY_OUTER_WRITEBACK_NONTRANSIENT_READALLOCATE
            TYPE_NORMAL_MEMORY_OUTER_WRITEBACK_NONTRANSIENT_WRITEALLOCATE
            TYPE_NORMAL_MEMORY_OUTER_WRITEBACK_NONTRANSIENT_READALLOCATE_WRITEALLOCATE
            TYPE_NORMAL_MEMORY_INNER_WRITETHROUGH_TRANSIENT_READALLOCATE
            TYPE_NORMAL_MEMORY_INNER_WRITETHROUGH_TRANSIENT_WRITEALLOCATE
            TYPE_NORMAL_MEMORY_INNER_WRITETHROUGH_TRANSIENT_READALLOCATE_WRITEALLOCATE
            TYPE_NORMAL_MEMORY_INNER_NON_CACHEABLE
            TYPE_NORMAL_MEMORY_INNER_WRITEBACK_TRANSIENT_READALLOCATE
            TYPE_NORMAL_MEMORY_INNER_WRITEBACK_TRANSIENT_WRITEALLOCATE
            TYPE_NORMAL_MEMORY_INNER_WRITEBACK_TRANSIENT_READALLOCATE_WRITEALLOCATE
            TYPE_NORMAL_MEMORY_INNER_WRITETHROUGH_NONTRANSIENT
            TYPE_NORMAL_MEMORY_INNER_WRITETHROUGH_NONTRANSIENT_READALLOCATE
            TYPE_NORMAL_MEMORY_INNER_WRITETHROUGH_NONTRANSIENT_WRITEALLOCATE
            TYPE_NORMAL_MEMORY_INNER_WRITETHROUGH_NONTRANSIENT_READALLOCATE_WRITEALLOCATE
            TYPE_NORMAL_MEMORY_INNER_WRITEBACK_NONTRANSIENT
            TYPE_NORMAL_MEMORY_INNER_WRITEBACK_NONTRANSIENT_READALLOCATE
            TYPE_NORMAL_MEMORY_INNER_WRITEBACK_NONTRANSIENT_WRITEALLOCATE
            TYPE_NORMAL_MEMORY_INNER_WRITEBACK_NONTRANSIENT_READALLOCATE_WRITEALLOCATE
        OsMemoryRegionDefaults_AppT (OsMemoryRegionDefaults):
          OsMemoryRegionDefIdentifier = 1
          OsMemoryRegionDefType = APPLICATION_PRIVILEGED
          OsMemoryRegionDefAccessRights = SUPERVISOR_RW_USER_NONE
          OsMemoryRegionDefFlags = TYPE_NORMAL_MEMORY_INNER_WRITEBACK_TRANSIENT_READALLOCATE_WRITEALLOCATE
          OsMemoryRegionDefFlags = TYPE_NORMAL_MEMORY_OUTER_WRITEBACK_TRANSIENT_READALLOCATE_WRITEALLOCATE
        OsMemoryRegionDefaults_AppNT (OsMemoryRegionDefaults):
          OsMemoryRegionDefIdentifier = 1
          OsMemoryRegionDefType = APPLICATION_NONPRIVILEGED
          OsMemoryRegionDefAccessRights = SUPERVISOR_RW_USER_RW
          OsMemoryRegionDefFlags = TYPE_NORMAL_MEMORY_INNER_WRITEBACK_TRANSIENT_READALLOCATE_WRITEALLOCATE
          OsMemoryRegionDefFlags = TYPE_NORMAL_MEMORY_OUTER_WRITEBACK_TRANSIENT_READALLOCATE_WRITEALLOCATE
