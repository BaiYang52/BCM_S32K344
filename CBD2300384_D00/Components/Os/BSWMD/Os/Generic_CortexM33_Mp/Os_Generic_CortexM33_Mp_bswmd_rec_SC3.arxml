AUTOSAR XML (schema 4-2-1)
package /MICROSAR
  module config Os_Rec: definition=Os
    OsMemoryProtection
      4 x OsMemoryRegion, all with OsMemoryRegionProtectionUnit=Core0_MPU:
        Core0_ROM_Execute_All: OsMemoryRegionProtectionUnitSlot=3, OsMemoryRegionAccessRights=SUPERVISOR_R_USER_R, OsMemoryRegionAccessRights=EXECUTE_ALLOWED, OsMemoryRegionFlags=TYPE_NORMAL_MEMORY_INNER_WRITEBACK_TRANSIENT_READALLOCATE_WRITEALLOCATE, OsMemoryRegionFlags=TYPE_NORMAL_MEMORY_OUTER_WRITEBACK_TRANSIENT_READALLOCATE_WRITEALLOCATE
        Core0_ROM_Read_All: OsMemoryRegionProtectionUnitSlot=4, OsMemoryRegionAccessRights=SUPERVISOR_R_USER_R, OsMemoryRegionFlags=TYPE_NORMAL_MEMORY_INNER_WRITEBACK_TRANSIENT_READALLOCATE_WRITEALLOCATE, OsMemoryRegionFlags=TYPE_NORMAL_MEMORY_OUTER_WRITEBACK_TRANSIENT_READALLOCATE_WRITEALLOCATE
        Core0_RAM_Peripherals: OsMemoryRegionProtectionUnitSlot=5, OsMemoryRegionAccessRights=SUPERVISOR_RW_USER_NONE, OsMemoryRegionFlags=TYPE_DEVICE_nGnRE_MEMORY
        Core0_RAM_Shared_All: OsMemoryRegionProtectionUnitSlot=6, OsMemoryRegionAccessRights=SUPERVISOR_RW_USER_RW, OsMemoryRegionFlags=TYPE_NORMAL_MEMORY_INNER_NON_CACHEABLE, OsMemoryRegionFlags=TYPE_NORMAL_MEMORY_OUTER_NON_CACHEABLE
