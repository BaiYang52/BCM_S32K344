AUTOSAR XML (schema 4-2-1)
package /MICROSAR
  module config Os_Rec: definition=Os
    OsMemoryProtection
      3 x OsMemoryRegion, all with OsMemoryRegionAccessRights=SUPERVISOR_RWX, OsMemoryRegionProtectionUnit=SystemMPU0, OsMemoryRegionBusMasters=Core, OsMemoryRegionBusMasters=Debugger:
        FullAccessSupervisor_0: OsMemoryRegionStartAddress=0, OsMemoryRegionEndAddress=_OS_CORE0_STACKS_START
        AccessPeripherals: OsMemoryRegionStartAddress=0x40000000, OsMemoryRegionEndAddress=_OS_CORE0_STACKS_START, OsMemoryRegionFlags=PID_ENABLE
        FullAccessSupervisor_1: OsMemoryRegionStartAddress=_OS_CORE0_STACKS_END, OsMemoryRegionEndAddress=0xFFFFFFFF
