AUTOSAR XML (schema 4-2-1)
package /MICROSAR
  module config Os_Pre: definition=Os
    OsPublishedInformation
      S32K148 (OsDerivativeInformation):
        OsMpuAlignment = 32
        OsMpuEndAddressAccessible = 1
        OsStackAlignment = 0
        OsExceptionVectorTableAlignment = 0
        OsInterruptVectorTableAlignment = 1024
        OsHardwareManuals = NXP/Freescale - S32K14x Series Reference Manual - Supports S32K142, S32K144, S32K146, and S32K148 Document Number: S32K1XXRM Rev. 12.1, 02/2020
        OsMpuPrivilegedRegionsConfigurable = 0
        Core0 (OsPhysicalCore):
          OsPhysicalCoreId = 0
          OsPhysicalCoreExceptionSources = 8
          OsPhysicalCoreIsAutostart = 1
          OsPhysicalCoreMasterStartAllowed = 0
          OsPhysicalCorePrivelegedHwAccess = 1
          OsPhysicalCoreType = Cortex-M
          OsPhysicalCoreDefaultEntrySymbol = _start
          OsPhysicalCoreStackProtectionUnit = SystemMPU0
        NVIC (OsSystemIntCtrl):
          OsSystemIntCtrlMaxPrios = 240
          OsSystemIntCtrlMaxSources = 163
          OsSystemIntCtrlPrioOrder = DESC
          OsSystemIntCtrlBaseAddress = 3758153728
          OsSystemIntCtrlType = NVIC
        OsMemoryRegionDefaults_AppNT (OsMemoryRegionDefaults):
          OsMemoryRegionDefType = APPLICATION_NONPRIVILEGED
          OsMemoryRegionDefBusMasters = Core
          OsMemoryRegionDefAccessRights = USER_R
          OsMemoryRegionDefAccessRights = USER_W
        OsMemoryRegionSpecifics
          3 x OsMemoryRegionAccess:
            SUPERVISOR_RW: OsMemoryRegionAccessRights=RW, OsMemoryRegionAccessType=SUPERVISOR
            SUPERVISOR_RWX: OsMemoryRegionAccessRights=RWX, OsMemoryRegionAccessType=SUPERVISOR
            USER_W: OsMemoryRegionAccessRights=W, OsMemoryRegionAccessType=USER
          4 x OsMemoryRegionBusMaster:
            Core: OsMemoryRegionBusMasterId=0
            Debugger: OsMemoryRegionBusMasterId=1
            DMA: OsMemoryRegionBusMasterId=2
            ENET: OsMemoryRegionBusMasterId=3
          PID_ENABLE (OsMemoryRegionFlag)
          3 x OsMemoryRegionAccess:
            USER_R: OsMemoryRegionAccessRights=R, OsMemoryRegionAccessType=USER
            USER_X: OsMemoryRegionAccessRights=X, OsMemoryRegionAccessType=USER
            SUPERVISOR_RX: OsMemoryRegionAccessRights=RX, OsMemoryRegionAccessType=SUPERVISOR
        SysTick (OsHardwareTimer): OsHardwareTimerBaseAddress=3758153744, OsHardwareTimerId=0, OsHardwareTimerSize=24, OsHardwareTimerUnit=PIT, OsHardwareTimerType=SysTick
          SysTick_Ch0 (OsHardwareTimerChannel): OsHardwareTimerChannelId=0, OsHardwareTimerChannelIntSource=15, OsHardwareTimerChannelOffset=0
        SystemMPU0 (OsSystemMpu): OsSystemMpuBaseAddress=1073795072, OsSystemMpuId=0, OsSystemMpuMaxRegions=16, OsSystemMpuType=SYSTEM_MPU_NXP
        FTM0 (OsHardwareTimer): OsHardwareTimerBaseAddress=1073971200, OsHardwareTimerId=0, OsHardwareTimerSize=16, OsHardwareTimerType=FTM, OsHardwareTimerUnit=FRT
          4 x OsHardwareTimerChannel:
            FTM0_Ch0: OsHardwareTimerChannelId=0, OsHardwareTimerChannelIntSource=115, OsHardwareTimerChannelOffset=12
            FTM0_Ch2: OsHardwareTimerChannelId=2, OsHardwareTimerChannelIntSource=116, OsHardwareTimerChannelOffset=28
            FTM0_Ch4: OsHardwareTimerChannelId=4, OsHardwareTimerChannelIntSource=117, OsHardwareTimerChannelOffset=44
            FTM0_Ch6: OsHardwareTimerChannelId=6, OsHardwareTimerChannelIntSource=118, OsHardwareTimerChannelOffset=60
        FTM1 (OsHardwareTimer): OsHardwareTimerBaseAddress=1073975296, OsHardwareTimerId=1, OsHardwareTimerSize=16, OsHardwareTimerType=FTM, OsHardwareTimerUnit=FRT
          4 x OsHardwareTimerChannel:
            FTM1_Ch0: OsHardwareTimerChannelId=0, OsHardwareTimerChannelIntSource=121, OsHardwareTimerChannelOffset=12
            FTM1_Ch2: OsHardwareTimerChannelId=2, OsHardwareTimerChannelIntSource=122, OsHardwareTimerChannelOffset=28
            FTM1_Ch4: OsHardwareTimerChannelId=4, OsHardwareTimerChannelIntSource=123, OsHardwareTimerChannelOffset=44
            FTM1_Ch6: OsHardwareTimerChannelId=6, OsHardwareTimerChannelIntSource=124, OsHardwareTimerChannelOffset=60
