AUTOSAR XML (schema 4-2-1)
package /MICROSAR
  module config Os_Pre: definition=Os
    OsPublishedInformation
      TDA2x (OsDerivativeInformation):
        OsStackAlignment = 0
        OsExceptionVectorTableAlignment = 0
        OsInterruptVectorTableAlignment = 512
        OsHardwareManuals = ARMv7-M Architecture Reference Manual edition: ARM DDI 0403E.b (ID120114), 02 December 2014 TDA2x SoC for Advanced Driver Assistance Systems (ADAS) Silicon Revision 2.0, 1.x (Rev. D), Revised April 2017
        OsMpuAlignment = SIZE
        OsMpuEndAddressAccessible = 1
        OsMpuPrivilegedRegionsConfigurable = 0
        IPUx_Core0 (OsPhysicalCore):
          OsPhysicalCoreId = 0
          OsPhysicalCoreExceptionSources = 8
          OsPhysicalCoreIsAutostart = 1
          OsPhysicalCoreMasterStartAllowed = 0
          OsPhysicalCorePrivelegedHwAccess = 1
          OsPhysicalCoreType = Cortex-M
          OsPhysicalCoreDefaultEntrySymbol = _start
          INTC_Core0 (OsPhysicalCoreIntCtrl): OsPhysicalCoreIntCtrlMaxPrios=240, OsPhysicalCoreIntCtrlMaxSources=80, OsPhysicalCoreIntCtrlPrioOrder=DESC, OsPhysicalCoreIntCtrlType=NVIC
            OsPhysicalCoreIntCtrlAddress: OsPhysicalCoreIntCtrlAddressValue=3758153728
        IPUx_Core1 (OsPhysicalCore):
          OsPhysicalCoreId = 1
          OsPhysicalCoreExceptionSources = 8
          OsPhysicalCoreIsAutostart = 1
          OsPhysicalCoreMasterStartAllowed = 0
          OsPhysicalCorePrivelegedHwAccess = 1
          OsPhysicalCoreType = Cortex-M
          OsPhysicalCoreDefaultEntrySymbol = _start
          INTC_Core1 (OsPhysicalCoreIntCtrl): OsPhysicalCoreIntCtrlMaxPrios=240, OsPhysicalCoreIntCtrlMaxSources=80, OsPhysicalCoreIntCtrlPrioOrder=DESC, OsPhysicalCoreIntCtrlType=NVIC
            OsPhysicalCoreIntCtrlAddress: OsPhysicalCoreIntCtrlAddressValue=3758153728
        SysTick_Core0 (OsHardwareTimer): OsHardwareTimerBaseAddress=0, OsHardwareTimerId=0, OsHardwareTimerSize=24, OsHardwareTimerUnit=PIT, OsHardwareTimerType=SysTick
          SysTick_Core0_Ch0 (OsHardwareTimerChannel): OsHardwareTimerChannelId=0, OsHardwareTimerChannelIntSource=15, OsHardwareTimerChannelOffset=0
        SysTick_Core1 (OsHardwareTimer): OsHardwareTimerBaseAddress=0, OsHardwareTimerId=1, OsHardwareTimerSize=24, OsHardwareTimerUnit=PIT, OsHardwareTimerType=SysTick
          SysTick_Core1_Ch0 (OsHardwareTimerChannel): OsHardwareTimerChannelId=0, OsHardwareTimerChannelIntSource=15, OsHardwareTimerChannelOffset=0
