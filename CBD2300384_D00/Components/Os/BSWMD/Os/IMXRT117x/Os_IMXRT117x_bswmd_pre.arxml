AUTOSAR XML (schema 4-2-1)
package /MICROSAR
  module config Os_Pre: definition=Os
    OsPublishedInformation
      IMXRT117x (OsDerivativeInformation):
        OsMpuAlignment = SIZE
        OsMpuEndAddressAccessible = 1
        OsStackAlignment = 0
        OsExceptionVectorTableAlignment = 1024
        OsInterruptVectorTableAlignment = 1024
        OsHardwareManuals = ARMv7-M Architecture Reference Manual, Issue Ed, 29 June 2018 - DDI0403E_d_armv7m_arm i.MX RT1170 Processor Reference Manual, Document Number: IMXRT1170RM, Rev. H, 10/2020
        OsMpuPrivilegedRegionsConfigurable = 0
        Core0 (OsPhysicalCore):
          OsPhysicalCoreId = 0
          OsPhysicalCoreExceptionSources = 8
          OsPhysicalCoreIsAutostart = 1
          OsPhysicalCoreMasterStartAllowed = 1
          OsPhysicalCorePrivelegedHwAccess = 1
          OsPhysicalCoreType = Cortex-M
          OsPhysicalCoreDefaultEntrySymbol = _start
          OsPhysicalCoreStackProtectionUnit = Core0_MPU
          Core0_MPU (OsPhysicalCoreMpu): OsPhysicalCoreMpuMaxRegions=8, OsPhysicalCoreMpuId=0, OsPhysicalCoreMpuType=Cortex-M
          Core0_INTC (OsPhysicalCoreIntCtrl): OsPhysicalCoreIntCtrlMaxPrios=240, OsPhysicalCoreIntCtrlPrioOrder=DESC, OsPhysicalCoreIntCtrlMaxSources=233, OsPhysicalCoreIntCtrlType=NVIC
            OsPhysicalCoreIntCtrlAddress: OsPhysicalCoreIntCtrlAddressValue=3758153728
          CORE0_MU_A (OsPhysicalCoreAddress): OsPhysicalCoreAddressValue=1086619648
          CORE0_MU_B (OsPhysicalCoreAddress): OsPhysicalCoreAddressValue=1086636032
        7 x OsHardwareTimer:
          SysTick_Core0: OsHardwareTimerBaseAddress=3758153744, OsHardwareTimerId=0, OsHardwareTimerSize=24, OsHardwareTimerUnit=PIT, OsHardwareTimerType=SysTick
            SysTick_Core0_Ch0 (OsHardwareTimerChannel): OsHardwareTimerChannelId=0, OsHardwareTimerChannelIntSource=15, OsHardwareTimerChannelOffset=0
          GPT1_Timer: OsHardwareTimerId=1, OsHardwareTimerBaseAddress=1074708480, OsHardwareTimerType=NXP_GPT, OsHardwareTimerUnit=FRT, OsHardwareTimerSize=32
            GPT1_Ch1 (OsHardwareTimerChannel): OsHardwareTimerChannelId=1, OsHardwareTimerChannelOffset=0, OsHardwareTimerChannelIntSource=135
          GPT2_Timer: OsHardwareTimerId=2, OsHardwareTimerBaseAddress=1074724864, OsHardwareTimerType=NXP_GPT, OsHardwareTimerUnit=FRT, OsHardwareTimerSize=32
            GPT2_Ch1 (OsHardwareTimerChannel): OsHardwareTimerChannelId=1, OsHardwareTimerChannelOffset=0, OsHardwareTimerChannelIntSource=136
          GPT3_Timer: OsHardwareTimerId=3, OsHardwareTimerBaseAddress=1074741248, OsHardwareTimerType=NXP_GPT, OsHardwareTimerUnit=FRT, OsHardwareTimerSize=32
            GPT3_Ch1 (OsHardwareTimerChannel): OsHardwareTimerChannelId=1, OsHardwareTimerChannelOffset=0, OsHardwareTimerChannelIntSource=137
          GPT4_Timer: OsHardwareTimerId=4, OsHardwareTimerBaseAddress=1074757632, OsHardwareTimerType=NXP_GPT, OsHardwareTimerUnit=FRT, OsHardwareTimerSize=32
            GPT4_Ch1 (OsHardwareTimerChannel): OsHardwareTimerChannelId=1, OsHardwareTimerChannelOffset=0, OsHardwareTimerChannelIntSource=138
          GPT5_Timer: OsHardwareTimerId=5, OsHardwareTimerBaseAddress=1074774016, OsHardwareTimerType=NXP_GPT, OsHardwareTimerUnit=FRT, OsHardwareTimerSize=32
            GPT5_Ch1 (OsHardwareTimerChannel): OsHardwareTimerChannelId=1, OsHardwareTimerChannelOffset=0, OsHardwareTimerChannelIntSource=139
          GPT6_Timer: OsHardwareTimerId=6, OsHardwareTimerBaseAddress=1074790400, OsHardwareTimerType=NXP_GPT, OsHardwareTimerUnit=FRT, OsHardwareTimerSize=32
            GPT6_Ch1 (OsHardwareTimerChannel): OsHardwareTimerChannelId=1, OsHardwareTimerChannelOffset=0, OsHardwareTimerChannelIntSource=140
        OsMemoryRegionDefaults_AppNT (OsMemoryRegionDefaults):
          OsMemoryRegionDefIdentifier = 1
          OsMemoryRegionDefType = APPLICATION_NONPRIVILEGED
          OsMemoryRegionDefProtectionUnitSlot = 14
          OsMemoryRegionDefAccessRights = SUPERVISOR_RW
          OsMemoryRegionDefAccessRights = USER_RW
          OsMemoryRegionDefFlags = TYPE_CACHEABLE_WRITEBACK_ALLOCATE
        OsMemoryRegionSpecifics
          10 x OsMemoryRegionAccess:
            SUPERVISOR_R: OsMemoryRegionAccessRights=R, OsMemoryRegionAccessType=SUPERVISOR
            SUPERVISOR_RW: OsMemoryRegionAccessRights=RW, OsMemoryRegionAccessType=SUPERVISOR
            USER_R: OsMemoryRegionAccessRights=R, OsMemoryRegionAccessType=USER
            USER_RW: OsMemoryRegionAccessRights=RW, OsMemoryRegionAccessType=USER
            SUPERVISOR_NONE: OsMemoryRegionAccessRights=NONE, OsMemoryRegionAccessType=SUPERVISOR
            USER_NONE: OsMemoryRegionAccessRights=NONE, OsMemoryRegionAccessType=USER
            SUPERVISOR_RX: OsMemoryRegionAccessRights=RX, OsMemoryRegionAccessType=SUPERVISOR
            SUPERVISOR_RWX: OsMemoryRegionAccessRights=RWX, OsMemoryRegionAccessType=SUPERVISOR
            USER_RX: OsMemoryRegionAccessRights=RX, OsMemoryRegionAccessType=USER
            USER_RWX: OsMemoryRegionAccessRights=RWX, OsMemoryRegionAccessType=USER
          8 x OsMemoryRegionFlag:
            SHAREABLE
            TYPE_STRONGLY_ORDERED
            TYPE_NON_CACHEABLE
            TYPE_CACHEABLE_WRITEBACK_ALLOCATE
            TYPE_SHARED_DEVICE
            TYPE_NON_SHARED_DEVICE
            TYPE_CACHEABLE_WRITETHROUGH_NO_ALLOCATE
            TYPE_CACHEABLE_WRITEBACK_NO_ALLOCATE
        Core1 (OsPhysicalCore):
          OsPhysicalCoreId = 1
          OsPhysicalCoreExceptionSources = 8
          OsPhysicalCoreIsAutostart = 0
          OsPhysicalCoreMasterStartAllowed = 0
          OsPhysicalCorePrivelegedHwAccess = 1
          OsPhysicalCoreType = Cortex-M
          OsPhysicalCoreDefaultEntrySymbol = _start_c1
          OsPhysicalCoreStackProtectionUnit = Core1_MPU
          Core1_MPU (OsPhysicalCoreMpu): OsPhysicalCoreMpuMaxRegions=8, OsPhysicalCoreMpuId=1, OsPhysicalCoreMpuType=Cortex-M
          Core1_INTC (OsPhysicalCoreIntCtrl): OsPhysicalCoreIntCtrlMaxPrios=240, OsPhysicalCoreIntCtrlPrioOrder=DESC, OsPhysicalCoreIntCtrlMaxSources=233, OsPhysicalCoreIntCtrlType=NVIC
            OsPhysicalCoreIntCtrlAddress: OsPhysicalCoreIntCtrlAddressValue=3758153728
          4 x OsPhysicalCoreAddress:
            CORE1_MU_A: OsPhysicalCoreAddressValue=1086619648
            CORE1_MU_B: OsPhysicalCoreAddressValue=1086636032
            SRC: OsPhysicalCoreAddressValue=1086341120
            IOMUXC_LPSR_GPR: OsPhysicalCoreAddressValue=1086373888
        SysTick_Core1 (OsHardwareTimer): OsHardwareTimerBaseAddress=3758153744, OsHardwareTimerId=1, OsHardwareTimerSize=24, OsHardwareTimerUnit=PIT, OsHardwareTimerType=SysTick
          SysTick_Core1_Ch0 (OsHardwareTimerChannel): OsHardwareTimerChannelId=0, OsHardwareTimerChannelIntSource=15, OsHardwareTimerChannelOffset=0
        SysIntCtrl (OsSystemIntCtrl):
          OsSystemIntCtrlMaxPrios = 240
          OsSystemIntCtrlBaseAddress = 3758153728
          OsSystemIntCtrlMaxSources = 233
          OsSystemIntCtrlPrioOrder = DESC
          OsSystemIntCtrlType = NVIC
