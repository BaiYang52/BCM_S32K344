AUTOSAR XML (schema 4-2-1)
package /MICROSAR
  module config Os_Pre: definition=Os
    OsPublishedInformation
      IMX8x (OsDerivativeInformation):
        OsMpuAlignment = SIZE
        OsMpuEndAddressAccessible = 1
        OsStackAlignment = 0
        OsExceptionVectorTableAlignment = 0
        OsInterruptVectorTableAlignment = 512
        OsHardwareManuals = ARMv7-M Architecture Reference Manual edition: ARM DDI 0403E.b (ID120114), 02 December 2014 Cortex-M4 Devices Generic User Guide i.MX 8DualXPlus/8QuadXPlus Applications Processor Reference Manual Document Number: IMX8DQXPRM Rev. B, 5/2018
        OsMpuPrivilegedRegionsConfigurable = 0
        Core0 (OsPhysicalCore):
          OsPhysicalCoreId = 0
          OsPhysicalCoreExceptionSources = 8
          OsPhysicalCoreIsAutostart = 1
          OsPhysicalCoreMasterStartAllowed = 0
          OsPhysicalCorePrivelegedHwAccess = 1
          OsPhysicalCoreType = Cortex-M
          OsPhysicalCoreDefaultEntrySymbol = _start
          OsPhysicalCoreStackProtectionUnit = Core0_MPU
          Core0_MPU (OsPhysicalCoreMpu): OsPhysicalCoreMpuMaxRegions=8, OsPhysicalCoreMpuId=0, OsPhysicalCoreMpuType=Cortex-M
          Core0_INTC (OsPhysicalCoreIntCtrl): OsPhysicalCoreIntCtrlMaxPrios=240, OsPhysicalCoreIntCtrlMaxSources=127, OsPhysicalCoreIntCtrlPrioOrder=DESC, OsPhysicalCoreIntCtrlType=NVIC_IMX8
            OsPhysicalCoreIntCtrlAddress: OsPhysicalCoreIntCtrlAddressValue=3758153728
            8 x OsPhysicalCoreIntCtrlSlaveConfig:
              CoreExternalIRQ0: OsPhysicalCoreIntCtrlMasterSource=48, OsPhysicalCoreIntCtrlSlaveMinSource=31, OsPhysicalCoreIntCtrlSlaveMaxSource=63
              CoreExternalIRQ1: OsPhysicalCoreIntCtrlMasterSource=49, OsPhysicalCoreIntCtrlSlaveMinSource=64, OsPhysicalCoreIntCtrlSlaveMaxSource=127
              CoreExternalIRQ2: OsPhysicalCoreIntCtrlMasterSource=50, OsPhysicalCoreIntCtrlSlaveMinSource=128, OsPhysicalCoreIntCtrlSlaveMaxSource=191
              CoreExternalIRQ3: OsPhysicalCoreIntCtrlMasterSource=51, OsPhysicalCoreIntCtrlSlaveMinSource=192, OsPhysicalCoreIntCtrlSlaveMaxSource=255
              CoreExternalIRQ4: OsPhysicalCoreIntCtrlMasterSource=52, OsPhysicalCoreIntCtrlSlaveMinSource=256, OsPhysicalCoreIntCtrlSlaveMaxSource=319
              CoreExternalIRQ5: OsPhysicalCoreIntCtrlMasterSource=53, OsPhysicalCoreIntCtrlSlaveMinSource=320, OsPhysicalCoreIntCtrlSlaveMaxSource=383
              CoreExternalIRQ6: OsPhysicalCoreIntCtrlMasterSource=54, OsPhysicalCoreIntCtrlSlaveMinSource=384, OsPhysicalCoreIntCtrlSlaveMaxSource=447
              CoreExternalIRQ7: OsPhysicalCoreIntCtrlMasterSource=55, OsPhysicalCoreIntCtrlSlaveMinSource=448, OsPhysicalCoreIntCtrlSlaveMaxSource=511
        STEER (OsSystemIntCtrl):
          OsSystemIntCtrlMaxPrios = 240
          OsSystemIntCtrlMaxSources = 511
          OsSystemIntCtrlPrioOrder = DESC
          OsSystemIntCtrlBaseAddress = 1359413248
          OsSystemIntCtrlType = NVIC_IMX8
          4 x OsSystemIntCtrlAddress:
            STEER_CHN_STATUS: OsSystemIntCtrlAddressValue=1359413380
            STEER_CHN_MASK: OsSystemIntCtrlAddressValue=1359413252
            STEER_CHN_MINTDIS_REG_OFFSET: OsSystemIntCtrlAddressValue=196
            STEER_NUMBER_OF_CHANNELS: OsSystemIntCtrlAddressValue=15
        SysTick (OsHardwareTimer): OsHardwareTimerBaseAddress=3758153744, OsHardwareTimerId=0, OsHardwareTimerSize=24, OsHardwareTimerUnit=PIT, OsHardwareTimerType=SysTick
          SysTick_Ch0 (OsHardwareTimerChannel): OsHardwareTimerChannelId=0, OsHardwareTimerChannelIntSource=15, OsHardwareTimerChannelOffset=0
        OsMemoryRegionSpecifics
          10 x OsMemoryRegionAccess:
            SUPERVISOR_R: OsMemoryRegionAccessRights=R, OsMemoryRegionAccessType=SUPERVISOR
            SUPERVISOR_RW: OsMemoryRegionAccessRights=RW, OsMemoryRegionAccessType=SUPERVISOR
            USER_R: OsMemoryRegionAccessRights=R, OsMemoryRegionAccessType=USER
            USER_RW: OsMemoryRegionAccessRights=RW, OsMemoryRegionAccessType=USER
            SUPERVISOR_NONE: OsMemoryRegionAccessRights=NONE, OsMemoryRegionAccessType=SUPERVISOR
            USER_NONE: OsMemoryRegionAccessRights=NONE, OsMemoryRegionAccessType=USER
            SUPERVISOR_RX: OsMemoryRegionAccessRights=RX, OsMemoryRegionAccessType=SUPERVISOR
            SUPERVISOR_RWX: OsMemoryRegionAccessRights=RWX, OsMemoryRegionAccessType=SUPERVISOR
            USER_RX: OsMemoryRegionAccessRights=RX, OsMemoryRegionAccessType=USER
            USER_RWX: OsMemoryRegionAccessRights=RWX, OsMemoryRegionAccessType=USER
          8 x OsMemoryRegionFlag:
            SHAREABLE
            TYPE_STRONGLY_ORDERED
            TYPE_NON_CACHEABLE
            TYPE_CACHEABLE_WRITEBACK_ALLOCATE
            TYPE_SHARED_DEVICE
            TYPE_NON_SHARED_DEVICE
            TYPE_CACHEABLE_WRITETHROUGH_NO_ALLOCATE
            TYPE_CACHEABLE_WRITEBACK_NO_ALLOCATE
        OsMemoryRegionDefaults_AppNT (OsMemoryRegionDefaults):
          OsMemoryRegionDefIdentifier = 1
          OsMemoryRegionDefType = APPLICATION_NONPRIVILEGED
          OsMemoryRegionDefProtectionUnitSlot = 6
          OsMemoryRegionDefAccessRights = SUPERVISOR_RW
          OsMemoryRegionDefAccessRights = USER_RW
          OsMemoryRegionDefFlags = TYPE_CACHEABLE_WRITEBACK_ALLOCATE
        TPM (OsHardwareTimer): OsHardwareTimerBaseAddress=1092616192, OsHardwareTimerId=0, OsHardwareTimerSize=32, OsHardwareTimerType=TPM, OsHardwareTimerUnit=FRT
          TPM_Ch0 (OsHardwareTimerChannel): OsHardwareTimerChannelId=0, OsHardwareTimerChannelIntSource=35, OsHardwareTimerChannelOffset=0
