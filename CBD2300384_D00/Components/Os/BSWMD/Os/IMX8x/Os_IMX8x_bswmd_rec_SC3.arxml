AUTOSAR XML (schema 4-2-1)
package /MICROSAR
  module config Os_Rec: definition=Os
    OsMemoryProtection
      Core0_FullAccessSupervisor (OsMemoryRegion):
        OsMemoryRegionStartAddress = 0
        OsMemoryRegionEndAddress = 0x100000000
        OsMemoryRegionProtectionUnitSlot = 0
        OsMemoryRegionProtectionUnit = Core0_MPU
        OsMemoryRegionAccessRights = SUPERVISOR_RWX
        OsMemoryRegionAccessRights = USER_RX
        OsMemoryRegionFlags = TYPE_CACHEABLE_WRITEBACK_ALLOCATE
      Core0_StackProtection (OsMemoryRegion):
        OsMemoryRegionStartAddress = _OS_CORE0_STACKS_START
        OsMemoryRegionProtectionUnitSlot = 1
        OsMemoryRegionProtectionUnit = Core0_MPU
        OsMemoryRegionAccessRights = SUPERVISOR_R
        OsMemoryRegionAccessRights = USER_R
        OsMemoryRegionFlags = TYPE_CACHEABLE_WRITEBACK_ALLOCATE
