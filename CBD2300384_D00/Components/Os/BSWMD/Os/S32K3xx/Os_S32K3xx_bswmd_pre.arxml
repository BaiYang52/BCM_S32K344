AUTOSAR XML (schema 4-2-1)
package /MICROSAR
  module config Os_Pre: definition=Os
    OsPublishedInformation
      S32K3xx (OsDerivativeInformation):
        OsHardwareManuals = ARMv7-M Architecture Reference Manual edition: ARM DDI 0403E.b (ID120114), 02 December 2014 Document identifier: S32K3xxRM Reference Manual Rev. 5, 09/2022 Document identifier: S32K396RM Reference Manual Rev. 1.1, 09/2022
        OsStackAlignment = 0
        OsExceptionVectorTableAlignment = 0
        OsInterruptVectorTableAlignment = 1024
        OsMpuAlignment = SIZE
        OsMpuEndAddressAccessible = 1
        OsMpuPrivilegedRegionsConfigurable = 0
        3 x OsPhysicalCore, all with OsPhysicalCoreExceptionSources=8, OsPhysicalCorePrivelegedHwAccess=1, OsPhysicalCoreType=Cortex-M:
          Core0: OsPhysicalCoreId=0, OsPhysicalCoreIsAutostart=1, OsPhysicalCoreMasterStartAllowed=1, OsPhysicalCoreDefaultEntrySymbol=_start
            Core0_MPU (OsPhysicalCoreMpu): OsPhysicalCoreMpuId=0, OsPhysicalCoreMpuMaxRegions=16, OsPhysicalCoreMpuType=Cortex-M
            Core0_INTC (OsPhysicalCoreIntCtrl): OsPhysicalCoreIntCtrlMaxPrios=240, OsPhysicalCoreIntCtrlPrioOrder=DESC, OsPhysicalCoreIntCtrlMaxSources=255, OsPhysicalCoreIntCtrlType=NVIC_S32
              OsPhysicalCoreIntCtrlAddress: OsPhysicalCoreIntCtrlAddressValue=3758153728
            MC_ME_PRTN0_CORE0 (OsPhysicalCoreAddress): OsPhysicalCoreAddressValue=1076740416
          Core1: OsPhysicalCoreId=1, OsPhysicalCoreIsAutostart=0, OsPhysicalCoreMasterStartAllowed=0, OsPhysicalCoreDefaultEntrySymbol=_start_c1
            Core1_MPU (OsPhysicalCoreMpu): OsPhysicalCoreMpuId=1, OsPhysicalCoreMpuType=Cortex-M, OsPhysicalCoreMpuMaxRegions=16
            Core1_INTC (OsPhysicalCoreIntCtrl): OsPhysicalCoreIntCtrlMaxPrios=240, OsPhysicalCoreIntCtrlMaxSources=255, OsPhysicalCoreIntCtrlPrioOrder=DESC, OsPhysicalCoreIntCtrlType=NVIC_S32
              OsPhysicalCoreIntCtrlAddress: OsPhysicalCoreIntCtrlAddressValue=3758153728
            MC_ME_PRTN0_CORE1 (OsPhysicalCoreAddress): OsPhysicalCoreAddressValue=1076740448
          Core2: OsPhysicalCoreId=2, OsPhysicalCoreIsAutostart=0, OsPhysicalCoreMasterStartAllowed=0, OsPhysicalCoreDefaultEntrySymbol=_start_c2
            Core2_MPU (OsPhysicalCoreMpu): OsPhysicalCoreMpuId=2, OsPhysicalCoreMpuType=Cortex-M, OsPhysicalCoreMpuMaxRegions=16
            Core2_INTC (OsPhysicalCoreIntCtrl): OsPhysicalCoreIntCtrlMaxPrios=240, OsPhysicalCoreIntCtrlMaxSources=255, OsPhysicalCoreIntCtrlPrioOrder=DESC, OsPhysicalCoreIntCtrlType=NVIC_S32
              OsPhysicalCoreIntCtrlAddress: OsPhysicalCoreIntCtrlAddressValue=3758153728
            MC_ME_PRTN0_CORE2 (OsPhysicalCoreAddress): OsPhysicalCoreAddressValue=1076740544
        3 x OsHardwareTimer, all with OsHardwareTimerBaseAddress=0, OsHardwareTimerSize=24, OsHardwareTimerUnit=PIT, OsHardwareTimerType=SysTick:
          SysTick_Core0: OsHardwareTimerId=0
            SysTick_Core0_Ch0 (OsHardwareTimerChannel): OsHardwareTimerChannelId=0, OsHardwareTimerChannelIntSource=15, OsHardwareTimerChannelOffset=0
          SysTick_Core1: OsHardwareTimerId=1
            SysTick_Core1_Ch0 (OsHardwareTimerChannel): OsHardwareTimerChannelId=0, OsHardwareTimerChannelIntSource=15, OsHardwareTimerChannelOffset=0
          SysTick_Core2: OsHardwareTimerId=2
            SysTick_Core2_Ch0 (OsHardwareTimerChannel): OsHardwareTimerChannelId=0, OsHardwareTimerChannelIntSource=15, OsHardwareTimerChannelOffset=0
        OsMemoryRegionSpecifics
          10 x OsMemoryRegionAccess:
            SUPERVISOR_R: OsMemoryRegionAccessRights=R, OsMemoryRegionAccessType=SUPERVISOR
            SUPERVISOR_RW: OsMemoryRegionAccessRights=RW, OsMemoryRegionAccessType=SUPERVISOR
            USER_R: OsMemoryRegionAccessRights=R, OsMemoryRegionAccessType=USER
            USER_RW: OsMemoryRegionAccessRights=RW, OsMemoryRegionAccessType=USER
            SUPERVISOR_NONE: OsMemoryRegionAccessRights=NONE, OsMemoryRegionAccessType=SUPERVISOR
            USER_NONE: OsMemoryRegionAccessRights=NONE, OsMemoryRegionAccessType=USER
            SUPERVISOR_RX: OsMemoryRegionAccessRights=RX, OsMemoryRegionAccessType=SUPERVISOR
            SUPERVISOR_RWX: OsMemoryRegionAccessRights=RWX, OsMemoryRegionAccessType=SUPERVISOR
            USER_RX: OsMemoryRegionAccessRights=RX, OsMemoryRegionAccessType=USER
            USER_RWX: OsMemoryRegionAccessRights=RWX, OsMemoryRegionAccessType=USER
          8 x OsMemoryRegionFlag:
            SHAREABLE
            TYPE_STRONGLY_ORDERED
            TYPE_NON_CACHEABLE
            TYPE_CACHEABLE_WRITEBACK_ALLOCATE
            TYPE_SHARED_DEVICE
            TYPE_NON_SHARED_DEVICE
            TYPE_CACHEABLE_WRITETHROUGH_NO_ALLOCATE
            TYPE_CACHEABLE_WRITEBACK_NO_ALLOCATE
        OsMemoryRegionDefaults_AppNT (OsMemoryRegionDefaults):
          OsMemoryRegionDefIdentifier = 1
          OsMemoryRegionDefType = APPLICATION_NONPRIVILEGED
          OsMemoryRegionDefProtectionUnitSlot = 14
          OsMemoryRegionDefAccessRights = SUPERVISOR_RW
          OsMemoryRegionDefAccessRights = USER_RW
          OsMemoryRegionDefFlags = TYPE_CACHEABLE_WRITEBACK_ALLOCATE
        MSCM (OsSystemIntCtrl):
          OsSystemIntCtrlBaseAddress = 1076232192
          OsSystemIntCtrlMaxPrios = 240
          OsSystemIntCtrlMaxSources = 255
          OsSystemIntCtrlPrioOrder = DESC
          OsSystemIntCtrlType = NVIC_S32
          MSCM_IRSPRC (OsSystemIntCtrlAddress): OsSystemIntCtrlAddressValue=1076234370
        OsInterruptRouting: OsInterruptRoutingCore0Offset=0
        3 x OsHardwareTimer, all with OsHardwareTimerSize=32, OsHardwareTimerType=STM, OsHardwareTimerUnit=FRT:
          STM0: OsHardwareTimerId=0, OsHardwareTimerBaseAddress=1076314112
            STM0 (OsHardwareTimerChannel): OsHardwareTimerChannelId=0, OsHardwareTimerChannelIntSource=55, OsHardwareTimerChannelOffset=0
          STM1: OsHardwareTimerId=1, OsHardwareTimerBaseAddress=1078411264
            STM1 (OsHardwareTimerChannel): OsHardwareTimerChannelId=0, OsHardwareTimerChannelIntSource=56, OsHardwareTimerChannelOffset=0
          STM2: OsHardwareTimerId=2, OsHardwareTimerBaseAddress=1078427648
            STM2 (OsHardwareTimerChannel): OsHardwareTimerChannelId=0, OsHardwareTimerChannelIntSource=57, OsHardwareTimerChannelOffset=0
