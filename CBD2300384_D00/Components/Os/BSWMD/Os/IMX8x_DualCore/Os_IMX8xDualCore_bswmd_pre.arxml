AUTOSAR XML (schema 4-2-1)
package /MICROSAR
  module config Os_Pre: definition=Os
    OsPublishedInformation
      IMX8xDualCore (OsDerivativeInformation):
        OsMpuAlignment = SIZE
        OsMpuEndAddressAccessible = 1
        OsStackAlignment = 0
        OsExceptionVectorTableAlignment = 0
        OsInterruptVectorTableAlignment = 512
        OsHardwareManuals = ARMv7-M Architecture Reference Manual edition: ARM DDI 0403E.b (ID120114), 02 December 2014 Cortex-M4 Devices Generic User Guide i.MX 8QuadMax Applications Processor Reference Manual Document Number: IMX8QMRM Rev. F, 10/2019
        OsMpuPrivilegedRegionsConfigurable = 0
        Core0 (OsPhysicalCore):
          OsPhysicalCoreId = 0
          OsPhysicalCoreExceptionSources = 8
          OsPhysicalCoreIsAutostart = 1
          OsPhysicalCoreMasterStartAllowed = 0
          OsPhysicalCorePrivelegedHwAccess = 1
          OsPhysicalCoreType = Cortex-M
          OsPhysicalCoreDefaultEntrySymbol = _start
          OsPhysicalCoreStackProtectionUnit = Core0_MPU
          Core0_MPU (OsPhysicalCoreMpu): OsPhysicalCoreMpuMaxRegions=8, OsPhysicalCoreMpuId=0, OsPhysicalCoreMpuType=Cortex-M
          Core0_INTC (OsPhysicalCoreIntCtrl): OsPhysicalCoreIntCtrlMaxPrios=240, OsPhysicalCoreIntCtrlMaxSources=127, OsPhysicalCoreIntCtrlPrioOrder=DESC, OsPhysicalCoreIntCtrlType=NVIC_IMX8
            OsPhysicalCore0IntCtrlAddress (OsPhysicalCoreIntCtrlAddress): OsPhysicalCoreIntCtrlAddressValue=3758153728
            8 x OsPhysicalCoreIntCtrlSlaveConfig:
              Core0ExternalIRQ0: OsPhysicalCoreIntCtrlMasterSource=48, OsPhysicalCoreIntCtrlSlaveMinSource=31, OsPhysicalCoreIntCtrlSlaveMaxSource=63
              Core0ExternalIRQ1: OsPhysicalCoreIntCtrlMasterSource=49, OsPhysicalCoreIntCtrlSlaveMinSource=64, OsPhysicalCoreIntCtrlSlaveMaxSource=127
              Core0ExternalIRQ2: OsPhysicalCoreIntCtrlMasterSource=50, OsPhysicalCoreIntCtrlSlaveMinSource=128, OsPhysicalCoreIntCtrlSlaveMaxSource=191
              Core0ExternalIRQ3: OsPhysicalCoreIntCtrlMasterSource=51, OsPhysicalCoreIntCtrlSlaveMinSource=192, OsPhysicalCoreIntCtrlSlaveMaxSource=255
              Core0ExternalIRQ4: OsPhysicalCoreIntCtrlMasterSource=52, OsPhysicalCoreIntCtrlSlaveMinSource=256, OsPhysicalCoreIntCtrlSlaveMaxSource=319
              Core0ExternalIRQ5: OsPhysicalCoreIntCtrlMasterSource=53, OsPhysicalCoreIntCtrlSlaveMinSource=320, OsPhysicalCoreIntCtrlSlaveMaxSource=383
              Core0ExternalIRQ6: OsPhysicalCoreIntCtrlMasterSource=54, OsPhysicalCoreIntCtrlSlaveMinSource=384, OsPhysicalCoreIntCtrlSlaveMaxSource=447
              Core0ExternalIRQ7: OsPhysicalCoreIntCtrlMasterSource=55, OsPhysicalCoreIntCtrlSlaveMinSource=448, OsPhysicalCoreIntCtrlSlaveMaxSource=511
          CORE0_MU0_A0 (OsPhysicalCoreAddress): OsPhysicalCoreAddressValue=927203328
          CORE0_MU0_B (OsPhysicalCoreAddress): OsPhysicalCoreAddressValue=927137792
        STEER (OsSystemIntCtrl):
          OsSystemIntCtrlMaxPrios = 240
          OsSystemIntCtrlMaxSources = 511
          OsSystemIntCtrlPrioOrder = DESC
          OsSystemIntCtrlBaseAddress = 1359413248
          OsSystemIntCtrlType = NVIC_IMX8
          4 x OsSystemIntCtrlAddress:
            STEER_CHN_STATUS: OsSystemIntCtrlAddressValue=1359413380
            STEER_CHN_MASK: OsSystemIntCtrlAddressValue=1359413252
            STEER_CHN_MINTDIS_REG_OFFSET: OsSystemIntCtrlAddressValue=196
            STEER_NUMBER_OF_CHANNELS: OsSystemIntCtrlAddressValue=15
        SysTick_Core0 (OsHardwareTimer): OsHardwareTimerBaseAddress=3758153744, OsHardwareTimerId=0, OsHardwareTimerSize=24, OsHardwareTimerUnit=PIT, OsHardwareTimerType=SysTick
          SysTick_Core0_Ch0 (OsHardwareTimerChannel): OsHardwareTimerChannelId=0, OsHardwareTimerChannelIntSource=15, OsHardwareTimerChannelOffset=0
        OsMemoryRegionSpecifics
          10 x OsMemoryRegionAccess:
            SUPERVISOR_R: OsMemoryRegionAccessRights=R, OsMemoryRegionAccessType=SUPERVISOR
            SUPERVISOR_RW: OsMemoryRegionAccessRights=RW, OsMemoryRegionAccessType=SUPERVISOR
            USER_R: OsMemoryRegionAccessRights=R, OsMemoryRegionAccessType=USER
            USER_RW: OsMemoryRegionAccessRights=RW, OsMemoryRegionAccessType=USER
            SUPERVISOR_NONE: OsMemoryRegionAccessRights=NONE, OsMemoryRegionAccessType=SUPERVISOR
            USER_NONE: OsMemoryRegionAccessRights=NONE, OsMemoryRegionAccessType=USER
            SUPERVISOR_RX: OsMemoryRegionAccessRights=RX, OsMemoryRegionAccessType=SUPERVISOR
            SUPERVISOR_RWX: OsMemoryRegionAccessRights=RWX, OsMemoryRegionAccessType=SUPERVISOR
            USER_RX: OsMemoryRegionAccessRights=RX, OsMemoryRegionAccessType=USER
            USER_RWX: OsMemoryRegionAccessRights=RWX, OsMemoryRegionAccessType=USER
          8 x OsMemoryRegionFlag:
            SHAREABLE
            TYPE_STRONGLY_ORDERED
            TYPE_NON_CACHEABLE
            TYPE_CACHEABLE_WRITEBACK_ALLOCATE
            TYPE_SHARED_DEVICE
            TYPE_NON_SHARED_DEVICE
            TYPE_CACHEABLE_WRITETHROUGH_NO_ALLOCATE
            TYPE_CACHEABLE_WRITEBACK_NO_ALLOCATE
        OsMemoryRegionDefaults_AppNT (OsMemoryRegionDefaults):
          OsMemoryRegionDefIdentifier = 1
          OsMemoryRegionDefType = APPLICATION_NONPRIVILEGED
          OsMemoryRegionDefProtectionUnitSlot = 5
          OsMemoryRegionDefAccessRights = SUPERVISOR_RW
          OsMemoryRegionDefAccessRights = USER_RW
          OsMemoryRegionDefFlags = TYPE_CACHEABLE_WRITEBACK_ALLOCATE
        Core1 (OsPhysicalCore):
          OsPhysicalCoreId = 1
          OsPhysicalCoreExceptionSources = 8
          OsPhysicalCoreIsAutostart = 1
          OsPhysicalCoreMasterStartAllowed = 0
          OsPhysicalCorePrivelegedHwAccess = 1
          OsPhysicalCoreType = Cortex-M
          OsPhysicalCoreDefaultEntrySymbol = _start_c1
          OsPhysicalCoreStackProtectionUnit = Core1_MPU
          Core1_MPU (OsPhysicalCoreMpu): OsPhysicalCoreMpuMaxRegions=8, OsPhysicalCoreMpuId=1, OsPhysicalCoreMpuType=Cortex-M
          Core1_INTC (OsPhysicalCoreIntCtrl): OsPhysicalCoreIntCtrlMaxPrios=240, OsPhysicalCoreIntCtrlMaxSources=127, OsPhysicalCoreIntCtrlPrioOrder=DESC, OsPhysicalCoreIntCtrlType=NVIC_IMX8
            OsPhysicalCore1IntCtrlAddress (OsPhysicalCoreIntCtrlAddress): OsPhysicalCoreIntCtrlAddressValue=3758153728
            8 x OsPhysicalCoreIntCtrlSlaveConfig:
              Core1ExternalIRQ0: OsPhysicalCoreIntCtrlMasterSource=48, OsPhysicalCoreIntCtrlSlaveMinSource=31, OsPhysicalCoreIntCtrlSlaveMaxSource=63
              Core1ExternalIRQ1: OsPhysicalCoreIntCtrlMasterSource=49, OsPhysicalCoreIntCtrlSlaveMinSource=64, OsPhysicalCoreIntCtrlSlaveMaxSource=127
              Core1ExternalIRQ2: OsPhysicalCoreIntCtrlMasterSource=50, OsPhysicalCoreIntCtrlSlaveMinSource=128, OsPhysicalCoreIntCtrlSlaveMaxSource=191
              Core1ExternalIRQ3: OsPhysicalCoreIntCtrlMasterSource=51, OsPhysicalCoreIntCtrlSlaveMinSource=192, OsPhysicalCoreIntCtrlSlaveMaxSource=255
              Core1ExternalIRQ4: OsPhysicalCoreIntCtrlMasterSource=52, OsPhysicalCoreIntCtrlSlaveMinSource=256, OsPhysicalCoreIntCtrlSlaveMaxSource=319
              Core1ExternalIRQ5: OsPhysicalCoreIntCtrlMasterSource=53, OsPhysicalCoreIntCtrlSlaveMinSource=320, OsPhysicalCoreIntCtrlSlaveMaxSource=383
              Core1ExternalIRQ6: OsPhysicalCoreIntCtrlMasterSource=54, OsPhysicalCoreIntCtrlSlaveMinSource=384, OsPhysicalCoreIntCtrlSlaveMaxSource=447
              Core1ExternalIRQ7: OsPhysicalCoreIntCtrlMasterSource=55, OsPhysicalCoreIntCtrlSlaveMinSource=448, OsPhysicalCoreIntCtrlSlaveMaxSource=511
          CORE1_MU0_A0 (OsPhysicalCoreAddress): OsPhysicalCoreAddressValue=994312192
          CORE1_MU0_B (OsPhysicalCoreAddress): OsPhysicalCoreAddressValue=994246656
        SysTick_Core1 (OsHardwareTimer): OsHardwareTimerBaseAddress=3758153744, OsHardwareTimerId=1, OsHardwareTimerSize=24, OsHardwareTimerUnit=PIT, OsHardwareTimerType=SysTick
          SysTick_Core1_Ch0 (OsHardwareTimerChannel): OsHardwareTimerChannelId=0, OsHardwareTimerChannelIntSource=15, OsHardwareTimerChannelOffset=0
        TPM (OsHardwareTimer): OsHardwareTimerBaseAddress=1092616192, OsHardwareTimerId=0, OsHardwareTimerSize=32, OsHardwareTimerType=TPM, OsHardwareTimerUnit=FRT
          TPM_Ch0 (OsHardwareTimerChannel): OsHardwareTimerChannelId=0, OsHardwareTimerChannelIntSource=35, OsHardwareTimerChannelOffset=0
          TPM_Ch1 (OsHardwareTimerChannel): OsHardwareTimerChannelId=1, OsHardwareTimerChannelIntSource=35, OsHardwareTimerChannelOffset=0
