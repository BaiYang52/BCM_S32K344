AUTOSAR XML (schema 4-2-1)
package /MICROSAR
  module config Os_Pre: definition=Os
    OsPublishedInformation
      S32G3x (OsDerivativeInformation):
        OsHardwareManuals = ARMv7-M Architecture Reference Manual edition: ARM DDI 0403E.b (ID120114), 02 December 2014 S32G3 Reference Manual: S32G3RM Rev.1 Nov 2021
        OsStackAlignment = 0
        OsExceptionVectorTableAlignment = 0
        OsInterruptVectorTableAlignment = 1024
        OsMpuAlignment = SIZE
        OsMpuEndAddressAccessible = 1
        OsMpuPrivilegedRegionsConfigurable = 0
        Core0 (OsPhysicalCore):
          OsPhysicalCoreId = 0
          OsPhysicalCoreExceptionSources = 8
          OsPhysicalCoreIsAutostart = 1
          OsPhysicalCoreMasterStartAllowed = 1
          OsPhysicalCorePrivelegedHwAccess = 1
          OsPhysicalCoreType = Cortex-M
          OsPhysicalCoreDefaultEntrySymbol = _start
          Core0_MPU (OsPhysicalCoreMpu): OsPhysicalCoreMpuId=0, OsPhysicalCoreMpuMaxRegions=16, OsPhysicalCoreMpuType=Cortex-M
          Core0_INTC (OsPhysicalCoreIntCtrl): OsPhysicalCoreIntCtrlMaxPrios=224, OsPhysicalCoreIntCtrlPrioOrder=DESC, OsPhysicalCoreIntCtrlMaxSources=255, OsPhysicalCoreIntCtrlType=NVIC_S32
            OsPhysicalCoreIntCtrlAddress: OsPhysicalCoreIntCtrlAddressValue=3758153728
          3 x OsPhysicalCoreAddress:
            RGM_PRST: OsPhysicalCoreAddressValue=1074233408
            RGM_PSTAT: OsPhysicalCoreAddressValue=1074233664
            MC_ME_PRTN0_CORE0: OsPhysicalCoreAddressValue=1074299200
        SysTick_Core0 (OsHardwareTimer): OsHardwareTimerBaseAddress=0, OsHardwareTimerId=0, OsHardwareTimerSize=24, OsHardwareTimerUnit=PIT, OsHardwareTimerType=SysTick
          SysTick_Core0_Ch0 (OsHardwareTimerChannel): OsHardwareTimerChannelId=0, OsHardwareTimerChannelIntSource=15, OsHardwareTimerChannelOffset=0
        OsMemoryRegionSpecifics
          10 x OsMemoryRegionAccess:
            SUPERVISOR_R: OsMemoryRegionAccessRights=R, OsMemoryRegionAccessType=SUPERVISOR
            SUPERVISOR_RW: OsMemoryRegionAccessRights=RW, OsMemoryRegionAccessType=SUPERVISOR
            USER_R: OsMemoryRegionAccessRights=R, OsMemoryRegionAccessType=USER
            USER_RW: OsMemoryRegionAccessRights=RW, OsMemoryRegionAccessType=USER
            SUPERVISOR_NONE: OsMemoryRegionAccessRights=NONE, OsMemoryRegionAccessType=SUPERVISOR
            USER_NONE: OsMemoryRegionAccessRights=NONE, OsMemoryRegionAccessType=USER
            SUPERVISOR_RX: OsMemoryRegionAccessRights=RX, OsMemoryRegionAccessType=SUPERVISOR
            SUPERVISOR_RWX: OsMemoryRegionAccessRights=RWX, OsMemoryRegionAccessType=SUPERVISOR
            USER_RX: OsMemoryRegionAccessRights=RX, OsMemoryRegionAccessType=USER
            USER_RWX: OsMemoryRegionAccessRights=RWX, OsMemoryRegionAccessType=USER
          8 x OsMemoryRegionFlag:
            SHAREABLE
            TYPE_STRONGLY_ORDERED
            TYPE_NON_CACHEABLE
            TYPE_CACHEABLE_WRITEBACK_ALLOCATE
            TYPE_SHARED_DEVICE
            TYPE_NON_SHARED_DEVICE
            TYPE_CACHEABLE_WRITETHROUGH_NO_ALLOCATE
            TYPE_CACHEABLE_WRITEBACK_NO_ALLOCATE
        OsMemoryRegionDefaults_AppNT (OsMemoryRegionDefaults):
          OsMemoryRegionDefIdentifier = 1
          OsMemoryRegionDefType = APPLICATION_NONPRIVILEGED
          OsMemoryRegionDefProtectionUnitSlot = 14
          OsMemoryRegionDefAccessRights = SUPERVISOR_RW
          OsMemoryRegionDefAccessRights = USER_RW
          OsMemoryRegionDefFlags = TYPE_CACHEABLE_WRITEBACK_ALLOCATE
        MSCM (OsSystemIntCtrl):
          OsSystemIntCtrlBaseAddress = 1075412992
          OsSystemIntCtrlMaxPrios = 224
          OsSystemIntCtrlMaxSources = 255
          OsSystemIntCtrlPrioOrder = DESC
          OsSystemIntCtrlType = NVIC_S32
          MSCM_IRSPRC (OsSystemIntCtrlAddress): OsSystemIntCtrlAddressValue=1075415168
        Core1 (OsPhysicalCore):
          OsPhysicalCoreId = 1
          OsPhysicalCoreType = Cortex-M
          OsPhysicalCoreExceptionSources = 8
          OsPhysicalCoreIsAutostart = 0
          OsPhysicalCoreMasterStartAllowed = 0
          OsPhysicalCorePrivelegedHwAccess = 1
          OsPhysicalCoreDefaultEntrySymbol = _start_c1
          Core1_MPU (OsPhysicalCoreMpu): OsPhysicalCoreMpuId=1, OsPhysicalCoreMpuType=Cortex-M, OsPhysicalCoreMpuMaxRegions=16
          Core1_INTC (OsPhysicalCoreIntCtrl): OsPhysicalCoreIntCtrlMaxPrios=224, OsPhysicalCoreIntCtrlMaxSources=255, OsPhysicalCoreIntCtrlPrioOrder=DESC, OsPhysicalCoreIntCtrlType=NVIC_S32
            OsPhysicalCoreIntCtrlAddress: OsPhysicalCoreIntCtrlAddressValue=3758153728
          MC_ME_PRTN0_CORE1 (OsPhysicalCoreAddress): OsPhysicalCoreAddressValue=1074299232
        Core2 (OsPhysicalCore):
          OsPhysicalCoreId = 2
          OsPhysicalCoreType = Cortex-M
          OsPhysicalCoreExceptionSources = 8
          OsPhysicalCoreIsAutostart = 0
          OsPhysicalCoreMasterStartAllowed = 0
          OsPhysicalCorePrivelegedHwAccess = 1
          OsPhysicalCoreDefaultEntrySymbol = _start_c2
          Core2_INTC (OsPhysicalCoreIntCtrl): OsPhysicalCoreIntCtrlMaxPrios=224, OsPhysicalCoreIntCtrlMaxSources=255, OsPhysicalCoreIntCtrlPrioOrder=DESC, OsPhysicalCoreIntCtrlType=NVIC_S32
            OsPhysicalCoreIntCtrlAddress: OsPhysicalCoreIntCtrlAddressValue=3758153728
          Core2_MPU (OsPhysicalCoreMpu): OsPhysicalCoreMpuId=2, OsPhysicalCoreMpuType=Cortex-M, OsPhysicalCoreMpuMaxRegions=16
          MC_ME_PRTN0_CORE2 (OsPhysicalCoreAddress): OsPhysicalCoreAddressValue=1074299264
        9 x OsHardwareTimer:
          SysTick_Core1: OsHardwareTimerBaseAddress=0, OsHardwareTimerId=1, OsHardwareTimerSize=24, OsHardwareTimerUnit=PIT, OsHardwareTimerType=SysTick
            SysTick_Core1_Ch0 (OsHardwareTimerChannel): OsHardwareTimerChannelId=0, OsHardwareTimerChannelIntSource=15, OsHardwareTimerChannelOffset=0
          SysTick_Core2: OsHardwareTimerBaseAddress=0, OsHardwareTimerId=2, OsHardwareTimerSize=24, OsHardwareTimerUnit=PIT, OsHardwareTimerType=SysTick
            SysTick_Core2_Ch0 (OsHardwareTimerChannel): OsHardwareTimerChannelId=0, OsHardwareTimerChannelIntSource=15, OsHardwareTimerChannelOffset=0
          STM0: OsHardwareTimerId=0, OsHardwareTimerBaseAddress=1074905088, OsHardwareTimerSize=32, OsHardwareTimerType=STM, OsHardwareTimerUnit=FRT
            STM0 (OsHardwareTimerChannel): OsHardwareTimerChannelId=0, OsHardwareTimerChannelIntSource=40, OsHardwareTimerChannelOffset=0
          STM1: OsHardwareTimerId=1, OsHardwareTimerBaseAddress=1074921472, OsHardwareTimerSize=32, OsHardwareTimerType=STM, OsHardwareTimerUnit=FRT
            STM1 (OsHardwareTimerChannel): OsHardwareTimerChannelId=0, OsHardwareTimerChannelIntSource=41, OsHardwareTimerChannelOffset=0
          STM2: OsHardwareTimerId=2, OsHardwareTimerBaseAddress=1074937856, OsHardwareTimerSize=32, OsHardwareTimerType=STM, OsHardwareTimerUnit=FRT
            STM2 (OsHardwareTimerChannel): OsHardwareTimerChannelId=0, OsHardwareTimerChannelIntSource=42, OsHardwareTimerChannelOffset=0
          STM3: OsHardwareTimerId=3, OsHardwareTimerBaseAddress=1074954240, OsHardwareTimerSize=32, OsHardwareTimerType=STM, OsHardwareTimerUnit=FRT
            STM3 (OsHardwareTimerChannel): OsHardwareTimerChannelId=0, OsHardwareTimerChannelIntSource=43, OsHardwareTimerChannelOffset=0
          STM4: OsHardwareTimerId=4, OsHardwareTimerBaseAddress=1075953664, OsHardwareTimerSize=32, OsHardwareTimerType=STM, OsHardwareTimerUnit=FRT
            STM4 (OsHardwareTimerChannel): OsHardwareTimerChannelId=0, OsHardwareTimerChannelIntSource=44, OsHardwareTimerChannelOffset=0
          STM5: OsHardwareTimerId=5, OsHardwareTimerBaseAddress=1075970048, OsHardwareTimerSize=32, OsHardwareTimerType=STM, OsHardwareTimerUnit=FRT
            STM5 (OsHardwareTimerChannel): OsHardwareTimerChannelId=0, OsHardwareTimerChannelIntSource=45, OsHardwareTimerChannelOffset=0
          STM6: OsHardwareTimerId=6, OsHardwareTimerBaseAddress=1075986432, OsHardwareTimerSize=32, OsHardwareTimerType=STM, OsHardwareTimerUnit=FRT
            STM6 (OsHardwareTimerChannel): OsHardwareTimerChannelId=0, OsHardwareTimerChannelIntSource=46, OsHardwareTimerChannelOffset=0
        OsInterruptRouting: OsInterruptRoutingCore0Offset=1
        Core3 (OsPhysicalCore):
          OsPhysicalCoreId = 3
          OsPhysicalCoreType = Cortex-M
          OsPhysicalCoreExceptionSources = 8
          OsPhysicalCoreIsAutostart = 0
          OsPhysicalCoreMasterStartAllowed = 0
          OsPhysicalCorePrivelegedHwAccess = 1
          OsPhysicalCoreDefaultEntrySymbol = _start_c3
          Core3_INTC (OsPhysicalCoreIntCtrl): OsPhysicalCoreIntCtrlMaxPrios=224, OsPhysicalCoreIntCtrlMaxSources=255, OsPhysicalCoreIntCtrlPrioOrder=DESC, OsPhysicalCoreIntCtrlType=NVIC_S32
            OsPhysicalCoreIntCtrlAddress: OsPhysicalCoreIntCtrlAddressValue=3758153728
          Core3_MPU (OsPhysicalCoreMpu): OsPhysicalCoreMpuId=3, OsPhysicalCoreMpuType=Cortex-M, OsPhysicalCoreMpuMaxRegions=16
          MC_ME_PRTN0_CORE3 (OsPhysicalCoreAddress): OsPhysicalCoreAddressValue=1074299296
        6 x OsHardwareTimer:
          SysTick_Core3: OsHardwareTimerBaseAddress=0, OsHardwareTimerId=3, OsHardwareTimerSize=24, OsHardwareTimerUnit=PIT, OsHardwareTimerType=SysTick
            SysTick_Core3_Ch0 (OsHardwareTimerChannel): OsHardwareTimerChannelId=0, OsHardwareTimerChannelIntSource=15, OsHardwareTimerChannelOffset=0
          STM7: OsHardwareTimerId=7, OsHardwareTimerBaseAddress=1076002816, OsHardwareTimerSize=32, OsHardwareTimerType=STM, OsHardwareTimerUnit=FRT
            STM7 (OsHardwareTimerChannel): OsHardwareTimerChannelId=0, OsHardwareTimerChannelIntSource=47, OsHardwareTimerChannelOffset=0
          STM8: OsHardwareTimerId=8, OsHardwareTimerBaseAddress=1079115776, OsHardwareTimerSize=32, OsHardwareTimerType=STM, OsHardwareTimerUnit=FRT
            STM8 (OsHardwareTimerChannel): OsHardwareTimerChannelId=0, OsHardwareTimerChannelIntSource=176, OsHardwareTimerChannelOffset=0
          STM9: OsHardwareTimerId=9, OsHardwareTimerBaseAddress=1079132160, OsHardwareTimerSize=32, OsHardwareTimerType=STM, OsHardwareTimerUnit=FRT
            STM9 (OsHardwareTimerChannel): OsHardwareTimerChannelId=0, OsHardwareTimerChannelIntSource=177, OsHardwareTimerChannelOffset=0
          STM10: OsHardwareTimerId=10, OsHardwareTimerBaseAddress=1079148544, OsHardwareTimerSize=32, OsHardwareTimerType=STM, OsHardwareTimerUnit=FRT
            STM10 (OsHardwareTimerChannel): OsHardwareTimerChannelId=0, OsHardwareTimerChannelIntSource=178, OsHardwareTimerChannelOffset=0
          STM11: OsHardwareTimerId=11, OsHardwareTimerBaseAddress=1079164928, OsHardwareTimerSize=32, OsHardwareTimerType=STM, OsHardwareTimerUnit=FRT
            STM11 (OsHardwareTimerChannel): OsHardwareTimerChannelId=0, OsHardwareTimerChannelIntSource=179, OsHardwareTimerChannelOffset=0
        OsSystemIntCtrlOffsets: OsSystemIntCtrlIrcpsrOffset=2656, OsSystemIntCtrlIrcpgrOffset=2660, OsSystemIntCtrlIrcpsrCoreOffset=112, OsSystemIntCtrlIrcpsrAckMask=4095
