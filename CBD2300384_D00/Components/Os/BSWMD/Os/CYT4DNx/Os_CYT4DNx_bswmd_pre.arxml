AUTOSAR XML (schema 4-2-1)
package /MICROSAR
  module config Os_Pre: definition=Os
    OsPublishedInformation
      CYT4DNx (OsDerivativeInformation):
        OsStackAlignment = 0
        OsExceptionVectorTableAlignment = 0
        OsInterruptVectorTableAlignment = 256
        OsHardwareManuals = ARMv7-M Architecture Reference Manual edition: ARM DDI 0403E.b (ID120114), 2. December 2014 Traveo II Automotive Cluster 2D Family Architecture Technical Reference Manual: 002-25800 Rev.*B, May 22, 2020 CYT4DN Data sheet (32-bit Arm Cortex-M7 Microcontroller Traveo II Family), Rev.C, March 31, 2020 CYT3DL Data sheet (32-bit Arm Cortex-M7 Microcontroller Traveo II Family), March 3, 2020
        OsMpuAlignment = SIZE
        OsMpuEndAddressAccessible = 1
        OsMpuPrivilegedRegionsConfigurable = 0
        Core0 (OsPhysicalCore):
          OsPhysicalCoreId = 0
          OsPhysicalCoreExceptionSources = 8
          OsPhysicalCoreIsAutostart = 1
          OsPhysicalCoreMasterStartAllowed = 1
          OsPhysicalCorePrivelegedHwAccess = 1
          OsPhysicalCoreType = Cortex-M
          OsPhysicalCoreDefaultEntrySymbol = _start
          Core0_MPU (OsPhysicalCoreMpu): OsPhysicalCoreMpuId=0, OsPhysicalCoreMpuMaxRegions=16, OsPhysicalCoreMpuType=Cortex-M
          Core0_INTC (OsPhysicalCoreIntCtrl): OsPhysicalCoreIntCtrlMaxPrios=224, OsPhysicalCoreIntCtrlPrioOrder=DESC, OsPhysicalCoreIntCtrlMaxSources=31, OsPhysicalCoreIntCtrlType=NVIC_CYT4
            OsPhysicalCoreIntCtrlAddress: OsPhysicalCoreIntCtrlAddressValue=3758153728
            8 x OsPhysicalCoreIntCtrlSlaveConfig:
              CoreExternalIRQ0: OsPhysicalCoreIntCtrlMasterSource=16
              CoreExternalIRQ1: OsPhysicalCoreIntCtrlMasterSource=17
              CoreExternalIRQ2: OsPhysicalCoreIntCtrlMasterSource=18
              CoreExternalIRQ3: OsPhysicalCoreIntCtrlMasterSource=19
              CoreExternalIRQ4: OsPhysicalCoreIntCtrlMasterSource=20
              CoreExternalIRQ5: OsPhysicalCoreIntCtrlMasterSource=21
              CoreExternalIRQ6: OsPhysicalCoreIntCtrlMasterSource=22
              CoreExternalIRQ7: OsPhysicalCoreIntCtrlMasterSource=23
        SysTick_Core0 (OsHardwareTimer): OsHardwareTimerBaseAddress=0, OsHardwareTimerId=0, OsHardwareTimerSize=24, OsHardwareTimerUnit=PIT, OsHardwareTimerType=SysTick
          SysTick_Core0_Ch0 (OsHardwareTimerChannel): OsHardwareTimerChannelId=0, OsHardwareTimerChannelIntSource=15, OsHardwareTimerChannelOffset=0
        OsMemoryRegionSpecifics
          10 x OsMemoryRegionAccess:
            SUPERVISOR_R: OsMemoryRegionAccessRights=R, OsMemoryRegionAccessType=SUPERVISOR
            SUPERVISOR_RW: OsMemoryRegionAccessRights=RW, OsMemoryRegionAccessType=SUPERVISOR
            USER_R: OsMemoryRegionAccessRights=R, OsMemoryRegionAccessType=USER
            USER_RW: OsMemoryRegionAccessRights=RW, OsMemoryRegionAccessType=USER
            SUPERVISOR_NONE: OsMemoryRegionAccessRights=NONE, OsMemoryRegionAccessType=SUPERVISOR
            USER_NONE: OsMemoryRegionAccessRights=NONE, OsMemoryRegionAccessType=USER
            SUPERVISOR_RX: OsMemoryRegionAccessRights=RX, OsMemoryRegionAccessType=SUPERVISOR
            SUPERVISOR_RWX: OsMemoryRegionAccessRights=RWX, OsMemoryRegionAccessType=SUPERVISOR
            USER_RX: OsMemoryRegionAccessRights=RX, OsMemoryRegionAccessType=USER
            USER_RWX: OsMemoryRegionAccessRights=RWX, OsMemoryRegionAccessType=USER
          8 x OsMemoryRegionFlag:
            SHAREABLE
            TYPE_STRONGLY_ORDERED
            TYPE_NON_CACHEABLE
            TYPE_CACHEABLE_WRITEBACK_ALLOCATE
            TYPE_SHARED_DEVICE
            TYPE_NON_SHARED_DEVICE
            TYPE_CACHEABLE_WRITETHROUGH_NO_ALLOCATE
            TYPE_CACHEABLE_WRITEBACK_NO_ALLOCATE
        OsMemoryRegionDefaults_AppNT (OsMemoryRegionDefaults):
          OsMemoryRegionDefIdentifier = 1
          OsMemoryRegionDefType = APPLICATION_NONPRIVILEGED
          OsMemoryRegionDefProtectionUnitSlot = 14
          OsMemoryRegionDefAccessRights = SUPERVISOR_RW
          OsMemoryRegionDefAccessRights = USER_RW
          OsMemoryRegionDefFlags = TYPE_CACHEABLE_WRITEBACK_ALLOCATE
        CPUSS_CM7_SYSTEM (OsSystemIntCtrl):
          OsSystemIntCtrlBaseAddress = 1075879936
          OsSystemIntCtrlMaxPrios = 224
          OsSystemIntCtrlMaxSources = 794
          OsSystemIntCtrlPrioOrder = DESC
          OsSystemIntCtrlType = NVIC_CYT4
          CPUSS_CM7_0_INT_STATUS (OsSystemIntCtrlAddress): OsSystemIntCtrlAddressValue=1075839232
          CPUSS_CM7_1_INT_STATUS (OsSystemIntCtrlAddress): OsSystemIntCtrlAddressValue=1075840256
        Core1 (OsPhysicalCore):
          OsPhysicalCoreId = 1
          OsPhysicalCoreExceptionSources = 8
          OsPhysicalCoreIsAutostart = 1
          OsPhysicalCoreMasterStartAllowed = 1
          OsPhysicalCorePrivelegedHwAccess = 1
          OsPhysicalCoreType = Cortex-M
          OsPhysicalCoreDefaultEntrySymbol = _start_c1
          Core1_MPU (OsPhysicalCoreMpu): OsPhysicalCoreMpuId=1, OsPhysicalCoreMpuMaxRegions=16, OsPhysicalCoreMpuType=Cortex-M
          Core1_INTC (OsPhysicalCoreIntCtrl): OsPhysicalCoreIntCtrlMaxPrios=224, OsPhysicalCoreIntCtrlPrioOrder=DESC, OsPhysicalCoreIntCtrlMaxSources=31, OsPhysicalCoreIntCtrlType=NVIC_CYT4
            OsPhysicalCoreIntCtrlAddress: OsPhysicalCoreIntCtrlAddressValue=3758153728
        SysTick_Core1 (OsHardwareTimer): OsHardwareTimerBaseAddress=0, OsHardwareTimerId=1, OsHardwareTimerSize=24, OsHardwareTimerUnit=PIT, OsHardwareTimerType=SysTick
          SysTick_Core1_Ch0 (OsHardwareTimerChannel): OsHardwareTimerChannelId=0, OsHardwareTimerChannelIntSource=15, OsHardwareTimerChannelOffset=0
        TCPWM0_Group2 (OsHardwareTimer): OsHardwareTimerBaseAddress=1077477376, OsHardwareTimerId=2, OsHardwareTimerSize=32, OsHardwareTimerType=TCPWM, OsHardwareTimerUnit=FRT
          4 x OsHardwareTimerChannel, all with OsHardwareTimerChannelOffset=0:
            TCPWM_Group2_Counter0: OsHardwareTimerChannelId=0, OsHardwareTimerChannelIntSource=680
            TCPWM_Group2_Counter1: OsHardwareTimerChannelId=1, OsHardwareTimerChannelIntSource=681
            TCPWM_Group2_Counter2: OsHardwareTimerChannelId=2, OsHardwareTimerChannelIntSource=682
            TCPWM_Group2_Counter3: OsHardwareTimerChannelId=3, OsHardwareTimerChannelIntSource=683
