AUTOSAR XML (schema 4-3-0)
# COPYRIGHT
# Copyright (c) 2022 by Vector Informatik GmbH. All rights reserved.
# This software is copyright protected and proprietary to Vector Informatik GmbH.
# Vector Informatik GmbH grants to you only those rights as set out in the license conditions.
package /MICROSAR
  module definition Csm [0..1]: category=VENDOR_SPECIFIC_MODULE_DEFINITION, refined-module-def=Csm, variants pre-compile  # The Crypto Service Manager (CSM) provides synchronous or asynchronous services to enable a unique access to basic cryptographic functionalities for all software modules. The CSM provides an abstraction layer, which offers an AUTOSAR standardized interface to higher software layers to access these functionalities required for security related use cases. Since functionality required by a software module can be different to the functionality required by other software modules, there is the possibility to configure and initialize the services provided by the CSM individually for each software module. #Crypto #Cryptographic #Cryptography #Security #AUTOSAR #ServiceComponent
    container CsmCallbacks [0..1]: multiplicity set at pre-compile  # Container for callback function configurations
      container CsmCallback [0..*]: multiplicity set at pre-compile  # Container for configuration of a callback function
        function name CsmCallbackFunc: multiplicity set at pre-compile, set at pre-compile  # Callback function to be called if an asynchronous operation has finished. The corresponding job has to be configured to be processed asynchronously.
        integer CsmCallbackId: 0..4294967295, multiplicity set at pre-compile, set at pre-compile, symbolic-name-value=true, default-value=0  # Identifier of the callback function.
        enumeration CsmBswCallbackAsrVersion [0..1]: {CSM_ASR_VERSION_4_03, CSM_ASR_VERSION_4_04, CSM_ASR_VERSION_R19_11}, multiplicity set at pre-compile, origin=Vector Informatik, set at pre-compile, default-value=CSM_ASR_VERSION_4_03  # Determines the signature of the configured callback when it is used as BSW callback. CSM_ASR_VERSION_4_03: void <CallbackFunc> (Crypto_JobType* job, Std_ReturnType result) CSM_ASR_VERSION_4_04: void <CallbackFunc> (const uint32 jobID, Csm_ResultType result) CSM_ASR_VERSION_R19_11: void <CallbackFunc> (const Crypto_JobType* job, Crypto_ResultType result) Defaults to CSM_ASR_VERSION_4_03 if unset.
    container CsmGeneral: multiplicity set at pre-compile  # Container for common configuration options.
      integer CsmAsymPrivateKeyMaxLength: 1..4294967295, multiplicity set at pre-compile, set at pre-compile, default-value=32  # Not used and not supported. Maximum length in bytes of an asymmetric public key for all algorithm.
      integer CsmAsymPublicKeyMaxLength: 1..4294967295, multiplicity set at pre-compile, set at pre-compile, default-value=1024  # Not used and not supported. Maximum length in bytes of an asymmetric key for all algorithm.
      boolean CsmDevErrorDetect: multiplicity set at pre-compile, set at pre-compile, default-value=true  # Switches the development error detection and notification on or off. | * true: detection and notification is enabled. * false: detection and notification is disabled.
      float CsmMainFunctionPeriod: 0..1.7976931348623157E+308, multiplicity set at pre-compile, set at pre-compile, default-value=0.01  # Specifies the period of main function Csm_MainFunction in seconds.
      integer CsmSymKeyMaxLength: 1..4294967295, multiplicity set at pre-compile, origin=Vector Informatik, set at pre-compile, default-value=16  # Not used and not supported. Maximum length in bytes of a symmetric key for all algorithm
      boolean CsmUseDeprecated: multiplicity set at pre-compile, set at pre-compile, default-value=false  # Not used and not supported. Decides if the deprecated interfaces shall be used (Backwards compatibility). | true: use deprecated interfaces. false: use normal interfaces.
      boolean CsmVersionInfoApi: multiplicity set at pre-compile, set at pre-compile, default-value=false  # Pre-processor switch to enable and disable availability of the API Csm_GetVersionInfo(). | True: API Csm_GetVersionInfo() is available. False: API Csm_GetVersionInfo() is not available.
      string CsmCustomIncludeFiles [0..*]: multiplicity set at pre-compile, origin=Vector Informatik, set at pre-compile, min-length=3  # Include custom header file.
      boolean CsmCallbackStartNotification: multiplicity set at pre-compile, origin=Vector Informatik, set at pre-compile, default-value=false  # In ASR 4.3.0, only callbacks for Update (if CsmJobPrimitiveCallbackUpdateNotification is enabled) and Finish shall be forwarded to application. If this switch is enabled, Callback is also notified if Start was handled and every Update is notified too (CsmJobPrimitiveCallbackUpdateNotification is ignored).
      boolean CsmCancelationDuringProcessing: multiplicity set at pre-compile, origin=Vector Informatik, set at pre-compile, default-value=false  # If enabled, Csm allows cancelation during the processing of an asynchronous job. Due to this, CRYPTO_E_JOB_CANCELED of lower layer is supported and forwarded to application (this return value was introduced in ASR 4.4). If enabled, the runtime of a asynchronous job is slightly increased because the callback needs to enter an exclusive area to check the state.
      boolean CsmSafeBswChecks: multiplicity set at pre-compile, origin=Vector Informatik, set at pre-compile, default-value=false  # Enables safety checks. These checks improve robustness. E.g. invalid parameters are checked before function is executed. This attribute has to be enabled for safety projects where this component is mapped to an ASIL partition.
      container CsmJobTypeLayout: multiplicity set at pre-compile  # Container for configuration options for the Csm data structure Crypto_JobType and used sub data structures.
        boolean CsmJobTypeLayoutAsr430Compatibility: multiplicity set at pre-compile, origin=Vector Informatik, set at pre-compile, default-value=true  # AUTOSAR 4.3.0 Compatibility | The Crypto_JobType has - according to Autosar - the fields 'jobState' and 'jobPrimitiveInputOutput'. These field names changed from AUTOSAR 4.3.0 to AUTOSAR 4.3.1. These fields defined by AUTOSAR 4.3.0 could be required by an underlying Crypto Driver. If enabled, the Crypto_JobType is extended by the fields 'state' and 'PrimitiveInputOutput' as they are named in AUTOSAR 4.3.0. If disabled, these fields are not contained in the definition of the Crypto_JobType and the Crypto_JobType is defined as specified in AUTOSAR 4.3.1.
        boolean CsmJobTypeLayoutVarMembers: multiplicity set at pre-compile, origin=Vector Informatik, set at pre-compile, default-value=false  # Var Members | The Crypto_JobType has in its sub data structures - according to Autosar- certain fields (e.g. 'jobId') which are defined as const fields. If a variable of this type shall be used in different use cases, these fields might be overwritten. This could be a requirement of an underlying Crypto Driver. If enabled, the const members of Crypto_JobType's sub data structures are defined as non-const members If disabled, the Crypto_JobType's sub data structures stay as defined according to Autosar.
        boolean CsmJobTypeLayoutInput64: multiplicity set at pre-compile, origin=Vector Informatik, set at pre-compile, default-value=false  # Input64 | The Crypto_JobPrimitiveInputOutputType has - according to Autosar - the field 'input64'. By default, this field is switched off in order to reduce memory usage. This field can be switched on if it is required by the underlying crypto driver. If enabled, the field 'input64' exists within the Crypto_JobPrimitiveInputOutputType. If disabled, the field 'input64' doesn't exist within the Crypto_JobPrimitiveInputOutputType.
        boolean CsmJobTypeLayoutOutput64Ptr: multiplicity set at pre-compile, origin=Vector Informatik, set at pre-compile, default-value=false  # Output64Ptr | The Crypto_JobPrimitiveInputOutputType has - according to Autosar - the field 'output64Ptr'. By default, this field is switched off in order to reduce memory usage. This field can be switched on if it is required by the underlying crypto driver. If enabled, the field 'output64Ptr' exists within the Crypto_JobPrimitiveInputOutputType. If disabled, the field 'output64Ptr' doesn't exist within the Crypto_JobPrimitiveInputOutputType.
        boolean CsmJobTypeLayoutRedirectionInfoRef: multiplicity set at pre-compile, origin=Vector Informatik, set at pre-compile, default-value=true  # RedirectionInfoRef | The Crypto_JobType has the field 'jobRedirectionInfoRef'. This field can be switched off if it not required in order to reduce memory usage. If enabled, the field 'jobRedirectionInfoRef' exists within the Crypto_JobType. If disabled, the field 'jobRedirectionInfoRef' doesn't exist within the Crypto_JobType.
    container CsmJobs [0..1]: multiplicity set at pre-compile  # Container for configuration of CSM jobs.
      container CsmJob [1..*]: multiplicity set at pre-compile  # Container for configuration of CSM job. The container name serves as a symbolic name for the identifier of a job configuration.
        integer CsmJobId: 0..4294967295, multiplicity set at pre-compile, set at pre-compile, symbolic-name-value=true, default-value=0  # Identifier of the CSM job
        boolean CsmJobPrimitiveCallbackUpdateNotification [0..1]: multiplicity set at pre-compile, set at pre-compile, default-value=false  # This parameter indicates, whether the callback function shall be called, if the UPDATE operation has been finished.
        integer CsmJobPriority: 0..4294967295, multiplicity set at pre-compile, set at pre-compile, default-value=0  # Priority of the job. The higher the value, the higher the job's priority. | The higher the value, the higher the job's priority.
        boolean CsmJobUsePort: multiplicity set at pre-compile, origin=Vector Informatik, set at pre-compile, default-value=false  # Does the job need RTE interfaces? | True: the job needs RTE interfaces False: the job needs no RTE interfaces
        enumeration CsmProcessingMode: {CRYPTO_PROCESSING_ASYNC, CRYPTO_PROCESSING_SYNC}, multiplicity set at pre-compile, set at pre-compile, default-value=CRYPTO_PROCESSING_SYNC  # Determines how the interface shall be used for that job. Synchronous processing returns with the result while asynchronous processing returns without processing the job. The caller will be notified by the corresponding callback.
        enumeration CsmJobInterfaceUsePort: {CRYPTO_USE_FNC, CRYPTO_USE_PORT, CRYPTO_USE_PORT_OPTIMIZED}, multiplicity set at pre-compile, set at pre-compile, default-value=CRYPTO_USE_FNC  # Does the job need RTE interfaces?
        enumeration CsmJobServiceInterfaceContextUsePort [0..1]: {CRYPTO_USE_FUNC, CRYPTO_USE_PORT}, multiplicity set at pre-compile, set at pre-compile, default-value=CRYPTO_USE_FUNC  # Does the job need RTE interfaces for context operations
        reference CsmJobKeyRef: multiplicity set at pre-compile, set at pre-compile, destination=CsmKey  # This parameter refers to the key which shall be used for the CsmPrimitive. It's possible to use a CsmKey for different jobs
        reference CsmJobPrimitiveCallbackRef [0..1]: multiplicity set at pre-compile, set at pre-compile, destination=CsmCallback  # This parameter refers to the used CsmCallback. | The referred CsmCallback is called when the crypto job has been finished.
        reference CsmJobPrimitiveRef: multiplicity set at pre-compile, set at pre-compile, destination=CsmPrimitives  # This parameter refers to the used CsmPrimitive. | Different jobs may refer to one CsmPrimitive. The referred CsmPrimitive provides detailed information on the actual cryptographic routine.
        reference CsmJobQueueRef: multiplicity set at pre-compile, set at pre-compile, destination=CsmQueue  # This parameter refers to the queue. | The queue is used if the underlying crypto driver object is busy. The queue refers also to the channel which is used.
        reference CsmJobCalloutRef [0..1]: multiplicity set at pre-compile, origin=Vector Informatik, set at pre-compile, destination=CsmCallout  # This parameter refers to the used CsmCallout. It contains a pre- and a post-job callout reference.
        reference CsmInOutRedirectionRef [0..1]: multiplicity set at pre-compile, set at pre-compile, destination=CsmInOutRedirection  # This parameter refers to the used redirection
    container CsmKeys [0..1]: multiplicity set at pre-compile  # Container for CSM key configurations.
      container CsmKey [0..*]: multiplicity set at pre-compile  # Container for configuration of a CSM key. The container name serves as a symbolic name for the identifier of a key configuration.
        integer CsmKeyId: 0..4294967295, multiplicity set at pre-compile, set at pre-compile, symbolic-name-value=true, default-value=0  # Identifier of the CsmKey
        boolean CsmKeyUsePort: multiplicity set at pre-compile, set at pre-compile, default-value=false  # Does the key need RTE interfaces? | True: RTE interfaces used for this key False: No RTE interfaces used for this key
        enumeration CsmKeySwcInterfaceVersion [0..1]: {CSM_ASR_VERSION_4_03, CSM_ASR_VERSION_4_04}, multiplicity set at pre-compile, origin=Vector Informatik, set at pre-compile, default-value=CSM_ASR_VERSION_4_04  # Specifies the AUTOSAR version that the Client-Server-Interfaces of this key should adhere to. CSM_ASR_VERSION_4_03: Interface adheres to AUTOSAR 4.3.x specification CSM_ASR_VERSION_4_04: Interface adheres to AUTOSAR 4.4.0 specification Compared to AUTOSAR 4.3.x, AUTOSAR 4.4.0 changes the direction of the operation KeyElementGet's keyLength parameter from OUT to INOUT and introduces the following additional error codes to the interface's operations: CertificateParse: CSM_E_KEY_EMPTY CertificateVerify: CSM_E_KEY_EMPTY KeyCopy: CSM_E_KEY_EMPTY KeyDerive: CSM_E_KEY_EMPTY, CSM_E_BUSY, CSM_E_KEY_READ_FAIL, CSM_E_KEY_WRITE_FAIL, CSM_E_KEY_SIZE_MISMATCH KeyElementCopy: CSM_E_KEY_EMPTY KeyElementGet: CSM_E_KEY_EMPTY KeyExchangeCalcPubVal: CSM_E_KEY_EMPTY, CSM_E_SMALL_BUFFER KeyExchangeCalcSecret: CSM_E_KEY_EMPTY, CSM_E_SMALL_BUFFER KeyGenerate: CSM_E_KEY_EMPTY, CSM_E_BUSY
        symbolic name reference CsmKeyRef: multiplicity set at pre-compile, set at pre-compile, requires-symbolic-name-value=true, destination=CryIfKey  # This parameter refers to the used CryIfKey. The underlying CryIfKey refers to a specific CryptoKey in the Crypto Driver.
    container CsmPrimitives [0..*]: multiplicity set at pre-compile  # Container for configuration of CsmPrimitives
      container CsmAEADDecrypt [0..1]: multiplicity set at pre-compile  # Configuration of AEAD decryption primitives
        container CsmAEADDecryptConfig: multiplicity set at pre-compile  # Container for configuration of a CSM decryption interface. The container name serves as a symbolic name for the identifier of an decryption interface.
          enumeration CsmAEADDecryptAlgorithmFamiliy: {CRYPTO_ALGOFAM_3DES, CRYPTO_ALGOFAM_AES, CRYPTO_ALGOFAM_CHACHA, CRYPTO_ALGOFAM_CUSTOM, CRYPTO_ALGOFAM_EEA3}, multiplicity set at pre-compile, origin=Vector Informatik, set at pre-compile  # Not used. Determines the algorithm family used for the crypto service. This parameter defines the most significant part of the algorithm.
          enumeration CsmAEADDecryptAlgorithmFamily: {CRYPTO_ALGOFAM_3DES, CRYPTO_ALGOFAM_AES, CRYPTO_ALGOFAM_CHACHA, CRYPTO_ALGOFAM_CUSTOM, CRYPTO_ALGOFAM_EEA3}, multiplicity set at pre-compile, set at pre-compile  # Determines the algorithm family used for the crypto service. This parameter defines the most significant part of the algorithm.
          string CsmAEADDecryptAlgorithmFamilyCustom [0..1]: multiplicity set at pre-compile, set at pre-compile  # This is the name of the custom algorithm family, if CRYPTO_ALGOFAM_CUSTOM is used as CsmAEADDecryptAlgorithmFamily.
          integer CsmAEADDecryptAlgorithmKeyLength: 1..4294967295, multiplicity set at pre-compile, set at pre-compile, default-value=16  # Size of the AEAD decryption key. This value is generated as constant value without any modifications. Thus, this value needs to be set either in bytes or in bits depending on what is expected by the required Crypto Driver. E.g. set 8 if eight bytes are required, but set 64 if sixty-four bits are required.
          enumeration CsmAEADDecryptAlgorithmMode: {CRYPTO_ALGOMODE_12ROUNDS, CRYPTO_ALGOMODE_20ROUNDS, CRYPTO_ALGOMODE_8ROUNDS, CRYPTO_ALGOMODE_CUSTOM, CRYPTO_ALGOMODE_GCM}, multiplicity set at pre-compile, set at pre-compile  # Determines the algorithm mode used for the crypto service
          string CsmAEADDecryptAlgorithmModeCustom [0..1]: multiplicity set at pre-compile, set at pre-compile  # Name of the custom algorithm mode used for the crypto service
          integer CsmAEADDecryptAssociatedDataMaxLength [0..1]: 1..4294967295, multiplicity set at pre-compile, set at pre-compile  # Max size of the input associated data length in bytes
          integer CsmAEADDecryptCiphertextMaxLength [0..1]: 1..4294967295, multiplicity set at pre-compile, set at pre-compile  # Max size of the input ciphertext in bytes
          integer CsmAEADDecryptPlaintextMaxLength [0..1]: 1..4294967295, multiplicity set at pre-compile, set at pre-compile  # Size of the output plaintext length in bytes
          enumeration CsmAEADDecryptProcessing: {CSM_ASYNCHRONOUS, CSM_SYNCHRONOUS}, multiplicity set at pre-compile, origin=Vector Informatik, set at pre-compile  # Not used. Determines how the interface shall be used for that primitive. Synchronous processing returns with the result while asynchronous processing returns without processing the job. The caller will be notified by the corresponding callback Csm will ignore this parameter since it is obsolete as of AUTOSAR 4.4. However, other modules may still rely on its value. It is strongly encouraged to make this parameter consistent with the ProcessingMode parameter in the Jobs that use this primitive. If multiple Jobs with different Processing Modes shall use the same Primitive, the respective Primitive may need to be duplicated and the duplicate's Processing parameter adapted accordingly.
          integer CsmAEADDecryptTagLength: 1..4294967295, multiplicity set at pre-compile, set at pre-compile  # Size of the input Tag length in BITS
          enumeration CsmAEADDecryptSwcInterfaceVersion [0..1]: {CSM_ASR_VERSION_4_03, CSM_ASR_VERSION_4_04}, multiplicity set at pre-compile, origin=Vector Informatik, set at pre-compile, default-value=CSM_ASR_VERSION_4_04  # Specifies the AUTOSAR version that the Client-Server-Interfaces of this primitive should adhere to. CSM_ASR_VERSION_4_03: Interface adheres to AUTOSAR 4.3.x specification CSM_ASR_VERSION_4_04: Interface adheres to AUTOSAR 4.4.0 specification Compared to AUTOSAR 4.3.x, AUTOSAR 4.4.0 introduces the following additional error codes to the interface's operations: AEADDecrypt: CSM_E_KEY_NOT_VALID, CSM_E_KEY_SIZE_MISMATCH, CSM_E_KEY_EMPTY CancelJob: CSM_E_JOB_CANCELED
          enumeration CsmAEADDecryptAlgorithmSecondaryFamily: {CRYPTO_ALGOFAM_CUSTOM, CRYPTO_ALGOFAM_NOT_SET, CRYPTO_ALGOFAM_POLY1305}, multiplicity set at pre-compile, set at pre-compile, default-value=CRYPTO_ALGOFAM_NOT_SET  # Defines the secondary family used for the crypto service
          reference CsmAEADDecryptKeyRef: multiplicity set at pre-compile, set at pre-compile, destination=CsmKey  # This parameter refers to the key used for that decryption primitive.
          reference CsmAEADDecryptQueueRef [0..1]: multiplicity set at pre-compile, set at pre-compile, destination=CsmQueue  # Not used. Queue is referred in Job. This parameter refers to the queue used for that decryption primitive.
          symbolic name reference CsmAEADDecryptAlgorithmFamilyCustomRef [0..1]: multiplicity set at pre-compile, set at pre-compile, requires-symbolic-name-value=true, destination=CryptoPrimitiveAlgorithmFamilyCustom  # Reference to a customer specific algorithm family custom container
          symbolic name reference CsmAEADDecryptAlgorithmSecondaryFamilyCustomRef [0..1]: multiplicity set at pre-compile, set at pre-compile, requires-symbolic-name-value=true, destination=CryptoPrimitiveAlgorithmFamilyCustom  # Reference to a customer specific algorithm family container in the Crypto Driver
          symbolic name reference CsmAEADDecryptAlgorithmModeCustomRef [0..1]: multiplicity set at pre-compile, set at pre-compile, requires-symbolic-name-value=true, destination=CryptoPrimitiveAlgorithmModeCustom  # Reference to a customer specific algorithm mode custom container
      container CsmAEADEncrypt [0..1]: multiplicity set at pre-compile  # Configuration of AEAD encryption primitives
        container CsmAEADEncryptConfig: multiplicity set at pre-compile  # Container for configuration of a CSM encryption interface. The container name serves as a symbolic name for the identifier of an encryption interface.
          enumeration CsmAEADEncryptAlgorithmFamiliy: {CRYPTO_ALGOFAM_3DES, CRYPTO_ALGOFAM_AES, CRYPTO_ALGOFAM_CHACHA, CRYPTO_ALGOFAM_CUSTOM, CRYPTO_ALGOFAM_EEA3}, multiplicity set at pre-compile, origin=Vector Informatik, set at pre-compile  # Not used. Determines the algorithm family used for the crypto service. This parameter defines the most significant part of the algorithm.
          enumeration CsmAEADEncryptAlgorithmFamily: {CRYPTO_ALGOFAM_3DES, CRYPTO_ALGOFAM_AES, CRYPTO_ALGOFAM_CHACHA, CRYPTO_ALGOFAM_CUSTOM, CRYPTO_ALGOFAM_EEA3}, multiplicity set at pre-compile, set at pre-compile  # Determines the algorithm family used for the crypto service. This parameter defines the most significant part of the algorithm.
          string CsmAEADEncryptAlgorithmFamilyCustom [0..1]: multiplicity set at pre-compile, set at pre-compile  # This is the name of the custom algorithm family, if CRYPTO_ALGOFAM_CUSTOM is used as CsmAEADEncryptAlgorithmFamily.
          integer CsmAEADEncryptAlgorithmKeyLength: 1..4294967295, multiplicity set at pre-compile, set at pre-compile, default-value=16  # Size of the AEAD encryption key. This value is generated as constant value without any modifications. Thus, this value needs to be set either in bytes or in bits depending on what is expected by the required Crypto Driver. E.g. set 8 if eight bytes are required, but set 64 if sixty-four bits are required.
          enumeration CsmAEADEncryptAlgorithmMode: {CRYPTO_ALGOMODE_12ROUNDS, CRYPTO_ALGOMODE_20ROUNDS, CRYPTO_ALGOMODE_8ROUNDS, CRYPTO_ALGOMODE_CUSTOM, CRYPTO_ALGOMODE_GCM}, multiplicity set at pre-compile, set at pre-compile  # Determines the algorithm mode used for the crypto service
          string CsmAEADEncryptAlgorithmModeCustom [0..1]: multiplicity set at pre-compile, set at pre-compile  # Name of the custom algorithm mode used for the crypto service
          integer CsmAEADEncryptAssociatedDataMaxLength [0..1]: 1..4294967295, multiplicity set at pre-compile, set at pre-compile  # Max size of the input associated data length in bytes
          integer CsmAEADEncryptCiphertextMaxLength [0..1]: 1..4294967295, multiplicity set at pre-compile, set at pre-compile  # Max size of the output ciphertext length in bytes
          integer CsmAEADEncryptPlaintextMaxLength [0..1]: 1..4294967295, multiplicity set at pre-compile, set at pre-compile  # Max size of the input plaintext length in bytes
          enumeration CsmAEADEncryptProcessing: {CSM_ASYNCHRONOUS, CSM_SYNCHRONOUS}, multiplicity set at pre-compile, origin=Vector Informatik, set at pre-compile  # Not used. Determines how the interface shall be used for that primitive. Synchronous processing returns with the result while asynchronous processing returns without processing the job. The caller will be notified by the corresponding callback Csm will ignore this parameter since it is obsolete as of AUTOSAR 4.4. However, other modules may still rely on its value. It is strongly encouraged to make this parameter consistent with the ProcessingMode parameter in the Jobs that use this primitive. If multiple Jobs with different Processing Modes shall use the same Primitive, the respective Primitive may need to be duplicated and the duplicate's Processing parameter adapted accordingly.
          integer CsmAEADEncryptTagLength: 1..4294967295, multiplicity set at pre-compile, set at pre-compile  # Size of the output Tag length in bytes
          enumeration CsmAEADEncryptSwcInterfaceVersion [0..1]: {CSM_ASR_VERSION_4_03, CSM_ASR_VERSION_4_04}, multiplicity set at pre-compile, origin=Vector Informatik, set at pre-compile, default-value=CSM_ASR_VERSION_4_04  # Specifies the AUTOSAR version that the Client-Server-Interfaces of this primitive should adhere to. CSM_ASR_VERSION_4_03: Interface adheres to AUTOSAR 4.3.x specification CSM_ASR_VERSION_4_04: Interface adheres to AUTOSAR 4.4.0 specification Compared to AUTOSAR 4.3.x, AUTOSAR 4.4.0 introduces the following additional error codes to the interface's operations: Encrypt: CSM_E_KEY_NOT_VALID, CSM_E_KEY_SIZE_MISMATCH, CSM_E_KEY_EMPTY CancelJob: CSM_E_JOB_CANCELED
          enumeration CsmAEADEncryptAlgorithmSecondaryFamily: {CRYPTO_ALGOFAM_CUSTOM, CRYPTO_ALGOFAM_NOT_SET, CRYPTO_ALGOFAM_POLY1305}, multiplicity set at pre-compile, set at pre-compile, default-value=CRYPTO_ALGOFAM_NOT_SET  # Defines the secondary family used for the crypto service
          reference CsmAEADEncryptKeyRef: multiplicity set at pre-compile, set at pre-compile, destination=CsmKey  # This parameter refers to the key used for that encryption primitive.
          reference CsmAEADEncryptQueueRef [0..1]: multiplicity set at pre-compile, set at pre-compile, destination=CsmQueue  # Not used. Queue is referred in Job. This parameter refers to the queue used for that encryption primitive.
          symbolic name reference CsmAEADEncryptAlgorithmFamilyCustomRef [0..1]: multiplicity set at pre-compile, set at pre-compile, requires-symbolic-name-value=true, destination=CryptoPrimitiveAlgorithmFamilyCustom  # Reference to a customer specific algorithm family custom container
          symbolic name reference CsmAEADEncryptAlgorithmSecondaryFamilyCustomRef [0..1]: multiplicity set at pre-compile, set at pre-compile, requires-symbolic-name-value=true, destination=CryptoPrimitiveAlgorithmFamilyCustom  # Reference to a customer specific algorithm family container in the Crypto Driver
          symbolic name reference CsmAEADEncryptAlgorithmModeCustomRef [0..1]: multiplicity set at pre-compile, set at pre-compile, requires-symbolic-name-value=true, destination=CryptoPrimitiveAlgorithmModeCustom  # Reference to a customer specific algorithm mode custom container
      container CsmDecrypt [0..1]: multiplicity set at pre-compile  # Configurations of Decryption primitives
        container CsmDecryptConfig: multiplicity set at pre-compile  # Container for configuration of a CSM decryption interface. The container name serves as a symbolic name for the identifier of an decryption interface.
          enumeration CsmDecryptAlgorithmFamiliy: {CRYPTO_ALGOFAM_3DES, CRYPTO_ALGOFAM_AES, CRYPTO_ALGOFAM_CHACHA, CRYPTO_ALGOFAM_CUSTOM, CRYPTO_ALGOFAM_ECIES, CRYPTO_ALGOFAM_EEA3, CRYPTO_ALGOFAM_RSA}, multiplicity set at pre-compile, origin=Vector Informatik, set at pre-compile  # Not used. Determines the algorithm family used for the crypto service. This parameter defines the most significant part of the algorithm.
          enumeration CsmDecryptAlgorithmFamily: {CRYPTO_ALGOFAM_3DES, CRYPTO_ALGOFAM_AES, CRYPTO_ALGOFAM_CHACHA, CRYPTO_ALGOFAM_CUSTOM, CRYPTO_ALGOFAM_ECIES, CRYPTO_ALGOFAM_EEA3, CRYPTO_ALGOFAM_RSA}, multiplicity set at pre-compile, set at pre-compile  # Determines the algorithm family used for the crypto service. This parameter defines the most significant part of the algorithm.
          string CsmDecryptAlgorithmFamilyCustom [0..1]: multiplicity set at pre-compile, set at pre-compile  # Name of the custom algorithm family, if CRYPTO_ALGOFAM_CUSTOM is used as CsmDecryptAlgorithmFamily.
          integer CsmDecryptAlgorithmKeyLength: 1..4294967295, multiplicity set at pre-compile, set at pre-compile, default-value=16  # Size of the encryption key. This value is generated as constant value without any modifications. Thus, this value needs to be set either in bytes or in bits depending on what is expected by the required Crypto Driver. E.g. set 8 if eight bytes are required, but set 64 if sixty-four bits are required.
          enumeration CsmDecryptAlgorithmMode: {CRYPTO_ALGOMODE_12ROUNDS, CRYPTO_ALGOMODE_20ROUNDS, CRYPTO_ALGOMODE_8ROUNDS, CRYPTO_ALGOMODE_CBC, CRYPTO_ALGOMODE_CFB, CRYPTO_ALGOMODE_CTR, CRYPTO_ALGOMODE_CUSTOM, CRYPTO_ALGOMODE_ECB, CRYPTO_ALGOMODE_NOT_SET, CRYPTO_ALGOMODE_OFB, CRYPTO_ALGOMODE_RSAES_OAEP, CRYPTO_ALGOMODE_RSAES_PKCS1_v1_5, CRYPTO_ALGOMODE_XTS}, multiplicity set at pre-compile, set at pre-compile, default-value=CRYPTO_ALGOMODE_NOT_SET  # Determines the algorithm mode used for the crypto service
          string CsmDecryptAlgorithmModeCustom [0..1]: multiplicity set at pre-compile, set at pre-compile  # Name of the custom algorithm mode used for the crypto service
          enumeration CsmDecryptAlgorithmSecondaryFamily: {CRYPTO_ALGOFAM_BLAKE_1_256, CRYPTO_ALGOFAM_BLAKE_1_512, CRYPTO_ALGOFAM_BLAKE_2s_256, CRYPTO_ALGOFAM_BLAKE_2s_512, CRYPTO_ALGOFAM_CUSTOM, CRYPTO_ALGOFAM_NOT_SET, CRYPTO_ALGOFAM_RIPEMD160, CRYPTO_ALGOFAM_SHA1, CRYPTO_ALGOFAM_SHA2_224, CRYPTO_ALGOFAM_SHA2_256, CRYPTO_ALGOFAM_SHA2_384, CRYPTO_ALGOFAM_SHA2_512, CRYPTO_ALGOFAM_SHA2_512_224, CRYPTO_ALGOFAM_SHA2_512_256, CRYPTO_ALGOFAM_SHA3_224, CRYPTO_ALGOFAM_SHA3_256, CRYPTO_ALGOFAM_SHA3_384, CRYPTO_ALGOFAM_SHA3_512, CRYPTO_ALGOFAM_SHA3_SHAKE128, CRYPTO_ALGOFAM_SHA3_SHAKE256, CRYPTO_ALGOFAM_SHAKE128, CRYPTO_ALGOFAM_SHAKE256}, multiplicity set at pre-compile, set at pre-compile, default-value=CRYPTO_ALGOFAM_NOT_SET  # Determines the secondary algorithm family used for the crypto service
          string CsmDecryptAlgorithmSecondaryFamilyCustom [0..1]: multiplicity set at pre-compile, set at pre-compile  # Name of the custom secondary algorithm family used for the crypto service
          integer CsmDecryptDataMaxLength [0..1]: 1..4294967295, multiplicity set at pre-compile, set at pre-compile  # Max size of the input ciphertext length in bytes
          enumeration CsmDecryptProcessing: {CSM_ASYNCHRONOUS, CSM_SYNCHRONOUS}, multiplicity set at pre-compile, origin=Vector Informatik, set at pre-compile  # Not used. Determines how the interface shall be used for that primitive. Synchronous processing returns with the result while asynchronous processing returns without processing the job. The caller will be notified by the corresponding callback Csm will ignore this parameter since it is obsolete as of AUTOSAR 4.4. However, other modules may still rely on its value. It is strongly encouraged to make this parameter consistent with the ProcessingMode parameter in the Jobs that use this primitive. If multiple Jobs with different Processing Modes shall use the same Primitive, the respective Primitive may need to be duplicated and the duplicate's Processing parameter adapted accordingly.
          integer CsmDecryptResultMaxLength [0..1]: 1..4294967295, multiplicity set at pre-compile, set at pre-compile  # Max size of the output plaintext length in bytes
          enumeration CsmDecryptSwcInterfaceVersion [0..1]: {CSM_ASR_VERSION_4_03, CSM_ASR_VERSION_4_04}, multiplicity set at pre-compile, origin=Vector Informatik, set at pre-compile, default-value=CSM_ASR_VERSION_4_04  # Specifies the AUTOSAR version that the Client-Server-Interfaces of this primitive should adhere to. CSM_ASR_VERSION_4_03: Interface adheres to AUTOSAR 4.3.x specification CSM_ASR_VERSION_4_04: Interface adheres to AUTOSAR 4.4.0 specification Compared to AUTOSAR 4.3.x, AUTOSAR 4.4.0 introduces the following additional error codes to the interface's operations: Decrypt: CSM_E_KEY_NOT_VALID, CSM_E_KEY_SIZE_MISMATCH, CSM_E_KEY_EMPTY CancelJob: CSM_E_JOB_CANCELED
          symbolic name reference CsmDecryptAlgorithmFamilyCustomRef [0..1]: multiplicity set at pre-compile, set at pre-compile, requires-symbolic-name-value=true, destination=CryptoPrimitiveAlgorithmFamilyCustom  # Reference to a customer specific algorithm family custom container
          symbolic name reference CsmDecryptAlgorithmModeCustomRef [0..1]: multiplicity set at pre-compile, set at pre-compile, requires-symbolic-name-value=true, destination=CryptoPrimitiveAlgorithmModeCustom  # Reference to a customer specific algorithm mode custom container
          symbolic name reference CsmDecryptAlgorithmSecondaryFamilyCustomRef [0..1]: multiplicity set at pre-compile, set at pre-compile, requires-symbolic-name-value=true, destination=CryptoPrimitiveAlgorithmFamilyCustom  # Reference to a customer specific algorithm family container in the Crypto Driver
      container CsmEncrypt [0..1]: multiplicity set at pre-compile  # Configurations of Encryption primitives
        container CsmEncryptConfig: multiplicity set at pre-compile  # Container for configuration of a CSM encryption interface. The container name serves as a symbolic name for the identifier of an encryption interface.
          enumeration CsmEncryptAlgorithmFamiliy: {CRYPTO_ALGOFAM_3DES, CRYPTO_ALGOFAM_AES, CRYPTO_ALGOFAM_CHACHA, CRYPTO_ALGOFAM_CUSTOM, CRYPTO_ALGOFAM_ECIES, CRYPTO_ALGOFAM_EEA3, CRYPTO_ALGOFAM_RSA}, multiplicity set at pre-compile, origin=Vector Informatik, set at pre-compile  # Not used. Determines the algorithm family used for the crypto service. This parameter defines the most significant part of the algorithm.
          enumeration CsmEncryptAlgorithmFamily: {CRYPTO_ALGOFAM_3DES, CRYPTO_ALGOFAM_AES, CRYPTO_ALGOFAM_CHACHA, CRYPTO_ALGOFAM_CUSTOM, CRYPTO_ALGOFAM_ECIES, CRYPTO_ALGOFAM_EEA3, CRYPTO_ALGOFAM_RSA}, multiplicity set at pre-compile, set at pre-compile  # Determines the algorithm family used for the crypto service. This parameter defines the most significant part of the algorithm.
          string CsmEncryptAlgorithmFamilyCustom [0..1]: multiplicity set at pre-compile, set at pre-compile  # This is the name of the custom algorithm family, if CRYPTO_ALGOFAM_CUSTOM is used as CsmEncryptAlgorithmFamily.
          enumeration CsmEncryptAlgorithmMode: {CRYPTO_ALGOMODE_12ROUNDS, CRYPTO_ALGOMODE_20ROUNDS, CRYPTO_ALGOMODE_8ROUNDS, CRYPTO_ALGOMODE_CBC, CRYPTO_ALGOMODE_CFB, CRYPTO_ALGOMODE_CTR, CRYPTO_ALGOMODE_CUSTOM, CRYPTO_ALGOMODE_ECB, CRYPTO_ALGOMODE_NOT_SET, CRYPTO_ALGOMODE_OFB, CRYPTO_ALGOMODE_RSAES_OAEP, CRYPTO_ALGOMODE_RSAES_PKCS1_v1_5, CRYPTO_ALGOMODE_XTS}, multiplicity set at pre-compile, set at pre-compile, default-value=CRYPTO_ALGOMODE_NOT_SET  # Determines the algorithm mode used for the crypto service
          string CsmEncryptAlgorithmModeCustom [0..1]: multiplicity set at pre-compile, set at pre-compile  # Name of the custom algorithm mode used for the crypto service
          enumeration CsmEncryptAlgorithmSecondaryFamily: {CRYPTO_ALGOFAM_BLAKE_1_256, CRYPTO_ALGOFAM_BLAKE_1_512, CRYPTO_ALGOFAM_BLAKE_2s_256, CRYPTO_ALGOFAM_BLAKE_2s_512, CRYPTO_ALGOFAM_CUSTOM, CRYPTO_ALGOFAM_NOT_SET, CRYPTO_ALGOFAM_RIPEMD160, CRYPTO_ALGOFAM_SHA1, CRYPTO_ALGOFAM_SHA2_224, CRYPTO_ALGOFAM_SHA2_256, CRYPTO_ALGOFAM_SHA2_384, CRYPTO_ALGOFAM_SHA2_512, CRYPTO_ALGOFAM_SHA2_512_224, CRYPTO_ALGOFAM_SHA2_512_256, CRYPTO_ALGOFAM_SHA3_224, CRYPTO_ALGOFAM_SHA3_256, CRYPTO_ALGOFAM_SHA3_384, CRYPTO_ALGOFAM_SHA3_512, CRYPTO_ALGOFAM_SHA3_SHAKE128, CRYPTO_ALGOFAM_SHA3_SHAKE256, CRYPTO_ALGOFAM_SHAKE128, CRYPTO_ALGOFAM_SHAKE256}, multiplicity set at pre-compile, set at pre-compile, default-value=CRYPTO_ALGOFAM_NOT_SET  # Determines the algorithm family used for the crypto service
          string CsmEncryptAlgorithmSecondaryFamilyCustom [0..1]: multiplicity set at pre-compile, set at pre-compile  # Name of the custom secondary algorithm family used for the crypto service
          integer CsmEncryptDataMaxLength [0..1]: 1..4294967295, multiplicity set at pre-compile, set at pre-compile  # Max size of the input plaintext length in bytes
          enumeration CsmEncryptProcessing: {CSM_ASYNCHRONOUS, CSM_SYNCHRONOUS}, multiplicity set at pre-compile, origin=Vector Informatik, set at pre-compile  # Not used. Determines how the interface shall be used for that primitive. Synchronous processing returns with the result while asynchronous processing returns without processing the job. The caller will be notified by the corresponding callback Csm will ignore this parameter since it is obsolete as of AUTOSAR 4.4. However, other modules may still rely on its value. It is strongly encouraged to make this parameter consistent with the ProcessingMode parameter in the Jobs that use this primitive. If multiple Jobs with different Processing Modes shall use the same Primitive, the respective Primitive may need to be duplicated and the duplicate's Processing parameter adapted accordingly.
          integer CsmEncryptResultMaxLength [0..1]: 1..4294967295, multiplicity set at pre-compile, set at pre-compile  # Max size of the output cipher length in bytes
          enumeration CsmEncryptSwcInterfaceVersion [0..1]: {CSM_ASR_VERSION_4_03, CSM_ASR_VERSION_4_04}, multiplicity set at pre-compile, origin=Vector Informatik, set at pre-compile, default-value=CSM_ASR_VERSION_4_04  # Specifies the AUTOSAR version that the Client-Server-Interfaces of this primitive should adhere to. CSM_ASR_VERSION_4_03: Interface adheres to AUTOSAR 4.3.x specification CSM_ASR_VERSION_4_04: Interface adheres to AUTOSAR 4.4.0 specification Compared to AUTOSAR 4.3.x, AUTOSAR 4.4.0 introduces the following additional error codes to the interface's operations: AEADEncrypt: CSM_E_KEY_NOT_VALID, CSM_E_KEY_SIZE_MISMATCH, CSM_E_KEY_EMPTY CancelJob: CSM_E_JOB_CANCELED
          integer CsmEncryptAlgorithmKeyLength: 1..4294967295, multiplicity set at pre-compile, set at pre-compile, default-value=16  # Size of the encryption key. This value is generated as constant value without any modifications. Thus, this value needs to be set either in bytes or in bits depending on what is expected by the required Crypto Driver. E.g. set 8 if eight bytes are required, but set 64 if sixty-four bits are required.
          symbolic name reference CsmEncryptAlgorithmFamilyCustomRef [0..1]: multiplicity set at pre-compile, set at pre-compile, requires-symbolic-name-value=true, destination=CryptoPrimitiveAlgorithmFamilyCustom  # Reference to a customer specific algorithm family custom container
          symbolic name reference CsmEncryptAlgorithmSecondaryFamilyCustomRef [0..1]: multiplicity set at pre-compile, set at pre-compile, requires-symbolic-name-value=true, destination=CryptoPrimitiveAlgorithmFamilyCustom  # Reference to a customer specific algorithm family container in the Crypto Driver
          symbolic name reference CsmEncryptAlgorithmModeCustomRef [0..1]: multiplicity set at pre-compile, set at pre-compile, requires-symbolic-name-value=true, destination=CryptoPrimitiveAlgorithmModeCustom  # Reference to a customer specific algorithm mode custom container
      container CsmHash [0..1]: multiplicity set at pre-compile  # Container for Hash Configurations
        container CsmHashConfig: multiplicity set at pre-compile  # Container for configuration of a CSM hash. The container name serves as a symbolic name for the identifier of a key configuration.
          enumeration CsmHashAlgorithmFamiliy: {CRYPTO_ALGOFAM_BLAKE_1_256, CRYPTO_ALGOFAM_BLAKE_1_512, CRYPTO_ALGOFAM_BLAKE_2s_256, CRYPTO_ALGOFAM_BLAKE_2s_512, CRYPTO_ALGOFAM_CUSTOM, CRYPTO_ALGOFAM_RIPEMD160, CRYPTO_ALGOFAM_SHA1, CRYPTO_ALGOFAM_SHA2_224, CRYPTO_ALGOFAM_SHA2_256, CRYPTO_ALGOFAM_SHA2_384, CRYPTO_ALGOFAM_SHA2_512, CRYPTO_ALGOFAM_SHA2_512_224, CRYPTO_ALGOFAM_SHA2_512_256, CRYPTO_ALGOFAM_SHA3_224, CRYPTO_ALGOFAM_SHA3_256, CRYPTO_ALGOFAM_SHA3_384, CRYPTO_ALGOFAM_SHA3_512, CRYPTO_ALGOFAM_SHA3_SHAKE128, CRYPTO_ALGOFAM_SHA3_SHAKE256, CRYPTO_ALGOFAM_SHAKE128, CRYPTO_ALGOFAM_SHAKE256, CRYPTO_ALGOFAM_SM3}, multiplicity set at pre-compile, origin=Vector Informatik, set at pre-compile  # Not used. Determines the algorithm family used for the crypto service. This parameter defines the most significant part of the algorithm.
          enumeration CsmHashAlgorithmFamily: {CRYPTO_ALGOFAM_BLAKE_1_256, CRYPTO_ALGOFAM_BLAKE_1_512, CRYPTO_ALGOFAM_BLAKE_2s_256, CRYPTO_ALGOFAM_BLAKE_2s_512, CRYPTO_ALGOFAM_CUSTOM, CRYPTO_ALGOFAM_RIPEMD160, CRYPTO_ALGOFAM_SHA1, CRYPTO_ALGOFAM_SHA2_224, CRYPTO_ALGOFAM_SHA2_256, CRYPTO_ALGOFAM_SHA2_384, CRYPTO_ALGOFAM_SHA2_512, CRYPTO_ALGOFAM_SHA2_512_224, CRYPTO_ALGOFAM_SHA2_512_256, CRYPTO_ALGOFAM_SHA3_224, CRYPTO_ALGOFAM_SHA3_256, CRYPTO_ALGOFAM_SHA3_384, CRYPTO_ALGOFAM_SHA3_512, CRYPTO_ALGOFAM_SHA3_SHAKE128, CRYPTO_ALGOFAM_SHA3_SHAKE256, CRYPTO_ALGOFAM_SHAKE128, CRYPTO_ALGOFAM_SHAKE256, CRYPTO_ALGOFAM_SM3}, multiplicity set at pre-compile, set at pre-compile  # Determines the algorithm family used for the crypto service. This parameter defines the most significant part of the algorithm.
          string CsmHashAlgorithmFamilyCustom [0..1]: multiplicity set at pre-compile, set at pre-compile  # This is the name of the custom algorithm family, if CRYPTO_ALGOFAM_CUSTOM is used as CsmHashAlgorithmFamily.
          enumeration CsmHashAlgorithmMode: {CRYPTO_ALGOMODE_CUSTOM, CRYPTO_ALGOMODE_NOT_SET}, multiplicity set at pre-compile, set at pre-compile, default-value=CRYPTO_ALGOMODE_NOT_SET  # Determines the algorithm mode used for the crypto service
          string CsmHashAlgorithmModeCustom [0..1]: multiplicity set at pre-compile, set at pre-compile  # Name of the custom primitive mode.
          enumeration CsmHashAlgorithmSecondaryFamily: {CRYPTO_ALGOFAM_CUSTOM, CRYPTO_ALGOFAM_NOT_SET}, multiplicity set at pre-compile, set at pre-compile, default-value=CRYPTO_ALGOFAM_NOT_SET  # Determines the algorithm family used for the crypto service
          string CsmHashAlgorithmSecondaryFamilyCustom [0..1]: multiplicity set at pre-compile, set at pre-compile  # This is the second name of the custom algorithm family, if CRYPTO_ALGOFAM_CUSTOM is set as CsmHashAlgorithmSecondaryFamily.
          integer CsmHashDataMaxLength [0..1]: 1..4294967295, multiplicity set at pre-compile, set at pre-compile  # Max size of the input data length in bytes
          enumeration CsmHashProcessing: {CSM_ASYNCHRONOUS, CSM_SYNCHRONOUS}, multiplicity set at pre-compile, origin=Vector Informatik, set at pre-compile  # Not used. Determines how the interface shall be used for that primitive. Synchronous processing returns with the result while asynchronous processing returns without processing the job. The caller will be notified by the corresponding callback. Csm will ignore this parameter since it is obsolete as of AUTOSAR 4.4. However, other modules may still rely on its value. It is strongly encouraged to make this parameter consistent with the ProcessingMode parameter in the Jobs that use this primitive. If multiple Jobs with different Processing Modes shall use the same Primitive, the respective Primitive may need to be duplicated and the duplicate's Processing parameter adapted accordingly.
          integer CsmHashResultLength: 1..4294967295, multiplicity set at pre-compile, set at pre-compile  # Size of the output hash length in bytes
          enumeration CsmHashSwcInterfaceVersion [0..1]: {CSM_ASR_VERSION_4_03, CSM_ASR_VERSION_4_04}, multiplicity set at pre-compile, origin=Vector Informatik, set at pre-compile, default-value=CSM_ASR_VERSION_4_04  # Specifies the AUTOSAR version that the Client-Server-Interfaces of this primitive should adhere to. CSM_ASR_VERSION_4_03: Interface adheres to AUTOSAR 4.3.x specification CSM_ASR_VERSION_4_04: Interface adheres to AUTOSAR 4.4.0 specification Compared to AUTOSAR 4.3.x, AUTOSAR 4.4.0 introduces the following additional error codes to the interface's operations: CancelJob: CSM_E_JOB_CANCELED
          symbolic name reference CsmHashAlgorithmFamilyCustomRef [0..1]: multiplicity set at pre-compile, set at pre-compile, requires-symbolic-name-value=true, destination=CryptoPrimitiveAlgorithmFamilyCustom  # Reference to a customer specific algorithm family custom container
          symbolic name reference CsmHashAlgorithmModeCustomRef [0..1]: multiplicity set at pre-compile, set at pre-compile, requires-symbolic-name-value=true, destination=CryptoPrimitiveAlgorithmModeCustom  # Reference to a customer specific algorithm mode custom container
          symbolic name reference CsmHashAlgorithmSecondaryFamilyCustomRef [0..1]: multiplicity set at pre-compile, set at pre-compile, requires-symbolic-name-value=true, destination=CryptoPrimitiveAlgorithmFamilyCustom  # Reference to a customer specific algorithm family container in the Crypto Driver
      container CsmMacGenerate [0..1]: multiplicity set at pre-compile  # Configurations of MacGenerate primitives
        container CsmMacGenerateConfig: multiplicity set at pre-compile  # Container for configuration of a CSM mac generation interface. The container name serves as a symbolic name for the identifier of a MAC generation interface.
          enumeration CsmMacGenerateAlgorithmFamiliy: {CRYPTO_ALGOFAM_3DES, CRYPTO_ALGOFAM_AES, CRYPTO_ALGOFAM_BLAKE_1_256, CRYPTO_ALGOFAM_BLAKE_1_512, CRYPTO_ALGOFAM_BLAKE_2s_256, CRYPTO_ALGOFAM_BLAKE_2s_512, CRYPTO_ALGOFAM_CHACHA, CRYPTO_ALGOFAM_CUSTOM, CRYPTO_ALGOFAM_EEA3, CRYPTO_ALGOFAM_EIA3, CRYPTO_ALGOFAM_POLY1305, CRYPTO_ALGOFAM_RIPEMD160, CRYPTO_ALGOFAM_RNG, CRYPTO_ALGOFAM_SHA1, CRYPTO_ALGOFAM_SHA2_224, CRYPTO_ALGOFAM_SHA2_256, CRYPTO_ALGOFAM_SHA2_384, CRYPTO_ALGOFAM_SHA2_512, CRYPTO_ALGOFAM_SHA2_512_224, CRYPTO_ALGOFAM_SHA2_512_256, CRYPTO_ALGOFAM_SHA3_224, CRYPTO_ALGOFAM_SHA3_256, CRYPTO_ALGOFAM_SHA3_384, CRYPTO_ALGOFAM_SHA3_512, CRYPTO_ALGOFAM_SHA3_SHAKE128, CRYPTO_ALGOFAM_SHA3_SHAKE256, CRYPTO_ALGOFAM_SHAKE128, CRYPTO_ALGOFAM_SHAKE256, CRYPTO_ALGOFAM_SIPHASH, CRYPTO_ALGOFAM_SM3}, multiplicity set at pre-compile, origin=Vector Informatik, set at pre-compile  # Not used. Determines the algorithm family used for the crypto service. This parameter defines the most significant part of the algorithm.
          enumeration CsmMacGenerateAlgorithmFamily: {CRYPTO_ALGOFAM_3DES, CRYPTO_ALGOFAM_AES, CRYPTO_ALGOFAM_BLAKE_1_256, CRYPTO_ALGOFAM_BLAKE_1_512, CRYPTO_ALGOFAM_BLAKE_2s_256, CRYPTO_ALGOFAM_BLAKE_2s_512, CRYPTO_ALGOFAM_CHACHA, CRYPTO_ALGOFAM_CUSTOM, CRYPTO_ALGOFAM_EEA3, CRYPTO_ALGOFAM_EIA3, CRYPTO_ALGOFAM_POLY1305, CRYPTO_ALGOFAM_RIPEMD160, CRYPTO_ALGOFAM_RNG, CRYPTO_ALGOFAM_SHA1, CRYPTO_ALGOFAM_SHA2_224, CRYPTO_ALGOFAM_SHA2_256, CRYPTO_ALGOFAM_SHA2_384, CRYPTO_ALGOFAM_SHA2_512, CRYPTO_ALGOFAM_SHA2_512_224, CRYPTO_ALGOFAM_SHA2_512_256, CRYPTO_ALGOFAM_SHA3_224, CRYPTO_ALGOFAM_SHA3_256, CRYPTO_ALGOFAM_SHA3_384, CRYPTO_ALGOFAM_SHA3_512, CRYPTO_ALGOFAM_SHA3_SHAKE128, CRYPTO_ALGOFAM_SHA3_SHAKE256, CRYPTO_ALGOFAM_SHAKE128, CRYPTO_ALGOFAM_SHAKE256, CRYPTO_ALGOFAM_SIPHASH, CRYPTO_ALGOFAM_SM3}, multiplicity set at pre-compile, set at pre-compile  # Determines the algorithm family used for the crypto service. This parameter defines the most significant part of the algorithm.
          string CsmMacGenerateAlgorithmFamilyCustom [0..1]: multiplicity set at pre-compile, set at pre-compile  # This is the name of the custom algorithm family, | if CRYPTO_ALGOFAM_CUSTOM is used as CsmMacGenerateAlgorithmFamily
          integer CsmMacGenerateAlgorithmKeyLength: 1..4294967295, multiplicity set at pre-compile, set at pre-compile, default-value=16  # Size of the MAC key. This value is generated as constant value without any modifications. Thus, this value needs to be set either in bytes or in bits depending on what is expected by the required Crypto Driver. E.g. set 8 if eight bytes are required, but set 64 if sixty-four bits are required.
          enumeration CsmMacGenerateAlgorithmMode: {CRYPTO_ALGOMODE_CMAC, CRYPTO_ALGOMODE_CTRDRBG, CRYPTO_ALGOMODE_CUSTOM, CRYPTO_ALGOMODE_GMAC, CRYPTO_ALGOMODE_HMAC, CRYPTO_ALGOMODE_NOT_SET, CRYPTO_ALGOMODE_SIPHASH_2_4, CRYPTO_ALGOMODE_SIPHASH_4_8}, multiplicity set at pre-compile, set at pre-compile, default-value=CRYPTO_ALGOMODE_NOT_SET  # Determines the algorithm mode used for the crypto service
          string CsmMacGenerateAlgorithmModeCustom [0..1]: multiplicity set at pre-compile, set at pre-compile  # Name of the custom algorithm mode used for the crypto service
          enumeration CsmMacGenerateAlgorithmSecondaryFamily: {CRYPTO_ALGOFAM_CUSTOM, CRYPTO_ALGOFAM_NOT_SET}, multiplicity set at pre-compile, set at pre-compile, default-value=CRYPTO_ALGOFAM_NOT_SET  # Determines the secondary algorithm family used for the crypto service
          string CsmMacGenerateAlgorithmSecondaryFamilyCustom [0..1]: multiplicity set at pre-compile, set at pre-compile  # This is the second name of the custom algorithm family, if CRYPTO_ALGOFAM_CUSTOM is set as CsmHashAlgorithmSecondaryFamilyCustom.
          integer CsmMacGenerateDataMaxLength [0..1]: 1..4294967295, multiplicity set at pre-compile, set at pre-compile  # Max size of the input data length in bytes
          enumeration CsmMacGenerateProcessing: {CSM_ASYNCHRONOUS, CSM_SYNCHRONOUS}, multiplicity set at pre-compile, origin=Vector Informatik, set at pre-compile  # Not used. Determines how the interface shall be used for that primitive. Synchronous processing returns with the result while asynchronous processing returns without processing the job. The caller will be notified by the corresponding callback. Csm will ignore this parameter since it is obsolete as of AUTOSAR 4.4. However, other modules may still rely on its value. It is strongly encouraged to make this parameter consistent with the ProcessingMode parameter in the Jobs that use this primitive. If multiple Jobs with different Processing Modes shall use the same Primitive, the respective Primitive may need to be duplicated and the duplicate's Processing parameter adapted accordingly.
          integer CsmMacGenerateResultLength: 1..4294967295, multiplicity set at pre-compile, set at pre-compile  # Size of the output MAC length in bytes
          enumeration CsmMacGenerateSwcInterfaceVersion [0..1]: {CSM_ASR_VERSION_4_03, CSM_ASR_VERSION_4_04}, multiplicity set at pre-compile, origin=Vector Informatik, set at pre-compile, default-value=CSM_ASR_VERSION_4_04  # Specifies the AUTOSAR version that the Client-Server-Interfaces of this primitive should adhere to. CSM_ASR_VERSION_4_03: Interface adheres to AUTOSAR 4.3.x specification CSM_ASR_VERSION_4_04: Interface adheres to AUTOSAR 4.4.0 specification Compared to AUTOSAR 4.3.x, AUTOSAR 4.4.0 introduces the following additional error codes to the interface's operations: MacGenerate: CSM_E_KEY_NOT_VALID, CSM_E_KEY_SIZE_MISMATCH, CSM_E_KEY_EMPTY CancelJob: CSM_E_JOB_CANCELED
          symbolic name reference CsmMacGenerateAlgorithmFamilyCustomRef [0..1]: multiplicity set at pre-compile, set at pre-compile, requires-symbolic-name-value=true, destination=CryptoPrimitiveAlgorithmFamilyCustom  # Reference to a customer specific algorithm family custom container
          symbolic name reference CsmMacGenerateAlgorithmSecondaryFamilyCustomRef [0..1]: multiplicity set at pre-compile, set at pre-compile, requires-symbolic-name-value=true, destination=CryptoPrimitiveAlgorithmFamilyCustom  # Reference to a customer specific algorithm family container in the Crypto Driver
          symbolic name reference CsmMacGenerateAlgorithmModeCustomRef [0..1]: multiplicity set at pre-compile, set at pre-compile, requires-symbolic-name-value=true, destination=CryptoPrimitiveAlgorithmModeCustom  # Reference to a customer specific algorithm mode custom container
      container CsmMacVerify [0..1]: multiplicity set at pre-compile  # Configurations of MacVerify primitives
        container CsmMacVerifyConfig: multiplicity set at pre-compile  # Container for configuration of a CSM MAC verification interface. The container name serves as a symbolic name for the identifier of a MAC generation interface
          enumeration CsmMacVerifyAlgorithmFamiliy: {CRYPTO_ALGOFAM_3DES, CRYPTO_ALGOFAM_AES, CRYPTO_ALGOFAM_BLAKE_1_256, CRYPTO_ALGOFAM_BLAKE_1_512, CRYPTO_ALGOFAM_BLAKE_2s_256, CRYPTO_ALGOFAM_BLAKE_2s_512, CRYPTO_ALGOFAM_CHACHA, CRYPTO_ALGOFAM_CUSTOM, CRYPTO_ALGOFAM_EEA3, CRYPTO_ALGOFAM_EIA3, CRYPTO_ALGOFAM_POLY1305, CRYPTO_ALGOFAM_RIPEMD160, CRYPTO_ALGOFAM_RNG, CRYPTO_ALGOFAM_SHA1, CRYPTO_ALGOFAM_SHA2_224, CRYPTO_ALGOFAM_SHA2_256, CRYPTO_ALGOFAM_SHA2_384, CRYPTO_ALGOFAM_SHA2_512, CRYPTO_ALGOFAM_SHA2_512_224, CRYPTO_ALGOFAM_SHA2_512_256, CRYPTO_ALGOFAM_SHA3_224, CRYPTO_ALGOFAM_SHA3_256, CRYPTO_ALGOFAM_SHA3_384, CRYPTO_ALGOFAM_SHA3_512, CRYPTO_ALGOFAM_SHA3_SHAKE128, CRYPTO_ALGOFAM_SHA3_SHAKE256, CRYPTO_ALGOFAM_SHAKE128, CRYPTO_ALGOFAM_SHAKE256, CRYPTO_ALGOFAM_SIPHASH, CRYPTO_ALGOFAM_SM3}, multiplicity set at pre-compile, origin=Vector Informatik, set at pre-compile  # Not used. Determines the algorithm family used for the crypto service. This parameter defines the most significant part of the algorithm.
          enumeration CsmMacVerifyAlgorithmFamily: {CRYPTO_ALGOFAM_3DES, CRYPTO_ALGOFAM_AES, CRYPTO_ALGOFAM_BLAKE_1_256, CRYPTO_ALGOFAM_BLAKE_1_512, CRYPTO_ALGOFAM_BLAKE_2s_256, CRYPTO_ALGOFAM_BLAKE_2s_512, CRYPTO_ALGOFAM_CHACHA, CRYPTO_ALGOFAM_CUSTOM, CRYPTO_ALGOFAM_EEA3, CRYPTO_ALGOFAM_EIA3, CRYPTO_ALGOFAM_POLY1305, CRYPTO_ALGOFAM_RIPEMD160, CRYPTO_ALGOFAM_RNG, CRYPTO_ALGOFAM_SHA1, CRYPTO_ALGOFAM_SHA2_224, CRYPTO_ALGOFAM_SHA2_256, CRYPTO_ALGOFAM_SHA2_384, CRYPTO_ALGOFAM_SHA2_512, CRYPTO_ALGOFAM_SHA2_512_224, CRYPTO_ALGOFAM_SHA2_512_256, CRYPTO_ALGOFAM_SHA3_224, CRYPTO_ALGOFAM_SHA3_256, CRYPTO_ALGOFAM_SHA3_384, CRYPTO_ALGOFAM_SHA3_512, CRYPTO_ALGOFAM_SHA3_SHAKE128, CRYPTO_ALGOFAM_SHA3_SHAKE256, CRYPTO_ALGOFAM_SHAKE128, CRYPTO_ALGOFAM_SHAKE256, CRYPTO_ALGOFAM_SIPHASH, CRYPTO_ALGOFAM_SM3}, multiplicity set at pre-compile, set at pre-compile  # Determines the algorithm family used for the crypto service. This parameter defines the most significant part of the algorithm.
          string CsmMacVerifyAlgorithmFamilyCustom [0..1]: multiplicity set at pre-compile, set at pre-compile  # Name of the custom algorithm family used for the crypto service
          enumeration CsmMacVerifyAlgorithmSecondaryFamily: {CRYPTO_ALGOFAM_CUSTOM, CRYPTO_ALGOFAM_NOT_SET}, multiplicity set at pre-compile, set at pre-compile, default-value=CRYPTO_ALGOFAM_NOT_SET  # Determines the secondary algorithm family used for the crypto service
          string CsmMacVerifyAlgorithmSecondaryFamilyCustom [0..1]: multiplicity set at pre-compile, set at pre-compile  # This is the second the name of the custom algorithm, if CRYPTO_ALGOFAM_CUSTOM is set as CsmMacVerifyAlgorithmSecondaryFamily
          integer CsmMacVerifyCompareLength: 1..4294967295, multiplicity set at pre-compile, set at pre-compile  # Size of the input MAC length, that shall be verified, in BITS
          integer CsmMacVerifyDataMaxLength [0..1]: 1..4294967295, multiplicity set at pre-compile, set at pre-compile  # Max size of the input data length, for which MAC shall be verified, in bytes
          enumeration CsmMacVerifyProcessing: {CSM_ASYNCHRONOUS, CSM_SYNCHRONOUS}, multiplicity set at pre-compile, origin=Vector Informatik, set at pre-compile  # Not used. Determines how the interface shall be used for that primitive. Synchronous processing returns with the result while asynchronous processing returns without processing the job. The caller will be notified by the corresponding callback. Csm will ignore this parameter since it is obsolete as of AUTOSAR 4.4. However, other modules may still rely on its value. It is strongly encouraged to make this parameter consistent with the ProcessingMode parameter in the Jobs that use this primitive. If multiple Jobs with different Processing Modes shall use the same Primitive, the respective Primitive may need to be duplicated and the duplicate's Processing parameter adapted accordingly.
          enumeration CsmMacVerifyAlgorithmMode: {CRYPTO_ALGOMODE_CMAC, CRYPTO_ALGOMODE_CTRDRBG, CRYPTO_ALGOMODE_CUSTOM, CRYPTO_ALGOMODE_GMAC, CRYPTO_ALGOMODE_HMAC, CRYPTO_ALGOMODE_NOT_SET, CRYPTO_ALGOMODE_SIPHASH_2_4, CRYPTO_ALGOMODE_SIPHASH_4_8}, multiplicity set at pre-compile, set at pre-compile, default-value=CRYPTO_ALGOMODE_NOT_SET  # Determines the algorithm mode used for the crypto service.
          string CsmMacVerifyAlgorithmModeCustom [0..1]: multiplicity set at pre-compile, set at pre-compile  # Name of the custom algorithm mode used for the crypto service.
          enumeration CsmMacVerifySwcInterfaceVersion [0..1]: {CSM_ASR_VERSION_4_03, CSM_ASR_VERSION_4_04}, multiplicity set at pre-compile, origin=Vector Informatik, set at pre-compile, default-value=CSM_ASR_VERSION_4_04  # Specifies the AUTOSAR version that the Client-Server-Interfaces of this primitive should adhere to. CSM_ASR_VERSION_4_03: Interface adheres to AUTOSAR 4.3.x specification CSM_ASR_VERSION_4_04: Interface adheres to AUTOSAR 4.4.0 specification Compared to AUTOSAR 4.3.x, AUTOSAR 4.4.0 introduces the following additional error codes to the interface's operations: MacVerify: CSM_E_KEY_NOT_VALID, CSM_E_KEY_SIZE_MISMATCH, CSM_E_KEY_EMPTY CancelJob: CSM_E_JOB_CANCELED
          integer CsmMacVerifyAlgorithmKeyLength: 1..4294967295, multiplicity set at pre-compile, set at pre-compile, default-value=16  # Size of the MAC key. This value is generated as constant value without any modifications. Thus, this value needs to be set either in bytes or in bits depending on what is expected by the required Crypto Driver. E.g. set 8 if eight bytes are required, but set 64 if sixty-four bits are required.
          symbolic name reference CsmMacVerifyAlgorithmFamilyCustomRef [0..1]: multiplicity set at pre-compile, set at pre-compile, requires-symbolic-name-value=true, destination=CryptoPrimitiveAlgorithmFamilyCustom  # Reference to a customer specific algorithm family custom container
          symbolic name reference CsmMacVerifyAlgorithmSecondaryFamilyCustomRef [0..1]: multiplicity set at pre-compile, set at pre-compile, requires-symbolic-name-value=true, destination=CryptoPrimitiveAlgorithmFamilyCustom  # Reference to a customer specific algorithm family container in the Crypto Driver
          symbolic name reference CsmMacVerifyAlgorithmModeCustomRef [0..1]: multiplicity set at pre-compile, set at pre-compile, requires-symbolic-name-value=true, destination=CryptoPrimitiveAlgorithmModeCustom  # Reference to a customer specific algorithm mode custom container
      container CsmRandomGenerate [0..1]: multiplicity set at pre-compile  # Configurations of RandomGenerate primitives
        container CsmRandomGenerateConfig: multiplicity set at pre-compile  # Container for configuration of a CSM random generator. The container name serves as a symbolic name for the identifier of a random generator configuration.
          enumeration CsmRandomGenerateAlgorithmFamiliy: {CRYPTO_ALGOFAM_3DES, CRYPTO_ALGOFAM_AES, CRYPTO_ALGOFAM_BLAKE_1_256, CRYPTO_ALGOFAM_BLAKE_1_512, CRYPTO_ALGOFAM_BLAKE_2s_256, CRYPTO_ALGOFAM_BLAKE_2s_512, CRYPTO_ALGOFAM_CHACHA, CRYPTO_ALGOFAM_CUSTOM, CRYPTO_ALGOFAM_EEA3, CRYPTO_ALGOFAM_RIPEMD160, CRYPTO_ALGOFAM_RNG, CRYPTO_ALGOFAM_SHA1, CRYPTO_ALGOFAM_SHA2_224, CRYPTO_ALGOFAM_SHA2_256, CRYPTO_ALGOFAM_SHA2_384, CRYPTO_ALGOFAM_SHA2_512, CRYPTO_ALGOFAM_SHA2_512_224, CRYPTO_ALGOFAM_SHA2_512_256, CRYPTO_ALGOFAM_SHA3_224, CRYPTO_ALGOFAM_SHA3_256, CRYPTO_ALGOFAM_SHA3_384, CRYPTO_ALGOFAM_SHA3_512, CRYPTO_ALGOFAM_SHA3_SHAKE128, CRYPTO_ALGOFAM_SHA3_SHAKE256, CRYPTO_ALGOFAM_SHAKE128, CRYPTO_ALGOFAM_SHAKE256, CRYPTO_ALGOFAM_SM3}, multiplicity set at pre-compile, origin=Vector Informatik, set at pre-compile  # Not used. Determines the algorithm family used for the crypto service. This parameter defines the most significant part of the algorithm.
          enumeration CsmRandomGenerateAlgorithmFamily: {CRYPTO_ALGOFAM_3DES, CRYPTO_ALGOFAM_AES, CRYPTO_ALGOFAM_BLAKE_1_256, CRYPTO_ALGOFAM_BLAKE_1_512, CRYPTO_ALGOFAM_BLAKE_2s_256, CRYPTO_ALGOFAM_BLAKE_2s_512, CRYPTO_ALGOFAM_CHACHA, CRYPTO_ALGOFAM_CUSTOM, CRYPTO_ALGOFAM_EEA3, CRYPTO_ALGOFAM_RIPEMD160, CRYPTO_ALGOFAM_RNG, CRYPTO_ALGOFAM_SHA1, CRYPTO_ALGOFAM_SHA2_224, CRYPTO_ALGOFAM_SHA2_256, CRYPTO_ALGOFAM_SHA2_384, CRYPTO_ALGOFAM_SHA2_512, CRYPTO_ALGOFAM_SHA2_512_224, CRYPTO_ALGOFAM_SHA2_512_256, CRYPTO_ALGOFAM_SHA3_224, CRYPTO_ALGOFAM_SHA3_256, CRYPTO_ALGOFAM_SHA3_384, CRYPTO_ALGOFAM_SHA3_512, CRYPTO_ALGOFAM_SHA3_SHAKE128, CRYPTO_ALGOFAM_SHA3_SHAKE256, CRYPTO_ALGOFAM_SHAKE128, CRYPTO_ALGOFAM_SHAKE256, CRYPTO_ALGOFAM_SM3}, multiplicity set at pre-compile, set at pre-compile  # Determines the algorithm family used for the crypto service. This parameter defines the most significant part of the algorithm.
          string CsmRandomGenerateAlgorithmFamilyCustom [0..1]: multiplicity set at pre-compile, set at pre-compile  # Name of the custom algorithm family used for the crypto service. This is the name of the custom algorithm family, if CRYPTO_ALGOFAM_CUSTOM is used as CsmRandomAlgorithmFamily
          enumeration CsmRandomGenerateAlgorithmMode: {CRYPTO_ALGOMODE_CMAC, CRYPTO_ALGOMODE_CTRDRBG, CRYPTO_ALGOMODE_CUSTOM, CRYPTO_ALGOMODE_GMAC, CRYPTO_ALGOMODE_HMAC, CRYPTO_ALGOMODE_NOT_SET, CRYPTO_ALGOMODE_SIPHASH_2_4, CRYPTO_ALGOMODE_SIPHASH_4_8}, multiplicity set at pre-compile, set at pre-compile, default-value=CRYPTO_ALGOMODE_NOT_SET  # Determines the algorithm mode used for the crypto service
          string CsmRandomGenerateAlgorithmModeCustom [0..1]: multiplicity set at pre-compile, set at pre-compile  # Name of the custom algorithm mode used for the crypto service. This is the name of the custom algorithm family, if CRYPTO_ALGOFAM_CUSTOM is used as CsmRandomGenerateAlgorithmFamily.
          enumeration CsmRandomGenerateAlgorithmSecondaryFamily: {CRYPTO_ALGOFAM_CUSTOM, CRYPTO_ALGOFAM_NOT_SET}, multiplicity set at pre-compile, set at pre-compile, default-value=CRYPTO_ALGOFAM_NOT_SET  # Determines the algorithm family used for the crypto service
          string CsmRandomGenerateAlgorithmSecondaryFamilyCustom [0..1]: multiplicity set at pre-compile, set at pre-compile  # Name of the custom secondary algorithm family used for the crypto service. This is the second name of the custom algorithm family, if CRYPTO_ALGOFAM_CUSTOM is set as Csm RandomAlgorithmSecondaryFamily.
          enumeration CsmRandomGenerateProcessing: {CSM_ASYNCHRONOUS, CSM_SYNCHRONOUS}, multiplicity set at pre-compile, origin=Vector Informatik, set at pre-compile  # Not used. Determines how the interface shall be used for that primitive. Synchronous processing returns with the result while asynchronous processing returns without processing the job. The caller will be notified by the corresponding callback Csm will ignore this parameter since it is obsolete as of AUTOSAR 4.4. However, other modules may still rely on its value. It is strongly encouraged to make this parameter consistent with the ProcessingMode parameter in the Jobs that use this primitive. If multiple Jobs with different Processing Modes shall use the same Primitive, the respective Primitive may need to be duplicated and the duplicate's Processing parameter adapted accordingly.
          integer CsmRandomGenerateResultLength: 1..4294967295, multiplicity set at pre-compile, set at pre-compile  # Size of the random generate key in bytes
          symbolic name reference CsmRandomGenerateAlgorithmFamilyCustomRef [0..1]: multiplicity set at pre-compile, set at pre-compile, requires-symbolic-name-value=true, destination=CryptoPrimitiveAlgorithmFamilyCustom  # Reference to a customer specific algorithm family custom container
          symbolic name reference CsmRandomGenerateAlgorithmSecondaryFamilyCustomRef [0..1]: multiplicity set at pre-compile, set at pre-compile, requires-symbolic-name-value=true, destination=CryptoPrimitiveAlgorithmFamilyCustom  # Reference to a customer specific algorithm family container in the Crypto Driver
          symbolic name reference CsmRandomGenerateAlgorithmModeCustomRef [0..1]: multiplicity set at pre-compile, set at pre-compile, requires-symbolic-name-value=true, destination=CryptoPrimitiveAlgorithmModeCustom  # Reference to a customer specific algorithm mode custom container
      container CsmSecureCounter [0..1]: multiplicity set at pre-compile  # Configurations of SecureCounter primitives
        container CsmSecureCounterConfig: multiplicity set at pre-compile  # Container for configuration of a CSM counter. The container name serves as a symbolic name for the identifier of a secure counter configuration.
          enumeration CsmSecureCounterProcessing: {CSM_ASYNCHRONOUS, CSM_SYNCHRONOUS}, multiplicity set at pre-compile, origin=Vector Informatik, set at pre-compile, default-value=CSM_SYNCHRONOUS  # Not used. Determines how the interface shall be used for that primitive. Synchronous processing returns with the result while asynchronous processing returns without processing the job. The caller will be notified by the corresponding callback
          reference CsmSecureCounterQueueRef [0..1]: multiplicity set at pre-compile, origin=Vector Informatik, set at pre-compile, destination=CsmQueue  # Not used. Queue is referred in Job. This parameter refers to the queue used for that secure counter.
      container CsmSignatureGenerate [0..1]: multiplicity set at pre-compile  # Configurations of SignatureGenerate primitives
        container CsmSignatureGenerateConfig: multiplicity set at pre-compile  # Container for configuration of a CSM signature generation interface. The container name serves as a symbolic name for the identifier of signature generation interface.
          enumeration CsmSignatureGenerateAlgorithmFamiliy: {CRYPTO_ALGOFAM_BRAINPOOL, CRYPTO_ALGOFAM_CUSTOM, CRYPTO_ALGOFAM_ECCNIST, CRYPTO_ALGOFAM_ECDSA, CRYPTO_ALGOFAM_ED25519, CRYPTO_ALGOFAM_RSA, CRYPTO_ALGOFAM_SM2}, multiplicity set at pre-compile, origin=Vector Informatik, set at pre-compile  # Not used. Determines the algorithm family used for the crypto service. This parameter defines the most significant part of the algorithm.
          enumeration CsmSignatureGenerateAlgorithmFamily: {CRYPTO_ALGOFAM_BRAINPOOL, CRYPTO_ALGOFAM_CUSTOM, CRYPTO_ALGOFAM_ECCNIST, CRYPTO_ALGOFAM_ECDSA, CRYPTO_ALGOFAM_ED25519, CRYPTO_ALGOFAM_RSA, CRYPTO_ALGOFAM_SM2}, multiplicity set at pre-compile, set at pre-compile  # Determines the algorithm family used for the crypto service. This parameter defines the most significant part of the algorithm.
          string CsmSignatureGenerateAlgorithmFamilyCustom [0..1]: multiplicity set at pre-compile, set at pre-compile  # Name of the custom algorithm family used for the crypto service. | This is the name of the custom algorithm family, if CRYPTO_ALGOFAM_CUSTOM is used as CsmSignatureGenerateAlgorithmFamily.
          enumeration CsmSignatureGenerateAlgorithmMode: {CRYPTO_ALGOMODE_CUSTOM, CRYPTO_ALGOMODE_NOT_SET, CRYPTO_ALGOMODE_RSASSA_PKCS1_v1_5, CRYPTO_ALGOMODE_RSASSA_PSS}, multiplicity set at pre-compile, set at pre-compile, default-value=CRYPTO_ALGOMODE_NOT_SET  # Determines the algorithm mode used for the crypto service
          string CsmSignatureGenerateAlgorithmModeCustom [0..1]: multiplicity set at pre-compile, set at pre-compile  # Name of the custom algorithm mode used for the crypto service
          enumeration CsmSignatureGenerateAlgorithmSecondaryFamily: {CRYPTO_ALGOFAM_BLAKE_1_256, CRYPTO_ALGOFAM_BLAKE_1_512, CRYPTO_ALGOFAM_BLAKE_2s_256, CRYPTO_ALGOFAM_BLAKE_2s_512, CRYPTO_ALGOFAM_CUSTOM, CRYPTO_ALGOFAM_NOT_SET, CRYPTO_ALGOFAM_RIPEMD160, CRYPTO_ALGOFAM_SHA1, CRYPTO_ALGOFAM_SHA2_224, CRYPTO_ALGOFAM_SHA2_256, CRYPTO_ALGOFAM_SHA2_384, CRYPTO_ALGOFAM_SHA2_512, CRYPTO_ALGOFAM_SHA2_512_224, CRYPTO_ALGOFAM_SHA2_512_256, CRYPTO_ALGOFAM_SHA3_224, CRYPTO_ALGOFAM_SHA3_256, CRYPTO_ALGOFAM_SHA3_384, CRYPTO_ALGOFAM_SHA3_512, CRYPTO_ALGOFAM_SHA3_SHAKE128, CRYPTO_ALGOFAM_SHA3_SHAKE256, CRYPTO_ALGOFAM_SHAKE128, CRYPTO_ALGOFAM_SHAKE256}, multiplicity set at pre-compile, set at pre-compile, default-value=CRYPTO_ALGOFAM_NOT_SET  # Determines the algorithm mode used for the crypto service
          string CsmSignatureGenerateAlgorithmSecondaryFamilyCustom [0..1]: multiplicity set at pre-compile, set at pre-compile  # Name of the custom secondary algorithm family used for the crypto service. This is the second name of the custom algorithm family, if CRYPTO_ALGOFAM_CUSTOM is set as CsmSignatureGenerateAlgorithmSecondaryFamily.
          integer CsmSignatureGenerateDataMaxLength [0..1]: 1..4294967295, multiplicity set at pre-compile, set at pre-compile  # Size of the input data length in bytes
          integer CsmSignatureGenerateKeyLength: 1..4294967295, multiplicity set at pre-compile, set at pre-compile, default-value=32  # Size of the signature generate key. This value is generated as constant value without any modifications. Thus, this value needs to be set either in bytes or in bits depending on what is expected by the required Crypto Driver. E.g. set 8 if eight bytes are required, but set 64 if sixty-four bits are required.
          enumeration CsmSignatureGenerateProcessing: {CSM_ASYNCHRONOUS, CSM_SYNCHRONOUS}, multiplicity set at pre-compile, origin=Vector Informatik, set at pre-compile  # Not used. Determines how the interface shall be used for that primitive. Synchronous processing returns with the result while asynchronous processing returns without processing the job. The caller will be notified by the corresponding callback Csm will ignore this parameter since it is obsolete as of AUTOSAR 4.4. However, other modules may still rely on its value. It is strongly encouraged to make this parameter consistent with the ProcessingMode parameter in the Jobs that use this primitive. If multiple Jobs with different Processing Modes shall use the same Primitive, the respective Primitive may need to be duplicated and the duplicate's Processing parameter adapted accordingly.
          integer CsmSignatureGenerateResultLength: 1..4294967295, multiplicity set at pre-compile, set at pre-compile  # Size of the output signature length in bytes
          enumeration CsmSignatureGenerateSwcInterfaceVersion [0..1]: {CSM_ASR_VERSION_4_03, CSM_ASR_VERSION_4_04}, multiplicity set at pre-compile, origin=Vector Informatik, set at pre-compile, default-value=CSM_ASR_VERSION_4_04  # Specifies the AUTOSAR version that the Client-Server-Interfaces of this primitive should adhere to. CSM_ASR_VERSION_4_03: Interface adheres to AUTOSAR 4.3.x specification CSM_ASR_VERSION_4_04: Interface adheres to AUTOSAR 4.4.0 specification Compared to AUTOSAR 4.3.x, AUTOSAR 4.4.0 introduces the following additional error codes to the interface's operations: SignatureVerify: CSM_E_KEY_NOT_VALID, CSM_E_KEY_SIZE_MISMATCH, CSM_E_KEY_EMPTY CancelJob: CSM_E_JOB_CANCELED
          symbolic name reference CsmSignatureGenerateAlgorithmFamilyCustomRef [0..1]: multiplicity set at pre-compile, set at pre-compile, requires-symbolic-name-value=true, destination=CryptoPrimitiveAlgorithmFamilyCustom  # Reference to a customer specific algorithm family custom container
          symbolic name reference CsmSignatureGenerateAlgorithmSecondaryFamilyCustomRef [0..1]: multiplicity set at pre-compile, set at pre-compile, requires-symbolic-name-value=true, destination=CryptoPrimitiveAlgorithmFamilyCustom  # Reference to a customer specific algorithm family container in the Crypto Driver
          symbolic name reference CsmSignatureGenerateAlgorithmModeCustomRef [0..1]: multiplicity set at pre-compile, set at pre-compile, requires-symbolic-name-value=true, destination=CryptoPrimitiveAlgorithmModeCustom  # Reference to a customer specific algorithm mode custom container
      container CsmSignatureVerify [0..1]: multiplicity set at pre-compile  # Configurations of SignatureVerify primitives
        container CsmSignatureVerifyConfig: multiplicity set at pre-compile  # Container for configuration of a CSM signature verification interface. The container name serves as a symbolic name for the identifier of signature verification interface.
          enumeration CsmSignatureVerifyAlgorithmFamiliy: {CRYPTO_ALGOFAM_BRAINPOOL, CRYPTO_ALGOFAM_CUSTOM, CRYPTO_ALGOFAM_ECCNIST, CRYPTO_ALGOFAM_ECDSA, CRYPTO_ALGOFAM_ED25519, CRYPTO_ALGOFAM_RSA, CRYPTO_ALGOFAM_SM2}, multiplicity set at pre-compile, origin=Vector Informatik, set at pre-compile  # Not used. Determines the algorithm family used for the crypto service. This parameter defines the most significant part of the algorithm.
          enumeration CsmSignatureVerifyAlgorithmFamily: {CRYPTO_ALGOFAM_BRAINPOOL, CRYPTO_ALGOFAM_CUSTOM, CRYPTO_ALGOFAM_ECCNIST, CRYPTO_ALGOFAM_ECDSA, CRYPTO_ALGOFAM_ED25519, CRYPTO_ALGOFAM_RSA, CRYPTO_ALGOFAM_SM2}, multiplicity set at pre-compile, set at pre-compile  # Determines the algorithm family used for the crypto service. This parameter defines the most significant part of the algorithm.
          string CsmSignatureVerifyAlgorithmFamilyCustom [0..1]: multiplicity set at pre-compile, set at pre-compile  # Name of the custom algorithm family used for the crypto service. This is the name of the custom algorithm family, if CRYPTO_ALGOFAM_CUSTOM is used as CsmSignatureVerifyAlgorithmFamily.
          enumeration CsmSignatureVerifyAlgorithmMode: {CRYPTO_ALGOMODE_CUSTOM, CRYPTO_ALGOMODE_NOT_SET, CRYPTO_ALGOMODE_RSASSA_PKCS1_v1_5, CRYPTO_ALGOMODE_RSASSA_PSS}, multiplicity set at pre-compile, set at pre-compile, default-value=CRYPTO_ALGOMODE_NOT_SET  # Determines the algorithm mode used for the crypto service
          string CsmSignatureVerifyAlgorithmModeCustom [0..1]: multiplicity set at pre-compile, set at pre-compile  # Name of the custom algorithm mode used for the crypto service
          enumeration CsmSignatureVerifyAlgorithmSecondaryFamily: {CRYPTO_ALGOFAM_BLAKE_1_256, CRYPTO_ALGOFAM_BLAKE_1_512, CRYPTO_ALGOFAM_BLAKE_2s_256, CRYPTO_ALGOFAM_BLAKE_2s_512, CRYPTO_ALGOFAM_CUSTOM, CRYPTO_ALGOFAM_NOT_SET, CRYPTO_ALGOFAM_RIPEMD160, CRYPTO_ALGOFAM_SHA1, CRYPTO_ALGOFAM_SHA2_224, CRYPTO_ALGOFAM_SHA2_256, CRYPTO_ALGOFAM_SHA2_384, CRYPTO_ALGOFAM_SHA2_512, CRYPTO_ALGOFAM_SHA2_512_224, CRYPTO_ALGOFAM_SHA2_512_256, CRYPTO_ALGOFAM_SHA3_224, CRYPTO_ALGOFAM_SHA3_256, CRYPTO_ALGOFAM_SHA3_384, CRYPTO_ALGOFAM_SHA3_512, CRYPTO_ALGOFAM_SHA3_SHAKE128, CRYPTO_ALGOFAM_SHA3_SHAKE256, CRYPTO_ALGOFAM_SHAKE128, CRYPTO_ALGOFAM_SHAKE256}, multiplicity set at pre-compile, set at pre-compile, default-value=CRYPTO_ALGOFAM_NOT_SET  # Determines the algorithm family used for the crypto service. This parameter defines the most significant part of the algorithm.
          string CsmSignatureVerifyAlgorithmSecondaryFamilyCustom [0..1]: multiplicity set at pre-compile, set at pre-compile  # Name of the custom secondary algorithm family used for the crypto service. This is the name of the custom algorithm family, if CRYPTO_ALGOFAM_CUSTOM is used as CsmSignatureVerifyAlgorithmFamily.
          integer CsmSignatureVerifyCompareLength: 1..4294967295, multiplicity set at pre-compile, set at pre-compile  # Size of the input data length, for which signature shall be verified, in bytes
          integer CsmSignatureVerifyDataMaxLength [0..1]: 1..4294967295, multiplicity set at pre-compile, set at pre-compile  # Size of the input data length, for which signature shall be verified, in bytes
          enumeration CsmSignatureVerifyProcessing: {CSM_ASYNCHRONOUS, CSM_SYNCHRONOUS}, multiplicity set at pre-compile, origin=Vector Informatik, set at pre-compile  # Not used. Determines how the interface shall be used for that primitive. Synchronous processing returns with the result while asynchronous processing returns without processing the job. The caller will be notified by the corresponding callback. Csm will ignore this parameter since it is obsolete as of AUTOSAR 4.4. However, other modules may still rely on its value. It is strongly encouraged to make this parameter consistent with the ProcessingMode parameter in the Jobs that use this primitive. If multiple Jobs with different Processing Modes shall use the same Primitive, the respective Primitive may need to be duplicated and the duplicate's Processing parameter adapted accordingly.
          enumeration CsmSignatureVerifySwcInterfaceVersion [0..1]: {CSM_ASR_VERSION_4_03, CSM_ASR_VERSION_4_04}, multiplicity set at pre-compile, origin=Vector Informatik, set at pre-compile, default-value=CSM_ASR_VERSION_4_04  # Specifies the AUTOSAR version that the Client-Server-Interfaces of this primitive should adhere to. CSM_ASR_VERSION_4_03: Interface adheres to AUTOSAR 4.3.x specification CSM_ASR_VERSION_4_04: Interface adheres to AUTOSAR 4.4.0 specification Compared to AUTOSAR 4.3.x, AUTOSAR 4.4.0 introduces the following additional error codes to the interface's operations: SignatureVerify: CSM_E_KEY_NOT_VALID, CSM_E_KEY_SIZE_MISMATCH, CSM_E_KEY_EMPTY CancelJob: CSM_E_JOB_CANCELED
          integer CsmSignatureVerifyKeyLength: 1..4294967295, multiplicity set at pre-compile, set at pre-compile, default-value=32  # Size of the signature verify key. This value is generated as constant value without any modifications. Thus, this value needs to be set either in bytes or in bits depending on what is expected by the required Crypto Driver. E.g. set 8 if eight bytes are required, but set 64 if sixty-four bits are required.
          symbolic name reference CsmSignatureVerifyAlgorithmFamilyCustomRef [0..1]: multiplicity set at pre-compile, set at pre-compile, requires-symbolic-name-value=true, destination=CryptoPrimitiveAlgorithmFamilyCustom  # Reference to a customer specific algorithm family custom container
          symbolic name reference CsmSignatureVerifyAlgorithmSecondaryFamilyCustomRef [0..1]: multiplicity set at pre-compile, set at pre-compile, requires-symbolic-name-value=true, destination=CryptoPrimitiveAlgorithmFamilyCustom  # Reference to a customer specific algorithm family container in the Crypto Driver
          symbolic name reference CsmSignatureVerifyAlgorithmModeCustomRef [0..1]: multiplicity set at pre-compile, set at pre-compile, requires-symbolic-name-value=true, destination=CryptoPrimitiveAlgorithmModeCustom  # Reference to a customer specific algorithm mode custom container
      container CsmJobKeySetValid [0..1]: multiplicity set at pre-compile  # Configurations of KeySetValid primitives
        container CsmJobKeySetValidConfig: multiplicity set at pre-compile  # Container for configuration of a CSM key set valid operation. The container name serves as a symbolic name for the identifier of a key configuration.
          enumeration CsmJobKeySetValidAlgorithmFamily: {CRYPTO_ALGOFAM_CUSTOM, CRYPTO_ALGOFAM_NOT_SET}, multiplicity set at pre-compile, set at pre-compile, default-value=CRYPTO_ALGOFAM_NOT_SET  # Determines the algorithm family used for the crypto service. This parameter defines the most significant part of the algorithm.
          enumeration CsmJobKeySetValidAlgorithmMode: {CRYPTO_ALGOMODE_CUSTOM, CRYPTO_ALGOMODE_NOT_SET}, multiplicity set at pre-compile, set at pre-compile, default-value=CRYPTO_ALGOMODE_NOT_SET  # Determines the algorithm mode used for the crypto service.
          enumeration CsmJobKeySetValidAlgorithmSecondaryFamily: {CRYPTO_ALGOFAM_CUSTOM, CRYPTO_ALGOFAM_NOT_SET}, multiplicity set at pre-compile, set at pre-compile, default-value=CRYPTO_ALGOFAM_NOT_SET  # Determines the secondary algorithm family used for the crypto service.
          symbolic name reference CsmJobKeySetValidAlgorithmFamilyCustomRef [0..1]: multiplicity set at pre-compile, set at pre-compile, requires-symbolic-name-value=true, destination=CryptoPrimitiveAlgorithmFamilyCustom  # Reference to a customer specific algorithm family custom container
          symbolic name reference CsmJobKeySetValidAlgorithmModeCustomRef [0..1]: multiplicity set at pre-compile, set at pre-compile, requires-symbolic-name-value=true, destination=CryptoPrimitiveAlgorithmModeCustom  # Reference to a customer specific algorithm mode custom container
          symbolic name reference CsmJobKeySetValidAlgorithmSecondaryFamilyCustomRef [0..1]: multiplicity set at pre-compile, set at pre-compile, requires-symbolic-name-value=true, destination=CryptoPrimitiveAlgorithmFamilyCustom  # Reference to a customer specific algorithm family container in the Crypto Driver
      container CsmJobKeyExchangeCalcPubVal [0..1]: multiplicity set at pre-compile  # Configurations of KeyExchangeCalcPubVal primitives
        container CsmJobKeyExchangeCalcPubValConfig: multiplicity set at pre-compile  # Container for configuration of a CSM JobKeyExchangeCalcPubVal. The container name serves as a symbolic name for the identifier of a key configuration.
          enumeration CsmJobKeyExchangeCalcPubValAlgorithmFamiliy: {CRYPTO_ALGOFAM_CUSTOM, CRYPTO_ALGOFAM_DH, CRYPTO_ALGOFAM_ECDH, CRYPTO_ALGOFAM_RSA}, multiplicity set at pre-compile, origin=Vector Informatik, set at pre-compile  # Not used. Determines the algorithm family used for the crypto service. This parameter defines the most significant part of the algorithm.
          enumeration CsmJobKeyExchangeCalcPubValAlgorithmFamily: {CRYPTO_ALGOFAM_CUSTOM, CRYPTO_ALGOFAM_DH, CRYPTO_ALGOFAM_ECDH, CRYPTO_ALGOFAM_RSA}, multiplicity set at pre-compile, origin=Vector Informatik, set at pre-compile  # Determines the algorithm family used for the crypto service. This parameter defines the most significant part of the algorithm.
          string CsmJobKeyExchangeCalcPubValAlgorithmFamilyCustom [0..1]: multiplicity set at pre-compile, set at pre-compile  # Name of the custom algorithm family used for the crypto service. | This is the name of the custom algorithm family, if CRYPTO_ALGOFAM_CUSTOM is used.
          enumeration CsmJobKeyExchangeCalcPubValAlgorithmMode: {CRYPTO_ALGOMODE_CUSTOM, CRYPTO_ALGOMODE_NOT_SET}, multiplicity set at pre-compile, set at pre-compile, default-value=CRYPTO_ALGOMODE_NOT_SET  # Determines the algorithm mode used for the crypto service
          string CsmJobKeyExchangeCalcPubValAlgorithmModeCustom [0..1]: multiplicity set at pre-compile, set at pre-compile  # Name of the custom primitive mode.
          enumeration CsmJobKeyExchangeCalcPubValAlgorithmSecondaryFamily: {CRYPTO_ALGOFAM_CUSTOM, CRYPTO_ALGOFAM_ECCANSI, CRYPTO_ALGOFAM_ECCNIST, CRYPTO_ALGOFAM_ECCSEC, CRYPTO_ALGOFAM_NOT_SET, CRYPTO_ALGOFAM_X25519}, multiplicity set at pre-compile, set at pre-compile, default-value=CRYPTO_ALGOFAM_NOT_SET  # Determines the algorithm family used for the crypto service.
          string CsmJobKeyExchangeCalcPubValAlgorithmSecondaryFamilyCustom [0..1]: multiplicity set at pre-compile, set at pre-compile  # This is the second name of the custom algorithm family, if CRYPTO_ALGOFAM_CUSTOM is used .
          symbolic name reference CsmJobKeyExchangeCalcPubValAlgorithmFamilyCustomRef [0..1]: multiplicity set at pre-compile, set at pre-compile, requires-symbolic-name-value=true, destination=CryptoPrimitiveAlgorithmFamilyCustom  # Reference to a customer specific algorithm family custom container
          symbolic name reference CsmJobKeyExchangeCalcPubValAlgorithmSecondaryFamilyCustomRef [0..1]: multiplicity set at pre-compile, set at pre-compile, requires-symbolic-name-value=true, destination=CryptoPrimitiveAlgorithmFamilyCustom  # Reference to a customer specific algorithm family container in the Crypto Driver
          symbolic name reference CsmJobKeyExchangeCalcPubValAlgorithmModeCustomRef [0..1]: multiplicity set at pre-compile, set at pre-compile, requires-symbolic-name-value=true, destination=CryptoPrimitiveAlgorithmModeCustom  # Reference to a customer specific algorithm mode custom container
      container CsmJobKeyExchangeCalcSecret [0..1]: multiplicity set at pre-compile  # Configurations of KeyExchangeCalcSecret primitives
        container CsmJobKeyExchangeCalcSecretConfig: multiplicity set at pre-compile  # Container for configuration of a CSM JobKeyExchangeCalcSecret. The container name serves as a symbolic name for the identifier of a JobKeyExchangeCalcSecret configuration.
          enumeration CsmJobKeyExchangeCalcSecretAlgorithmFamiliy: {CRYPTO_ALGOFAM_CUSTOM, CRYPTO_ALGOFAM_DH, CRYPTO_ALGOFAM_ECDH, CRYPTO_ALGOFAM_RSA}, multiplicity set at pre-compile, origin=Vector Informatik, set at pre-compile  # Not used. Determines the algorithm family used for the crypto service. This parameter defines the most significant part of the algorithm.
          enumeration CsmJobKeyExchangeCalcSecretAlgorithmFamily: {CRYPTO_ALGOFAM_CUSTOM, CRYPTO_ALGOFAM_DH, CRYPTO_ALGOFAM_ECDH, CRYPTO_ALGOFAM_RSA}, multiplicity set at pre-compile, set at pre-compile  # Determines the algorithm family used for the crypto service. This parameter defines the most significant part of the algorithm.
          string CsmJobKeyExchangeCalcSecretAlgorithmFamilyCustom [0..1]: multiplicity set at pre-compile, set at pre-compile  # Name of the custom algorithm family used for the crypto service. | This is the name of the custom algorithm family, if CRYPTO_ALGOFAM_CUSTOM is used.
          enumeration CsmJobKeyExchangeCalcSecretAlgorithmMode: {CRYPTO_ALGOMODE_CUSTOM, CRYPTO_ALGOMODE_NOT_SET}, multiplicity set at pre-compile, set at pre-compile, default-value=CRYPTO_ALGOMODE_NOT_SET  # Determines the algorithm mode used for the crypto service
          string CsmJobKeyExchangeCalcSecretAlgorithmModeCustom [0..1]: multiplicity set at pre-compile, set at pre-compile  # Name of the custom primitive mode.
          enumeration CsmJobKeyExchangeCalcSecretAlgorithmSecondaryFamily: {CRYPTO_ALGOFAM_CUSTOM, CRYPTO_ALGOFAM_ECCANSI, CRYPTO_ALGOFAM_ECCNIST, CRYPTO_ALGOFAM_ECCSEC, CRYPTO_ALGOFAM_NOT_SET, CRYPTO_ALGOFAM_X25519}, multiplicity set at pre-compile, set at pre-compile, default-value=CRYPTO_ALGOFAM_NOT_SET  # Determines the algorithm family used for the crypto service.
          string CsmJobKeyExchangeCalcSecretAlgorithmSecondaryFamilyCustom [0..1]: multiplicity set at pre-compile, set at pre-compile  # This is the second name of the custom algorithm family, if CRYPTO_ALGOFAM_CUSTOM is used.
          symbolic name reference CsmJobKeyExchangeCalcSecretAlgorithmFamilyCustomRef [0..1]: multiplicity set at pre-compile, set at pre-compile, requires-symbolic-name-value=true, destination=CryptoPrimitiveAlgorithmFamilyCustom  # Reference to a customer specific algorithm family custom container
          symbolic name reference CsmJobKeyExchangeCalcSecretAlgorithmSecondaryFamilyCustomRef [0..1]: multiplicity set at pre-compile, set at pre-compile, requires-symbolic-name-value=true, destination=CryptoPrimitiveAlgorithmFamilyCustom  # Reference to a customer specific algorithm family container in the Crypto Driver
          symbolic name reference CsmJobKeyExchangeCalcSecretAlgorithmModeCustomRef [0..1]: multiplicity set at pre-compile, set at pre-compile, requires-symbolic-name-value=true, destination=CryptoPrimitiveAlgorithmModeCustom  # Reference to a customer specific algorithm mode custom container
      container CsmJobKeyDerive [0..1]: multiplicity set at pre-compile  # Configurations of KeyDerive primitives
        container CsmJobKeyDeriveConfig: multiplicity set at pre-compile  # Container for configuration of a CSM key derive operation. The container name serves as a symbolic name for the identifier of a key derive configuration.
          enumeration CsmJobKeyDeriveAlgorithmFamiliy: {CRYPTO_ALGOFAM_CUSTOM, CRYPTO_ALGOFAM_HKDF, CRYPTO_ALGOFAM_KDFX963, CRYPTO_ALGOFAM_PBKDF2}, multiplicity set at pre-compile, origin=Vector Informatik, set at pre-compile  # Not used. Determines the algorithm family used for the crypto service. This parameter defines the most significant part of the algorithm.
          enumeration CsmJobKeyDeriveAlgorithmFamily: {CRYPTO_ALGOFAM_CUSTOM, CRYPTO_ALGOFAM_HKDF, CRYPTO_ALGOFAM_KDFX963, CRYPTO_ALGOFAM_PBKDF2}, multiplicity set at pre-compile, set at pre-compile  # Determines the algorithm family used for the crypto service. This parameter defines the most significant part of the algorithm.
          enumeration CsmJobKeyDeriveAlgorithmMode: {CRYPTO_ALGOMODE_CMAC, CRYPTO_ALGOMODE_CTRDRBG, CRYPTO_ALGOMODE_CUSTOM, CRYPTO_ALGOMODE_GMAC, CRYPTO_ALGOMODE_HMAC, CRYPTO_ALGOMODE_NOT_SET, CRYPTO_ALGOMODE_SIPHASH_2_4, CRYPTO_ALGOMODE_SIPHASH_4_8}, multiplicity set at pre-compile, set at pre-compile, default-value=CRYPTO_ALGOMODE_NOT_SET  # Determines the algorithm mode used for the crypto service
          string CsmJobKeyDeriveAlgorithmModeCustom [0..1]: multiplicity set at pre-compile, set at pre-compile  # Name of the custom algorithm mode used for the crypto service.
          enumeration CsmJobKeyDeriveAlgorithmSecondaryFamily: {CRYPTO_ALGOFAM_BLAKE_1_256, CRYPTO_ALGOFAM_BLAKE_1_512, CRYPTO_ALGOFAM_BLAKE_2s_256, CRYPTO_ALGOFAM_BLAKE_2s_512, CRYPTO_ALGOFAM_CUSTOM, CRYPTO_ALGOFAM_NOT_SET, CRYPTO_ALGOFAM_RIPEMD160, CRYPTO_ALGOFAM_SHA1, CRYPTO_ALGOFAM_SHA2_224, CRYPTO_ALGOFAM_SHA2_256, CRYPTO_ALGOFAM_SHA2_384, CRYPTO_ALGOFAM_SHA2_512, CRYPTO_ALGOFAM_SHA2_512_224, CRYPTO_ALGOFAM_SHA2_512_256, CRYPTO_ALGOFAM_SHA3_224, CRYPTO_ALGOFAM_SHA3_256, CRYPTO_ALGOFAM_SHA3_384, CRYPTO_ALGOFAM_SHA3_512, CRYPTO_ALGOFAM_SHA3_SHAKE128, CRYPTO_ALGOFAM_SHA3_SHAKE256, CRYPTO_ALGOFAM_SHAKE128, CRYPTO_ALGOFAM_SHAKE256}, multiplicity set at pre-compile, set at pre-compile, default-value=CRYPTO_ALGOFAM_NOT_SET  # Determines the algorithm family used for the crypto service.
          string CsmJobKeyDeriveAlgorithmFamilyCustom [0..1]: multiplicity set at pre-compile, origin=Vector Informatik, set at pre-compile  # Name of the custom algorithm family used for the crypto service. | This is the name of the custom algorithm family, if CRYPTO_ALGOFAM_CUSTOM is used.
          string CsmJobKeyDeriveAlgorithmSecondaryFamilyCustom [0..1]: multiplicity set at pre-compile, origin=Vector Informatik, set at pre-compile  # This is the second name of the custom algorithm family, if CRYPTO_ALGOFAM_CUSTOM is used.
          symbolic name reference CsmJobKeyDeriveAlgorithmFamilyCustomRef [0..1]: multiplicity set at pre-compile, set at pre-compile, requires-symbolic-name-value=true, destination=CryptoPrimitiveAlgorithmFamilyCustom  # Reference to a customer specific algorithm family custom container
          symbolic name reference CsmJobKeyDeriveAlgorithmSecondaryFamilyCustomRef [0..1]: multiplicity set at pre-compile, set at pre-compile, requires-symbolic-name-value=true, destination=CryptoPrimitiveAlgorithmFamilyCustom  # Reference to a customer specific algorithm family container in the Crypto Driver
          symbolic name reference CsmJobKeyDeriveAlgorithmModeCustomRef [0..1]: multiplicity set at pre-compile, set at pre-compile, requires-symbolic-name-value=true, destination=CryptoPrimitiveAlgorithmModeCustom  # Reference to a customer specific algorithm mode custom container
      container CsmJobRandomSeed [0..1]: multiplicity set at pre-compile  # Configurations of RandomSeed primitives
        container CsmJobRandomSeedConfig: multiplicity set at pre-compile  # Container for configuration of a CSM random seed operation. The container name serves as a symbolic name for the identifier of a random seed configuration.
          string CsmJobRandomSeedAlgorithmFamilyCustom [0..1]: multiplicity set at pre-compile, set at pre-compile  # Name of the custom algorithm family used for the crypto service. This is the name of the custom algorithm family, if CRYPTO_ALGOFAM_CUSTOM is used.
          enumeration CsmJobRandomSeedAlgorithmMode: {CRYPTO_ALGOMODE_CMAC, CRYPTO_ALGOMODE_CTRDRBG, CRYPTO_ALGOMODE_CUSTOM, CRYPTO_ALGOMODE_GMAC, CRYPTO_ALGOMODE_HMAC, CRYPTO_ALGOMODE_NOT_SET, CRYPTO_ALGOMODE_SIPHASH_2_4, CRYPTO_ALGOMODE_SIPHASH_4_8}, multiplicity set at pre-compile, set at pre-compile, default-value=CRYPTO_ALGOMODE_NOT_SET  # Determines the algorithm mode used for the crypto service
          string CsmJobRandomSeedAlgorithmModeCustom [0..1]: multiplicity set at pre-compile, set at pre-compile  # Name of the custom algorithm mode used for the crypto service. This is the name of the custom algorithm family, if CRYPTO_ALGOFAM_CUSTOM is used.
          enumeration CsmJobRandomSeedAlgorithmSecondaryFamily: {CRYPTO_ALGOFAM_3DES, CRYPTO_ALGOFAM_AES, CRYPTO_ALGOFAM_BLAKE_1_256, CRYPTO_ALGOFAM_BLAKE_1_512, CRYPTO_ALGOFAM_BLAKE_2s_256, CRYPTO_ALGOFAM_BLAKE_2s_512, CRYPTO_ALGOFAM_CHACHA, CRYPTO_ALGOFAM_CUSTOM, CRYPTO_ALGOFAM_NOT_SET, CRYPTO_ALGOFAM_RIPEMD160, CRYPTO_ALGOFAM_SHA1, CRYPTO_ALGOFAM_SHA2_224, CRYPTO_ALGOFAM_SHA2_256, CRYPTO_ALGOFAM_SHA2_384, CRYPTO_ALGOFAM_SHA2_512, CRYPTO_ALGOFAM_SHA2_512_224, CRYPTO_ALGOFAM_SHA2_512_256, CRYPTO_ALGOFAM_SHA3_224, CRYPTO_ALGOFAM_SHA3_256, CRYPTO_ALGOFAM_SHA3_384, CRYPTO_ALGOFAM_SHA3_512, CRYPTO_ALGOFAM_SHA3_SHAKE128, CRYPTO_ALGOFAM_SHA3_SHAKE256, CRYPTO_ALGOFAM_SHAKE128, CRYPTO_ALGOFAM_SHAKE256}, multiplicity set at pre-compile, set at pre-compile, default-value=CRYPTO_ALGOFAM_NOT_SET  # Determines the algorithm family used for the crypto service.
          string CsmJobRandomSeedAlgorithmSecondaryFamilyCustom [0..1]: multiplicity set at pre-compile, set at pre-compile  # Name of the custom secondary algorithm family used for the crypto service. This is the second name of the custom algorithm family, if CRYPTO_ALGOFAM_CUSTOM is used.
          enumeration CsmRandomSeedAlgorithmFamily: {CRYPTO_ALGOFAM_3DES, CRYPTO_ALGOFAM_AES, CRYPTO_ALGOFAM_BLAKE_1_256, CRYPTO_ALGOFAM_BLAKE_1_512, CRYPTO_ALGOFAM_BLAKE_2s_256, CRYPTO_ALGOFAM_BLAKE_2s_512, CRYPTO_ALGOFAM_CHACHA, CRYPTO_ALGOFAM_CUSTOM, CRYPTO_ALGOFAM_RIPEMD160, CRYPTO_ALGOFAM_RNG, CRYPTO_ALGOFAM_SHA1, CRYPTO_ALGOFAM_SHA2_224, CRYPTO_ALGOFAM_SHA2_256, CRYPTO_ALGOFAM_SHA2_384, CRYPTO_ALGOFAM_SHA2_512, CRYPTO_ALGOFAM_SHA2_512_224, CRYPTO_ALGOFAM_SHA2_512_256, CRYPTO_ALGOFAM_SHA3_224, CRYPTO_ALGOFAM_SHA3_256, CRYPTO_ALGOFAM_SHA3_384, CRYPTO_ALGOFAM_SHA3_512, CRYPTO_ALGOFAM_SHA3_SHAKE128, CRYPTO_ALGOFAM_SHA3_SHAKE256, CRYPTO_ALGOFAM_SHAKE128, CRYPTO_ALGOFAM_SHAKE256}, multiplicity set at pre-compile, origin=Vector Informatik, set at pre-compile  # Not used. Determines the algorithm family used for the crypto service. This parameter defines the most significant part of the algorithm.
          enumeration CsmJobRandomSeedAlgorithmFamily: {CRYPTO_ALGOFAM_3DES, CRYPTO_ALGOFAM_AES, CRYPTO_ALGOFAM_BLAKE_1_256, CRYPTO_ALGOFAM_BLAKE_1_512, CRYPTO_ALGOFAM_BLAKE_2s_256, CRYPTO_ALGOFAM_BLAKE_2s_512, CRYPTO_ALGOFAM_CHACHA, CRYPTO_ALGOFAM_CUSTOM, CRYPTO_ALGOFAM_DRBG, CRYPTO_ALGOFAM_EEA3, CRYPTO_ALGOFAM_FIPS186, CRYPTO_ALGOFAM_RIPEMD160, CRYPTO_ALGOFAM_RNG, CRYPTO_ALGOFAM_SHA1, CRYPTO_ALGOFAM_SHA2_224, CRYPTO_ALGOFAM_SHA2_256, CRYPTO_ALGOFAM_SHA2_384, CRYPTO_ALGOFAM_SHA2_512, CRYPTO_ALGOFAM_SHA2_512_224, CRYPTO_ALGOFAM_SHA2_512_256, CRYPTO_ALGOFAM_SHA3_224, CRYPTO_ALGOFAM_SHA3_256, CRYPTO_ALGOFAM_SHA3_384, CRYPTO_ALGOFAM_SHA3_512, CRYPTO_ALGOFAM_SHA3_SHAKE128, CRYPTO_ALGOFAM_SHA3_SHAKE256, CRYPTO_ALGOFAM_SHAKE128, CRYPTO_ALGOFAM_SHAKE256, CRYPTO_ALGOFAM_SM3}, multiplicity set at pre-compile, set at pre-compile  # Determines the algorithm family used for the crypto service. This parameter defines the most significant part of the algorithm.
          symbolic name reference CsmJobRandomSeedAlgorithmFamilyCustomRef [0..1]: multiplicity set at pre-compile, set at pre-compile, requires-symbolic-name-value=true, destination=CryptoPrimitiveAlgorithmFamilyCustom  # Reference to a customer specific algorithm family custom container
          symbolic name reference CsmJobRandomSeedAlgorithmSecondaryFamilyCustomRef [0..1]: multiplicity set at pre-compile, set at pre-compile, requires-symbolic-name-value=true, destination=CryptoPrimitiveAlgorithmFamilyCustom  # Reference to a customer specific algorithm family container in the Crypto Driver
          symbolic name reference CsmJobRandomSeedAlgorithmModeCustomRef [0..1]: multiplicity set at pre-compile, set at pre-compile, requires-symbolic-name-value=true, destination=CryptoPrimitiveAlgorithmModeCustom  # Reference to a customer specific algorithm mode custom container
      container CsmJobKeyGenerate [0..1]: multiplicity set at pre-compile  # Configurations of KeyGenerate primitives
        container CsmJobKeyGenerateConfig: multiplicity set at pre-compile  # Container for configuration of a CSM key generate operation. The container name serves as a symbolic name for the identifier of a key generate configuration.
          enumeration CsmJobKeyGenerateAlgorithmFamiliy: {CRYPTO_ALGOFAM_CUSTOM, CRYPTO_ALGOFAM_ECCANSI, CRYPTO_ALGOFAM_ECCNIST, CRYPTO_ALGOFAM_ECCSEC, CRYPTO_ALGOFAM_ECDH, CRYPTO_ALGOFAM_ED25519, CRYPTO_ALGOFAM_X25519}, multiplicity set at pre-compile, origin=Vector Informatik, set at pre-compile  # Not used. Determines the algorithm family used for the crypto service. This parameter defines the most significant part of the algorithm.
          enumeration CsmJobKeyGenerateAlgorithmFamily: {CRYPTO_ALGOFAM_CUSTOM, CRYPTO_ALGOFAM_ECCANSI, CRYPTO_ALGOFAM_ECCNIST, CRYPTO_ALGOFAM_ECCSEC, CRYPTO_ALGOFAM_ECDH, CRYPTO_ALGOFAM_ED25519, CRYPTO_ALGOFAM_X25519}, multiplicity set at pre-compile, set at pre-compile  # Determines the algorithm family used for the crypto service. This parameter defines the most significant part of the algorithm.
          enumeration CsmJobKeyGenerateAlgorithmMode: {CRYPTO_ALGOMODE_CUSTOM, CRYPTO_ALGOMODE_NOT_SET}, multiplicity set at pre-compile, set at pre-compile, default-value=CRYPTO_ALGOMODE_NOT_SET  # Determines the algorithm mode used for the crypto service
          string CsmJobKeyGenerateAlgorithmModeCustom [0..1]: multiplicity set at pre-compile, set at pre-compile  # Name of the custom algorithm mode used for the crypto service.
          enumeration CsmJobKeyGenerateAlgorithmSecondaryFamily: {CRYPTO_ALGOFAM_CUSTOM, CRYPTO_ALGOFAM_NOT_SET}, multiplicity set at pre-compile, set at pre-compile, default-value=CRYPTO_ALGOFAM_NOT_SET  # Determines the algorithm family used for the crypto service.
          string CsmJobKeyGenerateAlgorithmFamilyCustom [0..1]: multiplicity set at pre-compile, origin=Vector Informatik, set at pre-compile  # Name of the custom algorithm family used for the crypto service. | This is the name of the custom algorithm family, if CRYPTO_ALGOFAM_CUSTOM is used.
          string CsmJobKeyGenerateAlgorithmSecondaryFamilyCustom [0..1]: multiplicity set at pre-compile, origin=Vector Informatik, set at pre-compile  # This is the second name of the custom algorithm family, if CRYPTO_ALGOFAM_CUSTOM is used.
          symbolic name reference CsmJobKeyGenerateAlgorithmFamilyCustomRef [0..1]: multiplicity set at pre-compile, set at pre-compile, requires-symbolic-name-value=true, destination=CryptoPrimitiveAlgorithmFamilyCustom  # Reference to a customer specific algorithm family custom container
          symbolic name reference CsmJobKeyGenerateAlgorithmSecondaryFamilyCustomRef [0..1]: multiplicity set at pre-compile, set at pre-compile, requires-symbolic-name-value=true, destination=CryptoPrimitiveAlgorithmFamilyCustom  # Reference to a customer specific algorithm family container in the Crypto Driver
          symbolic name reference CsmJobKeyGenerateAlgorithmModeCustomRef [0..1]: multiplicity set at pre-compile, set at pre-compile, requires-symbolic-name-value=true, destination=CryptoPrimitiveAlgorithmModeCustom  # Reference to a customer specific algorithm mode custom container
      container CsmJobCertificateParse [0..1]: multiplicity set at pre-compile  # Configurations of CertificateParse primitives
        container CsmJobCertificateParseConfig: multiplicity set at pre-compile  # Container for configuration of a CSM CsmJobCertificateParse. The container name serves as a symbolic name for the identifier of a key configuration.
          string CsmJobCertificateParseAlgorithmFamilyCustom [0..1]: multiplicity set at pre-compile, set at pre-compile  # This is the name of the custom algorithm family, if CRYPTO_ALGOFAM_CUSTOM is used.
          enumeration CsmJobCertificateParseAlgorithmMode: {CRYPTO_ALGOMODE_CUSTOM, CRYPTO_ALGOMODE_NOT_SET}, multiplicity set at pre-compile, set at pre-compile, default-value=CRYPTO_ALGOMODE_NOT_SET  # Determines the algorithm mode used for the crypto service
          string CsmJobCertificateParseAlgorithmModeCustom [0..1]: multiplicity set at pre-compile, set at pre-compile  # Name of the custom primitive mode.
          enumeration CsmJobCertificateParseAlgorithmSecondaryFamily: {CRYPTO_ALGOFAM_CUSTOM, CRYPTO_ALGOFAM_NOT_SET}, multiplicity set at pre-compile, set at pre-compile, default-value=CRYPTO_ALGOFAM_NOT_SET  # Determines the algorithm family used for the crypto service.
          string CsmJobCertificateParseAlgorithmSecondaryFamilyCustom [0..1]: multiplicity set at pre-compile, set at pre-compile  # This is the second name of the custom algorithm family, if CRYPTO_ALGOFAM_CUSTOM is used.
          integer CsmJobCertificateParseDataMaxLength [0..1]: 1..4294967295, multiplicity set at pre-compile, set at pre-compile  # Max size of the input data length in bytes
      container CsmJobCertificateVerify [0..1]: multiplicity set at pre-compile  # Configurations of CertificateVerify primitves
        container CsmJobCertificateVerifyConfig: multiplicity set at pre-compile  # Container for configuration of a CSM CsmJobCertificateVerify. The container name serves as a symbolic name for the identifier of a key configuration.
          enumeration CsmJobCertificateVerifyAlgorithmFamiliy: {CRYPTO_ALGOFAM_CUSTOM}, multiplicity set at pre-compile, set at pre-compile  # Not used. Determines the algorithm family used for the crypto service. This parameter defines the most significant part of the algorithm.
          string CsmJobCertificateVerifyAlgorithmFamilyCustom [0..1]: multiplicity set at pre-compile, set at pre-compile  # This is the name of the custom algorithm family, if CRYPTO_ALGOFAM_CUSTOM is used.
          enumeration CsmJobCertificateVerifyAlgorithmMode: {CRYPTO_ALGOMODE_CUSTOM, CRYPTO_ALGOMODE_NOT_SET}, multiplicity set at pre-compile, set at pre-compile, default-value=CRYPTO_ALGOMODE_NOT_SET  # Determines the algorithm mode used for the crypto service
          string CsmJobCertificateVerifyAlgorithmModeCustom [0..1]: multiplicity set at pre-compile, set at pre-compile  # Name of the custom primitive mode.
          enumeration CsmJobCertificateVerifyAlgorithmSecondaryFamily: {CRYPTO_ALGOFAM_CUSTOM, CRYPTO_ALGOFAM_NOT_SET}, multiplicity set at pre-compile, set at pre-compile, default-value=CRYPTO_ALGOFAM_NOT_SET  # Determines the algorithm family used for the crypto service.
          string CsmJobCertificateVerifyAlgorithmSecondaryFamilyCustom [0..1]: multiplicity set at pre-compile, set at pre-compile  # This is the second name of the custom algorithm family, if CRYPTO_ALGOFAM_CUSTOM is used.
          integer CsmJobCertificateVerifyDataMaxLength [0..1]: 1..4294967295, multiplicity set at pre-compile, set at pre-compile  # Max size of the input data length in bytes
    container CsmQueues [0..1]: multiplicity set at pre-compile  # Container for CSM queue configurations
      container CsmQueue [1..*]: multiplicity set at pre-compile  # Container for configuration of a CSM queue. The container name serves as a symbolic name for the identifier of a queue configuration. | A queue has two tasks: 1. queue jobs which cannot be processed since the underlying hardware is busy and 2. refer to channel which shall be used
        integer CsmQueueSize: 1..4294967295, multiplicity set at pre-compile, set at pre-compile, default-value=1  # Size of the CsmQueue. If jobs cannot be processed by the underlying hardware since the hardware is busy, the jobs stay in the prioritized queue. If the queue is full, the next job will be rejected.
        boolean CsmTriggerAsynchJobsInCallback: multiplicity set at pre-compile, origin=Vector Informatik, set at pre-compile, default-value=false  # If enabled, jobs will be triggered (given to the CryIf for processing) directly if the CryIf notifies the Csm that the last job was finished. Both is handled in the Csm_CallbackNotification(). If not enabled, the next job will be given to the CryIf for processing in the next mainfunction cycle.
        boolean CsmJobSharing: multiplicity set at pre-compile, origin=Vector Informatik, set at pre-compile, default-value=true  # If enabled, Csm will use shared job objects per queue instead of reserving an own job object for each configured job. This highly reduces the amount of needed RAM but increases the runtime due to setting up the complete job with every usage. The Csm will reserve the following amount of job objects: 1 for all synchronous jobs of the queue (if there are any) Queue size + 1 for all asynchronous jobs (if there are any) This means the queue of the Csm can be filled completely while one job is currenlty processed by the crypto driver object. If the crypto driver object which handles the job of this queue also implements a queing mechanism, either increase the queue size of Csm accordingly to get the necessary amount of job objects, or deactivate the job sharing.
        symbolic name reference CsmChannelRef: multiplicity set at pre-compile, set at pre-compile, requires-symbolic-name-value=true, destination=CryIfChannel  # Refers to the underlying Crypto Interface channel. Violation: Ref Target points currently to CryIf/CryIfKeys/CryIfKey instead of CryIf/CryIfChannel as defined in ASR 4.3
    container CsmCallouts [0..1]: multiplicity set at pre-compile  # Container for callout function configurations
      container CsmCallout [0..*]: multiplicity set at pre-compile  # Container for configuration of callout functions
        function name CsmPreJobCalloutFunc: multiplicity set at pre-compile, origin=Vector Informatik, set at pre-compile  # Callout function which will be called before the corresponding job is executed.
        function name CsmPostJobCalloutFunc: multiplicity set at pre-compile, origin=Vector Informatik, set at pre-compile  # Callout function which will be called after the corresponding job is executed.
    container CsmInOutRedirections [0..1]: multiplicity set at pre-compile  # Configuration for Csm redirection configurations
      container CsmInOutRedirection [1..*]: multiplicity set at pre-compile  # Container for configuration of a Csm redirection. A redirection lets a Csm job use a specific key element as input or/and output.
        integer CsmInputKeyElementId [0..1]: 0..4294967295, multiplicity set at pre-compile, set at pre-compile  # Identifier of the key element used as input.
        integer CsmSecondaryInputKeyElementId [0..1]: 0..4294967295, multiplicity set at pre-compile, set at pre-compile  # Identifier of the key element used as secondary input.
        integer CsmTertiaryInputKeyElementId [0..1]: 0..4294967295, multiplicity set at pre-compile, set at pre-compile  # Identifier of the key element used as tertiary input.
        integer CsmOutputKeyElementId [0..1]: 0..4294967295, multiplicity set at pre-compile, set at pre-compile  # Identifier of the key element used as output.
        integer CsmSecondaryOutputKeyElementId [0..1]: 0..4294967295, multiplicity set at pre-compile, set at pre-compile  # Identifier of the key element used as secondary output.
        reference CsmInputKeyRef [0..1]: multiplicity set at pre-compile, set at pre-compile, destination=CsmKey  # This parameter refers to the key used as input,
        reference CsmSecondaryInputKeyRef [0..1]: multiplicity set at pre-compile, set at pre-compile, destination=CsmKey  # This parameter refers to the key used as secondary input,
        reference CsmTertiaryInputKeyRef [0..1]: multiplicity set at pre-compile, set at pre-compile, destination=CsmKey  # This parameter refers to the key used as tertiary input,
        reference CsmOutputKeyRef [0..1]: multiplicity set at pre-compile, set at pre-compile, destination=CsmKey  # This parameter refers to the key used as output,
        reference CsmSecondaryOutputKeyRef [0..1]: multiplicity set at pre-compile, set at pre-compile, destination=CsmKey  # This parameter refers to the key used as secondary output.
  bsw implementation Csm_Impl: programming-language=C, sw-version=6.03.00, used-code-generator=DaVinci Configurator, vendor-id=30, ar-release-version=4.04.00, behavior=Behavior, preconfigured-configuration=Csm_Pre, recommended-configuration=Csm_Rec, vendor-specific-module-def=Csm
  module config Csm_Pre: definition=Csm  # Csm pre-configuration
  module config Csm_Rec: definition=Csm  # Csm recommended configuration
