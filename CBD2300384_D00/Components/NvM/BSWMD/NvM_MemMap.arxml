AUTOSAR XML (schema 00048)
# COPYRIGHT
# Copyright (c) 2022 by Vector Informatik GmbH. All rights reserved.
# This software is copyright protected and proprietary to Vector Informatik GmbH.
# Vector Informatik GmbH grants to you only those rights as set out in the license conditions.
package /MICROSAR
  bsw implementation NvM_Impl
    required-artifacts:
      dependency on artifact NvM_MemMap: category=MEMMAP, artifact-descriptor={short-label=NvM_MemMap.h, category=SWHDR}
    resource consumption ResourceConsumption
      14 x memory section:
        NVM_CODE: sw-addrmethod=CODE, symbol=CODE
        NVM_CONST_16: alignment=16, sw-addrmethod=CONST_16, symbol=CONST_16
        NVM_CONST_UNSPECIFIED: alignment=UNSPECIFIED, sw-addrmethod=CONST_UNSPECIFIED, symbol=CONST_UNSPECIFIED
        NVM_VAR_NO_INIT_8: alignment=8, sw-addrmethod=VAR_NO_INIT_8, symbol=VAR_NO_INIT_8
        NVM_VAR_NO_INIT_UNSPECIFIED: alignment=UNSPECIFIED, sw-addrmethod=VAR_NO_INIT_UNSPECIFIED, symbol=VAR_NO_INIT_UNSPECIFIED
        NVM_VAR_CLEARED_UNSPECIFIED: alignment=UNSPECIFIED, sw-addrmethod=VAR_CLEARED_UNSPECIFIED, symbol=VAR_CLEARED_UNSPECIFIED
        NVM_VAR_FAST_NO_INIT_8: alignment=8, sw-addrmethod=VAR_FAST_NO_INIT_8, symbol=VAR_FAST_NO_INIT_8
        NVM_VAR_INTERNAL_BUFFER: alignment=8, sw-addrmethod=VAR_NOCACHE_NO_INIT_8, symbol=VAR_INTERNAL_BUFFER
        NVM_VAR_SHARED_DATA: alignment=UNSPECIFIED, sw-addrmethod=VAR_NOCACHE_CLEARED_UNSPECIFIED, symbol=VAR_SHARED_DATA
        NvM_SWC_CODE: prefix=NvM_Prefix, sw-addrmethod=CODE, symbol=CODE
        NvM_SWC_CONST_UNSPECIFIED: alignment=UNSPECIFIED, prefix=NvM_Prefix, sw-addrmethod=CONST_UNSPECIFIED, symbol=CONST_UNSPECIFIED
        NvM_SWC_VAR_NOINIT_UNSPECIFIED: alignment=UNSPECIFIED, prefix=NvM_Prefix, sw-addrmethod=VAR_NOINIT_UNSPECIFIED, symbol=VAR_NOINIT_UNSPECIFIED
        NvM_SWC_VAR_INIT_UNSPECIFIED: alignment=UNSPECIFIED, prefix=NvM_Prefix, sw-addrmethod=VAR_INIT_UNSPECIFIED, symbol=VAR_INIT_UNSPECIFIED
        NvM_SWC_VAR_ZERO_INIT_UNSPECIFIED: alignment=UNSPECIFIED, prefix=NvM_Prefix, sw-addrmethod=VAR_ZERO_INIT_UNSPECIFIED, symbol=VAR_ZERO_INIT_UNSPECIFIED
      section name prefix NvM_Prefix: symbol=NvM
