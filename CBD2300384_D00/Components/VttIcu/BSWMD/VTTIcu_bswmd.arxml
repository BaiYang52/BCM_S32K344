AUTOSAR XML (schema 4-0-3)
package /MICROSAR/VTT
  bsw implementation VTTIcu_Impl: programming-language=C, sw-version=2.06.00, used-code-generator=cMSR, vendor-id=30, ar-release-version=4.00.03, preconfigured-configuration=VTTIcu_Pre, recommended-configuration=VTTIcu_Rec, vendor-specific-module-def=VTTIcu
  module definition VTTIcu [0..*]: category=VENDOR_SPECIFIC_MODULE_DEFINITION, variants pre-compile  # Input Capture Unit. Icu provides services for demodulation of a PWM signal, counting pulses, measuring of frequenc and duty cycle, generating simple interrupts and also wakeup interrupts. #VTT #Driver #AUTOSAR
    container IcuConfigSet [0..1]: multiple-configuration-container=true  # This container includes the configuration of the IcuChannels.
      integer IcuMaxChannel: 0..65535, set at pre-compile, default-value=0  # This parameter defines the number of channels configured. It will be gathered by tools during the configuration stage. | calculationFormula = Number of configured Icu Channels Implementation Type: Icu_ChannelType
      container IcuChannel [0..50]  # This container includes the configuration of an individual ICU channel.
        integer IcuChannelId: 0..50, set at pre-compile, symbolic-name-value=true, default-value=0  # This parameter defines the channel Id of the ICU channel. This value will be assigned to the symbolic name derived of the IcuChannel container short name.
        enumeration IcuDefaultStartEdge: set at pre-compile, default-value=ICU_RISING_EDGE  # This parameter defines the default-activation-edge which shall be used for this channel if there was no activation-edge configured by the call of service Icu_SetActivationCondition(). In case the Measurement Mode is "IcuSignalMeasurement" and the properties "DutyCycle" or "Period" are set, the edge configured here is used as Default Period Start Edge. ICU_BOTH_EDGES: As default, both edges are use. ICU_FALLING_EDGE: As default, falling edge is the used. ICU_RISING_EDGE: As default, rising edge is the used. | In case the Measurement Mode is "IcuSignalMeasurement" and the properties "DutyCycle" or "Period" are set, the edge configured here is used as Default Period Start Edge. Implementation Type: Icu_ActivationType
          ICU_BOTH_EDGES  # Both Edges
          ICU_FALLING_EDGE  # Falling Edge
          ICU_RISING_EDGE  # Rising Edge
        enumeration IcuMeasurementMode: set at pre-compile, default-value=ICU_MODE_SIGNAL_EDGE_DETECT  # This parameter defines the measurement mode of this channel. ICU_MODE_EDGE_COUNTER: The channel is used to count the edges which are configured by the call of the service Icu_SetActivationCondition(). The following API services support this mode: - Icu_EnableEdgeCount() - Icu_DisableEdgeCount() - Icu_GetEdgeNumbers() - Icu_ResetEdgeCount(). This mode can only be configured if IcuEdgeVountApi is switched on. ICU_MODE_SIGNAL_EDGE_DETECT: The channel is used for detecting the edges which are configured by the call of the service Icu_SetActivationCondition(). The following API services support this mode: - Icu_EnableNotification() - Icu_DisableNotification() - Icu_GetInputState(). ICU_MODE_SIGNAL_MEASUREMENT: The channel is used to measure different times between various configurable edges. The configuration of the period-start edges are done by configuration and cannot be changed during runtime. The following API services support his mode. - Icu_GetTimeElapsed() - Icu_GetDutyCycleValues() - Icu_GetInputState(). This mode can only be configure if at least one of the following switches are true: - IcuGetDutyCycleValuesApi - IcuGetTimeElapsedApi ICU_MODE_TIMESTAMP: The channel is used to capture timer values on the edges which are configured by the call of the service Icu_SetActivationCondition(). The following API services support this mode: - Icu_StartTimestamp() - Icu_StopTimestamp() - Icu_GetTimestampIndex() This mode can only be configured if IcuTimeStampApi is switched on. | Implementation Type: Icu_MeasurementModeType
          ICU_MODE_EDGE_COUNTER  # Edge Counter
          ICU_MODE_SIGNAL_EDGE_DETECT  # Signal Edge Detection
          ICU_MODE_SIGNAL_MEASUREMENT  # Signal Measurement
          ICU_MODE_TIMESTAMP  # Timestamp
        boolean IcuWakeupCapability: set at pre-compile, default-value=false  # This parameter defines the information about the wakeup-capability of this channel. True: Channel is wakeup capable. False: Channel is not wakeup capable. | true: Channel is wakeup capable. false: Channel is not wakeup capable.
        container IcuSignalEdgeDetection [0..1]  # This container includes the configuration (parameters) in case the measurement mode is "IcuSignalEdgeDetection".
          function name IcuSignalNotification [0..1]: set at pre-compile  # This parameter defines the notification function for signal notification. If no notification should be called for signal notification, please use one of the following capabilities: - Delete the parameter IcuSignalNotification - Leave the parameter empty - Configure the parameter with "NULL_PTR" If the parameter has an invalid expression, the behaviour is undefined. In case of an invalid synchronization from the real target, the parameter has to be set user defined and one of the capabilities above should be followed.
        container IcuSignalMeasurement [0..1]  # This container includes the configuration (parameters) in case the measurement mode is "IcuSignalMeasurement".
          enumeration IcuSignalMeasurementProperty: set at pre-compile  # This parameter defines the property that could be measured in case the mode is "IcuSignalMeasurement". ICU_ACTIVE_TIME: The channel is configured for reading the elapsed Signal Active Time ICU_DUTY_CYCLE: The channel is configured to read values which are needed for calculating the duty cyle (coherent Active and Period Time). ICU_HIGH_TIME: The channel is configured for reading the eapsed Signal High Time. ICU_LOW_TIME: The channel is configured for reading the elapsed Signal Low Time. ICU_PERIOD_TIME: The channel is configured for reading the elapsed Signal Period Time. | This property can not be changed during runtime. Implementation Type: Icu_SignalMeasurementPropertyType
            ICU_ACTIVE_TIME  # Active Time
            ICU_DUTY_CYCLE  # Duty Cycle
            ICU_HIGH_TIME  # High Time
            ICU_LOW_TIME  # Low Time
            ICU_PERIOD_TIME  # Period Time
        container IcuTimestampMeasurement [0..1]  # This container includes the configuration (parameters) in case the measurement mode is "IcuTimestamp".
          enumeration IcuTimestampMeasurementProperty: set at pre-compile  # This parameter defines the handling of the buffer in case the mode is "Timestamp". ICU_CIRCULAR_BUFFER: After reaching the end of the buffer, the driver restarts at the beginning of the buffer. ICU_LINEAR_BUFFER: The buffer will just be filled once. | Implementation Type: Icu_TimestampBufferType
            ICU_CIRCULAR_BUFFER  # Circular Buffer
            ICU_LINEAR_BUFFER  # Linear Buffer
          function name IcuTimestampNotification [0..1]: set at pre-compile  # This parameter defines the notification function if the number of requested timestamps are acquired. If no notification should be called if the number of requested timestamps are acquired, please use one of the following capabilities: - Delete the parameter IcuTimestampNotification - Leave the parameter empty - Configure the parameter with "NULL_PTR" If the parameter has an invalid expression, the behaviour is undefined. In case of an invalid synchronization from the real target, the parameter has to be set user defined and one of the capabilities above should be followed. | (Notification interval > 0) are acquired.
        container IcuWakeup [0..1]  # This container includes the configuration (parameters) needed to configure a wakeup capable channel.
          symbolic name reference IcuChannelWakeupInfo [0..1]: set at pre-compile, destination=EcuMWakeupSource  # Reference to ECU State Manager. If the wakeup-capability is true the wakeup source referenced is transmitted to the ECU State Manager (EcuM) . | Implementation Type: reference to EcuM_WakeupSourceType
    container IcuGeneral  # General configuration parameteres of the ICU module.
      boolean IcuDevErrorDetect: set at pre-compile, default-value=true  # This parameter switches the Development Error Detection and Notification ON or OFF. True: Development error detection is enabled. False: Development error detection is disabeld. Note: In general, the development error detection is recommended during pre-test phase. It is not recommended to enable the development error detection in production code due to increased runtime and ROM needs. | on or off. true: Enabled. false: Disabled.
      integer IcuIndex: 0..0, set at pre-compile, default-value=0  # This parameter defines the InstanceId of this module instance. If only one instance is present it shall have the Id 0.
      boolean IcuReportWakeupSource: set at pre-compile, default-value=false  # This parameter defines whether wakeup source reporting is enabled or disabled. True: Wakeup source reporting is enabled. False: Wakeup source reporting is disabled. | true: Report Wakeup source. false: Do not report Wakeup source.
      boolean IcuSafeBswChecks: set at pre-compile, origin=Vector Informatik, default-value=false  # Selects if safety checks are used. These checks improve robustness as e.g. invalid parameters are checked before function is executed. This attribute has to be enabled for safety projects where this component is mapped to an ASIL partition.
      string IcuPrefix [0..1]: set at pre-compile, origin=Vector Informatik, max-length=255, min-length=0  # Icu Prefix | This parameter can be used to overwrite the "ModuleName", “Vendor-ID” and “API-Infix” attributes of the real component, if necessary. Example: In general the implementation specific API name is specified as: <ModuleName>_<vendorId>_<vendorApiInfix>_<API name of module> This parameter overwrites the whole parenthesis <ModuleName>_<vendorId>_<vendorApiInfix>.
    container IcuOptionalApis  # This container includes all configuration switches for configuring optional API services of the ICU driver.
      boolean IcuDeInitApi: set at pre-compile, default-value=true  # This parameter defines whether the function Icu_DeInit() is enabled or disabled. True: API Icu_DeInit() is supported (function provided) False: API Icu_DeInit() is not supported (function not provided) | true: Icu_DeInit() can be used. false: Icu_DeInit() can not be used.
      boolean IcuDisableWakeupApi: set at pre-compile, default-value=true  # This parameter defines whether the function Icu_DisableWakeup() is enabled or disabled. True: API Icu_DisableWakeup() is supported (function provided) False: API Icu_DisableWakeup() is not supported (function not provided) | true: Icu_DisableWakeup() can be used. false: Icu_DisableWakeup() can not be used.
      boolean IcuEdgeCountApi: set at pre-compile, default-value=true  # This parameter defines whether the function Icu_ResetEdgeCount(), Icu_EnableEdgeCount(), Icu_DisableEdgeCount() and Icu_GetEdgeNumbers() are enabled or disabled. True: APIs Icu_ResetEdgeCount(), Icu_EnableEdgeCount(), Icu_DisableEdgeCount() and Icu_GetEdgeNumbers() are supported (function provided) False: APIs Icu_ResetEdgeCount(), Icu_EnableEdgeCount(), Icu_DisableEdgeCount() and Icu_GetEdgeNumbers() are not supported (function not provided) | true: The services listed above can be used. false: The services listed above can not be used.
      boolean IcuEdgeDetectApi: set at pre-compile, default-value=true  # This parameter defines whether the functions Icu_EnableEdgeDetection() and Icu_DisableEdgeDetection() are enabled or disabled. True: API Icu_EnableEdgeDetection() and Icu_DisableEdgeDetection() are supported (functions provided) False: API Icu_EnableEdgeDetection() and Icu_DisableEdgeDetection() are not supported (functions not provided) | Icu_EnableEdgeDetection() and Icu_DisableEdgeDetection(). true: These services can be used. false: These services can not be used.
      boolean IcuEnableWakeupApi: set at pre-compile, default-value=true  # This parameter defines whether the function Icu_EnableWakeup() is enabled or disabled. True: API Icu_EnableWakeup() is supported (function provided) False: API Icu_EnableWakeup() is not supported (function not provided) | true: Icu_EnableWakeup() can be used. false: Icu_EnableWakeup() can not be used.
      boolean IcuGetDutyCycleValuesApi: set at pre-compile, default-value=true  # This parameter defines whether the function Icu_GetDutyCycleValues() is enabled or disabled. True: API Icu_GetDutyCycleValues() is supported (function provided) False: API Icu_GetDutyCycleValues() is not supported (function not provided) | true: Icu_GetDutyCycleValues() can be used. false: Icu_GetDutyCycleValues() can not be used.
      boolean IcuGetInputStateApi: set at pre-compile, default-value=true  # This parameter defines whether the function Icu_GetInputState() is enabled or disabled. True: API Icu_GetInputState() is supported (function provided) False: API Icu_GetInputState() is not supported (function not provided) | true: Icu_GetInputState() can be used. false: Icu_GetInputState() can not be used.
      boolean IcuGetTimeElapsedApi: set at pre-compile, default-value=true  # This parameter defines whether the function Icu_GetTimeElapsed() is enabled or disabled. True: API Icu_GetTimeElapsed() is supported (function provided) False: API Icu_GetTimeElapsed() is not supported (function not provided) | true: Icu_GetTimeElapsed() can be used. false: Icu_GetTimeElapsed() can not be used.
      boolean IcuGetVersionInfoApi: set at pre-compile, default-value=false  # This parameter enables/disables the function Icu_GetVersionInfo() to get major, minor and patch version information. | true: Icu_GetVersionInfo() can be used. false: Icu_GetVersionInfo() can not be used.
      boolean IcuSetModeApi: set at pre-compile, default-value=true  # This parameter defines whether the function Icu_SetMode() is enabled or disabled. True: API Icu_SetMode() is supported (function provided) False: API Icu_SetMode() is not supported (function not provided) | true: Icu_SetMode() can be used. false: Icu_SetMode() can not be used.
      boolean IcuSignalMeasurementApi: set at pre-compile, default-value=true  # This parameter defines whether the functions Icu_StartSignalMeasurement() and Icu_StopSignalMeasurement() are enabled or disabled. True: APIs Icu_StartSignalMeasurement() and Icu_StopSignalMeasurement() are supported (functions provided) False: APIs Icu_StartSignalMeasurement() and Icu_StopSignalMeasurement() are not supported (functions not provided) | true: Icu_StartSignalMeasurement() and Icu_StopSignalMeasurement() can be used. false: Icu_StartSignalMeasurement() and Icu_StopSignalMeasurement() can not be used.
      boolean IcuTimestampApi: set at pre-compile, default-value=true  # This parameter defines whether the functions Icu_StartTimestamp(), Icu_StopTimestamp() and Icu_GetTimestampIndex() are enabled or disabled. True: APIs Icu_StartTimestamp(), Icu_StopTimestamp() and Icu_GetTimestampIndex() are supported (functions provided) False: APIs Icu_StartTimestamp(), Icu_StopTimestamp() and Icu_GetTimestampIndex() are not supported (functions not provided) | true: The services listed above can be used. false: The services listed above can not be used.
      boolean IcuWakeupFunctionalityApi: set at pre-compile, default-value=false  # This parameter defines whether the function Icu_CheckWakeup() is enabled or disabled. True: API Icu_CheckWakeup() is supported (function provided) False: API Icu_CheckWakeup() is not supported (function not provided) | true: Icu_CheckWakeup() can be used. false: Icu_CheckWakeup() cannot be used.
  module config VTTIcu_Pre: definition=VTTIcu, implementation-config-variant=VARIANT-PRE-COMPILE
  module config VTTIcu_Rec: definition=VTTIcu, implementation-config-variant=VARIANT-PRE-COMPILE
