AUTOSAR XML (schema 4-0-3)
package /MICROSAR/VTT
  bsw implementation VTTDio_Impl: programming-language=C, sw-version=2.05.00, used-code-generator=cMSR, vendor-id=30, ar-release-version=4.00.03, preconfigured-configuration=VTTDio_Pre, recommended-configuration=VTTDio_Rec, vendor-specific-module-def=VTTDio
  module definition VTTDio [0..1]: category=VENDOR_SPECIFIC_MODULE_DEFINITION, variants pre-compile  # Digital Input Output. DIO reads from/writes to digital I/Os (pins and ports) of the microcontroller. #VTT #Driver #AUTOSAR
    container DioConfig [0..1]  # This container includes the configuration parameters and sub containers of the AUTOSAR DIO module. This container is a MultipleConfigurationContainer, i.e. this container and its sub-containers exist once per configuration set.
      container DioPort [0..*]  # This container includes the configuration of individual DIO ports, consisting of channels and possible channel groups. | Note that this container definition does not explicitly define a symbolic name parameter. Instead, the container's short name will be used in the Ecu Configuration Description to specify the symbolic name of the port.
        integer DioPortId: 0..4294967295, set at pre-compile, symbolic-name-value=true, default-value=0  # Parameter not used. This parameter defines the numeric identifier of the DIO port. Not all MCU ports may be used for DIO, thus there may be "gaps" in the list of all IDs. This value will be assigned to the DIO port symbolic name (i.e. the SHORTNAME of the DioPort container). | assigned to the DIO port symbolic name (i.e. the SHORT-NAME of the DioPort container).
        container DioChannel [0..*]  # This container includes the configuration of an individual DIO channel. Besides a HW specific channel name which is typically fixed for a specific micro controller, additional symbolic names can be defined per channel. | Note hat this container definition does not explicitly define a symbolic name parameter. Instead, the container's short name will be used in the Ecu Configuration Description to specify the symbolic name of the channel.
          integer DioChannelId: 0..4294967295, set at pre-compile, symbolic-name-value=true, default-value=0  # Parameter not used. This parameter defines the channel Id of the DIO channel. This value will be assigned to the symbolic names.
        container DioChannelGroup [0..*]  # This container includes the definition and configuration of DIO channel groups. A channel group represents several adjoining DIO channels represented by a logical group. | Note hat this container definition does not explicitly define a symbolic name parameter. Instead, the container's short name will be used in the Ecu Configuration Description to specify the symbolic name of the channel group.
          string DioChannelGroupIdentification [0..1]: set at pre-compile, symbolic-name-value=true  # Parameter not used. The DIO channel group is identified in DIO API by a pointer to a data structure (of type Dio_ChannelGroupType). That data structure contains the channel group information. This parameter defines the code fragment that has to be inserted in the API call of the calling module to get the address of the variable in memory which holds the channel group information. Example values are "&MyDioGroup1" or "&MyDioGroupArray[0]". | This parameter contains the code fragment that has to be inserted in the API call of the calling module to get the address of the variable in memory which holds the channel group information. Example values are "&MyDioGroup1" or "&MyDioGroupArray[0]"
          integer DioPortMask: 0..4294967295, set at pre-compile, default-value=1  # This parameter defines the mask wich specify the positions of the channel. | group. The channels shall consist of adjoining bits in the same port. The data type depends on the port width.
          integer DioPortOffset: 0..31, set at pre-compile, default-value=0  # This parameter defines the position of the Channel Group on the port, counted | from the LSB. This value can be derived from DioPortMask. calculationFormula = Position of the first bit of DioPortMask which is set to '1' counted from LSB
    container DioGeneral  # General configuration parameteres of the DIO module.
      boolean DioDevErrorDetect: set at pre-compile, default-value=true  # This parameter switches the Development Error Detection and Notification ON or OFF. True: Development error detection is enabled. False: Development error detection is disabeld. Note: In general, the development error detection is recommended during pre-test phase. It is not recommended to enable the development error detection in production code due to increased runtime and ROM needs. | ON or OFF
      boolean DioFlipChannelApi: set at pre-compile, default-value=false  # This parameter defines whether the function Dio_FlipChannel() is enabled or disabled. True: API Dio_FlipChannel() is supported (function provided) False: API Dio_FlipChannel() is not supported (function not provided)
      boolean DioVersionInfoApi: set at pre-compile, default-value=false  # This parameter enables/disables the function Dio_ GetVersionInfo() to get major, minor and patch version information.
      boolean DioSafeBswChecks: set at pre-compile, origin=Vector Informatik, default-value=false  # Selects if safety checks are used. These checks improve robustness as e.g. invalid parameters are checked before function is executed. This attribute has to be enabled for safety projects where this component is mapped to an ASIL partition
      string DioPrefix [0..1]: set at pre-compile, origin=Vector Informatik, max-length=255, min-length=0  # Dio Prefix | This parameter can be used to overwrite the "ModuleName", “Vendor-ID” and “API-Infix” attributes of the real component, if necessary. Example: In general the implementation specific API name is specified as: <ModuleName>_<vendorId>_<vendorApiInfix>_<API name of module> This parameter overwrites the whole parenthesis <ModuleName>_<vendorId>_<vendorApiInfix>.
  module config VTTDio_Pre: definition=VTTDio
  module config VTTDio_Rec: definition=VTTDio
