AUTOSAR XML (schema 4-0-3)
package /MICROSAR/VTT
  bsw implementation VTTEep_Impl: programming-language=C, sw-version=2.06.00, used-code-generator=cMSR, vendor-id=30, ar-release-version=4.00.03, behavior=EepBehavior, preconfigured-configuration=VTTEep_Pre, recommended-configuration=VTTEep_Rec, vendor-specific-module-def=VTTEep
  module definition VTTEep [0..*]: category=VENDOR_SPECIFIC_MODULE_DEFINITION, variants pre-compile  # EEPROM Driver. The driver provides services for reading, writing, erasing and comparing data to/ from an EEPROM. #VTT #Driver #AUTOSAR | Its multiplicity describes the number of EEPROM drivers present, so there will be one container for each EEPROM driver in the ECUC template. When no EEPROM driver is present then the multiplicity is 0.
    container EepGeneral  # This parameter switches the Development Error Detection and Notification ON or OFF. True: Development error detection is enabled. False: Development error detection is disabeld. Note: In general, the development error detection is recommended during pre-test phase. It is not recommended to enable the development error detection in production code due to increased runtime and ROM needs.
      boolean EepDevErrorDetect: set at pre-compile, default-value=true  # This parameter switches the Development Error Detection and Notification ON or OFF. True: Development error detection is enabled. False: Development error detection is disabeld. Note: In general, the development error detection is recommended during pre-test phase. It is not recommended to enable the development error detection in production code due to increased runtime and ROM needs. | true: Development error detection enabled. false: Development error detection disabled.
      integer EepDriverIndex [0..1]: 0..254, set at pre-compile, symbolic-name-value=true  # Parameter not used. This parameter defines the Index of the driver, used by EA.
      boolean EepUseInterrupts [0..1]: set at pre-compile, default-value=false  # Parameter not used. This parameter defines whether the interrupt controlled job processing is activated or deactivated. True: Interrupt controlled job processing is activated. False: Interrupt controlled job processing is deactivated. | true: Interrupt controlled job processing enabled. false: Interrupt controlled job processing disabled.
      boolean EepVersionInfoApi: set at pre-compile, default-value=false  # This parameter enables/disables the function Eep_GetVersionInfo() to get major, minor and patch version information. | true: Version info API enabled. false: Version info API disabled.
      boolean EepWriteCycleReduction [0..1]: set at pre-compile, default-value=false  # Parameter not used. This parameter defines whether write cycle reduction is activated or deactivated, (EEPROM value is read and compared before being overwritten). True: Write cycle reduction is activated. False: Write cycle reduction is deactivated. | true: Write cycle reduction enabled. false: Write cycle reduction disabled.
      boolean EepSafeBswChecks: set at pre-compile, origin=Vector Informatik, default-value=false  # Selects if safety checks are used. These checks improve robustness as e.g. invalid parameters are checked before function is executed. This attribute has to be enabled for safety projects where this component is mapped to an ASIL partition
      string EepPrefix [0..1]: set at pre-compile, origin=Vector Informatik, max-length=255, min-length=0  # Eep Prefix | This parameter can be used to overwrite the "ModuleName", “Vendor-ID” and “API-Infix” attributes of the real component, if necessary. Example: In general the implementation specific API name is specified as: <ModuleName>_<vendorId>_<vendorApiInfix>_<API name of module> This parameter overwrites the whole parenthesis <ModuleName>_<vendorId>_<vendorApiInfix>.
    container EepInitConfiguration [0..1]  # This container includes runtime configuration parameters of the EEPROM driver. | Implementation Type: Eep_ConfigType.
      integer EepBaseAddress: 0..65535, set at pre-compile, default-value=0  # Parameter not used. This parameter defines the EEPROM device base address. | Implementation Type: Eep_AddressType.
      enumeration EepDefaultMode [0..1]: set at pre-compile, default-value=MEMIF_MODE_SLOW  # Parameter not used. This parameter defines the default EEPROM device mode after initialization. MEMIF_MODE_FAST: The driver is working in fast mode (fast read access / SPI burst access) MEMIF_MODE_SLOW: The driver is working in slow mode (default) | Implementation Type: MemIf_ModeType.
        MEMIF_MODE_FAST  # Fast
        MEMIF_MODE_SLOW  # Slow
      integer EepFastReadBlockSize: 0..4096, set at pre-compile, default-value=256  # This parameter defines the number of bytes read within one job processing cycle in fast mode. If the hardware does not support burst mode this parameter shall be set to the same value as EepNormalReadBlockSize. | Implementation Type: Eep_LengthType.
      integer EepFastWriteBlockSize: 0..4096, set at pre-compile, default-value=256  # This parameter defines the number of bytes written within one job processing cycle in fast mode. If the hardware does not support burst mode this parameter shall be set to the same value as EepNormalWriteBlockSize. | Implementation Type: Eep_LengthType.
      float EepJobCallCycle: 1E-07..1, set at pre-compile, default-value=0.01  # This parameter defines the call cycle time of the EEPROM driver's main function. Unit: [s]
      function name EepJobEndNotification [0..1]: set at pre-compile, default-value=Ea_JobEndNotification  # This parameter defines the name of a callback function for positive job result. If no notification should be called for a positive job result, please use one of the following capabilities: - Delete the parameter EepJobEndNotification - Leave the parameter empty - Configure the parameter with "NULL_PTR" If the parameter has an invalid expression, the behaviour is undefined. In case of an invalid synchronization from the real target, the parameter has to be set user defined and one of the capabilities above should be followed.
      function name EepJobErrorNotification [0..1]: set at pre-compile, default-value=Ea_JobErrorNotification  # This parameter defines the name of a callback function for negative job result. If no notification should be called for a negative job result, please use one of the following capabilities: - Delete the parameter EepJobErrorNotification - Leave the parameter empty - Configure the parameter with "NULL_PTR" If the parameter has an invalid expression, the behaviour is undefined. In case of an invalid synchronization from the real target, the parameter has to be set user defined and one of the capabilities above should be followed.
      integer EepNormalReadBlockSize: 0..4096, set at pre-compile, default-value=32  # This parameter defines the number of bytes read within one job processing cycle in normal mode. | Implementation Type: Eep_LengthType.
      integer EepNormalWriteBlockSize: 0..4096, set at pre-compile, default-value=32  # This parameter defines the number of bytes written within one job processing cycle in normal mode. | Implementation Type: Eep_LengthType.
      integer EepSize: 0..10485760, set at pre-compile, default-value=4096  # This parameter defines the used size of EEPROM device in bytes. | Implementation Type: Eep_LengthType.
      container EepDemEventParameterRefs [0..1]  # This container inculdes the references to DemEventParameter elements which shall be invoked using the API Dem_ReportErrorStatus API in case the corresponding error occurs. The EventId is taken from the referenced DemEventParameter's DemEventId value.
        symbolic name reference EEP_E_COMPARE_FAILED [0..1]: set at pre-compile, destination=DemEventParameter  # Parameter not used. Reference to the DemEventParameter which shall be issued when the error "EEPROM compare failed (HW)" has occurred.
        symbolic name reference EEP_E_ERASE_FAILED [0..1]: set at pre-compile, destination=DemEventParameter  # Parameter not used. Reference to the DemEventParameter which shall be issued when the error "EEPROM erase failed (HW)" has occurred.
        symbolic name reference EEP_E_READ_FAILED [0..1]: set at pre-compile, destination=DemEventParameter  # Parameter not used. Reference to the DemEventParameter which shall be issued when the error "EEPROM read failed (HW)" has occurred.
        symbolic name reference EEP_E_WRITE_FAILED [0..1]: set at pre-compile, destination=DemEventParameter  # Parameter not used. Reference to the DemEventParameter which shall be issued when the error "EEPROM write failed (HW)" has occurred.
      container EepExternalDriver [0..1]  # Container not used. This container includes configuration for external EEPROM drivers only. Internal EEPROM drivers do not use the parameter listed in this container, hence its multiplicity is 0 for internal drivers.
        symbolic name reference EepSpiReference [1..*]: set at pre-compile, destination=SpiSequence  # Parameter not used. Reference to SPI sequence (required for external EEPROM drivers).
    container EepPublishedInformation  # Additional published parameters not covered by CommonPublishedInformation container. | Note that these parameters do not have any configuration class setting, since they are published information.
      integer EepAllowedWriteCycles: 0..4294967295, set at published-information, default-value=50000  # Parameter not used. Specified maximum number of write cycles under worst case conditions of specific EEPROM hardware (e.g. +90°C)
      float EepEraseTime: 0..Inf, set at published-information, default-value=20000  # Parameter not used. Maximum time for erasing one EEPROM data unit.
      integer EepEraseUnitSize: 0..4294967295, set at published-information, default-value=4  # Size of smallest erasable EEPROM data unit in bytes.
      integer EepEraseValue: 0..255, set at published-information, default-value=255  # Value of an erased EEPROM cell.
      integer EepMinimumAddressType [0..1]: 0..4294967295, set at published-information, default-value=2  # Parameter not used. Minimum expected size of Eep_AddressType.
      integer EepMinimumLengthType [0..1]: 0..4294967295, set at published-information, default-value=2  # Parameter not used. Minimum expected size of Eep_LengthType.
      integer EepReadUnitSize: 0..4294967295, set at published-information, default-value=1  # Parameter not used. Size of smallest readable EEPROM data unit in bytes.
      integer EepSpecifiedEraseCycles [0..1]: 0..4294967295, set at published-information, default-value=0  # Parameter not used. Number of erase cycles specified for the EEP device (usually given in the device data sheet).
      integer EepTotalSize [0..1]: 0..10485760, set at published-information  # Parameter not used. Total size of EEPROM in bytes. | Implementation Type: Eep_LengthType.
      float EepWriteTime [0..1]: 0..Inf, set at published-information  # Parameter not used. Maximum time for writing one EEPROM data unit.
      integer EepWriteUnitSize: 0..4294967295, set at published-information, default-value=4  # Parameter not used. Size of smallest writeable EEPROM data unit in bytes.
  module config VTTEep_Pre: definition=VTTEep
  module config VTTEep_Rec: definition=VTTEep
