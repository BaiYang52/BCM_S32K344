AUTOSAR XML (schema 4-0-3)
package /MICROSAR
  module definition EcuC [0..1]: category=VENDOR_SPECIFIC_MODULE_DEFINITION, refined-module-def=EcuC, variants pre-compile/post-build-loadable/post-build-selectable  # Virtual module to collect ECU Configuration specific / global configuration information.
    container EcucPartitionCollection [0..1]  # Collection of Partitions defined for this ECU.
      container EcucPartition [0..*]  # Definition of one Partition on this ECU. | One Partition will be implemented using one Os-Application.
        boolean EcucPartitionBswModuleExecution: set at pre-compile, default-value=false  # Denotes the main BSW partition. Satellite-BSW modules may also be executed in other Partitions.
        boolean PartitionCanBeRestarted: set at pre-compile, default-value=false  # Specifies the requirement whether the Partition can be restarted. If set to true all software executing in this partition shall be capable of handling a restart.
        enumeration ASIL: set at pre-compile, origin=Vector Informatik  # ASIL level of this Partition.
          QM
          A  # ASIL A
          B  # ASIL B
          C  # ASIL C
          D  # ASIL D
        instance reference EcucPartitionSoftwareComponentInstanceRef [0..*]: set at pre-compile, destination-context=ROOT-SW-COMPOSITION-PROTOTYPE, destination-type=SW-COMPONENT-PROTOTYPE  # References the SW Component instances from the Ecu Extract that shall be executed in this partition.
    container EcucPduCollection [0..1]  # Collection of all Pdu objects flowing through the Com-Stack.
      enumeration PduIdTypeEnum: {UINT8, UINT16}, set at pre-compile, default-value=UINT8  # The PduIdType is used within the entire AUTOSAR Com Stack except for bus drivers. The size of this global type depends on the maximum number of PDUs used within one software module. If no software module deals with more PDUs that 256, this type can be set to uint8. If at least one software module handles more than 256 PDUs, this type must be set to uint16. See AUTOSAR_SWS_CommunicationStackTypes for more details.
      enumeration PduLengthTypeEnum: {UINT8, UINT16, UINT32}, set at pre-compile, default-value=UINT8  # The PduLengthType is used within the entire AUTOSAR Com Stack except for bus drivers. The size of this global type depends on the maximum length of PDUs to be sent by an ECU. If no segmentation is used the length depends on the maximum payload size of a frame of the underlying communication system (for FlexRay maximum size is 255 bytes, therefore uint8). If segementation is used it depends on the maximum length of a segmeneted N-PDU (in general uint16 is used). See AUTOSAR_SWS_CommunicationStackTypes for more details.
      container Pdu [0..*]: post-build-changeable=true  # One Pdu flowing through the COM-Stack. | This Pdu is used by all Com-Stack modules to agree on referencing the same Pdu.
        boolean DynamicLength [0..1]: set at pre-compile, origin=Vector Informatik, default-value=false  # This parameter defines whether the Pdu has dynamic length (true) or not (false). Please note that this parameter is only relevant for UserDefinedPdus, UserDefinedIPdus and J1939DcmIPdus.
        integer MetaDataLength [0..1]: 1..4, set at pre-compile, origin=Vector Informatik  # Number of additional bytes in PDU data that contain auxiliary information (MetaData) for the PDU, e.g. the CAN ID. These bytes are handled as part of the PDU data and increase the PDU data length accordingly.
        integer PduLength: 0..4294967295, set at post-build in variant post-build-loadable+post-build-selectable / pre-compile in variant pre-compile  # The maximum used length of the Pdu in bytes.
        boolean J1939Requestable: set at pre-compile, origin=Vector Informatik, default-value=false  # Specifies whether this PDU can be requested on a J1939 bus using the J1939Rm. The PDU can be transmitted by COM, the RTE, a CDD, J1939Nm, or J1939Dcm. The configuration of J1939Rm for PDUs with J1939Requestable set to TRUE depends strongly on the transmitting module. RTE: The application receives a callback via service port interface, and triggers one of the signals of the requestable PDU according to the requested PGN. COM: J1939Rm calls Com_TriggerIPduSendWithMetaData for the requestable PDU. CDD: J1939Rm calls <Cdd>_RequestIndication, the CDD sends the PDU corresponding to the requested PGN. J1939Dcm, J1939Nm: J1939Rm calls <Msn>_RequestIndication to trigger transmission of diagnostic messages and the AddressClaimed message.
        foreign reference SysTPduToFrameMappingRef [0..1]: set at post-build in variant post-build-loadable+post-build-selectable / pre-compile in variant pre-compile, destination-type=PDU-TO-FRAME-MAPPING  # Optional reference to the PduToFrameMapping from the SystemTemplate which this Pdu represents.
        reference EcucPduDefaultPartitionRef [0..1]: set at pre-compile, origin=Vector Informatik, destination=EcucPartition  # Reference to EcucPartition, where the according Pdu is assigned to.
        container EcucPduDedicatedPartition [0..*]  # Module specific container for Pdu to partition assignment.
          foreign reference EcucPduDedicatedPartitionBswModuleRef: set at pre-compile, origin=Vector Informatik, destination-type=ECUC-MODULE-CONFIGURATION-VALUES  # Reference to BSW module, for which the according dedicated Pdu assignment is valid.
          reference EcucPduDedicatedPartitionRef: set at pre-compile, origin=Vector Informatik, destination=EcucPartition  # Module specific reference to EcucPartition, where the according Pdu is assigned to. The dedicated partition reference shall overrule the default partition reference for the respective module.
    container EcucPostBuildVariants [0..1]  # Collection of toplevel PostBuildSelectable variants. The PredefinedVariants linked inside this container will determine how many PostBuildSelectableVariants exist. If this container exist the name pattern for initialization of BSW modules will be <Mip>_Config_<PredefinedVariant.shortName>. If this container does not exist the name pattern for initialization of BSW modlues will be <Mip>_Config.
      foreign reference EcucPostBuildVariantRef [1..*]: set at pre-compile, origin=Vector Informatik, destination-type=PREDEFINED-VARIANT  # Reference to a PredefinedVariant that defines one toplevel postBuild configuration set (covering all post-build capable BSW modules). PredefinedVariants that are referenced here shall contain only PostBuildVariantCriterionValueSets.
    container EcucVariationResolver [0..1]  # Collection of PredefinedVariant elements containing definition of values for SwSystemconst which shall be applied when resolving the variability during ECU Configuration.
      foreign reference PredefinedVariantRef [1..*]: set at pre-compile, destination-type=PREDEFINED-VARIANT  # Reference to a predefined variant.
    container EcucGeneral  # Global configuration parameters of the EcuC.
      enumeration CPUType: set at pre-compile, origin=Vector Informatik  # Register width of the CPU in bit.
        CPU8Bit  # 8 Bit
        CPU16Bit  # 16 Bit
        CPU32Bit  # 32 Bit
        CPU64Bit  # 64 Bit
      enumeration ByteOrder: set at pre-compile, origin=Vector Informatik  # Byte order on memory level.
        BIG_ENDIAN  # Big Endian
        LITTLE_ENDIAN  # Little Endian
      enumeration BitOrder: set at pre-compile, origin=Vector Informatik  # Bit order on register level.
        LSB_to_MSB  # LSB to MSB
        MSB_to_LSB  # MSB to LSB
      boolean AtomicBitAccessInBitfield: set at pre-compile, origin=Vector Informatik  # Enables optimization for single bit read and write accesses in bit-fields if the compiler creates an atomic access in all cases. This is compiler and platform dependent and has to be checked and configured very carefully! Caution Enabling this configuration option requires atomic bit access in bit-fields. This option must only be enabled if the before mentioned access type is supported by the hardware, the compiler and the used compiler options. Enabling this option without verifying those conditions may lead to data consistency issues.
      enumeration AtomicVariableAccess: set at pre-compile, origin=Vector Informatik  # Selection of Bit size for atomic read and write accesses of global variables. This configuration switch is compiler and platform dependent and has to be checked and configured very carefully! Caution Setting this configuration option to "Atomic16BitAccess" requires atomic access all global 8 Bit and 16 Bit variables. Setting this configuration option to "Atomic32BitAccess" requires atomic access all global 8 Bit, 16 Bit and 32 Bit variables. Setting this configuration option to "Atomic64BitAccess" requires atomic access all global 8 Bit, 16 Bit, 32 Bit and 64 Bit variables. The optimization must only be enabled if the before mentioned access types are supported by the hardware, the compiler and the used compiler options. Enabling the optimization without verifying those conditions may lead to data consistency issues.
        Atomic8BitAccess  # 8 Bit
        Atomic16BitAccess  # 16 Bit
        Atomic32BitAccess  # 32 Bit
        Atomic64BitAccess  # 64 Bit
      enumeration SizeOfEnum: set at pre-compile, origin=Vector Informatik  # Size of type enum in bit.
        Size8Bit  # 8 Bit
        Size16Bit  # 16 Bit
        Size32Bit  # 32 Bit
      enumeration SizeOfInt: set at pre-compile, origin=Vector Informatik  # Size of type int in bit.
        Size16Bit  # 16 Bit
        Size32Bit  # 32 Bit
      enumeration SizeOfROMPointer: set at pre-compile, origin=Vector Informatik  # Size of ROM pointer in bit.
        Size16Bit  # 16 Bit
        Size24Bit  # 24 Bit
        Size32Bit  # 32 Bit
        Size64Bit  # 64 Bit
      enumeration SizeOfRAMPointer: set at pre-compile, origin=Vector Informatik  # Size of RAM pointer in bit.
        Size16Bit  # 16 Bit
        Size24Bit  # 24 Bit
        Size32Bit  # 32 Bit
        Size64Bit  # 64 Bit
      enumeration BitFieldDataType: set at pre-compile, origin=Vector Informatik, default-value=INT  # Defines the data type of a C bit-field. The default value is int as defined by MISRA. Other values can be used, but the compiler may add padding bits into the bit-field structures.
        UNSIGNED_CHAR  # unsigned char
        UNSIGNED_SHORT  # unsigned short
        UNSIGNED_INT  # unsigned int
        INT  # int
      enumeration StructAlignment: set at pre-compile, origin=Vector Informatik, default-value=Auto  # Alignment of struct elements. Alignment is given in bit: N bit means, that the address of each struct element in bit must be a multiple of N. Auto Alignment: In this case, the alignment of each struct element is determined by its natural alignment requirements. Remark: The alignment of the overall struct is done automatically and cannot be configured except for structs in arrays (see StructInArrayAlignment).
        Auto
        Align8Bit  # 8 Bit
        Align16Bit  # 16 Bit
        Align32Bit  # 32 Bit
        Align64Bit  # 64 bit
      enumeration ArrayAlignment: set at pre-compile, origin=Vector Informatik, default-value=Auto  # Alignment of arrays. Alignment is given in bit: N bit means, that the size and the address of an array in bit must be a multiple of N. Auto Alignment: In this case, the alignment of an array is the same as the alignment of one array element. The address and the size of the array must be a multiple of this alignment requirement.
        Auto
        Align8Bit  # 8 Bit
        Align16Bit  # 16 Bit
        Align32Bit  # 32 Bit
        Align64Bit  # 64 Bit
      enumeration StructInArrayAlignment: set at pre-compile, origin=Vector Informatik, default-value=Auto  # Alignment of structs in an array. Alignment is given in bit: N bit means, that the size and the address of the struct in bit must be a multiple of N. Auto Alignment: In this case, the alignment of the overall struct is determined by the struct element with the most restrictive alignment requirements.
        Auto
        Align8Bit  # 8 Bit
        Align16Bit  # 16 Bit
        Align32Bit  # 32 Bit
        Align64Bit  # 64 Bit
      boolean DummyFunction: set at pre-compile, origin=Vector Informatik, default-value=false  # Dummy functions used to avoid NULL pointer entrance in call tables
      boolean DummyStatement: set at pre-compile, origin=Vector Informatik, default-value=false  # Dummy statements used to avoid compiler warnings about e.g. unused parameters
      enumeration DummyStatementKind: {None, VoidCast, SelfAssignment, UserDefined}, set at pre-compile, origin=Vector Informatik, default-value=None  # Dummy statements used to avoid compiler warnings about e.g. unused parameters.
      boolean ConditionalGenerating: set at pre-compile, origin=Vector Informatik, default-value=true  # If enabled, only the files are written to the output directory which are changed in their content. As a result the time stamps will only be updated if changes have been made. Enabling this feature will result in a reduced compile time. Disable the feature if all files shall be updated with the generation step.
      enumeration EcucBswImplementationCodeType: set at pre-compile, origin=Vector Informatik, default-value=EcuCSourceCode  # Defines the realization type of MICROSAR BSW modules with Service-SWC APIs at the point in time when the RTE is build: - Source Code: All BSW modules with Service SWC interfaces are available as Source Code. This option shall be used by default as it allows the RTE to generate optimized code. - Library: Some or all BSW modules with Service SWC interface are available as library only. This option requires the RTE to disable some optimization strategies.
        EcuCSourceCode  # Source Code
        EcuCLibrary  # Library
      boolean EcuCUseStdReturnTypeForRte: set at pre-compile, origin=Vector Informatik, default-value=false  # Defines whether the Std_ReturnType is used for RTE.
      container PostbuildLoadable [0..1]  # Post-Build Loadable specific settings.
        integer AlignmentFillPattern: 0..255, set at post-build in variant post-build-loadable+post-build-selectable / pre-compile in variant pre-compile, origin=Vector Informatik, default-value=0  # Alignment Fill Pattern. Byte pattern which is used for the inserted padding bytes.
        integer PBROMStartAddress: 0..4294967295, set at post-build in variant post-build-loadable+post-build-selectable / pre-compile in variant pre-compile, origin=Vector Informatik, default-value=0  # Post-Build ROM Start Address | Start address of post-build ROM data. The defined memory are is used globally for all modules excluding these defined as IndividualPostBuildLoadableModule.
        integer PBRAMStartAddress: 0..4294967295, set at post-build in variant post-build-loadable+post-build-selectable / pre-compile in variant pre-compile, origin=Vector Informatik, default-value=0  # Post-Build RAM Start Address | Start address of post-build RAM data (flexible RAM management). The defined memory are is used globally for all modules excluding these defined as IndividualPostBuildLoadableModule.
        integer PBROMEndAddress: 0..4294967295, set at post-build in variant post-build-loadable+post-build-selectable / pre-compile in variant pre-compile, origin=Vector Informatik, default-value=0  # Post-Build ROM End Address | End address of available ROM for post-build. The defined memory are is used globally for all modules excluding these defined as IndividualPostBuildLoadableModule.
        integer PBRAMEndAddress: 0..4294967295, set at post-build in variant post-build-loadable+post-build-selectable / pre-compile in variant pre-compile, origin=Vector Informatik, default-value=0  # Post-Build RAM End Address | End address of available RAM for post-build. The defined memory are is used globally for all modules excluding these defined as IndividualPostBuildLoadableModule.
        container IndividualPostBuildLoadableModule [0..*]  # Modules that shall be updated individually need to be configured here. For each module a dedicated Post-Build ROM and RAM memory are need to be defined. Modules that are updated individually must not be part of the global root structure. For each module defined here an individual Hex file will be created.
          integer ModulePBROMStartAddress: 0..4294967295, set at post-build in variant post-build-loadable+post-build-selectable / pre-compile in variant pre-compile, origin=Vector Informatik, default-value=0  # Module Specific Post-Build ROM Start Address | Start address of post-build ROM data.
          integer ModulePBRAMStartAddress: 0..4294967295, set at post-build in variant post-build-loadable+post-build-selectable / pre-compile in variant pre-compile, origin=Vector Informatik, default-value=0  # Module Specific Post-Build RAM Start Address | Start address of post-build RAM data (flexible RAM management).
          integer ModulePBROMEndAddress: 0..4294967295, set at post-build in variant post-build-loadable+post-build-selectable / pre-compile in variant pre-compile, origin=Vector Informatik, default-value=0  # Module Specific Post-Build ROM End Address | End address of available ROM for post-build.
          integer ModulePBRAMEndAddress: 0..4294967295, set at post-build in variant post-build-loadable+post-build-selectable / pre-compile in variant pre-compile, origin=Vector Informatik, default-value=0  # Module Specific Post-Build RAM End Address | End address of available RAM for post-build.
          container ModuleInitializationStructure [0..*]  # Defines the name of the module initialzation structure(s) used for BSW initialization. Projects not using post-build selectable have one initialization structure. For these projects the parameter ModuleInitStructureStartAddress need not to be configured as the address is equal to the configured ModulePBROMStartAddress. Projects using selectable post-build have for each module multiple module intialization structures (one for each identity). For each identity one ModuleInitializationStructure container shall be defined. For each container the ModuleInitStructureStartAddress must be configured according to the location of that structure in ROM. All module initialization structures shall be located sequently directly after ModulePBROMStartAddress.
            integer ModuleInitStructureStartAddress [0..1]: 0..4294967295, set at post-build in variant post-build-loadable+post-build-selectable / pre-compile in variant pre-compile, origin=Vector Informatik, default-value=0  # Relevant for post-build selectable projects with multiple module initialization structures. The indicated addresses must follow directly after the PBROMStartAddress. There may be gaps If there is only a single initialization structure this container is not relevant as the start address must be equal to PBROMStartAddress.
        container GlobalInitializationStructure [0..*]  # Defines the name of the global root structure(s) used for BSW initialization. Projects not using post-build selectable have one initialization structure. For these projects the parameter GlobalRootStructureStartAddress need not to be configured as the address is equal to the configured PBROMStartAddress. Projects using selectable post-build have multiple global root structures (one for each identity). For each identity one GlobalInitializationStructure container shall be defined. For each container the GlobalRootStructureStartAddress must be configured according to the location of that structure in ROM. All global root structures shall be located sequently directly after PBROMStartAddress.
          integer GlobalRootStructureStartAddress [0..1]: 0..4294967295, set at post-build in variant post-build-loadable+post-build-selectable / pre-compile in variant pre-compile, origin=Vector Informatik, default-value=0  # Start address of post-build ROM data.
      container BswInitialization [0..1]  # Contains all functions
        container InitFunction [0..*]  # Name of the init function. E.g. ComM_Init
          string Header: set at pre-compile, origin=Vector Informatik  # Header which declares function and types.
          string ConfigType [0..1]: set at pre-compile, origin=Vector Informatik  # Name of ConfigType
          string ConfigPtrName [0..1]: set at pre-compile in variant post-build-loadable+pre-compile / post-build in variant post-build-selectable, origin=Vector Informatik  # Name of Config Pointer which shall be passed to function. If Empty no parameter is passed. If Init Function has a pointer, at least a NULL_PTR should be inserted here.
          string ConfigPtrClass [0..1]: set at pre-compile, origin=Vector Informatik  # Memory class of Config Pointer.
          enumeration InitPhase: {NO_INIT, INIT_MEMORY, INIT_ZERO, INIT_ONE_EARLY, INIT_ONE, INIT_ONE_LATE, INIT_TWO_MCAL, INIT_TWO_TRCV, INIT_TWO_DRV, INIT_TWO_IF, INIT_TWO_COM, INIT_TWO_SM, INIT_TWO_NM, INIT_TWO_TP, INIT_TWO_SYS, INIT_TWO_POST_NVMREADALL, INIT_THREE}, set at pre-compile in variant post-build-loadable+pre-compile / post-build in variant post-build-selectable, origin=Vector Informatik, default-value=INIT_TWO_POST_NVMREADALL  # Phase in which this init function shall be called.
          string AdditionalInitCode [0..1]: set at pre-compile, origin=Vector Informatik  # Specify additional code which can be referenced from the initialization callouts of EcuM and BswM. E.g.: Mcu_InitClock() If it is necessary to call a function with a module pointer from the global postbuild-loadable configuration, the placeholder %CONFIGPTR% can be used: E.g.: Mcu_Init(%CONFIGPTR%)
          foreign reference ModuleRef: set at pre-compile, origin=Vector Informatik, destination-type=ECUC-MODULE-CONFIGURATION-VALUES  # Reference to module for initialization.
    container InterruptFunctionality [0..1]  # Global interrupt configuration for Mcs12 .
      string GlobalReEnableCat1: set at pre-compile, origin=Vector Informatik  # Mcs12 specific parameter. It shall contain a c-Code instruction that re-enables Irqs in interrupt context, to allow nested interrupts of different sources with higher priority. This code is mostly an inline assembler instruction and therefore Compiler specific. It is used in case that a driver interrupt is configured as category 1.
      string GlobalReEnableCat2: set at pre-compile, origin=Vector Informatik  # Mcs12 specific parameter. It shall contain a c-Code instruction that re-enables Irqs in interrupt context, to allow nested interrupts of different sources with higher priority. This code is mostly an inline assembler instruction and therefore Compiler specific. It is used in case that a driver interrupt is configured as category 2.
    container EcucHardware [0..1]  # Hardware definition of this Ecu.
      container EcucCoreDefinition [0..*]  # Definition of one Core on this Ecu.
        integer EcucCoreId: 0..65535, set at pre-compile, origin=Vector Informatik, symbolic-name-value=true, default-value=0  # ID of the core.
        foreign reference EcucCoreHwRef [0..1]: set at pre-compile, origin=Vector Informatik, destination-type=HW-ELEMENT  # Optional reference to the HwElement of HwCategory ProcessingUnit that represents this Core in the ECU Resource Template.
  bsw implementation EcuC_Impl: programming-language=C, sw-version=2.00.00, used-code-generator=DaVinci Configurator, vendor-id=30, ar-release-version=4.00.03, preconfigured-configuration=EcuC_Pre, recommended-configuration=EcuC_Rec, vendor-specific-module-def=EcuC
  module config EcuC_Pre: definition=EcuC
  module config EcuC_Rec: definition=EcuC
