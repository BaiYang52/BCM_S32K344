AUTOSAR XML (schema 00046)
package /TS_T40D34M20I1R0
  module config Port_Rec: definition=Port
  bsw implementation Port_Impl: programming-language=C, used-code-generator=Tresos, behavior=PortBehavior, recommended-configuration=Port_Rec, vendor-specific-module-def=Port
