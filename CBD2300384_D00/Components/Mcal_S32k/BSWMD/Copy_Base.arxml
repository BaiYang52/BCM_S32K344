AUTOSAR XML (schema 00046)
package /TS_T40D34M20I1R0
  ecuc definition collection Base_EcuParameterDefinition: module=Base
  module definition Base: variants pre-compile  # Configuration of Base module.
    container OsIfGeneral  # This container contains the configuration parameters for the OS Interface.
      boolean OsIfMulticoreSupport: origin=NXP, set at pre-compile, default-value=false  # Switches global multicore support on or off: False: For all variants, no EcucPartition shall be referenced in OsIfEcucPartitionRef. True: For all variants, at least one EcucPartition needs to be referenced in OsIfEcucPartitionRef.
      boolean OsIfEnableUserModeSupport: origin=NXP, set at pre-compile, default-value=false  # When this parameter is enabled, the OsIf module will adapt to run from User Mode, with the following measures: (if applicable) a) configuring REG_PROT for the Eth Controllers so that the registers under protection eth be accessed from user mode by setting UAA bit in REG_PROT_GCR to 1 (if applicable) b) using 'call trusted function' stubs for all internal function calls that access registers requiring supervisor mode. (if applicable) c) other module specific measures for more information, please see chapter 5.7 User Mode Support in IM
      boolean OsIfDevErrorDetect: origin=NXP, set at pre-compile, default-value=false  # Switches the development error detection and notification on or off.
      boolean OsIfUseSystemTimer: origin=NXP, set at pre-compile, default-value=false  # Switches the system timer usage on or off. The system timer is architecture-specific and may not exist.
      boolean OsIfUseCustomTimer: origin=NXP, set at pre-compile, default-value=false  # Switches the custom timer usage on or off. When this feature is enabled, the application will have to provide the functions expected by the OSIF API.
      integer OsIfInstanceId: 0..255, set at pre-compile, default-value=0  # Instance ID of the OsIf driver. This ID is used to discern several OsIf drivers in case more than one driver is used in the same ECU.
      reference OsIfEcucPartitionRef [0..*]: scope=ECU, multiplicity set at pre-compile, origin=NXP, set at pre-compile, destination=EcucPartition  # Maps the OsIf module to zero or multiple ECUC partitions to make the module's API available in this partition. The OsIf module will operate as an independent instance in each of the partitions.
      choice container OsIfOperatingSystemType  # This container contains the configuration parameters for the OS Interface.
        container OsIfAutosarOsType [0..1]  # This container contains the configuration parameters for AUTOSAR OS.
        container OsIfFreeRtosType [0..1]  # This container contains the configuration parameters for FreeRTOS.
        container OsIfZephyrOsType [0..1]  # This container contains the configuration parameters for Zephyr OS.
        container OsIfBaremetalType [0..1]  # This container contains the configuration parameters for bare-metal.
      container OsIfCounterConfig [0..*]: multiplicity set at pre-compile  # Configures counters used by OsIf.
        reference OsIfCounterEcucPartitionRef [0..1]: scope=ECU, multiplicity set at pre-compile, origin=NXP, set at pre-compile, destination=EcucPartition  # Maps the OsIf Counter to zero or one ECUC partition. The ECUC partition referenced is a subset of the ECUC partitions where the OsIf module is mapped to.
        reference OsIfSystemTimerClockRef [0..1]: multiplicity set at pre-compile, origin=NXP, set at pre-compile, destination=McuClockReferencePoint  # Reference to the system timer clock source configuration, which is set in the MCU module configuration. Cortex-M: The clock source of the system timer is usually the clock source of the CPU on which the application will run. Cortex-A/R: The clock source of the system timer is usually a divided clock of FXOSC_CLK. The divide value is system specific, usually residing in a register of the GPR hardware module.
        reference OsIfOsCounterRef [0..1]: multiplicity set at pre-compile, origin=NXP, set at pre-compile, destination=OsCounter  # A reference to an OS Counter. Parameter OsSecondsPerTick of the referenced OS Counter must have multiplicity = 1. Limitation: The referenced OS Counter will be used by all drivers assigned to the same partition referenced by OsIfCounterEcucPartitionRef.
    container CommonPublishedInformation  # Common container, aggregated by all modules. It contains published information about vendor and versions.
      integer ArReleaseMajorVersion: 4..4, origin=NXP, set at pre-compile, default-value=4  # Major version number of AUTOSAR specification on which the appropriate implementation is based on.
      integer ArReleaseMinorVersion: 4..4, origin=NXP, set at pre-compile, default-value=4  # Minor version number of AUTOSAR specification on which the appropriate implementation is based on.
      integer ArReleaseRevisionVersion: 0..0, origin=NXP, set at pre-compile, default-value=0  # Revision version number of AUTOSAR specification on which the appropriate implementation is based on.
      integer ModuleId: 0..0, origin=NXP, set at pre-compile, default-value=0  # Module ID of this module from Module List.
      integer SwMajorVersion: 2..2, origin=NXP, set at pre-compile, default-value=2  # Major version number of the vendor specific implementation of the module. The numbering is vendor specific.
      integer SwMinorVersion: 0..0, origin=NXP, set at pre-compile, default-value=0  # Minor version number of the vendor specific implementation of the module. The numbering is vendor specific.
      integer SwPatchVersion: 1..1, origin=NXP, set at pre-compile, default-value=1  # Patch level version number of the vendor specific implementation of the module. The numbering is vendor specific.
      string VendorApiInfix [0..1]: multiplicity set at pre-compile, origin=NXP, set at pre-compile  # In driver modules which can be instantiated several times on a single ECU, BSW00347 requires that the name of APIs is extended by the VendorId and a vendor specific name. This parameter is used to specify the vendor specific name. In total, the implementation specific name is generated as follows: <ModuleName>_>VendorId>_<VendorApiInfix>. E.g. assuming that the VendorId of the implementor is 123 and the implementer chose a VendorApiInfix of "v11r456" a api name Can_Write defined in the SWS will translate to Can_123_v11r456Write. This parameter is mandatory for all modules with upper multiplicity > 1. It shall not be used for modules with upper multiplicity =1.
      integer VendorId: 43..43, origin=NXP, set at pre-compile, default-value=43  # Vendor ID of the dedicated implementation of this module according to the AUTOSAR vendor list.
