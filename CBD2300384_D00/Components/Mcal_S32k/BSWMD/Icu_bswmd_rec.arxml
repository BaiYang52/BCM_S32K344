AUTOSAR XML (schema 00046)
package /TS_T40D34M20I1R0
  module config Icu_Rec: definition=Icu
  bsw implementation Icu_Impl: programming-language=C, behavior=IcuBehavior, recommended-configuration=Icu_Rec, vendor-specific-module-def=Icu
