AUTOSAR XML (schema 00046)
package /TS_T40D34M20I1R0
  module config Mcu_Rec: definition=Mcu
    McuGeneralConfiguration: McuNoPll=0
  bsw implementation Mcu_Impl: programming-language=C, used-code-generator=Tresos, behavior=McuBehavior, recommended-configuration=Mcu_Rec, vendor-specific-module-def=Mcu
