AUTOSAR XML (schema 00046)
package /TS_T40D34M20I1R0
  module config Mcl_Rec: definition=Mcl
  bsw implementation Mcl_Impl: programming-language=C, used-code-generator=Tresos, behavior=MclBehavior, recommended-configuration=Mcl_Rec, vendor-specific-module-def=Mcl
