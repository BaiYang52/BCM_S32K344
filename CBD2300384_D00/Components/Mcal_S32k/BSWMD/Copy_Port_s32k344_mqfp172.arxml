AUTOSAR XML (schema 00046)
package /TS_T40D34M20I1R0
  ecuc definition collection Port_EcuParameterDefinition: module=Port
  module definition Port [0..1]: post-build-variant-support=true, refined-module-def=Port, variants post-build/pre-compile  # Configuration of the Port module.
    container PortConfigSet  # This container contains a configuration of the PORT driver / SIUL2 module.
      container NotUsedPortPin  # The init parameters values for the not used pins in the PORT configuration.
        boolean PortPinPue: origin=NXP, post-build-variant-value=true, set at post-build in variant post-build / pre-compile in variant pre-compile, default-value=false  # Enables the pull function. Used only when the associated destination is a chip pin. Checked box means the Pull Up or Pull Down configuration selected by 'PortPin PUS' is enabled for the pin. Unchecked box means the Pull Up or Pull Down configuration selected by 'PortPin PUS' is disabled for the pin. This is an implementation specific parameter.
        boolean PortPinPus: origin=NXP, post-build-variant-value=true, set at post-build in variant post-build / pre-compile in variant pre-compile, default-value=false  # Determines whether the pull function is a pullup or pulldown when the pull function is enabled by the 'PortPin Pull Enable' field. Used only when the associated destination is a chip pin. Checked box means the Pull Up configuration is set. Unchecked box means the Pull Down configuration is set. This is an implementation specific parameter.
        enumeration PortPinDirection: {PORT_PIN_IN, PORT_PIN_OUT, PORT_PIN_DISABLED}, origin=NXP, post-build-variant-value=true, set at post-build in variant post-build / pre-compile in variant pre-compile, default-value=PORT_PIN_IN  # Selects the initial direction of the pin (IN or OUT). If the direction is not changeable, the value configured here is fixed. The pin direction can be set only for the GPIO pins. For the Alternative Function modes the OUT pin direction is hw selected. If the IN direction is needed too, it can be set at runtime. NOTE: To set the IN direction take care, please, that all the possible module inputs, possible as Alternative Functions for the pad mode, are hw connected together, if IN direction is enabled, to the pad.
        enumeration PortPinLevelValue: {PORT_PIN_LEVEL_HIGH, PORT_PIN_LEVEL_LOW}, origin=NXP, post-build-variant-value=true, set at post-build in variant post-build / pre-compile in variant pre-compile, default-value=PORT_PIN_LEVEL_LOW  # Port Pin Level value from Port pin list.
      container PortContainer [1..*]: multiplicity set at pre-compile  # Container collecting the PortPins.
        integer PortNumberOfPortPins: 1..220, set at pre-compile, default-value=3  # The number of specified PortPins in this PortContainer.
        container PortPin [1..*]: multiplicity set at pre-compile  # Configuration of the individual port pins.
          boolean PortPinPue: origin=NXP, post-build-variant-value=true, set at post-build in variant post-build / pre-compile in variant pre-compile, default-value=false  # Enables the pull function. Used only when the associated destination is a chip pin. Checked box means the Pull Up or Pull Down configuration selected by 'PortPin PUS' is enabled for the pin. Unchecked box means the Pull Up or Pull Down configuration selected by 'PortPin PUS' is disabled for the pin. This is an implementation specific parameter.
          boolean PortPinPus: origin=NXP, post-build-variant-value=true, set at post-build in variant post-build / pre-compile in variant pre-compile, default-value=false  # Determines whether the pull function is a pullup or pulldown when the pull function is enabled by the 'PortPin Pull Enable' field. Used only when the associated destination is a chip pin. Checked box means the Pull Up configuration is set. Unchecked box means the Pull Down configuration is set. This is an implementation specific parameter.
          boolean PortPinSafeMode: origin=NXP, post-build-variant-value=true, set at post-build in variant post-build / pre-compile in variant pre-compile, default-value=false  # Enable/Disable Safe Mode for the pin. Checked box means the Safe Mode is enabled.
          boolean PortPinDse: origin=NXP, post-build-variant-value=true, set at post-build in variant post-build / pre-compile in variant pre-compile, default-value=false  # Enable Drive Strength for the configured Pin. Checked box means the Drive Strength is enabled. This is an implementation specific parameter.
          boolean PortPinWithReadBack: origin=NXP, post-build-variant-value=true, set at post-build in variant post-build / pre-compile in variant pre-compile, default-value=false  # Enables/Disables the read back possibility for this pin. Checked box means the Read Back is enabled. When ReadBack is enabled, the Input Bufer of the pin gets enabled by setting the IBE bit in the MSCR (PCR) of the pin. Some alternate functions working as inputs might require having the IBE set to 1, so check this box in order to achieve this.
          boolean PortPinPke: origin=NXP, post-build-variant-value=true, set at post-build in variant post-build / pre-compile in variant pre-compile, default-value=false  # Enables/disables pad keeping in standby mode. When padkeeping is enabled in standby mode, the pad output path latches the value till standby exit. Checked box means pad keeping in stanby mode is enabled for the pin. This is an implementation specific parameter.
          boolean PortPinIfe: origin=NXP, post-build-variant-value=true, set at post-build in variant post-build / pre-compile in variant pre-compile, default-value=false  # Enables/disables Input Filter. Checked box means Input Filter is enabled for the pin. This is an implementation specific parameter.
          boolean PortPinDirectionChangeable: post-build-variant-value=true, set at post-build in variant post-build / pre-compile in variant pre-compile, default-value=true  # Enable/Disable the changeability for the configured Pin. Checked box means the Direction Changeability is enabled. This is an implementation specific parameter. The changeable pin direction can be set only for the GPIO pins. For a mode different than GPIO, pin direction changeability shall be disabled.
          boolean PortPinModeChangeable: post-build-variant-value=true, set at post-build in variant post-build / pre-compile in variant pre-compile, default-value=true  # Parameter to indicate if the mode of a port pin is changeable during runtime. Checked box: Port Pin mode changeable allowed. Unchecked box: Port Pin mode changeable not permitted The function for changing the pin modes is not supported by the safety implementation.
          boolean PortPinInvertControl: origin=NXP, post-build-variant-value=true, set at post-build in variant post-build / pre-compile in variant pre-compile, default-value=false  # Invert the signal selected by SSS before transmitting it to the associated destination. Checked box means the signal will be inverted. This is an implementation specific parameter.
          enumeration PortPinSiul2Instance: {SIUL2_0}, origin=NXP, post-build-variant-value=true, set at post-build in variant post-build / pre-compile in variant pre-compile, default-value=SIUL2_0  # Selects one of the SIULs instances available on the platform to configure the current pin from.
          integer PortPinId: 1..220, set at pre-compile, symbolic-name-value=true, default-value=2  # Pin Id of the port pin. This value will be assigned to the symbolic name derived from the port pin container short name.
          integer PortPinPcr: 0..160, origin=NXP, post-build-variant-value=true, set at post-build in variant post-build / pre-compile in variant pre-compile, default-value=0  # Used to specify port configuration register: SIUL I/O Pin Multiplexed Signal Configuration Registers (MSCR number).
          enumeration PortPinDirection: {PORT_PIN_IN, PORT_PIN_OUT, PORT_PIN_INOUT, PORT_PIN_HIGH_Z}, post-build-variant-value=true, set at post-build in variant post-build / pre-compile in variant pre-compile, default-value=PORT_PIN_HIGH_Z  # Selects the direction of the pin (IN, OUT , INOUT or HIGH_Z) that will be configured by Port_Init() function if the pin is configured as GPIO. If the direction is not changeable, the value configured here is fixed. For the Alternative Function modes (PortPinMode is different than GPIO), the setting in this enumeration control is kept in the port configuration structure and it is used when Port_SetPinMode() is called at runtime to change the mode of the pin to GPIO. If your Alternative Function is an input functionality that requires the IBE bit to be set in the MSCR, please select the checkbox 'PortPinWithReadback. If direction is PORT_PIN_HIGH_Z, there will be no initial direction setting.
          enumeration PortPinInitialMode: {PORT_GPIO_MODE, PORT_ALT1_FUNC_MODE, PORT_ALT2_FUNC_MODE, PORT_ALT3_FUNC_MODE, PORT_ANALOG_INPUT_MODE, PORT_ONLY_INPUT_MODE, PORT_EXTRA_INPUT_MODE}, post-build-variant-value=true, set at post-build in variant post-build / pre-compile in variant pre-compile, default-value=PORT_GPIO_MODE  # Port pin mode from mode list for use with Port_Init() function. NOTE: This parameter is not used in the current implementation and is retained as per std AUTOSAR_EcucParamDef.arxml file.
          enumeration PortPinMode: {ADC0_ADC0_MA_0, ADC0_ADC0_MA_1, ADC0_ADC0_MA_2, ADC0_ADC0_P0, ADC0_ADC0_P1, ADC0_ADC0_P2, ADC0_ADC0_P3, ADC0_ADC0_P4, ADC0_ADC0_P5, ADC0_ADC0_P6, ADC0_ADC0_P7, ADC0_ADC0_S10, ADC0_ADC0_S11, ADC0_ADC0_S12, ADC0_ADC0_S13, ADC0_ADC0_S14, ADC0_ADC0_S15, ADC0_ADC0_S16, ADC0_ADC0_S17, ADC0_ADC0_S18, ADC0_ADC0_S19, ADC0_ADC0_S20, ADC0_ADC0_S21, ADC0_ADC0_S22, ADC0_ADC0_S23, ADC0_ADC0_S8, ADC0_ADC0_S9, ADC0_ADC0_X_0, ADC0_ADC0_X_1, ADC0_ADC0_X_2, ADC0_ADC0_X_3, ADC1_ADC1_MA_0, ADC1_ADC1_MA_1, ADC1_ADC1_MA_2, ADC1_ADC1_P0, ADC1_ADC1_P1, ADC1_ADC1_P2, ADC1_ADC1_P3, ADC1_ADC1_P4, ADC1_ADC1_P5, ADC1_ADC1_P6, ADC1_ADC1_P7, ADC1_ADC1_S10, ADC1_ADC1_S11, ADC1_ADC1_S12, ADC1_ADC1_S13, ADC1_ADC1_S14, ADC1_ADC1_S15, ADC1_ADC1_S16, ADC1_ADC1_S17, ADC1_ADC1_S18, ADC1_ADC1_S19, ADC1_ADC1_S20, ADC1_ADC1_S21, ADC1_ADC1_S22, ADC1_ADC1_S23, ADC1_ADC1_S8, ADC1_ADC1_S9, ADC1_ADC1_X_0, ADC1_ADC1_X_1, ADC1_ADC1_X_2, ADC1_ADC1_X_3, ADC2_ADC2_P0, ADC2_ADC2_P1, ADC2_ADC2_P2, ADC2_ADC2_P3, ADC2_ADC2_P4, ADC2_ADC2_P5, ADC2_ADC2_P6, ADC2_ADC2_P7, ADC2_ADC2_S10, ADC2_ADC2_S11, ADC2_ADC2_S12, ADC2_ADC2_S13, ADC2_ADC2_S14, ADC2_ADC2_S15, ADC2_ADC2_S16, ADC2_ADC2_S17, ADC2_ADC2_S18, ADC2_ADC2_S19, ADC2_ADC2_S20, ADC2_ADC2_S21, ADC2_ADC2_S22, ADC2_ADC2_S23, ADC2_ADC2_S8, ADC2_ADC2_S9, CAN0_CAN0_RX, CAN0_CAN0_TX, CAN1_CAN1_RX, CAN1_CAN1_TX, CAN2_CAN2_RX, CAN2_CAN2_TX, CAN3_CAN3_RX, CAN3_CAN3_TX, CAN4_CAN4_RX, CAN4_CAN4_TX, CAN5_CAN5_RX, CAN5_CAN5_TX, CMP0_CMP0_IN0, CMP0_CMP0_IN1, CMP0_CMP0_IN2, CMP0_CMP0_IN3, CMP0_CMP0_IN4, CMP0_CMP0_IN5, CMP0_CMP0_IN6, CMP0_CMP0_IN7, CMP0_CMP0_OUT, CMP0_CMP0_RRT, CMP1_CMP1_IN0, CMP1_CMP1_IN1, CMP1_CMP1_IN2, CMP1_CMP1_IN3, CMP1_CMP1_OUT, CMP1_CMP1_RRT, CMP2_CMP2_IN0, CMP2_CMP2_IN1, CMP2_CMP2_IN2, CMP2_CMP2_IN3, CMP2_CMP2_OUT, CMP2_CMP2_RRT, EMAC_EMAC_MII_COL, EMAC_EMAC_MII_CRS, EMAC_EMAC_MII_RMII_MDC, EMAC_EMAC_MII_RMII_MDIO_INOUT, EMAC_EMAC_MII_RMII_MDIO_IN, EMAC_EMAC_MII_RMII_MDIO_OUT, EMAC_EMAC_MII_RMII_RXD_0, EMAC_EMAC_MII_RMII_RXD_1, EMAC_EMAC_MII_RMII_RX_DV, EMAC_EMAC_MII_RMII_RX_ER, EMAC_EMAC_MII_RMII_TXD_0, EMAC_EMAC_MII_RMII_TXD_1, EMAC_EMAC_MII_RMII_TX_CLK, EMAC_EMAC_MII_RMII_TX_EN, EMAC_EMAC_MII_RXD2, EMAC_EMAC_MII_RXD3, EMAC_EMAC_MII_RX_CLK, EMAC_EMAC_MII_TXD2, EMAC_EMAC_MII_TXD3, EMAC_EMAC_PPS0_INOUT, EMAC_EMAC_PPS0_IN, EMAC_EMAC_PPS0_OUT, EMAC_EMAC_PPS1_INOUT, EMAC_EMAC_PPS1_IN, EMAC_EMAC_PPS1_OUT, EMAC_EMAC_PPS2_INOUT, EMAC_EMAC_PPS2_IN, EMAC_EMAC_PPS2_OUT, EMAC_EMAC_PPS3_INOUT, EMAC_EMAC_PPS3_IN, EMAC_EMAC_PPS3_OUT, eMIOS_0_eMIOS_0_CH_0_X_INOUT, eMIOS_0_eMIOS_0_CH_0_X_IN, eMIOS_0_eMIOS_0_CH_0_X_OUT, eMIOS_0_eMIOS_0_CH_10_H_INOUT, eMIOS_0_eMIOS_0_CH_10_H_IN, eMIOS_0_eMIOS_0_CH_10_H_OUT, eMIOS_0_eMIOS_0_CH_11_H_INOUT, eMIOS_0_eMIOS_0_CH_11_H_IN, eMIOS_0_eMIOS_0_CH_11_H_OUT, eMIOS_0_eMIOS_0_CH_12_H_INOUT, eMIOS_0_eMIOS_0_CH_12_H_IN, eMIOS_0_eMIOS_0_CH_12_H_OUT, eMIOS_0_eMIOS_0_CH_13_H_INOUT, eMIOS_0_eMIOS_0_CH_13_H_IN, eMIOS_0_eMIOS_0_CH_13_H_OUT, eMIOS_0_eMIOS_0_CH_14_H_INOUT, eMIOS_0_eMIOS_0_CH_14_H_IN, eMIOS_0_eMIOS_0_CH_14_H_OUT, eMIOS_0_eMIOS_0_CH_15_H_INOUT, eMIOS_0_eMIOS_0_CH_15_H_IN, eMIOS_0_eMIOS_0_CH_15_H_OUT, eMIOS_0_eMIOS_0_CH_16_X_INOUT, eMIOS_0_eMIOS_0_CH_16_X_IN, eMIOS_0_eMIOS_0_CH_16_X_OUT, eMIOS_0_eMIOS_0_CH_17_Y_INOUT, eMIOS_0_eMIOS_0_CH_17_Y_IN, eMIOS_0_eMIOS_0_CH_17_Y_OUT, eMIOS_0_eMIOS_0_CH_18_Y_INOUT, eMIOS_0_eMIOS_0_CH_18_Y_IN, eMIOS_0_eMIOS_0_CH_18_Y_OUT, eMIOS_0_eMIOS_0_CH_19_Y_INOUT, eMIOS_0_eMIOS_0_CH_19_Y_IN, eMIOS_0_eMIOS_0_CH_19_Y_OUT, eMIOS_0_eMIOS_0_CH_1_G_INOUT, eMIOS_0_eMIOS_0_CH_1_G_IN, eMIOS_0_eMIOS_0_CH_1_G_OUT, eMIOS_0_eMIOS_0_CH_20_Y_INOUT, eMIOS_0_eMIOS_0_CH_20_Y_IN, eMIOS_0_eMIOS_0_CH_20_Y_OUT, eMIOS_0_eMIOS_0_CH_21_Y_INOUT, eMIOS_0_eMIOS_0_CH_21_Y_IN, eMIOS_0_eMIOS_0_CH_21_Y_OUT, eMIOS_0_eMIOS_0_CH_22_X_INOUT, eMIOS_0_eMIOS_0_CH_22_X_IN, eMIOS_0_eMIOS_0_CH_22_X_OUT, eMIOS_0_eMIOS_0_CH_23_X_INOUT, eMIOS_0_eMIOS_0_CH_23_X_IN, eMIOS_0_eMIOS_0_CH_23_X_OUT, eMIOS_0_eMIOS_0_CH_2_G_INOUT, eMIOS_0_eMIOS_0_CH_2_G_IN, eMIOS_0_eMIOS_0_CH_2_G_OUT, eMIOS_0_eMIOS_0_CH_3_G_INOUT, eMIOS_0_eMIOS_0_CH_3_G_IN, eMIOS_0_eMIOS_0_CH_3_G_OUT, eMIOS_0_eMIOS_0_CH_4_G_INOUT, eMIOS_0_eMIOS_0_CH_4_G_IN, eMIOS_0_eMIOS_0_CH_4_G_OUT, eMIOS_0_eMIOS_0_CH_5_G_INOUT, eMIOS_0_eMIOS_0_CH_5_G_IN, eMIOS_0_eMIOS_0_CH_5_G_OUT, eMIOS_0_eMIOS_0_CH_6_G_INOUT, eMIOS_0_eMIOS_0_CH_6_G_IN, eMIOS_0_eMIOS_0_CH_6_G_OUT, eMIOS_0_eMIOS_0_CH_7_G_INOUT, eMIOS_0_eMIOS_0_CH_7_G_IN, eMIOS_0_eMIOS_0_CH_7_G_OUT, eMIOS_0_eMIOS_0_CH_8_X_INOUT, eMIOS_0_eMIOS_0_CH_8_X_IN, eMIOS_0_eMIOS_0_CH_8_X_OUT, eMIOS_0_eMIOS_0_CH_9_H_INOUT, eMIOS_0_eMIOS_0_CH_9_H_IN, eMIOS_0_eMIOS_0_CH_9_H_OUT, eMIOS_1_eMIOS_1_CH_0_X_INOUT, eMIOS_1_eMIOS_1_CH_0_X_IN, eMIOS_1_eMIOS_1_CH_0_X_OUT, eMIOS_1_eMIOS_1_CH_10_H_INOUT, eMIOS_1_eMIOS_1_CH_10_H_IN, eMIOS_1_eMIOS_1_CH_10_H_OUT, eMIOS_1_eMIOS_1_CH_11_H_INOUT, eMIOS_1_eMIOS_1_CH_11_H_IN, eMIOS_1_eMIOS_1_CH_11_H_OUT, eMIOS_1_eMIOS_1_CH_12_H_INOUT, eMIOS_1_eMIOS_1_CH_12_H_IN, eMIOS_1_eMIOS_1_CH_12_H_OUT, eMIOS_1_eMIOS_1_CH_13_H_INOUT, eMIOS_1_eMIOS_1_CH_13_H_IN, eMIOS_1_eMIOS_1_CH_13_H_OUT, eMIOS_1_eMIOS_1_CH_14_H_INOUT, eMIOS_1_eMIOS_1_CH_14_H_IN, eMIOS_1_eMIOS_1_CH_14_H_OUT, eMIOS_1_eMIOS_1_CH_15_H_INOUT, eMIOS_1_eMIOS_1_CH_15_H_IN, eMIOS_1_eMIOS_1_CH_15_H_OUT, eMIOS_1_eMIOS_1_CH_16_X_INOUT, eMIOS_1_eMIOS_1_CH_16_X_IN, eMIOS_1_eMIOS_1_CH_16_X_OUT, eMIOS_1_eMIOS_1_CH_17_Y_INOUT, eMIOS_1_eMIOS_1_CH_17_Y_IN, eMIOS_1_eMIOS_1_CH_17_Y_OUT, eMIOS_1_eMIOS_1_CH_18_Y_INOUT, eMIOS_1_eMIOS_1_CH_18_Y_IN, eMIOS_1_eMIOS_1_CH_18_Y_OUT, eMIOS_1_eMIOS_1_CH_19_Y_INOUT, eMIOS_1_eMIOS_1_CH_19_Y_IN, eMIOS_1_eMIOS_1_CH_19_Y_OUT, eMIOS_1_eMIOS_1_CH_1_H_INOUT, eMIOS_1_eMIOS_1_CH_1_H_IN, eMIOS_1_eMIOS_1_CH_1_H_OUT, eMIOS_1_eMIOS_1_CH_20_Y_INOUT, eMIOS_1_eMIOS_1_CH_20_Y_IN, eMIOS_1_eMIOS_1_CH_20_Y_OUT, eMIOS_1_eMIOS_1_CH_21_Y_INOUT, eMIOS_1_eMIOS_1_CH_21_Y_IN, eMIOS_1_eMIOS_1_CH_21_Y_OUT, eMIOS_1_eMIOS_1_CH_22_X_INOUT, eMIOS_1_eMIOS_1_CH_22_X_IN, eMIOS_1_eMIOS_1_CH_22_X_OUT, eMIOS_1_eMIOS_1_CH_23_X_INOUT, eMIOS_1_eMIOS_1_CH_23_X_IN, eMIOS_1_eMIOS_1_CH_23_X_OUT, eMIOS_1_eMIOS_1_CH_2_H_INOUT, eMIOS_1_eMIOS_1_CH_2_H_IN, eMIOS_1_eMIOS_1_CH_2_H_OUT, eMIOS_1_eMIOS_1_CH_3_H_INOUT, eMIOS_1_eMIOS_1_CH_3_H_IN, eMIOS_1_eMIOS_1_CH_3_H_OUT, eMIOS_1_eMIOS_1_CH_4_H_INOUT, eMIOS_1_eMIOS_1_CH_4_H_IN, eMIOS_1_eMIOS_1_CH_4_H_OUT, eMIOS_1_eMIOS_1_CH_5_H_INOUT, eMIOS_1_eMIOS_1_CH_5_H_IN, eMIOS_1_eMIOS_1_CH_5_H_OUT, eMIOS_1_eMIOS_1_CH_6_H_INOUT, eMIOS_1_eMIOS_1_CH_6_H_IN, eMIOS_1_eMIOS_1_CH_6_H_OUT, eMIOS_1_eMIOS_1_CH_7_H, eMIOS_1_eMIOS_1_CH_7_H_INOUT, eMIOS_1_eMIOS_1_CH_7_H_IN, eMIOS_1_eMIOS_1_CH_7_H_OUT, eMIOS_1_eMIOS_1_CH_8_X, eMIOS_1_eMIOS_1_CH_8_X_INOUT, eMIOS_1_eMIOS_1_CH_8_X_IN, eMIOS_1_eMIOS_1_CH_8_X_OUT, eMIOS_1_eMIOS_1_CH_9_H_INOUT, eMIOS_1_eMIOS_1_CH_9_H_IN, eMIOS_1_eMIOS_1_CH_9_H_OUT, eMIOS_2_eMIOS_2_CH_0_X_INOUT, eMIOS_2_eMIOS_2_CH_0_X_IN, eMIOS_2_eMIOS_2_CH_0_X_OUT, eMIOS_2_eMIOS_2_CH_10_H_INOUT, eMIOS_2_eMIOS_2_CH_10_H_IN, eMIOS_2_eMIOS_2_CH_10_H_OUT, eMIOS_2_eMIOS_2_CH_11_H_INOUT, eMIOS_2_eMIOS_2_CH_11_H_IN, eMIOS_2_eMIOS_2_CH_11_H_OUT, eMIOS_2_eMIOS_2_CH_12_H_INOUT, eMIOS_2_eMIOS_2_CH_12_H_IN, eMIOS_2_eMIOS_2_CH_12_H_OUT, eMIOS_2_eMIOS_2_CH_13_H_INOUT, eMIOS_2_eMIOS_2_CH_13_H_IN, eMIOS_2_eMIOS_2_CH_13_H_OUT, eMIOS_2_eMIOS_2_CH_14_H_INOUT, eMIOS_2_eMIOS_2_CH_14_H_IN, eMIOS_2_eMIOS_2_CH_14_H_OUT, eMIOS_2_eMIOS_2_CH_15_H_INOUT, eMIOS_2_eMIOS_2_CH_15_H_IN, eMIOS_2_eMIOS_2_CH_15_H_OUT, eMIOS_2_eMIOS_2_CH_16_X_INOUT, eMIOS_2_eMIOS_2_CH_16_X_IN, eMIOS_2_eMIOS_2_CH_16_X_OUT, eMIOS_2_eMIOS_2_CH_17_Y_INOUT, eMIOS_2_eMIOS_2_CH_17_Y_IN, eMIOS_2_eMIOS_2_CH_17_Y_OUT, eMIOS_2_eMIOS_2_CH_18_Y_INOUT, eMIOS_2_eMIOS_2_CH_18_Y_IN, eMIOS_2_eMIOS_2_CH_18_Y_OUT, eMIOS_2_eMIOS_2_CH_19_Y_INOUT, eMIOS_2_eMIOS_2_CH_19_Y_IN, eMIOS_2_eMIOS_2_CH_19_Y_OUT, eMIOS_2_eMIOS_2_CH_1_H_INOUT, eMIOS_2_eMIOS_2_CH_1_H_IN, eMIOS_2_eMIOS_2_CH_1_H_OUT, eMIOS_2_eMIOS_2_CH_20_Y_INOUT, eMIOS_2_eMIOS_2_CH_20_Y_IN, eMIOS_2_eMIOS_2_CH_20_Y_OUT, eMIOS_2_eMIOS_2_CH_21_Y_INOUT, eMIOS_2_eMIOS_2_CH_21_Y_IN, eMIOS_2_eMIOS_2_CH_21_Y_OUT, eMIOS_2_eMIOS_2_CH_22_X_INOUT, eMIOS_2_eMIOS_2_CH_22_X_IN, eMIOS_2_eMIOS_2_CH_22_X_OUT, eMIOS_2_eMIOS_2_CH_23_X_INOUT, eMIOS_2_eMIOS_2_CH_23_X_IN, eMIOS_2_eMIOS_2_CH_23_X_OUT, eMIOS_2_eMIOS_2_CH_2_H_INOUT, eMIOS_2_eMIOS_2_CH_2_H_IN, eMIOS_2_eMIOS_2_CH_2_H_OUT, eMIOS_2_eMIOS_2_CH_3_H_INOUT, eMIOS_2_eMIOS_2_CH_3_H_IN, eMIOS_2_eMIOS_2_CH_3_H_OUT, eMIOS_2_eMIOS_2_CH_4_H_INOUT, eMIOS_2_eMIOS_2_CH_4_H_IN, eMIOS_2_eMIOS_2_CH_4_H_OUT, eMIOS_2_eMIOS_2_CH_5_H_INOUT, eMIOS_2_eMIOS_2_CH_5_H_IN, eMIOS_2_eMIOS_2_CH_5_H_OUT, eMIOS_2_eMIOS_2_CH_6_H_INOUT, eMIOS_2_eMIOS_2_CH_6_H_IN, eMIOS_2_eMIOS_2_CH_6_H_OUT, eMIOS_2_eMIOS_2_CH_7_H_INOUT, eMIOS_2_eMIOS_2_CH_7_H_IN, eMIOS_2_eMIOS_2_CH_7_H_OUT, eMIOS_2_eMIOS_2_CH_8_X, eMIOS_2_eMIOS_2_CH_8_X_INOUT, eMIOS_2_eMIOS_2_CH_8_X_IN, eMIOS_2_eMIOS_2_CH_8_X_OUT, eMIOS_2_eMIOS_2_CH_9_H_INOUT, eMIOS_2_eMIOS_2_CH_9_H_IN, eMIOS_2_eMIOS_2_CH_9_H_OUT, FCCU_FCCU_ERR0, FCCU_FCCU_ERR1, FCCU_FCCU_ERR_IN0, FCCU_FCCU_ERR_IN1, FXIO_FXIO_D0_INOUT, FXIO_FXIO_D0_IN, FXIO_FXIO_D0_OUT, FXIO_FXIO_D10_INOUT, FXIO_FXIO_D10_IN, FXIO_FXIO_D10_OUT, FXIO_FXIO_D11_INOUT, FXIO_FXIO_D11_IN, FXIO_FXIO_D11_OUT, FXIO_FXIO_D12_INOUT, FXIO_FXIO_D12_IN, FXIO_FXIO_D12_OUT, FXIO_FXIO_D13_INOUT, FXIO_FXIO_D13_IN, FXIO_FXIO_D13_OUT, FXIO_FXIO_D14_INOUT, FXIO_FXIO_D14_IN, FXIO_FXIO_D14_OUT, FXIO_FXIO_D15_INOUT, FXIO_FXIO_D15_IN, FXIO_FXIO_D15_OUT, FXIO_FXIO_D16_INOUT, FXIO_FXIO_D16_IN, FXIO_FXIO_D16_OUT, FXIO_FXIO_D17_INOUT, FXIO_FXIO_D17_IN, FXIO_FXIO_D17_OUT, FXIO_FXIO_D18_INOUT, FXIO_FXIO_D18_IN, FXIO_FXIO_D18_OUT, FXIO_FXIO_D19_INOUT, FXIO_FXIO_D19_IN, FXIO_FXIO_D19_OUT, FXIO_FXIO_D1_INOUT, FXIO_FXIO_D1_IN, FXIO_FXIO_D1_OUT, FXIO_FXIO_D20_INOUT, FXIO_FXIO_D20_IN, FXIO_FXIO_D20_OUT, FXIO_FXIO_D21_INOUT, FXIO_FXIO_D21_IN, FXIO_FXIO_D21_OUT, FXIO_FXIO_D22_INOUT, FXIO_FXIO_D22_IN, FXIO_FXIO_D22_OUT, FXIO_FXIO_D23_INOUT, FXIO_FXIO_D23_IN, FXIO_FXIO_D23_OUT, FXIO_FXIO_D24_INOUT, FXIO_FXIO_D24_IN, FXIO_FXIO_D24_OUT, FXIO_FXIO_D25_INOUT, FXIO_FXIO_D25_IN, FXIO_FXIO_D25_OUT, FXIO_FXIO_D26_INOUT, FXIO_FXIO_D26_IN, FXIO_FXIO_D26_OUT, FXIO_FXIO_D27_INOUT, FXIO_FXIO_D27_IN, FXIO_FXIO_D27_OUT, FXIO_FXIO_D28_INOUT, FXIO_FXIO_D28_IN, FXIO_FXIO_D28_OUT, FXIO_FXIO_D29_INOUT, FXIO_FXIO_D29_IN, FXIO_FXIO_D29_OUT, FXIO_FXIO_D2, FXIO_FXIO_D2_INOUT, FXIO_FXIO_D2_IN, FXIO_FXIO_D2_OUT, FXIO_FXIO_D30_INOUT, FXIO_FXIO_D30_IN, FXIO_FXIO_D30_OUT, FXIO_FXIO_D31_INOUT, FXIO_FXIO_D31_IN, FXIO_FXIO_D31_OUT, FXIO_FXIO_D3, FXIO_FXIO_D3_INOUT, FXIO_FXIO_D3_IN, FXIO_FXIO_D3_OUT, FXIO_FXIO_D4_INOUT, FXIO_FXIO_D4_IN, FXIO_FXIO_D4_OUT, FXIO_FXIO_D5_INOUT, FXIO_FXIO_D5_IN, FXIO_FXIO_D5_OUT, FXIO_FXIO_D6_INOUT, FXIO_FXIO_D6_IN, FXIO_FXIO_D6_OUT, FXIO_FXIO_D7_INOUT, FXIO_FXIO_D7_IN, FXIO_FXIO_D7_OUT, FXIO_FXIO_D8_INOUT, FXIO_FXIO_D8_IN, FXIO_FXIO_D8_OUT, FXIO_FXIO_D9_INOUT, FXIO_FXIO_D9_IN, FXIO_FXIO_D9_OUT, GPIO, HSE_HSE_TAMPER_EXTIN0, HSE_HSE_TAMPER_LOOP_OUT0, JTAG_JTAG_TCK_SWD_CLK, JTAG_JTAG_TDI, JTAG_JTAG_TMS_SWD_DIO_INOUT, JTAG_JTAG_TMS_SWD_DIO_IN, JTAG_JTAG_TMS_SWD_DIO_OUT, JTAG_TRACEnoETM_JTAG_TDO_TRACEnoETM_SWO, LCU0_LCU0_OUT0, LCU0_LCU0_OUT10, LCU0_LCU0_OUT11, LCU0_LCU0_OUT1, LCU0_LCU0_OUT2, LCU0_LCU0_OUT3, LCU0_LCU0_OUT4, LCU0_LCU0_OUT5, LCU0_LCU0_OUT6, LCU0_LCU0_OUT7, LCU0_LCU0_OUT8, LCU0_LCU0_OUT9, LCU1_LCU1_OUT0, LCU1_LCU1_OUT10, LCU1_LCU1_OUT11, LCU1_LCU1_OUT1, LCU1_LCU1_OUT2, LCU1_LCU1_OUT3, LCU1_LCU1_OUT4, LCU1_LCU1_OUT5, LCU1_LCU1_OUT6, LCU1_LCU1_OUT7, LCU1_LCU1_OUT8, LCU1_LCU1_OUT9, LPI2C0_LPI2C0_HREQ, LPI2C0_LPI2C0_SCLS_INOUT, LPI2C0_LPI2C0_SCLS_IN, LPI2C0_LPI2C0_SCLS_OUT, LPI2C0_LPI2C0_SCL_INOUT, LPI2C0_LPI2C0_SCL_IN, LPI2C0_LPI2C0_SCL_OUT, LPI2C0_LPI2C0_SDAS_INOUT, LPI2C0_LPI2C0_SDAS_IN, LPI2C0_LPI2C0_SDAS_OUT, LPI2C0_LPI2C0_SDA_INOUT, LPI2C0_LPI2C0_SDA_IN, LPI2C0_LPI2C0_SDA_OUT, LPI2C1_LPI2C1_HREQ, LPI2C1_LPI2C1_SCLS_INOUT, LPI2C1_LPI2C1_SCLS_IN, LPI2C1_LPI2C1_SCLS_OUT, LPI2C1_LPI2C1_SCL_INOUT, LPI2C1_LPI2C1_SCL_IN, LPI2C1_LPI2C1_SCL_OUT, LPI2C1_LPI2C1_SDAS_INOUT, LPI2C1_LPI2C1_SDAS_IN, LPI2C1_LPI2C1_SDAS_OUT, LPI2C1_LPI2C1_SDA_INOUT, LPI2C1_LPI2C1_SDA_IN, LPI2C1_LPI2C1_SDA_OUT, LPSPI0_LPSPI0_PCS0_INOUT, LPSPI0_LPSPI0_PCS0_IN, LPSPI0_LPSPI0_PCS0_OUT, LPSPI0_LPSPI0_PCS1_INOUT, LPSPI0_LPSPI0_PCS1_IN, LPSPI0_LPSPI0_PCS1_OUT, LPSPI0_LPSPI0_PCS2_INOUT, LPSPI0_LPSPI0_PCS2_IN, LPSPI0_LPSPI0_PCS2_OUT, LPSPI0_LPSPI0_PCS3_INOUT, LPSPI0_LPSPI0_PCS3_IN, LPSPI0_LPSPI0_PCS3_OUT, LPSPI0_LPSPI0_PCS4_INOUT, LPSPI0_LPSPI0_PCS4_IN, LPSPI0_LPSPI0_PCS4_OUT, LPSPI0_LPSPI0_PCS5_INOUT, LPSPI0_LPSPI0_PCS5_IN, LPSPI0_LPSPI0_PCS5_OUT, LPSPI0_LPSPI0_PCS6_INOUT, LPSPI0_LPSPI0_PCS6_IN, LPSPI0_LPSPI0_PCS6_OUT, LPSPI0_LPSPI0_PCS7_INOUT, LPSPI0_LPSPI0_PCS7_IN, LPSPI0_LPSPI0_PCS7_OUT, LPSPI0_LPSPI0_SCK_INOUT, LPSPI0_LPSPI0_SCK_IN, LPSPI0_LPSPI0_SCK_OUT, LPSPI0_LPSPI0_SIN_INOUT, LPSPI0_LPSPI0_SIN_IN, LPSPI0_LPSPI0_SIN_OUT, LPSPI0_LPSPI0_SOUT_INOUT, LPSPI0_LPSPI0_SOUT_IN, LPSPI0_LPSPI0_SOUT_OUT, LPSPI1_LPSPI1_PCS0_INOUT, LPSPI1_LPSPI1_PCS0_IN, LPSPI1_LPSPI1_PCS0_OUT, LPSPI1_LPSPI1_PCS1_INOUT, LPSPI1_LPSPI1_PCS1_IN, LPSPI1_LPSPI1_PCS1_OUT, LPSPI1_LPSPI1_PCS2_INOUT, LPSPI1_LPSPI1_PCS2_IN, LPSPI1_LPSPI1_PCS2_OUT, LPSPI1_LPSPI1_PCS3_INOUT, LPSPI1_LPSPI1_PCS3_IN, LPSPI1_LPSPI1_PCS3_OUT, LPSPI1_LPSPI1_PCS4_INOUT, LPSPI1_LPSPI1_PCS4_IN, LPSPI1_LPSPI1_PCS4_OUT, LPSPI1_LPSPI1_PCS5_INOUT, LPSPI1_LPSPI1_PCS5_IN, LPSPI1_LPSPI1_PCS5_OUT, LPSPI1_LPSPI1_SCK_INOUT, LPSPI1_LPSPI1_SCK_IN, LPSPI1_LPSPI1_SCK_OUT, LPSPI1_LPSPI1_SIN, LPSPI1_LPSPI1_SIN_INOUT, LPSPI1_LPSPI1_SIN_IN, LPSPI1_LPSPI1_SIN_OUT, LPSPI1_LPSPI1_SOUT_INOUT, LPSPI1_LPSPI1_SOUT_IN, LPSPI1_LPSPI1_SOUT_OUT, LPSPI2_LPSPI2_PCS0_INOUT, LPSPI2_LPSPI2_PCS0_IN, LPSPI2_LPSPI2_PCS0_OUT, LPSPI2_LPSPI2_PCS1_INOUT, LPSPI2_LPSPI2_PCS1_IN, LPSPI2_LPSPI2_PCS1_OUT, LPSPI2_LPSPI2_PCS2_INOUT, LPSPI2_LPSPI2_PCS2_IN, LPSPI2_LPSPI2_PCS2_OUT, LPSPI2_LPSPI2_PCS3_INOUT, LPSPI2_LPSPI2_PCS3_IN, LPSPI2_LPSPI2_PCS3_OUT, LPSPI2_LPSPI2_SCK_INOUT, LPSPI2_LPSPI2_SCK_IN, LPSPI2_LPSPI2_SCK_OUT, LPSPI2_LPSPI2_SIN_INOUT, LPSPI2_LPSPI2_SIN_IN, LPSPI2_LPSPI2_SIN_OUT, LPSPI2_LPSPI2_SOUT_INOUT, LPSPI2_LPSPI2_SOUT_IN, LPSPI2_LPSPI2_SOUT_OUT, LPSPI3_LPSPI3_PCS0_INOUT, LPSPI3_LPSPI3_PCS0_IN, LPSPI3_LPSPI3_PCS0_OUT, LPSPI3_LPSPI3_PCS1_INOUT, LPSPI3_LPSPI3_PCS1_IN, LPSPI3_LPSPI3_PCS1_OUT, LPSPI3_LPSPI3_PCS2_INOUT, LPSPI3_LPSPI3_PCS2_IN, LPSPI3_LPSPI3_PCS2_OUT, LPSPI3_LPSPI3_PCS3_INOUT, LPSPI3_LPSPI3_PCS3_IN, LPSPI3_LPSPI3_PCS3_OUT, LPSPI3_LPSPI3_SCK_INOUT, LPSPI3_LPSPI3_SCK_IN, LPSPI3_LPSPI3_SCK_OUT, LPSPI3_LPSPI3_SIN_INOUT, LPSPI3_LPSPI3_SIN_IN, LPSPI3_LPSPI3_SIN_OUT, LPSPI3_LPSPI3_SOUT_INOUT, LPSPI3_LPSPI3_SOUT_IN, LPSPI3_LPSPI3_SOUT_OUT, LPSPI4_LPSPI4_PCS0_INOUT, LPSPI4_LPSPI4_PCS0_IN, LPSPI4_LPSPI4_PCS0_OUT, LPSPI4_LPSPI4_PCS1_INOUT, LPSPI4_LPSPI4_PCS1_IN, LPSPI4_LPSPI4_PCS1_OUT, LPSPI4_LPSPI4_PCS2_INOUT, LPSPI4_LPSPI4_PCS2_IN, LPSPI4_LPSPI4_PCS2_OUT, LPSPI4_LPSPI4_PCS3_INOUT, LPSPI4_LPSPI4_PCS3_IN, LPSPI4_LPSPI4_PCS3_OUT, LPSPI4_LPSPI4_SCK_INOUT, LPSPI4_LPSPI4_SCK_IN, LPSPI4_LPSPI4_SCK_OUT, LPSPI4_LPSPI4_SIN_INOUT, LPSPI4_LPSPI4_SIN_IN, LPSPI4_LPSPI4_SIN_OUT, LPSPI4_LPSPI4_SOUT_INOUT, LPSPI4_LPSPI4_SOUT_IN, LPSPI4_LPSPI4_SOUT_OUT, LPSPI5_LPSPI5_PCS0_INOUT, LPSPI5_LPSPI5_PCS0_IN, LPSPI5_LPSPI5_PCS0_OUT, LPSPI5_LPSPI5_PCS1_INOUT, LPSPI5_LPSPI5_PCS1_IN, LPSPI5_LPSPI5_PCS1_OUT, LPSPI5_LPSPI5_PCS2_INOUT, LPSPI5_LPSPI5_PCS2_IN, LPSPI5_LPSPI5_PCS2_OUT, LPSPI5_LPSPI5_PCS3_INOUT, LPSPI5_LPSPI5_PCS3_IN, LPSPI5_LPSPI5_PCS3_OUT, LPSPI5_LPSPI5_SCK_INOUT, LPSPI5_LPSPI5_SCK_IN, LPSPI5_LPSPI5_SCK_OUT, LPSPI5_LPSPI5_SIN_INOUT, LPSPI5_LPSPI5_SIN_IN, LPSPI5_LPSPI5_SIN_OUT, LPSPI5_LPSPI5_SOUT_INOUT, LPSPI5_LPSPI5_SOUT_IN, LPSPI5_LPSPI5_SOUT_OUT, LPUART0_LPUART0_CTS, LPUART0_LPUART0_RTS, LPUART0_LPUART0_RX, LPUART0_LPUART0_TX_INOUT, LPUART0_LPUART0_TX_IN, LPUART0_LPUART0_TX_OUT, LPUART10_LPUART10_RX, LPUART10_LPUART10_TX_INOUT, LPUART10_LPUART10_TX_IN, LPUART10_LPUART10_TX_OUT, LPUART11_LPUART11_RX, LPUART11_LPUART11_TX_INOUT, LPUART11_LPUART11_TX_IN, LPUART11_LPUART11_TX_OUT, LPUART12_LPUART12_RX, LPUART12_LPUART12_TX_INOUT, LPUART12_LPUART12_TX_IN, LPUART12_LPUART12_TX_OUT, LPUART13_LPUART13_RX, LPUART13_LPUART13_TX_INOUT, LPUART13_LPUART13_TX_IN, LPUART13_LPUART13_TX_OUT, LPUART14_LPUART14_RX, LPUART14_LPUART14_TX_INOUT, LPUART14_LPUART14_TX_IN, LPUART14_LPUART14_TX_OUT, LPUART15_LPUART15_RX, LPUART15_LPUART15_TX_INOUT, LPUART15_LPUART15_TX_IN, LPUART15_LPUART15_TX_OUT, LPUART1_LPUART1_CTS, LPUART1_LPUART1_RTS, LPUART1_LPUART1_RX, LPUART1_LPUART1_TX_INOUT, LPUART1_LPUART1_TX_IN, LPUART1_LPUART1_TX_OUT, LPUART2_LPUART2_CTS, LPUART2_LPUART2_RTS, LPUART2_LPUART2_RX, LPUART2_LPUART2_TX_INOUT, LPUART2_LPUART2_TX_IN, LPUART2_LPUART2_TX_OUT, LPUART3_LPUART3_RX, LPUART3_LPUART3_TX_INOUT, LPUART3_LPUART3_TX_IN, LPUART3_LPUART3_TX_OUT, LPUART4_LPUART4_RX, LPUART4_LPUART4_TX_INOUT, LPUART4_LPUART4_TX_IN, LPUART4_LPUART4_TX_OUT, LPUART5_LPUART5_RX, LPUART5_LPUART5_TX_INOUT, LPUART5_LPUART5_TX_IN, LPUART5_LPUART5_TX_OUT, LPUART6_LPUART6_RX, LPUART6_LPUART6_TX_INOUT, LPUART6_LPUART6_TX_IN, LPUART6_LPUART6_TX_OUT, LPUART7_LPUART7_RX, LPUART7_LPUART7_TX_INOUT, LPUART7_LPUART7_TX_IN, LPUART7_LPUART7_TX_OUT, LPUART8_LPUART8_RX, LPUART8_LPUART8_TX_INOUT, LPUART8_LPUART8_TX_IN, LPUART8_LPUART8_TX_OUT, LPUART9_LPUART9_RX, LPUART9_LPUART9_TX_INOUT, LPUART9_LPUART9_TX_IN, LPUART9_LPUART9_TX_OUT, OSC32K_OSC32K_EXTAL, OSC32K_OSC32K_XTAL, PG_VRC_CTRL, QuadSPI_QuadSPI_IOFA0_INOUT, QuadSPI_QuadSPI_IOFA0_IN, QuadSPI_QuadSPI_IOFA0_OUT, QuadSPI_QuadSPI_IOFA1_INOUT, QuadSPI_QuadSPI_IOFA1_IN, QuadSPI_QuadSPI_IOFA1_OUT, QuadSPI_QuadSPI_IOFA2_INOUT, QuadSPI_QuadSPI_IOFA2_IN, QuadSPI_QuadSPI_IOFA2_OUT, QuadSPI_QuadSPI_IOFA3_INOUT, QuadSPI_QuadSPI_IOFA3_IN, QuadSPI_QuadSPI_IOFA3_OUT, QuadSPI_QuadSPI_PCSFA, QuadSPI_QuadSPI_SCKFA_INOUT, QuadSPI_QuadSPI_SCKFA_IN, QuadSPI_QuadSPI_SCKFA_OUT, SAI0_SAI0_BCLK_INOUT, SAI0_SAI0_BCLK_IN, SAI0_SAI0_BCLK_OUT, SAI0_SAI0_D0_INOUT, SAI0_SAI0_D0_IN, SAI0_SAI0_D0_OUT, SAI0_SAI0_D1_INOUT, SAI0_SAI0_D1_IN, SAI0_SAI0_D1_OUT, SAI0_SAI0_D2_INOUT, SAI0_SAI0_D2_IN, SAI0_SAI0_D2_OUT, SAI0_SAI0_D3_INOUT, SAI0_SAI0_D3_IN, SAI0_SAI0_D3_OUT, SAI0_SAI0_MCLK, SAI0_SAI0_SYNC_INOUT, SAI0_SAI0_SYNC_IN, SAI0_SAI0_SYNC_OUT, SAI1_SAI1_BCLK_INOUT, SAI1_SAI1_BCLK_IN, SAI1_SAI1_BCLK_OUT, SAI1_SAI1_D0_INOUT, SAI1_SAI1_D0_IN, SAI1_SAI1_D0_OUT, SAI1_SAI1_MCLK, SAI1_SAI1_SYNC_INOUT, SAI1_SAI1_SYNC_IN, SAI1_SAI1_SYNC_OUT, SIUL_EIRQ_0, SIUL_EIRQ_10, SIUL_EIRQ_11, SIUL_EIRQ_12, SIUL_EIRQ_13, SIUL_EIRQ_14, SIUL_EIRQ_15, SIUL_EIRQ_16, SIUL_EIRQ_17, SIUL_EIRQ_18, SIUL_EIRQ_19, SIUL_EIRQ_1, SIUL_EIRQ_20, SIUL_EIRQ_21, SIUL_EIRQ_22, SIUL_EIRQ_23, SIUL_EIRQ_24, SIUL_EIRQ_25, SIUL_EIRQ_26, SIUL_EIRQ_27, SIUL_EIRQ_28, SIUL_EIRQ_29, SIUL_EIRQ_2, SIUL_EIRQ_30, SIUL_EIRQ_31, SIUL_EIRQ_3, SIUL_EIRQ_4, SIUL_EIRQ_5, SIUL_EIRQ_6, SIUL_EIRQ_7, SIUL_EIRQ_8, SIUL_EIRQ_9, SYSTEM_CLKOUT_RUN, SYSTEM_CLKOUT_STANDBY, SYSTEM_NMI_b, SYSTEM_RESET_b_INOUT, SYSTEM_RESET_b_IN, SYSTEM_RESET_b_OUT, TRACE_TRACE_ETM_CLKOUT, TRACE_TRACE_ETM_D0, TRACE_TRACE_ETM_D10, TRACE_TRACE_ETM_D11, TRACE_TRACE_ETM_D12, TRACE_TRACE_ETM_D13, TRACE_TRACE_ETM_D14, TRACE_TRACE_ETM_D15, TRACE_TRACE_ETM_D1, TRACE_TRACE_ETM_D2, TRACE_TRACE_ETM_D3, TRACE_TRACE_ETM_D4, TRACE_TRACE_ETM_D5, TRACE_TRACE_ETM_D6, TRACE_TRACE_ETM_D7, TRACE_TRACE_ETM_D8, TRACE_TRACE_ETM_D9, TRGMUX_TRGMUX_IN0, TRGMUX_TRGMUX_IN10, TRGMUX_TRGMUX_IN11, TRGMUX_TRGMUX_IN12, TRGMUX_TRGMUX_IN13, TRGMUX_TRGMUX_IN14, TRGMUX_TRGMUX_IN15, TRGMUX_TRGMUX_IN1, TRGMUX_TRGMUX_IN2, TRGMUX_TRGMUX_IN3, TRGMUX_TRGMUX_IN4, TRGMUX_TRGMUX_IN5, TRGMUX_TRGMUX_IN6, TRGMUX_TRGMUX_IN7, TRGMUX_TRGMUX_IN8, TRGMUX_TRGMUX_IN9, TRGMUX_TRGMUX_OUT0, TRGMUX_TRGMUX_OUT10, TRGMUX_TRGMUX_OUT11, TRGMUX_TRGMUX_OUT12, TRGMUX_TRGMUX_OUT13, TRGMUX_TRGMUX_OUT14, TRGMUX_TRGMUX_OUT15, TRGMUX_TRGMUX_OUT1, TRGMUX_TRGMUX_OUT2, TRGMUX_TRGMUX_OUT3, TRGMUX_TRGMUX_OUT4, TRGMUX_TRGMUX_OUT5, TRGMUX_TRGMUX_OUT6, TRGMUX_TRGMUX_OUT7, TRGMUX_TRGMUX_OUT8, TRGMUX_TRGMUX_OUT9, WKPU_WKPU_0, WKPU_WKPU_10, WKPU_WKPU_11, WKPU_WKPU_12, WKPU_WKPU_13, WKPU_WKPU_14, WKPU_WKPU_15, WKPU_WKPU_16, WKPU_WKPU_17, WKPU_WKPU_18, WKPU_WKPU_19, WKPU_WKPU_1, WKPU_WKPU_20, WKPU_WKPU_21, WKPU_WKPU_22, WKPU_WKPU_23, WKPU_WKPU_24, WKPU_WKPU_25, WKPU_WKPU_26, WKPU_WKPU_27, WKPU_WKPU_28, WKPU_WKPU_29, WKPU_WKPU_2, WKPU_WKPU_30, WKPU_WKPU_31, WKPU_WKPU_32, WKPU_WKPU_33, WKPU_WKPU_34, WKPU_WKPU_35, WKPU_WKPU_36, WKPU_WKPU_37, WKPU_WKPU_38, WKPU_WKPU_39, WKPU_WKPU_3, WKPU_WKPU_40, WKPU_WKPU_41, WKPU_WKPU_42, WKPU_WKPU_43, WKPU_WKPU_44, WKPU_WKPU_45, WKPU_WKPU_46, WKPU_WKPU_47, WKPU_WKPU_48, WKPU_WKPU_49, WKPU_WKPU_4, WKPU_WKPU_50, WKPU_WKPU_51, WKPU_WKPU_52, WKPU_WKPU_53, WKPU_WKPU_54, WKPU_WKPU_55, WKPU_WKPU_56, WKPU_WKPU_57, WKPU_WKPU_58, WKPU_WKPU_59, WKPU_WKPU_5, WKPU_WKPU_6, WKPU_WKPU_7, WKPU_WKPU_8, WKPU_WKPU_9}, post-build-variant-value=true, set at post-build in variant post-build / pre-compile in variant pre-compile, default-value=GPIO  # Selects the PORT pin mode from the modes list. One or more modes may be valid for a pin. This way it is possible to select between multiple modes.( e.g. DIO (GPIO option) or ICU (eTimer option)).
          enumeration PortPinLevelValue: {PORT_PIN_LEVEL_HIGH, PORT_PIN_LEVEL_LOW, PORT_PIN_LEVEL_NOTCHANGED}, post-build-variant-value=true, set at post-build in variant post-build / pre-compile in variant pre-compile, default-value=PORT_PIN_LEVEL_LOW  # Port Pin Level value from Port pin list.
          enumeration PortPinSlewRate: {FASTEST_SETTING, SLOWEST_SETTING}, origin=NXP, post-build-variant-value=true, set at post-build in variant post-build / pre-compile in variant pre-compile, default-value=FASTEST_SETTING  # Configures Slew Rate for the configured Pin. This is an implementation specific parameter.
          enumeration OBEGroupSelect: {NO_OBE_GROUP, OBE_GROUP1, OBE_GROUP2}, origin=NXP, post-build-variant-value=true, set at post-build in variant post-build / pre-compile in variant pre-compile, default-value=NO_OBE_GROUP  # Configures OBE Group Select for the configured Pin. This is an implementation specific parameter.
          enumeration MscrPdacSlot: {VIRTUAL_WRAPPER_PDAC0, VIRTUAL_WRAPPER_PDAC1}, origin=NXP, post-build-variant-value=true, set at post-build in variant post-build / pre-compile in variant pre-compile, default-value=VIRTUAL_WRAPPER_PDAC0  # Select the PDAC slot for PortPin controlling MSCR, GPDO, PGPDO, and MPGPDO
          enumeration ImcrPdacSlot: {VIRTUAL_WRAPPER_PDAC0, VIRTUAL_WRAPPER_PDAC1}, origin=NXP, post-build-variant-value=true, set at post-build in variant post-build / pre-compile in variant pre-compile, default-value=VIRTUAL_WRAPPER_PDAC0  # Select the PDAC slot for PortPin controlling IMCR
          reference PortPinEcucPartitionRef [0..*]: scope=ECU, multiplicity set at pre-compile, post-build-variant-multiplicity=true, post-build-variant-value=true, set at pre-compile, destination=EcucPartition  # Maps the Port pin to zero a multiple ECUC partitions. The ECUC partitions referenced are a subset of the ECUC partitions where the Port driver is mapped to. Tags: atp.Status=draft
      container UnTouchedPortPin [0..*]: multiplicity set at pre-compile  # List containing Pins that will not be touched by Port_Init() function.
        enumeration PortPinSiul2Instance: {SIUL2_0}, origin=NXP, post-build-variant-value=true, set at post-build in variant post-build / pre-compile in variant pre-compile, default-value=SIUL2_0  # Selects one of the SIULs instances available on the platform to configure the current pin from.
        integer PortPinPcr: 0..160, origin=NXP, post-build-variant-value=true, set at post-build in variant post-build / pre-compile in variant pre-compile, default-value=4  # Used to specify port configuration register: SIUL I/O Pin Multiplexed Signal Configuration Registers (MSCR number).
      container UntouchedIMCR [0..*]: multiplicity set at pre-compile  # List containing IMCR of Pins that will not be touched by Port_Init() function.
        enumeration IMCRSiul2Instance: {SIUL2_0}, origin=NXP, post-build-variant-value=true, set at post-build in variant post-build / pre-compile in variant pre-compile, default-value=SIUL2_0  # Selects one of the SIULs instances available on the platform to configure the current IMCR.
        integer UntouchedPortPinImcr: 0..379, origin=NXP, post-build-variant-value=true, set at post-build in variant post-build / pre-compile in variant pre-compile, default-value=0  # Selects one of the IMCR will be Untouched
    container PortGeneral  # Module wide configuration parameters of the PORT driver.
      boolean PortDevErrorDetect: set at pre-compile, default-value=true  # Switches the Development Error Detection and Notification ON or OFF.
      boolean SIUL2PortIPDevErrorDetect: origin=NXP, set at pre-compile, default-value=false  # Enables and Disables DevAssert checks in IP code. True: Enabled. False: Disabled.
      boolean PortSetPinDirectionApi: set at pre-compile, default-value=true  # Pre-processor switch to enable/disable the use of the function Port_SetPinDirection().
      boolean PortSetPinModeApi: set at pre-compile, default-value=true  # The function for changing the pin modes is not supported by the safety implementation.
      boolean PortVersionInfoApi: set at pre-compile, default-value=true  # Pre-processor switch to enable/disable the API to read out the modules version information.
      boolean PortSetPinModeDoesNotTouchGpioLevel: origin=NXP, set at pre-compile, default-value=false  # Pre-processor switch. When not checked, the function Port_SetPinMode() will set the output level of the pin to the value configured in the PortPinLevelValue combo when called at run time to change mode of a pin from alternate function to GPIO. When checked, the function Port_SetPinMode() will not touch the output level of the pin when called at run time to change mode of a pin from alternate function to GPIO.
      boolean PortSetAsUnusedPinApi: origin=NXP, set at pre-compile, default-value=false  # The function void Port_SetAsUnusedPin shall configure the referenced pin with all the properties specified in the NotUsedPortPin container. The function void Port_SetAsUsedPin shall configure the referenced pin with all the properties that where set during the Port_Init operation.
      boolean PortResetPinModeApi: origin=NXP, set at pre-compile, default-value=false  # The function Port_ResetPinMode shall revert the port pin mode of the referenced pin to the value that was set by Port_Init operation.
      boolean PortEnableUserModeSupport: origin=NXP, set at pre-compile, default-value=false  # When this parameter is enabled, the Port module will adapt to run from user mode, with the following measures: a) configuring REG_PROT for SIUL2 IP so that the registers under protection can be accessed from user mode by setting UAA bit in REG_PROT_GCR to 1 b) using 'call trusted function' stubs for all internal function calls that access registers requiring supervisor mode. For more information, please see chapter 5.7 user mode Support in IM Note: Implementation Specific Parameter.
      boolean PortMulticoreSupport: origin=NXP, set at pre-compile, default-value=false  # This parameter globally enables the possibility to support multicore. If this parmeter is enabled, at least one EcucPartition needs to be defined (in all variants). The S32K312, S32K314, S32K341, S32K342 and S32K344 derivatives will be treated as a single-core device. NoteThis is an Implementation Specific Parameter.
      boolean PortTspcSupport: origin=NXP, set at pre-compile, default-value=false  # This parameter shall allows to support configure The Touch Sensing Pin Coupling
      boolean SignalInversionConfigEnable: origin=NXP, set at pre-compile, default-value=false  # This parameter globally enables the posibility to invert the signal of the port pin. If this parameter is disabled, the signal of the port pin will not be allowed to invert. If this parameter is enabled, the signal of the port pin will be possible to be inverted in case the invert configuration of each pin is also enabled for this pin. This is an implementation specific parameter.
      boolean VirtWrapperSupport: origin=NXP, set at pre-compile, default-value=false  # This parameter enables the virtualization wrapper functionality. This is an implementation specific parameter. RM Enable Virtual Wrapper feature is required to enabled when Port Virtual Wrapper Support is enabled.
      reference PortEcucPartitionRef [0..*]: scope=ECU, multiplicity set at pre-compile, post-build-variant-multiplicity=true, post-build-variant-value=true, set at pre-compile, destination=EcucPartition  # Maps the Port driver to zero a multiple ECUC partitions to make the modules API available in this partition. Tags: atp.Status=draft
    container CommonPublishedInformation  # Common container, aggregated by all modules. It contains published information about vendor and versions.
      integer ArReleaseMajorVersion: 4..4, origin=NXP, set at published-information, default-value=4  # Major version number of AUTOSAR specification on which the appropriate implementation is based on.
      integer ArReleaseMinorVersion: 4..4, origin=NXP, set at published-information, default-value=4  # Minor version number of AUTOSAR specification on which the appropriate implementation is based on.
      integer ArReleaseRevisionVersion: 0..0, origin=NXP, set at published-information, default-value=0  # Revision version number of AUTOSAR specification on which the appropriate implementation is based on.
      integer ModuleId: 124..124, origin=NXP, set at published-information, default-value=124  # Module ID of this module from Module List.
      integer SwMajorVersion: 2..2, origin=NXP, set at published-information, default-value=2  # Major version number of the vendor specific implementation of the module. The numbering is vendor specific.
      integer SwMinorVersion: 0..0, origin=NXP, set at published-information, default-value=0  # Minor version number of the vendor specific implementation of the module. The numbering is vendor specific.
      integer SwPatchVersion: 1..1, origin=NXP, set at published-information, default-value=1  # Patch level version number of the vendor specific implementation of the module. The numbering is vendor specific.
      string VendorApiInfix [0..1]: multiplicity set at published-information, origin=NXP, set at published-information  # In driver modules which can be instantiated several times on a single ECU, BSW00347 requires that the name of APIs is extended by the VendorId and a vendor specific name. This parameter is used to specify the vendor specific name. In total, the implementation specific name is generated as follows: <ModuleName>_>VendorId>_<VendorApiInfix>. E.g. assuming that the VendorId of the implementor is 123 and the implementer chose a VendorApiInfix of "v11r456" a api name Can_Write defined in the SWS will translate to Can_123_v11r456Write. This parameter is mandatory for all modules with upper multiplicity > 1. It shall not be used for modules with upper multiplicity =1.
      integer VendorId: 43..43, origin=NXP, set at published-information, default-value=43  # Vendor ID of the dedicated implementation of this module according to the AUTOSAR vendor list.
