AUTOSAR XML (schema 00046)
package /TS_T40D34M20I1R0
  module config Fls_Rec: definition=Fls
  bsw implementation Fls_Impl: programming-language=C, behavior=FlsBehavior, recommended-configuration=Fls_Rec, vendor-specific-module-def=Fls
