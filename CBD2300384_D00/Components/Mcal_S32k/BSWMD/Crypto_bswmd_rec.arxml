AUTOSAR XML (schema 00046)
package /TS_T40D34M20I1R0
  module config Crypto_Rec: definition=Crypto
  bsw implementation Crypto_Impl: programming-language=C, behavior=CryptoBehavior, recommended-configuration=Crypto_Rec, vendor-specific-module-def=Crypto
