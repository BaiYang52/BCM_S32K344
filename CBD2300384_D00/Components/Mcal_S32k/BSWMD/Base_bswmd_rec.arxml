AUTOSAR XML (schema 00046)
package /TS_T40D34M20I1R0
  module config Base_Rec: definition=Base
  bsw implementation Base_Impl: programming-language=C, behavior=BaseBehavior, recommended-configuration=Base_Rec, vendor-specific-module-def=Base
