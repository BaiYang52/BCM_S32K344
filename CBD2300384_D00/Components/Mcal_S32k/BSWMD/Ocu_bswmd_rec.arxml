AUTOSAR XML (schema 00046)
package /TS_T40D34M20I1R0
  module config Ocu_Rec: definition=Ocu
  bsw implementation Ocu_Impl: programming-language=C, behavior=OcuBehavior, recommended-configuration=Ocu_Rec, vendor-specific-module-def=Ocu
