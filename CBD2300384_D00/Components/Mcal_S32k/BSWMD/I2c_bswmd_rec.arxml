AUTOSAR XML (schema 00046)
package /TS_T40D34M20I1R0
  module config I2c_Rec: definition=I2c
  bsw implementation I2c_Impl: programming-language=C, behavior=I2cBehavior, recommended-configuration=I2c_Rec, vendor-specific-module-def=I2c
