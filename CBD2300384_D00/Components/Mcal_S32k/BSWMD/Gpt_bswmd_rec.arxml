AUTOSAR XML (schema 00046)
package /TS_T40D34M20I1R0
  module config Gpt_Rec: definition=Gpt
  bsw implementation Gpt_Impl: programming-language=C, used-code-generator=Tresos, behavior=GptBehavior, recommended-configuration=Gpt_Rec, vendor-specific-module-def=Gpt
