AUTOSAR XML (schema 00046)
package /TS_T40D34M20I1R0
  module config Pwm_Rec: definition=Pwm
  bsw implementation Pwm_Impl: programming-language=C, behavior=PwmBehavior, recommended-configuration=Pwm_Rec, vendor-specific-module-def=Pwm
