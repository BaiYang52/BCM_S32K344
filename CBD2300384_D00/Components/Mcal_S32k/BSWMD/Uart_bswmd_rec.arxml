AUTOSAR XML (schema 00046)
package /TS_T40D34M20I1R0
  module config Uart_Rec: definition=Uart
  bsw implementation Uart_Impl: programming-language=C, behavior=UartBehavior, recommended-configuration=Uart_Rec, vendor-specific-module-def=Uart
