AUTOSAR XML (schema 00046)
package /TS_T40D34M20I1R0
  module config Adc_Rec: definition=Adc
  bsw implementation Adc_Impl: programming-language=C, behavior=AdcBehavior, recommended-configuration=Adc_Rec, vendor-specific-module-def=Adc
