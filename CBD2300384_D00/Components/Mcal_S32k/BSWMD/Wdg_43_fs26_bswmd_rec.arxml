AUTOSAR XML (schema 00046)
package /Wdg_43_fs26_TS_T40D34M20I1R0
  module config Wdg_43_fs26_Rec: definition=Wdg
  bsw implementation Wdg_43_fs26_Impl: programming-language=C, vendor-id=43, behavior=WdgBehavior, recommended-configuration=Wdg_43_fs26_Rec, vendor-api-infix=fs26, vendor-specific-module-def=Wdg
