AUTOSAR XML (schema 00046)
package /TS_T40D34M20I1R0
  module config Sbc_fs26_Rec: definition=Sbc_fs26
  bsw implementation Sbc_fs26_Impl: programming-language=C, used-code-generator=Tresos, behavior=Sbc_fs26Behavior, recommended-configuration=Sbc_fs26_Rec, vendor-specific-module-def=Sbc_fs26
