AUTOSAR XML (schema 00046)
package /Wdg_43_Instance3_TS_T40D34M20I1R0
  module config Wdg_Rec: definition=Wdg
  bsw implementation Wdg_Impl: programming-language=C, vendor-id=43, behavior=WdgBehavior, recommended-configuration=Wdg_Rec, vendor-api-infix=Instance3, vendor-specific-module-def=Wdg
