AUTOSAR XML (schema 00046)
package /TS_T40D34M20I1R0
  module config Dio_Rec: definition=Dio
  bsw implementation Dio_Impl: programming-language=C, used-code-generator=Tresos, behavior=DioBehavior, recommended-configuration=Dio_Rec, vendor-specific-module-def=Dio
