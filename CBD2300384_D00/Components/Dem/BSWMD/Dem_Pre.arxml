AUTOSAR XML (schema 4-1-2)
package /MICROSAR
  module config Dem_Pre: definition=Dem
    DemGeneral:
      DemAgingCycleCounterProcessing = DEM_PROCESS_AGINGCTR_INTERN
      DemGeneralInterfaceSupport = 0
      DemDataElementDefaultEndianness = LITTLE_ENDIAN
      DemAgingRequieresTestedCycle = 0
      DemMaxNumberEventEntryMirror = 0
      DemPTOSupport = 0
      DemTriggerMonitorInitBeforeClearOk = 1
      DemExtendedDataCapture = DEM_TRIGGER_EVENT_MEMORY_STORAGE
      DemFreezeFrameCapture = DEM_TRIGGER_EVENT_MEMORY_STORAGE
      DemOperationCycleProcessing = DEM_PROCESS_OPCYC_STATE
    DemConfigSet
  module config Dem_Pre_Class1: definition=Dem
    DemConfigSet
      DemEventParameter
        DemCallbackClearEventAllowed: DemClearEventAllowedBehavior=DEM_NO_STATUS_BYTE_CHANGE
  module config Dem_Pre_Class2: definition=Dem
    DemGeneral
      DemGeneralOBD:
        DemOBDCentralizedPID21Handling = 0
        DemOBDCentralizedPID31Handling = 0
        DemOBDDestinationOfEvents = DEM_DTC_ORIGIN_PRIMARY_MEMORY
        DemOBDEventDisplacement = 1
  module config Dem_Pre_Class6: definition=Dem
    DemConfigSet
      DemEventParameter
        DemEventClass
          DemIndicatorAttribute: DemIndicatorFailureCycleSource=DEM_FAILURE_CYCLE_EVENT
  module config Dem_Pre_Class5: definition=Dem
    DemGeneral
      DemGeneralJ1939: DemJ1939Readiness3Support=0
  module config Dem_Pre_Class7: definition=Dem
    DemGeneral
      DemPidConfiguration: DemSupportVid08=0, DemSupportVid0B=0
