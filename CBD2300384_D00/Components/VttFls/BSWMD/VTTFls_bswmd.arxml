AUTOSAR XML (schema 4-0-3)
package /MICROSAR/VTT
  module definition VTTFls [0..*]: category=VENDOR_SPECIFIC_MODULE_DEFINITION, variants pre-compile  # Flash Driver. The driver provides services for reading, writing, erasing and comparing data to/ from an Flash. #VTT #Driver #AUTOSAR | Its multiplicity describes the number of flash drivers present, so there will be one container for each flash driver in the ECUC template. When no flash driver is present then the multiplicity is 0.
    container FlsConfigSet [0..1]  # This container includes runtime configuration parameters of the flash driver. | Implementation Type: Fls_ConfigType.
      integer FlsAcErase [0..1]: 0..4294967295, set at pre-compile  # Parameter not used. This parameter defines the address offset in RAM to which the erase flash access code shall be loaded. | Used as function pointer to access the erase flash access code.
      integer FlsAcWrite [0..1]: 0..4294967295, set at pre-compile  # Parameter not used. This parameter defines the address offset in RAM to which the write flash access code shall be loaded. | Used as function pointer to access the write flash access code.
      float FlsCallCycle: 1E-07..1, set at pre-compile, default-value=0.01  # This parameter defines the cycle time of calls of the flash driver's main function (in seconds).
      enumeration FlsDefaultMode: set at pre-compile, default-value=MEMIF_MODE_SLOW  # This parameter defines the default FLS device mode after initialization. MEMIF_MODE_FAST: The driver is working in fast mode (fast read access / SPI burst access). MEMIF_MODE_SLOW: The driver is working in slow mode (default) | Implementation Type: MemIf_ModeType.
        MEMIF_MODE_FAST  # Fast
        MEMIF_MODE_SLOW  # Slow
      function name FlsJobEndNotification [0..1]: set at pre-compile  # This parameter defines the name of a callback function for positive job result. If no notification should be called for a positive job result, please use one of the following capabilities: - Delete the parameter FlsJobEndNotification - Leave the parameter empty - Configure the parameter with "NULL_PTR" If the parameter has an invalid expression, the behaviour is undefined. In case of an invalid synchronization from the real target, the parameter has to be set user defined and one of the capabilities above should be followed.
      function name FlsJobErrorNotification [0..1]: set at pre-compile  # This parameter defines the name of a callback function for negative job result. If no notification should be called for a negative job result, please use one of the following capabilities: - Delete the parameter FlsJobErrorNotification - Leave the parameter empty - Configure the parameter with "NULL_PTR" If the parameter has an invalid expression, the behaviour is undefined. In case of an invalid synchronization from the real target, the parameter has to be set user defined and one of the capabilities above should be followed.
      integer FlsMaxReadFastMode: 0..4294967295, set at pre-compile, default-value=16  # This parameter defines the maximum number of bytes to read or compare in one cycle of the flash driver's job processing function in fast mode.
      integer FlsMaxReadNormalMode: 0..4294967295, set at pre-compile, default-value=8  # This parameter defines the maximum number of bytes to read or compare in one cycle of the flash driver's job processing function in normal mode.
      integer FlsMaxWriteFastMode: 0..4294967295, set at pre-compile, default-value=16  # This parameter defines the maximum number of bytes to write in one cycle of the flash driver's job processing function in fast mode.
      integer FlsMaxWriteNormalMode: 0..4294967295, set at pre-compile, default-value=8  # This parameter defines the maximum number of bytes to write in one cycle of the flash driver's job processing function in normal mode.
      integer FlsProtection [0..1]: 0..4294967295, set at pre-compile  # Parameter not used. This parameter defines erase/write protection settings. Only relevant if supported by hardware.
      container FlsDemEventParameterRefs [0..1]  # Container not used. This container includes references to DemEventParameter elements which shall be invoked using the Dem_ReportErrorStatus API in case the corresponding error occurs. The EventId is taken from the referenced DemEventParameter's DemEventId value.
        symbolic name reference FLS_E_COMPARE_FAILED: set at pre-compile, destination=DemEventParameter  # Reference to the DemEventParameter which shall be issued when the error "Flash compare failed (HW)" has occurred.
        symbolic name reference FLS_E_ERASE_FAILED: set at pre-compile, destination=DemEventParameter  # Reference to the DemEventParameter which shall be issued when the error "Flash erase failed (HW)" has occurred.
        symbolic name reference FLS_E_READ_FAILED: set at pre-compile, destination=DemEventParameter  # Reference to the DemEventParameter which shall be issued when the error "Flash read failed (HW)" has occurred.
        symbolic name reference FLS_E_UNEXPECTED_FLASH_ID: set at pre-compile, destination=DemEventParameter  # Reference to the DemEventParameter which shall be issued when the error "Expected hardware ID not matched" has occurred.
        symbolic name reference FLS_E_WRITE_FAILED: set at pre-compile, destination=DemEventParameter  # Reference to the DemEventParameter which shall be issued when the error "Flash write failed (HW)" has occurred.
      container FlsExternalDriver [0..1]  # Container not used. This container includes configuration data for external Flash drivers only. Internal Flash drivers do not use the parameter listed in this container, hence its multiplicity is 0 for internal drivers.
        symbolic name reference FlsSpiReference [1..*]: set at pre-compile, destination=SpiSequence  # Reference to SPI sequence (required for external Flash drivers).
      container FlsSectorList  # This container includes a list of flashable sectors and pages. This container is required by the MICROSAR Fee.The emulated Fls does not need this container itself.
        container FlsSector [0..*]  # This container includes the configuration description of a flashable sector
          integer FlsNumberOfSectors: 0..65535, set at pre-compile, default-value=16  # This parameter defines the number of continuous sectors with identical values for FlsSectorSize and FlsSectorPageSize. The parameter FlsSectorStartAddress denotes the start address of the first sector. | FlsPageSize. The parameter FlsSectorStartAddress denotes the start address of the first sector.
          integer FlsPageSize: 0..4294967295, set at pre-compile, default-value=8  # This parameter defines the size of one page of this sector. | Implementation Type: Fls_LengthType.
          integer FlsSectorSize: 0..4294967295, set at pre-compile, default-value=8192  # This parameter defines the size of this sector. | Implementation Type: Fls_LengthType.
          integer FlsSectorStartaddress: 0..4294967295, set at pre-compile, default-value=0  # This parameter defines the start address of this sector. | Implementation Type: Fls_AddressType.
    container FlsGeneral  # General configuration parameteres of the FLS module.
      boolean FlsAcLoadOnJobStart [0..1]: set at pre-compile, default-value=false  # Parameter not used. This parameter defines whether the flash access code should be loaded to RAM whenever an erase or write job is startet and unload (overwrite) it after the job has been finished or canceled. True: Flash access code loaded on job start / unloaded on job end or error. False: Flash access code not loaded to / unloaded from RAM at all. | true: Flash access code loaded on job start / unloaded on job end or error. false: Flash access code not loaded to / unloaded from RAM at all.
      integer FlsBaseAddress: 0..4294967295, set at pre-compile, default-value=0  # Parameter not used. This parameter defines the flash memory start address. | FLS169_Conf: This parameter defines the lower boundary for read / write / erase and compare jobs.
      boolean FlsCancelApi: set at pre-compile, default-value=false  # This parameter defines whether the function Fls_Cancel() is enabled or disabled. True: API Fls_Cancel() is supported (function provided) False: API Fls_Cancel() is not supported (function not provided) | true: API supported / function provided. false: API not supported / function not provided
      boolean FlsCompareApi: set at pre-compile, default-value=false  # This parameter defines whether the function Fls_Compare() is enabled or disabled. True: API Fls_Compare() is supported (function provided) False: API Fls_Compare() is not supported (function not provided) | true: API supported / function provided. false: API not supported / function not provided
      boolean FlsDevErrorDetect: set at pre-compile, default-value=false  # This parameter switches the Development Error Detection and Notification ON or OFF. True: Development error detection is enabled. False: Development error detection is disabeld. Note: In general, the development error detection is recommended during pre-test phase. It is not recommended to enable the development error detection in production code due to increased runtime and ROM needs. | true: Development error detection enabled. false: Development error detection disabled.
      integer FlsDriverIndex: 0..254, set at pre-compile, symbolic-name-value=true, default-value=0  # This parameter defines the index of the driver, used by FEE.
      boolean FlsGetJobResultApi: set at pre-compile, default-value=false  # This parameter defines whether the function Fls_GetJobResult is enabled or disabled. True: API Fls_GetJobResult() is supported (function provided) False: API Fls_GetJobResult() is not supported (function not provided) | true: API supported / function provided. false: API not supported / function not provided
      boolean FlsGetStatusApi: set at pre-compile, default-value=false  # This parameter defines whether the function Fls_GetStatus() is enabled or disabled. True: API Fls_GetStatus() is supported (function provided) False: API Fls_GetStatus() is not supported (function not provided) | true: API supported / function provided. false: API not supported / function not provided
      boolean FlsSetModeApi: set at pre-compile, default-value=false  # This parameter defines whether the function Fls_SetMode() is enabled or disabled. True: API Fls_SetMode() is supported (function provided) False: API Fls_SetMode() is not supported (function not provided) | true: API supported / function provided. false: API not supported / function not provided
      integer FlsTotalSize: 0..20971520, set at pre-compile, default-value=131072  # This parameter defines the total amount of flash memory in bytes. Note: FlsTotalSize must be greater than the total amount of all configured FlsSectors. | FLS170_Conf: This parameter in conjunction with FLS_BASE_ADDRESS defines the upper boundary for read / write / erase and compare jobs.
      boolean FlsUseInterrupts [0..1]: set at pre-compile, default-value=false  # Parameter not used. This parameter defines whether the job processing is triggered by hardware interrupt. True: Job processing triggerd by interrupt (hardware controlled) False: Job processing not triggered by interrupt (software controlled) | true: Job processing triggered by interrupt (hardware controlled). false: Job processing not triggered by interrupt (software controlled)
      boolean FlsVersionInfoApi: set at pre-compile, default-value=false  # This parameter enables/disables the function Fls_VersionInfo() to get major, minor and patch version information. | true: Version info API enabled. false: Version info API disabled.
      boolean FlsSafeBswChecks: set at pre-compile, origin=Vector Informatik, default-value=false  # Selects if safety checks are used. These checks improve robustness as e.g. invalid parameters are checked before function is executed. This attribute has to be enabled for safety projects where this component is mapped to an ASIL partition.
      string FlsPrefix [0..1]: set at pre-compile, origin=Vector Informatik, max-length=255, min-length=0  # Fls Prefix | This parameter can be used to overwrite the "ModuleName", “Vendor-ID” and “API-Infix” attributes of the real component, if necessary. Example: In general the implementation specific API name is specified as: <ModuleName>_<vendorId>_<vendorApiInfix>_<API name of module> This parameter overwrites the whole parenthesis <ModuleName>_<vendorId>_<vendorApiInfix>.
    container FlsPublishedInformation  # This container includes additional parameters not covered by CommonPublishedInformation container. | Note that these parameters do not have any configuration class setting, since they are published information.
      integer FlsAcLocationErase [0..1]: 0..4294967295, set at published-information  # Parameter not used. This parameter defines the position in RAM, to which the erase flash access code has to be loaded. | Only relevant if the erase flash access code is not position independent. If this information is not provided it is assumed that the erase flash access code is position independent and that therefore the RAM position can be freely configured.
      integer FlsAcLocationWrite [0..1]: 0..4294967295, set at published-information  # Parameter not used. This parameter defines the position in RAM, to which the write flash access code has to be loaded. | Only relevant if the write flash access code is not position independent. If this information is not provided it is assumed that the write flash access code is position independent and that therefore the RAM position can be freely configured.
      integer FlsAcSizeErase [0..1]: 0..4294967295, set at published-information  # Parameter not used. This parameter defines the number of bytes in RAM needed for the erase flash access code.
      integer FlsAcSizeWrite [0..1]: 0..4294967295, set at published-information  # Parameter not used. This parameter defines the number of bytes in RAM needed for the write flash access code.
      float FlsEraseTime [0..1]: 0..Inf, set at published-information  # Parameter not used. This parameter defines the maximum time to erase one complete flash sector.
      integer FlsErasedValue: 0..255, set at published-information, default-value=255  # This parameter defines the contents of an erased flash memory cell.
      string FlsExpectedHwId [0..1]: set at published-information  # Parameter not used. This parameter defines a unique identifier of the hardware device that is expected by this driver (the device for which this driver has been implemented) | Only relevant for external flash drivers.
      integer FlsSpecifiedEraseCycles [0..1]: 0..4294967295, set at published-information  # Parameter not used. This parameter defines the number of erase cycles specified for the flash device (usually given in the device data sheet). | FLS198: If the number of specified erase cycles depends on the operating environment (temperature, voltage, ...) during reprogramming of the flash device, the minimum number for which a data retention of at least 15 years over the temperature range from -40°C .. +125°C can be guaranteed shall be given. Note: If there are different numbers of specified erase cycles for different flash sectors of the device this parameter has to be extended to a parameter list (similar to the sector list above).
      float FlsWriteTime [0..1]: 0..Inf, set at published-information  # Parameter not used. This parameter defines the maximum time to program one complete flash page.
  bsw implementation VTTFls_Impl: programming-language=C, sw-version=3.06.00, used-code-generator=cMSR, vendor-id=30, ar-release-version=4.00.03, behavior=FlsBehavior, preconfigured-configuration=VTTFls_Pre, recommended-configuration=VTTFls_Rec, vendor-specific-module-def=VTTFls
  module config VTTFls_Pre: definition=VTTFls, implementation-config-variant=VARIANT-PRE-COMPILE
  module config VTTFls_Rec: definition=VTTFls, implementation-config-variant=VARIANT-PRE-COMPILE
