AUTOSAR XML (schema 00048)
package /MICROSAR
  module config MemMap_Pre: definition=MemMap  # MemMap_ARM_Derivative Enabled
    MemMapGeneral: MemMapTypedPragmas=0, MemMapGeneratePragmasForNearAddressing=0
