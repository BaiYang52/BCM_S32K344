AUTOSAR XML (schema 4-0-3)
package /MICROSAR/VTT
  bsw implementation VTTPort_Impl: programming-language=C, sw-version=2.05.00, used-code-generator=cMSR, vendor-id=30, ar-release-version=4.00.03, preconfigured-configuration=VTTPort_Pre, recommended-configuration=VTTPort_Rec, vendor-specific-module-def=VTTPort
  module definition VTTPort [0..1]: category=VENDOR_SPECIFIC_MODULE_DEFINITION, variants pre-compile  # Configuration of the Port module.
    container PortConfigSet [0..1]: multiple-configuration-container=true  # This container is the base of a multiple configuration set
      enumeration Port_PinModeType: {uint8, uint16, uint32, uint64}, set at pre-compile, origin=Vector Informatik, default-value=uint8  # This parameter defines the type for all available pin modes.
      enumeration Port_PinType: {uint8, uint16, uint32, uint64}, set at pre-compile, origin=Vector Informatik, default-value=uint8  # This parameter defines the type for symbolic names of port pins.
      container PortContainer [0..*]  # This container includes the port configuration set.
        integer PortNumberOfPortPins [0..1]: 1..65535, set at pre-compile  # Parameter not used. This parameter defines the number of specified PortPins in this PortContainer.
        container PortPin [0..*]  # This container includes the configuration of the individual port pins.
          enumeration PortPinDirection: set at pre-compile, default-value=PORT_PIN_IN  # This parameter defines the initial direction of the pin (IN or OUT). If the direction is not changeable, the value configured here is fixed. PORT_PIN_IN: Port Pin direction set as input. PORT_PIN_OUT: Port Pin direction set as output. | The direction must match the pin mode. E.g. a pin used for an ADC must be configured to be an in port. Implementation Type: Port_PinDirectionType
            PORT_PIN_IN  # In
            PORT_PIN_OUT  # Out
          boolean PortPinDirectionChangeable: set at pre-compile, default-value=false  # This parameter defines if the direction is changeable on a port pin during runtime. | true: Port Pin direction changeable enabled. false: Port Pin direction changeable disabled.
          integer PortPinId [0..1]: 0..65535, set at pre-compile, symbolic-name-value=true, default-value=0  # Parameter not used. This parameter defines the pin id of the port pin. This value will be assigned to the symbolic name derived from the port pin container short name.
          enumeration PortPinInitialMode [0..1]: set at pre-compile  # Parameter not used. This paramater defines the port pin mode from mode list for use with Port_Init() function. PORT_PIN_MODE_ADC: Port Pin used by ADC PORT_PIN_MODE_CAN: Port Pin used for CAN PORT_PIN_MODE_DIO: Port Pin configured for DIO. It shall be used under control of the DIO driver. PORT_PIN_MODE_DIO_GPT: Port Pin configured for DIO. It shall be used under control of the general purpose timer driver. PORT_PIN_MODE_DIO_WDG: Port Pin configured for DIO. It shall be used under control of the watchdog driver. PORT_PIN_MODE_FLEXRAY: Port Pin used for FlexRay PORT_PIN_MODE_ICU: Port Pin used by ICU PORT_PIN_MODE_LIN: Port Pin used for LIN PORT_PIN_MODE_MEM: Port Pin used for external memory under control of a memory driver. PORT_PIN_MODE_PWM: Port Pin used by PWM. PORT_PIN_MODE_SPI: Port Pin used by SPI.
            PORT_PIN_MODE_ADC  # ADC
            PORT_PIN_MODE_CAN  # CAN
            PORT_PIN_MODE_DIO  # DIO
            PORT_PIN_MODE_DIO_GPT  # GPT
            PORT_PIN_MODE_DIO_WDG  # WDG
            PORT_PIN_MODE_FLEXRAY  # FlexRay
            PORT_PIN_MODE_ICU  # ICU
            PORT_PIN_MODE_LIN  # LIN
            PORT_PIN_MODE_MEM  # External Memory
            PORT_PIN_MODE_PWM  # PWM
            PORT_PIN_MODE_SPI  # SPI
          enumeration PortPinLevelValue: set at pre-compile, default-value=PORT_PIN_LEVEL_LOW  # This parameter defines the port pin level value from port pin list. PORT_PIN_LEVEL_HIGH: Port pin level is High PORT_PIN_LEVEL_LOW: Port pin level is Low
            PORT_PIN_LEVEL_HIGH  # High
            PORT_PIN_LEVEL_LOW  # Low
          enumeration PortPinMode [0..*]: set at pre-compile  # Parameter not used. This parameter defines the port pin mode from mode list. PORT_PIN_MODE_ADC: Port Pin used by ADC. PORT_PIN_MODE_CAN: Port Pin used for CAN. PORT_PIN_MODE_DIO: Port Pin configured for DIO. It shall be used under control of the DIO driver. PORT_PIN_MODE_DIO_GPT: Port Pin configured for DIO. It shall be used under control of the general purpose timer driver. PORT_PIN_MODE_DIO_WDG: Port Pin configured for DIO. It shall be used under control of the watchdog driver. PORT_PIN_MODE_FLEXRAY: Port Pin used for FlexRay. PORT_PIN_MODE_ICU: Port Pin used by ICU. PORT_PIN_MODE_LIN: Port Pin used for LIN. PORT_PIN_MODE_MEM: Port Pin used for external memory under control of a memory driver. PORT_PIN_MODE_PWM: Port Pin used by PWM. PORT_PIN_MODE_SPI: Port Pin used by SPI. | Note that more than one mode is allowed by default. That way it is e.g. possible to combine DIO with another mode such as ICU.
            PORT_PIN_MODE_ADC  # ADC
            PORT_PIN_MODE_CAN  # CAN
            PORT_PIN_MODE_DIO  # DIO
            PORT_PIN_MODE_DIO_GPT  # GPT
            PORT_PIN_MODE_DIO_WDG  # WDG
            PORT_PIN_MODE_FLEXRAY  # FlexRay
            PORT_PIN_MODE_ICU  # ICU
            PORT_PIN_MODE_LIN  # LIN
            PORT_PIN_MODE_MEM  # External Memory
            PORT_PIN_MODE_PWM  # PWM
            PORT_PIN_MODE_SPI  # SPI
          boolean PortPinModeChangeable: set at pre-compile, default-value=true  # This parameter defines if the mode is changeable on a port pin during runtime. True: Port Pin mode changeable allowed. False: Port Pin mode changeable not permitted.
    container PortGeneral  # General configuration parameteres of the PORT module.
      boolean PortDevErrorDetect: set at pre-compile, default-value=true  # This parameter switches the Development Error Detection and Notification ON or OFF. True: Development error detection is enabled. False: Development error detection is disabeld. Note: In general, the development error detection is recommended during pre-test phase. It is not recommended to enable the development error detection in production code due to increased runtime and ROM needs. | true: Enabled. false: Disabled.
      boolean PortSetPinDirectionApi: set at pre-compile, default-value=true  # This parameter defines whether the function Port_SetPinDirection() is enabled or disabled. True: API Port_SetPinDirection() is supported (function provided) False: API Port_SetPinDirection() is not supported (function not provided) | TRUE: Enabled - Function Port_SetPinDirection() is available. FALSE: Disabled - Function Port_SetPinDirection() is not available.
      boolean PortSetPinModeApi: set at pre-compile, default-value=true  # This parameter defines whether the function Port_SetPinMode() is enabled or disabled. True: API Port_SetPinMode() is supported (function provided) False: API Port_SetPinMode() is not supported (function not provided) | true: Enabled - Function Port_SetPinMode() is available. false: Disabled - Function Port_SetPinMode() is not available.
      boolean PortVersionInfoApi: set at pre-compile, default-value=false  # This parameter enables/disables the function Port_GetVersionInfo() to get major, minor and patch version information. | true: Version info API enabled. false: Version info API disabled.
      boolean PortSafeBswChecks: set at pre-compile, origin=Vector Informatik, default-value=false  # Selects if safety checks are used. These checks improve robustness as e.g. invalid parameters are checked before function is executed. This attribute has to be enabled for safety projects where this component is mapped to an ASIL partition.
      string PortPrefix [0..1]: set at pre-compile, origin=Vector Informatik, max-length=255, min-length=0  # Port Prefix | This parameter can be used to overwrite the "ModuleName", “Vendor-ID” and “API-Infix” attributes of the real component, if necessary. Example: In general the implementation specific API name is specified as: <ModuleName>_<vendorId>_<vendorApiInfix>_<API name of module> This parameter overwrites the whole parenthesis <ModuleName>_<vendorId>_<vendorApiInfix>.
  module config VTTPort_Pre: definition=VTTPort
  module config VTTPort_Rec: definition=VTTPort, implementation-config-variant=VARIANT-PRE-COMPILE
