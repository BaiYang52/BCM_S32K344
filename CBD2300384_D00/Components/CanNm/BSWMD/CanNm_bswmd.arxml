AUTOSAR XML (schema 4-0-3)
# COPYRIGHT
# Copyright (c) 2022 by Vector Informatik GmbH. All rights reserved.
# This software is copyright protected and proprietary to Vector Informatik GmbH.
# Vector Informatik GmbH grants to you only those rights as set out in the license conditions.
package /MICROSAR
  module definition CanNm [0..1]: category=VENDOR_SPECIFIC_MODULE_DEFINITION, refined-module-def=CanNm, variants post-build-loadable/pre-compile/post-build-selectable  # CAN Network Management. The CanNm is a hardware independent protocol that can only be used on CAN. Its main purpose is to coordinate the transition between normal operation and bus-sleep mode of the network. #CAN #ModeManagement #NetworkManagement #Shutdown #AUTOSAR
    container CanNmGlobalConfig  # Global configuration parameters of the CANNM.
      boolean CanNmBusLoadReductionEnabled: set at pre-compile, default-value=false  # This parameter defines if the busload reduction support is enabled. If this option is disabled the NM message is always transmitted cyclically with 'CanNmMsgCycleTime'. If it is enabled the NM message is still transmitted cyclically in Repeat Message State, but with a reduced rate in Normal Operation State. In Normal Operation State the two network nodes that have the smallest 'CanNmMsgReducedTime' and require bus-communication transmit their NM message alternately. This option is a network parameter and should be defined by the OEM. RESTRICTIONS: This parameter is only relevant if CanNmPassiveModeEnabled is false.
      boolean CanNmBusSynchronizationEnabled: set at pre-compile, default-value=false  # This parameter defines if the bus synchronization support is enabled. This feature is required for gateway nodes only. This option allows the transmission of an asynchronous NM message at any time within Network Mode. This may be required for the synchronized shutdown of networks. Therefore this option is usually only enabled in gateways. RESTRICTIONS: This parameter is derived from NmBusSynchronizationEnabled. This parameter is only relevant if CanNmPassiveModeEnabled == false.
      boolean CanNmComUserDataSupport: set at pre-compile, default-value=false  # This parameter defines if the user data handling by a PDU handled within an upper layer is supported.
      boolean CanNmCoordinatorSyncSupport: set at pre-compile, default-value=false  # This parameter defines if the coordinator synchronization support is enabled.
      boolean CanNmDevErrorDetect: set at pre-compile, default-value=true  # This parameter switches the Development Error Detection and Notification ON or OFF. true: Development error detection is enabled. false: Development error detection is disabled. Note: In general, the development error detection is recommended during pre-test phase. It is not recommended to enable the development error detection in production code due to increased runtime and ROM needs. If it is enabled development errors are reported to the Development Error Tracer (Det). The following development errors are reported: - service call without intialization of network management - service call with invalid channel handle - service call with invalid PDU ID - reception of an NM PDU in Bus Sleep Mode - network timeout (i.e. the network management timoeut timer has timed out in Repeat Message State or Normal Operation State) - null pointer has been passed as argument
      boolean CanNmImmediateTxconfEnabled: set at pre-compile, default-value=false  # This parameter defines if the immediate tx confirmation is enabled. If this option is enabled, the transmission confirmation is given immediately after transmission request. This mechanism can be used in systems which do not want to use the transmission confirmation from CanIf. RESTRICTIONS: This parameter is only relevant if CanNmPassiveModeEnabled is false.
      float CanNmMainFunctionPeriod: 0.001..0.255, set at pre-compile, default-value=0.01  # This value specifies the call cycle of CanNm_MainFunction.
      integer CanNmNumberOfChannels [0..1]: 1..255, set at pre-compile, default-value=1  # Parameter not used
      boolean CanNmPassiveModeEnabled: set at pre-compile, default-value=false  # This parameter defines if the Passive Mode is supported. If this option is set, the node is not able to send NM messages. This option can be used for nodes that do not require to keep the bus awake. RESTRICTIONS: Needs to have the same value as NmPassiveModeEnabled for all CanNm channels.
      boolean CanNmPduRxIndicationEnabled: set at pre-compile, default-value=false  # This parameter defines if the PDU Rx Indication is called. If this option is enabled a callback function for every received PDU will be triggered. RESTRICTIONS: Derived from NmPduRxIndicationEnabled.
      boolean CanNmPnEiraCalcEnabled [0..1]: set at pre-compile in variant post-build-loadable+pre-compile / post-build in variant post-build-selectable, default-value=false  # This parameter defines if the CanNm calculates the PN request information for internal and external requests. (EIRA) true: PN request information for internal and external requests are calculated false: PN request information for internal and external requests are not calculated RESTRICTIONS: This parameter is only relevant if (CanNmPnEnabled == true) for at least one channel.
      float CanNmPnResetTime [0..1]: 0.001..65.535, set at post-build in variant post-build-loadable+post-build-selectable / pre-compile in variant pre-compile, default-value=0.2  # This value specifies the runtime of the reset timer. This reset time is valid for the reset of PN requests in the EIRA and in the ERA. The value shall be the same for every channel. Thus it is a global configuration parameter. RESTRICTIONS: This parameter is only valid if (CanNmPnEnabled == true) for at least one channel.
      boolean CanNmRemoteSleepIndEnabled: set at pre-compile, default-value=false  # This parameter defines if the remote sleep indication support is enabled. This feature is required for gateway nodes only. 'CanNmRemoteSleepIndEnabled' is used in gateways to detect when the synchronized shutdown of networks has to be carried out. It comprises Remote Sleep Indication, Remote Sleep Cancelation and checking of the Remote Sleep Indication State. Remote Sleep Indication is notified when your network node is the only one in the whole network that requests bus-communication for 'CanNmRemote SleepIndTime'. Remote Sleep Cancelation is notified if any other network node requires the communication bus while Remote Sleep Indication takes place in your network node. RESTRICTIONS: Derived from NmRemoteSleepIndEnabled. This parameter is only relevant if CanNmPassiveModeEnabled is false.
      boolean CanNmStateChangeIndEnabled: set at pre-compile, default-value=false  # This parameter defines if the CAN NM state change notification is enabled. This option allows to track every change in the NM state machine by the means of a callback function triggered on every state change. RESTRICTIONS: Derived from NmStateChangeIndEnabled.
      boolean CanNmUserDataEnabled: set at pre-compile, default-value=false  # This parameter defines if the user data support is enabled. This option provides read and write access to the user data. Location of user data in the NM message depends on the message configuration. RESTRICTIONS: Derived from NmUserDataEnabled.
      boolean CanNmVersionInfoApi: set at pre-compile, default-value=false  # This parameter enables/disables the function CanNm_GetVersionInfo() to get major, minor and patch version information.
      string CanNmUserConfigFile [0..1]: set at pre-compile, origin=Vector Informatik  # Reference to an external text file that will be included during generation to CanNm_Cfg.h. The content of the user configuration file will be added at the end of the generated module configuration file and allows altering or extending the generated code. Caution: User configuration files can cause the software module to malfunction and must only be used with great care!
      boolean CanNmDisableTxErrReport: set at pre-compile, origin=Vector Informatik, default-value=false  # This parameter defines if the following error will not be reported to DET: - CANNM_E_NETWORK_TIMEOUT (DET: Network Timeout occurred) Note: For reporting to DET the parameter CanNmDevErrorDetect must be enabled.
      boolean CanNmApiOptimization: configuration-class-affection=affection-kind=PC-AFFECTS-LT, set at pre-compile, origin=Vector Informatik, default-value=false  # This parameter defines if single channel and the pre-compile optimization is enabled to save ROM, RAM and runtime. RESTRICTIONS: This option is only relevant for single channel CanNm configurations.
      boolean CanNmCanIfRangeConfigDLCCheck: set at pre-compile, origin=Vector Informatik, default-value=true  # This parameter defines if CanNm can assume that all RX PDUs have the same fixed length and/or the lower layer (CanIf) prevents CanNm from receiving PDUs with different lengths. In CanIf this is realized by the RX PDU Configuration setting 'Rx Pdu Dlc Check'. If disabled, the Minimum Data Length accepted by CanIf for CanNm PDUs can be adjusted by the user. Disable this setting if there are CanNm RX PDUs with multiple lengths on one channel. If enabled, the Minimum Data Length accepted by CanIf for CanNm PDUs is automatically determined by maximum of the 'Pdu Length' settings of the CanNm TX Pdu (if present) and CanNm RX Pdu for each channel. Enable this setting if all CanNm (RX and TX) PDUs on the same channel have the same length.
      boolean CanNmNodeIdEnabled [0..1]: set at pre-compile, origin=Vector Informatik, default-value=false  # This parameter enables the source node identifier. This option provides read access to the local node identifier and to the node identifier received in the last NM message. RESTRICTIONS: Derived from NmNodeIdEnabled. If this parameter is enabled, at least one channel must enable the parameter /MICROSAR/CanNm/CanNmGlobalConfig/CanNmChannelConfig/CanNmNodeIdEnabled. If this parameter is disabled, all channels must disable the parameter /MICROSAR/CanNm/CanNmGlobalConfig/CanNmChannelConfig/CanNmNodeIdEnabled.
      boolean CanNmRuntimeMeasurementSupport: set at pre-compile, origin=Vector Informatik, default-value=false  # This parameter defines if runtime measurement points are added to the BSW module code and to the module configuration of MICROSAR RTM. The available measurement points can be seen and configured in the RTM module configuration. Availability of the MICROSAR RTM module is a prerequisite to make use of the runtime measurement functionality. Runtime measurement should be disabled in production code as measurement points may inflict additional runtime.
      boolean CanNmSafeBswChecks: set at pre-compile, origin=Vector Informatik, default-value=false  # Selects if safety checks are used. These checks improve robustness as e.g. invalid parameters are checked before function is executed. This attribute has to be enabled for safety projects where this component is mapped to an ASIL partition.
      boolean CanNmComControlEnabled [0..1]: set at pre-compile, default-value=false  # This parameter defines if the Communication Control support is enabled. If this option is enabled an additional API is available that allows to enable and disable the transmission of Network Management Messages in the Normal Operation state. While the transmission is disabled the network cannot be released. RESTRICTIONS: Derived from NmComControlEnabled. If this parameter is enabled, at least one channel must enable the parameter /MICROSAR/CanNm/CanNmGlobalConfig/CanNmChannelConfig/CanNmComControlEnabled. If this parameter is disabled, all channels must disable the parameter /MICROSAR/CanNm/CanNmGlobalConfig/CanNmChannelConfig/CanNmComControlEnabled.
      boolean CanNmImmediateRestartEnabled [0..1]: set at pre-compile, default-value=false  # This parameter defines if the asynchronous transmission of a NM PDU upon bus-communication request in Prepare-Bus-Sleep mode is enabled. Enabling this option may lead to a burst of NM messages if all Nodes get a bus-communication request approximately at the same time. RESTRICTIONS: This parameter is only relevant if CanNmPassiveModeEnabled is False If this parameter is enabled, at least one channel must enable the parameter /MICROSAR/CanNm/CanNmGlobalConfig/CanNmChannelConfig/CanNmImmediateRestartEnabled. If this parameter is disabled, all channels must disable the parameter /MICROSAR/CanNm/CanNmGlobalConfig/CanNmChannelConfig/CanNmImmediateRestartEnabled.
      boolean CanNmNodeDetectionEnabled [0..1]: set at pre-compile, default-value=false  # This parameter defines if the node detection feature is enabled. If a Tester is present in the network 'CanNmNodeDetectionEnabled' offers the opportunity to detect all present network nodes. RESTRICTIONS: Derived from NmNodeDetectionEnabled. This parameter is only relevant if CanNmPassiveModeEnabled is false. The feature can only be used on a channel if CanNmPduNidPosition is not equal to CANNM_PDU_OFF. If this parameter is enabled, at least one channel must enable the parameter /MICROSAR/CanNm/CanNmGlobalConfig/CanNmChannelConfig/CanNmNodeDetectionEnabled. If this parameter is disabled, all channels must disable the parameter /MICROSAR/CanNm/CanNmGlobalConfig/CanNmChannelConfig/CanNmNodeDetectionEnabled.
      boolean CanNmRepeatMsgIndEnabled [0..1]: set at pre-compile, default-value=false  # This parameter defines if the notification that a RepeatMessageRequest bit has been received is enabled. This option enables a callback to the NM Interface whenever a state change due to a repeat message request or a repeat message bit occurs. RESTRICTIONS: If (CanNmNodeDetectionEnabled == false) then (CanNmRepeatMsgIndEnabled = false). Derived from NmRepeatMsgIndEnabled. If this parameter is enabled, at least one channel must enable the parameter /MICROSAR/CanNm/CanNmGlobalConfig/CanNmChannelConfig/CanNmRepeatMsgIndEnabled. If this parameter is disabled, all channels must disable the parameter /MICROSAR/CanNm/CanNmGlobalConfig/CanNmChannelConfig/CanNmRepeatMsgIndEnabled.
      boolean CanNmPnSyncShutdownErrorReactionEnabled: set at pre-compile, origin=Vector Informatik, default-value=false  # Pre-processor switch for enabling reaction, if a top-level PNC coordinator received a PN shutdown message on a NM-channel which refer to a ComM channel that is actively coordinated by a PNC gateway.
      float CanNmPnShutdownMessageRetransmissionDuration [0..1]: 0.001..65.535, set at pre-compile, origin=Vector Informatik  # Specifies the duration in ms of the retransmission phase of a PN shutdown message. A retransmission shall be performed per affected NM channel, as long as the PN shutdown message could not be successfully sent and the retransmission timer is running. The value shall be a multiple integral of CanNmMainFunctionPeriod.
      float CanNmPnShutdownMessageTimeoutTime [0..1]: 0.001..65.535, set at pre-compile, origin=Vector Informatik  # This message timeout time is only relevant if the feature CanNmSynchronizedPncShutdownEnabled is enabled. This parameter specifies the timeout time that is waited for a TxConfirmation of the transmitted PNSR message until a retry is performed. Note: This time must be smaller than the CanNmPnShutdownMessageRetransmissionDuration.
      boolean CanNmRuntimeErrorReport: set at pre-compile, origin=Vector Informatik, default-value=true  # Selects if runtime errors are reported.
      reference CanNmPnEiraRxNSduRef [0..1]: set at pre-compile in variant post-build-loadable+pre-compile / post-build in variant post-build-selectable, destination=Pdu  # Reference to a Pdu in the COM-Stack. With this Pdu the partial network information is forwarded to the upper layer. Only one SduRef is required for CanNm because the EIRA is the aggregation over all CAN channels. RESTRICTIONS: This parameter is only relevant if (CanNmPnEiraCalcEnabled == True)
      container CanNmChannelConfig [0..*]  # This container includes the channel specific configuration parameter of the CanNm.
        boolean CanNmAllNmMessagesKeepAwake [0..1]: set at pre-compile in variant post-build-loadable+pre-compile / post-build in variant post-build-selectable, default-value=false  # This parameter defines if all NM messages are handled. This parameter enables/disables if all received NM messages shall keep the ECU awake. If disabled only NM messages with CRI bit = TRUE and containing relevant cluster request for this ECU will keep the ECU awake. false: Only NM messages with an with CRI bit = true and containing a PN request for this ECU triggers the standard RX indication handling true: Every NM message triggers the standard RX indication handling Note: If 'Pn Enabled' is ON for this channel and a CAN transceiver is used that does not have Partial Networking support, CanNm always behaves as if this parameter is true. RESTRICTIONS: This parameter is only relevant if (CanNmPnEnabled == True)
        boolean CanNmBusLoadReductionActive: set at pre-compile in variant post-build-loadable+pre-compile / post-build in variant post-build-selectable, default-value=false  # This parameter defines if bus load reduction for the respective NM channel is active or not. If 'Bus Load Reduction Active' is disabled the NM message is always transmitted cyclically with 'CanNmMsgCycleTime'. If 'Bus Load Reduction Active' is enabled the NM message is still transmitted cyclically in Repeat Message State, but with a reduced rate in Normal Operation State. In Normal Operation State the two network nodes that have the smallest 'CanNmMsgReducedTime' and require bus-communication transmit their NM message alternately. This option is a network parameter and should be defined by the OEM. RESTRICTIONS: This parameter is only valid if (CanNmBusLoadReductionEnabled == True)
        integer CanNmCarWakeUpBitPosition [0..1]: 0..7, set at pre-compile in variant post-build-loadable+pre-compile / post-build in variant post-build-selectable, default-value=0  # This parameter specifies the Bit position of the Car Wake-Up Bit within the NM-PDU. Note that this parameter has to be set to a value between 0 and 7. RESTRICTIONS: This parameter is only relevant if (CanNmCarWakeUpRxEnabled == True)
        integer CanNmCarWakeUpBytePosition [0..1]: 0..63, set at pre-compile in variant post-build-loadable+pre-compile / post-build in variant post-build-selectable, default-value=2  # This parameter specifies the Byte position of the Car Wake-Up Bit within the NM-PDU. Note that this parameter has to be set to a valid byte position within the user data of the NM PDU. If this setting is set to '0', the first byte of the NM PDU (not necessarily the first user data byte) is referred. RESTRICTIONS: This parameter is only relevant if (CanNmCarWakeUpRxEnabled == True)
        boolean CanNmCarWakeUpFilterEnabled [0..1]: set at pre-compile in variant post-build-loadable+pre-compile / post-build in variant post-build-selectable, default-value=false  # This parameter defines if Car Wake-Up filtering is supported. Then only the Car Wake-Up bit within the NM message with source node identifier CanNmCarWakeUpFilterNodeId is considered as Car Wake-Up request. false: Car Wake-up filtering is not supported true: Car Wake-up filtering is supported RESTRICTIONS: This parameter is only relevant if (CanNmCarWakeUpRxEnabled == True)
        integer CanNmCarWakeUpFilterNodeId [0..1]: 0..255, set at pre-compile in variant post-build-loadable+pre-compile / post-build in variant post-build-selectable, default-value=0  # This value specifies the source node identifier for Car Wake-Up filtering. If Car Wake-Up filtering is supported, only the Car Wake-Up bit within the NM message with source node identifier CanNmCarWakeUpFilterNodeId is considered as Car Wake-Up request. Note that this parameter has to be set to a value between 0x00 and 0xFF. RESTRICTIONS: This parameter is only relevant if (CanNmCarWakeUpFilterEnabled == True)
        boolean CanNmCarWakeUpRxEnabled: set at pre-compile in variant post-build-loadable+pre-compile / post-build in variant post-build-selectable, default-value=false  # This parameter defines if support of Car Wake-Up bit evaluation in received NM PDUs is enabled. false: Car Wake-up is not supported true: Car Wake-up is supported
        float CanNmImmediateNmCycleTime [0..1]: 0.001..65.535, set at pre-compile in variant post-build-loadable+pre-compile / post-build in variant post-build-selectable, default-value=0.1  # This value specifies the immediate NM PDU cycle time which is used for CanNmImmediateNmTransmissions NM PDU transmissions. This parameter is only valid if CanNmImmediateNmTransmissions is greater than one.
        integer CanNmImmediateNmTransmissions: 0..255, set at pre-compile in variant post-build-loadable+pre-compile / post-build in variant post-build-selectable, default-value=0  # This value specifies the number of immediate NM PDUs which shall be transmitted. If the value is zero no immediate NM PDUs are transmitted. The cycle time of immediate NM PDUs is defined by CanNmImmediateNmCycleTime.
        float CanNmMsgCycleOffset: 0..65.535, set at post-build in variant post-build-loadable+post-build-selectable / pre-compile in variant pre-compile, default-value=0  # This value specifies the offset in the periodic transmission node. It determines the start delay of the transmission. Whenever the transmission of network management messages is started the transmission start is delayed by this value. RESTRICTIONS: This parameter is only relevant if (CanNmPassiveModeEnabled == False)
        float CanNmMsgCycleTime: 0.001..65.535, set at pre-compile in variant post-build-loadable+pre-compile / post-build in variant post-build-selectable, default-value=0.1  # This value specifies the period of a NM PDU. It determines the periodic rate in the "periodic transmission mode with bus load reduction" and is the basis for transmit scheduling in the "periodic transmission mode without bus load reduction". RESTRICTIONS: This parameter is only relevant if (CanNmPassiveModeEnabled == False)
        float CanNmMsgReducedTime: 0.001..65.535, set at post-build in variant post-build-loadable+post-build-selectable / pre-compile in variant pre-compile, default-value=0.08  # This value specifies the node specific bus cycle time in the periodic transmission mode with bus load reduction. RESTRICTIONS: This parameter is only relevant if (CanNmBusLoadReductionEnabled == True) and (CanNmBusLoadReductionActive == True) and (CanNmPassiveModeEnabled == False). The value must be unique within the network and the following value limitation applies: (0,5 * CanNmMsgCycleTime) <= CanNmMsgReducedTime < CanNmMsgCycleTime
        float CanNmMsgTimeoutTime: 0.001..65.535, set at pre-compile in variant post-build-loadable+pre-compile / post-build in variant post-build-selectable, default-value=0.06  # This value specifies the transmission timeout of NM PDUs. If there is no transmission confirmation by the CAN Interface within this timeout, the CANNM module shall give an error notification. RESTRICTIONS: This parameter is only relevant if (CanNmPassiveModeEnabled == False). It should be a multiple of CanNmMainFunctionPeriod and smaller than CanNmMsgCycleTime. If CanNmBusLoadReductionActive is True, it also should be smaller than CanNmMsgReducedTime.
        integer CanNmNodeId: 0..255, set at post-build in variant post-build-loadable+post-build-selectable / pre-compile in variant pre-compile, default-value=0  # This value specifies the node identifier of local node. The 'NodeId' is transmitted within the network management message if CanNmPduNidPosition != CANNM_PDU_OFF) The node identifier is used for the detection of present nodes and can be read by the application at any time. Note: This value is transmitted within the NM message.
        enumeration CanNmPduCbvPosition: {CANNM_PDU_BYTE_0, CANNM_PDU_BYTE_1, CANNM_PDU_OFF}, set at pre-compile in variant post-build-loadable+pre-compile / post-build in variant post-build-selectable, default-value=CANNM_PDU_OFF  # This value specifies the position of the control bit vector within the NM PDU. The value of the parameter represents the location of the control bit vector in the NM PDU (CANNM_PDU_BYTE_0 means byte 0, CANNM_PDU_BYTE_1 means byte 1, CANNM_PDU_OFF means that the Control Bit Vector is not part of the NM PDU). RESTRICTIONS: If (CanNmPduCbvPosition != CANNM_PDU_OFF) then (CanNmPduCbvPosition != CanNmPduNidPosition) and (CanNmPduLength >= CanNmPduCbvPosition). If (CanNmPduNidPosition == CANNM_PDU_OFF) then (CanNmPduCbvPosition != CANNM_PDU_BYTE_1).
        enumeration CanNmPduNidPosition: {CANNM_PDU_BYTE_0, CANNM_PDU_BYTE_1, CANNM_PDU_OFF}, set at pre-compile in variant post-build-loadable+pre-compile / post-build in variant post-build-selectable, default-value=CANNM_PDU_OFF  # This value specifies the position of the source node identifier within the NM PDU. The value of the parameter represents the location of the source node identifier in the NM PDU (CANNM_PDU_BYTE_0 means byte 0, CANNM_PDU_BYTE_1 means byte 1, CANNM_PDU_OFF means that the source node identifier is not part of the NM PDU). Note: If 'CanNmNodeIdEnabled' is ON, it is allowed to set 'CanNmPduNidPosition' to CANNM_PDU_OFF for each channel. RESTRICTIONS: If (CanNmPduNidPosition != CANNM_PDU_OFF) then (CanNmPduNidPosition != CanNmPduCbvPosition) and (CanNmPduLength >= CanNmPduNidPosition). If (CanNmPduCbvPosition == CANNM_PDU_OFF) then (CanNmPduNidPosition != CANNM_PDU_BYTE_1).
        boolean CanNmPnEnabled [0..1]: set at post-build in variant post-build-loadable+post-build-selectable / pre-compile in variant pre-compile, default-value=false  # This parameter defines if support of partial networking is enabled. false: Partial networking is not supported true: Partial networking is supported
        boolean CanNmPnEraCalcEnabled [0..1]: set at pre-compile in variant post-build-loadable+pre-compile / post-build in variant post-build-selectable, default-value=false  # This parameter defines if CanNm calculates the PN request information for external requests. (ERA) false: PN request information for external requests are not calculated. true: PN request information for external requests are calculated. RESTRICTIONS: This parameter is only relevant if (CanNmPnEnabled == True)
        boolean CanNmPnHandleMultipleNetworkRequests [0..1]: set at pre-compile in variant post-build-loadable+pre-compile / post-build in variant post-build-selectable, default-value=false  # This parameter defines whether CanNm_NetworkRequest calls have an effect in Network Mode. If disabled CanNm_NetworkRequest is ignored in Network Mode. If enabled CanNm_NetworkRequest triggers a change from Network Mode to Repeat Message. RESTRICTIONS: This parameter is only relevant if (CanNmPnEnabled == True)
        float CanNmRemoteSleepIndTime: 0..65.535, set at pre-compile in variant post-build-loadable+pre-compile / post-build in variant post-build-selectable, default-value=0.5  # This value specifies the timeout for Remote Sleep Indication. Remote Sleep Indication is notified when the network node of the own ECU is the only one in the whole network that requests bus communication for this timing value. Typically it should be equal to: n * CanNmMsgCycleTime, where n denotes the number of NM-Messages that are normally sent before Remote Sleep Indication is detected. The value of n decremented by one determines the amount of lost NM-Messages that can be tolerated by the Remote Sleep Indication procedure. RESTRICTIONS: This parameter is only relevant if (CanNmRemoteSleepIndEnabled == True) If (CanNmRemoteSleepIndEnabled == True) then (CanNmRemoteSleepIndTime > 0)
        float CanNmRepeatMessageTime: 0..65.535, set at pre-compile in variant post-build-loadable+pre-compile / post-build in variant post-build-selectable, default-value=0.4  # This value specifies the timeout for Repeat Message State. It defines how long the NM shall stay in the Repeat Message State. Within Repeat Message State the NM messages are always transmitted cyclically - even if 'Bus Load Reduction' is enabled. Typically it should be equal to: n * CanNmMsgCycleTime, where n denotes the number of NM-Messages that are normally sent in the Repeat Message State. The value of n decremented by one determines the amount of lost NM-Messages that can be tolerated by the node detection procedure. The value 0 denotes that no Repeat Message State is configured. It means that Repeat Message State is transient what implicates that it is left immediately after entrance and in result no start-up stability is guaranteed and no node detection procedure is possible. Note: If (CanNmPassiveModeEnabled == True), a value of CanNmRepeatMessageTime = 0 is recommended. RESTRICTIONS: If (CanNmNodeDetectionEnabled == True) then (CanNmRepeatMessageTime > 0)
        float CanNmTimeoutTime: 0.002..65.535, set at pre-compile in variant post-build-loadable+pre-compile / post-build in variant post-build-selectable, default-value=1  # This value specifies the Network Timeout for the reception and transmission of network management messages. If in Network Mode (Repeat Message State, Normal Operation State or Ready Sleep State) your network node does not require the communication bus anymore and no more NM messages are received within this time 'Prepare Bus-Sleep' is entered. It shall be equal for all nodes in the cluster. It shall be greater than CanNmMsgCycleTime. Typically it should be equal to n * CanNmMsgCycleTime, where n denotes the number of NM-Message cycle times in the Ready Sleep State before transition into the Bus-Sleep Mode is initiated. The value of n decremented by one determines the amount of lost NM-Messages that can be tolerated by the coordination algorithm.
        integer CanNmUserDataLength: 0..64, set at pre-compile in variant post-build-loadable+pre-compile / post-build in variant post-build-selectable, default-value=0  # This value specifies the length of the user data contained in the NM PDU.
        float CanNmWaitBusSleepTime: 0.001..65.535, set at pre-compile in variant post-build-loadable+pre-compile / post-build in variant post-build-selectable, default-value=0.75  # This value specifies the timeout for bus calm down phase (Prepare Bus-Sleep Mode). The bus calm down period is a safety zone between bus-communication of application messages and shutdown of the communication bus. It shall be equal for all nodes in the cluster. It shall be long enough to make all Tx-buffer empty.
        boolean CanNmActiveWakeupBitEnabled: set at pre-compile in variant post-build-loadable+pre-compile / post-build in variant post-build-selectable, origin=Vector Informatik, default-value=false  # This parameter defines if the active wakeup bit is set in the CBV for this channel.
        boolean CanNmRetryFirstMessageRequest [0..1]: set at pre-compile in variant post-build-loadable+pre-compile / post-build in variant post-build-selectable, origin=Vector Informatik, default-value=false  # This pararmeter specifies if first message request in CanNm is repeated until accepted by CanIf. RESTRICTION: CanNmRetryFirstMessageRequest = false if CanNmPassiveModeEnabled == true
        boolean CanNmNodeIdEnabled: set at pre-compile in variant post-build-loadable+pre-compile / post-build in variant post-build-selectable, origin=Vector Informatik, default-value=false  # This parameter enables the source node identifier on the selected channel. This option provides read access to the local node identifier and to the node identifier received in the last NM message. RESTRICTIONS: If this parameter is enabled, the global parameter /MICROSAR/CanNm/CanNmGlobalConfig/CanNmNodeIdEnabled must be enabled. If /MICROSAR/CanNm/CanNmGlobalConfig/CanNmNodeIdEnabled is disabled, this parameter must be disabled.
        boolean CanNmNodeDetectionEnabled: set at pre-compile in variant post-build-loadable+pre-compile / post-build in variant post-build-selectable, origin=Vector Informatik, default-value=false  # This parameter defines if the node detection feature is enabled per channel. If a Tester is present in the network 'CanNmNodeDetectionEnabled' offers the opportunity to detect all present network nodes. RESTRICTIONS: This parameter is only relevant if CanNmPassiveModeEnabled is false. The feature can only be used on a channel if CanNmPduNidPosition is not equal to CANNM_PDU_OFF. If this parameter is enabled, the global parameter /MICROSAR/CanNm/CanNmGlobalConfig/CanNmNodeDetectionEnabled must be enabled. If /MICROSAR/CanNm/CanNmGlobalConfig/CanNmNodeDetectionEnabled is disabled, this parameter must be disabled.
        boolean CanNmRepeatMsgIndEnabled: set at pre-compile in variant post-build-loadable+pre-compile / post-build in variant post-build-selectable, origin=Vector Informatik, default-value=false  # This parameter defines if the notification that a RepeatMessageRequest bit has been received is enabled per channel. This option enables a callback to the NM Interface whenever a state change due to a repeat message request or a repeat message bit occurs. RESTRICTIONS: If (CanNmNodeDetectionEnabled == false) then (CanNmRepeatMsgIndEnabled = false). If this parameter is enabled, the global parameter /MICROSAR/CanNm/CanNmGlobalConfig/CanNmRepeatMsgIndEnabled must be enabled. If /MICROSAR/CanNm/CanNmGlobalConfig/CanNmRepeatMsgIndEnabled is disabled, this parameter must be disabled.
        boolean CanNmImmediateRestartEnabled: set at pre-compile in variant post-build-loadable+pre-compile / post-build in variant post-build-selectable, origin=Vector Informatik, default-value=false  # This parameter defines if the asynchronous transmission of a NM PDU upon bus-communication request in Prepare-Bus-Sleep mode is enabled per channel. Enabling this option may lead to a burst of NM messages if all Nodes get a bus-communication request approximately at the same time. RESTRICTIONS: This parameter is only relevant if CanNmPassiveModeEnabled is False If this parameter is enabled, the global parameter /MICROSAR/CanNm/CanNmGlobalConfig/CanNmImmediateRestartEnabled must be enabled. If /MICROSAR/CanNm/CanNmGlobalConfig/CanNmImmediateRestartEnabled is disabled, this parameter must be disabled.
        boolean CanNmComControlEnabled: set at pre-compile in variant post-build-loadable+pre-compile / post-build in variant post-build-selectable, origin=Vector Informatik, default-value=false  # This parameter defines if the Communication Control support is enabled per channel. If this option is enabled an additional API is available that allows to enable and disable the transmission of Network Management Messages in the Normal Operation state. While the transmission is disabled the network cannot be released. RESTRICTIONS: If this parameter is enabled, the global parameter /MICROSAR/CanNm/CanNmGlobalConfig/CanNmComControlEnabled must be enabled. If /MICROSAR/CanNm/CanNmGlobalConfig/CanNmComControlEnabled is disabled, this parameter must be disabled.
        boolean CanNmCriBitAlwaysEnabled: set at pre-compile in variant post-build-loadable+pre-compile / post-build in variant post-build-selectable, origin=Vector Informatik, default-value=false  # When this feature is enabled, the CRI bit in the CBV byte is always enabled. Regardless of the configured Partial Network setting. Note: The CRI bit is responsible to display if the current message contains PN info bytes and is usually only set if Partial Network is enabled.
        boolean CanNmSynchronizedPncShutdownEnabled [0..1]: set at pre-compile, origin=Vector Informatik, default-value=false  # Specifies if CanNm handle PN shutdown messages to support a synchronized PNC shutdown across a PN topology. This is only used for ECUs in the role of a top-level PNC coordinator or intermediate PNC coordinator. Thus, the PNC gateway functionality is enabled and therefore ERA calculation is used. FALSE: synchronized PNC shutdown is disabled TRUE: synchronized PNC shutdown is enabled
        reference CanNmPnEraRxNSduRef [0..1]: set at pre-compile in variant post-build-loadable+pre-compile / post-build in variant post-build-selectable, destination=Pdu  # Reference to a Pdu in the COM-Stack. The SduRef is required for every CanNm Channel, because ERA is reported per channel. RESTRICTIONS: This parameter is only relevant if (CanNmPnEraCalcEnabled == True)
        symbolic name reference CanNmComMNetworkHandleRef: set at pre-compile in variant post-build-loadable+pre-compile / post-build in variant post-build-selectable, destination=ComMChannel  # ComM Network Handle Ref | Reference to the unique channel defined by the ComMChannel. It provides access to the unique channel index value in ComMChannelId.
        container CanNmRxPdu [1..*]  # This container includes the configuration of Rx PDU properties that are used for the CanNm Channel.
          integer CanNmRxPduId: 0..65535, set at pre-compile, symbolic-name-value=true, default-value=0  # This value specifies the Rx PDU ID of the CanIf L-PDU range that is associated with this CanNmChannel instance.
          reference CanNmRxPduRef: set at post-build in variant post-build-loadable+post-build-selectable / pre-compile in variant pre-compile, destination=Pdu  # Reference to the global Rx PDU that is used by this CanNmChannel.
        container CanNmTxPdu [0..1]  # This container includes the configuration of Tx PDU properties that are used for the CanNm Channel.
          integer CanNmTxConfirmationPduId: 0..65535, set at pre-compile, symbolic-name-value=true, default-value=0  # This value specifies the Tx PDU ID to be used by the Lower Layer to confirm the transmission of the CanNmTxPdu. RESTRICTIONS: This parameter is only relevant if CanNmPassiveModeEnabled = False. ImplementationType: PduIdType
          reference CanNmTxPduRef: set at post-build in variant post-build-loadable+post-build-selectable / pre-compile in variant pre-compile, destination=Pdu  # Reference to the global Tx PDU that is used by this CanNmChannel. RESTRICTIONS: This parameter is only relevant if CanNmPassiveModeEnabled = False.
        container CanNmUserDataTxPdu [0..1]  # This optional container is used to configure the UserNm PDU. This container is only available if CanNmComUserDataSupport is enabled.
          integer CanNmTxUserDataPduId: 0..65535, set at pre-compile, symbolic-name-value=true, default-value=0  # This value specifies the Handle ID of the NM User Data PDU. If NM user data has been changed, CanNm_Transmit may be called by PduR using this handle ID. RESTRICTIONS: This parameter is only relevant if CanNmComUserDataSupport = True. ImplementationType: PduIdType
          boolean CanNmAllowTriggeredMsgTransmission [0..1]: set at post-build in variant post-build-loadable+post-build-selectable / pre-compile in variant pre-compile, origin=Vector Informatik, default-value=false  # This parameter defines if changes written to the User Data Pdu triggers an immediate transmission of the NM message. RESTRICTIONS: This parameter is only relevant if (CanNmPassiveModeEnabled == False)
          reference CanNmTxUserDataPduRef: set at post-build in variant post-build-loadable+post-build-selectable / pre-compile in variant pre-compile, destination=Pdu  # Reference to the NM User Data I-PDU in the global PDU collection. RESTRICTIONS: This parameter is only relevant if CanNmComUserDataSupport = True.
      container CanNmPnInfo [0..1]  # This container includes the PN information configuration.
        integer CanNmPnInfoLength: 0..63, set at pre-compile in variant post-build-loadable+pre-compile / post-build in variant post-build-selectable, default-value=0  # This values specifies the length of the PN request information in the NM message. Note that this parameter has to be set to a value less or equal to user data length. RESTRICTIONS: This parameter is only valid if (CanNmPnEnabled == True) for at least one channel. This parameter cannot be edited directly in DaVinci Configurator. To change its value, add or remove CanNmPnFilterMaskByte containers.
        integer CanNmPnInfoOffset: 1..63, set at post-build in variant post-build-loadable+post-build-selectable / pre-compile in variant pre-compile, default-value=1  # This values specifies the offset of the PN request information in the NM message. Note that this parameter has to be set to a valid byte position within the user data of the NM PDU. RESTRICTIONS: This parameter is only valid if (CanNmPnEnabled == True) for at least one channel.
        container CanNmPnFilterMaskByte [0..63]  # This container includes the PN filter mask configuration.
          integer CanNmPnFilterMaskByteIndex: 0..62, set at post-build in variant post-build-loadable+post-build-selectable / pre-compile in variant pre-compile, default-value=0  # This value specifies the offset of the PN request information in the NM message. RESTRICTIONS: This parameter is only valid if (CanNmPnEnabled == True) for at least one channel.
          integer CanNmPnFilterMaskByteValue: 0..255, set at post-build in variant post-build-loadable+post-build-selectable / pre-compile in variant pre-compile, default-value=0  # This value specifies the filter mask byte. This parameter defines the value of the mask byte which is used for the filter algorithm for relevant NM messages. RESTRICTIONS: This parameter is only valid if (CanNmPnEnabled == True) for at least one channel.
      container CanNmGeneration  # Contains the generation configuration parameters of the module CanNm.
        boolean CanNmOutOfBoundsWriteSanitizer: set at pre-compile, origin=Vector Informatik, default-value=false  # This parameter activates/deactivates the generation of runtime checks which call a DET error notification function to find easily out of bounds write problems. FALSE: no checks are generated in the data access. TRUE: the data access is enriched with DET checks to validate indexes.
        boolean CanNmOutOfBoundsReadSanitizer: set at pre-compile, origin=Vector Informatik, default-value=false  # This parameter activates/deactivates the generation of runtime checks which call a DET error notification function to find easily out of bounds read problems. FALSE: no checks are generated in the data access. TRUE: the data access is enriched with DET checks to validate indexes.
        boolean CanNmInterfacesForDeactivatedData: set at pre-compile, origin=Vector Informatik, default-value=false  # This parameter activates/deactivates the capability to generate bsw data interfaces for deactivated data elements. This is an advantage for the BSW developer to reduce the time to market with a development environment using auto completition and to investigate potential interfaces. FALSE: data interfaces are not generated if the data elementis deactivated. TRUE: data interfaces are generated as e.g. emty macros.
  bsw implementation CanNm_Impl: programming-language=C, sw-version=11.00.01, used-code-generator=DaVinci Configurator, vendor-id=30, ar-release-version=4.00.03, behavior=CanNmBehavior, preconfigured-configuration=CanNm_Pre, recommended-configuration=CanNm_Rec, vendor-specific-module-def=CanNm
  module config CanNm_Pre: definition=CanNm
  module config CanNm_Rec: definition=CanNm
