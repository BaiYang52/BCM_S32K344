[part 3 of 3: package /MICROSAR]
AUTOSAR XML (schema 4-0-3)
# COPYRIGHT
# Copyright (c) 2022 by Vector Informatik GmbH. All rights reserved.
# This software is copyright protected and proprietary to Vector Informatik GmbH.
# Vector Informatik GmbH grants to you only those rights as set out in the license conditions.
package /MICROSAR  (continued)
  module definition Dcm [0..1]: category=VENDOR_SPECIFIC_MODULE_DEFINITION, refined-module-def=Dcm, variants pre-compile/post-build-loadable/post-build-selectable  (continued)
    container DcmConfigSet  (continued)
      container DcmDsp  (continued)
        container DcmDspRoutine [0..*]  # This container contains the configuration (parameters) for Routines.
          function name DcmDspRequestResultsRoutineFnc [0..1]: set at pre-compile  # Specifies the call out function name for requesting RID results. Effect: ------------------------------------ If this parameter is not empty, the Dcm will call the specified function on RID request results diagnostic request. Constraints: ------------------------------------ none Dependencies: ------------------------------------ Has effect only if: - the diagnostic service 0x31 (RoutineControlByIdentifier) is supported by Dcm (refer to /Dcm/DcmConfigSet/DcmDsd/DcmDsdServiceTable/DcmDsdService) - the RID supports the operation request routine results (refer to /Dcm/DcmConfigSet/DcmDsp/DcmDspRoutine/DcmDspRequestResultsRoutineSupported) - the DcmDspRoutineUsePort is set to FALSE (i.e. call out) types (refer to /Dcm/DcmConfigSet/DcmDsp/DcmDspRoutine/DcmDspRoutineUsePort) Runtime effects: ------------------------------------ none Code ROM usage effects: ------------------------------------ none Const data ROM usage effects: ------------------------------------ none Global RAM usage effects: ------------------------------------ none Stack RAM usage effects: ------------------------------------ none
          boolean DcmDspRequestResultsRoutineSupported: set at pre-compile  # Specifies whether the RID shall support request result operation. Effect: ------------------------------------ If set to TRUE, Dcm will accept a request result operation request on this RID. Otherwise, the Dcm will reject the request with a NRC 0x12 (SubFunctionNotSupported). Constraints: ------------------------------------ none Dependencies: ------------------------------------ none Runtime effects: ------------------------------------ none Code ROM usage effects: ------------------------------------ none Const data ROM usage effects: ------------------------------------ If set to TRUE, the Dcm configuration data ROM usage will increase due to the additional data to be hold for this operation. Global RAM usage effects: ------------------------------------ none Stack RAM usage effects: ------------------------------------ none
          boolean DcmDspRoutineFixedLength: set at pre-compile, default-value=false  # NOT USED Instead, the corresponding routine operation request/response data type specifies whether a signal has fixed/variable length. Example: /Dcm/DcmConfigSet/DcmDsp/DcmDspRoutineInfo/DcmDspRoutineRequestResOut/DcmDspRoutineRequestResOutSignal/DcmDspRoutineSignalType
          integer DcmDspRoutineIdentifier: 0..65535, set at pre-compile  # 2 bytes Identifier of the RID
          boolean DcmDspRoutineUsePort: set at pre-compile, default-value=true  # If this parameter is set to true, the DCM uses a port requiring a PortInterface RoutineServices_<ROUTINENAME>.
          boolean DcmDspRoutineUsed: set at pre-compile, default-value=true  # Allow to activate or deactivate the usage of a Routine, for multi purpose ECUs In a single configurations the parameter can be used to temporarily disable a complete RID in the Dcm configuration without the need to delete all its configuration parameters. Effect: ------------------------------------ If set to FALSE, the RID and all its signals will not be used in the Dcm generated code. Constraints: ------------------------------------ none Dependencies: ------------------------------------ none Runtime effects: ------------------------------------ none Code ROM usage effects: ------------------------------------ none Const data ROM usage effects: ------------------------------------ If set to FALSE, no data ROM for this RID will be used in the Dcm configuration sources. Global RAM usage effects: ------------------------------------ none Stack RAM usage effects: ------------------------------------ none
          function name DcmDspStartRoutineFnc [0..1]: set at pre-compile  # Specifies the call out function name for starting a RID. Effect: ------------------------------------ If this parameter is not empty, the Dcm will call the specified function on RID start diagnostic request. Constraints: ------------------------------------ none Dependencies: ------------------------------------ Has effect only if: - the diagnostic service 0x31 (RoutineControlByIdentifier) is supported by Dcm (refer to /Dcm/DcmConfigSet/DcmDsd/DcmDsdServiceTable/DcmDsdService) - the DcmDspRoutineUsePort is set to FALSE (i.e. call out) types (refer to /Dcm/DcmConfigSet/DcmDsp/DcmDspRoutine/DcmDspRoutineUsePort) Runtime effects: ------------------------------------ none Code ROM usage effects: ------------------------------------ none Const data ROM usage effects: ------------------------------------ none Global RAM usage effects: ------------------------------------ none Stack RAM usage effects: ------------------------------------ none
          function name DcmDspStopRoutineFnc [0..1]: set at pre-compile  # Specifies the call out function name for stopping a RID. Effect: ------------------------------------ If this parameter is not empty, the Dcm will call the specified function on RID stop diagnostic request. Constraints: ------------------------------------ none Dependencies: ------------------------------------ Has effect only if: - the diagnostic service 0x31 (RoutineControlByIdentifier) is supported by Dcm (refer to /Dcm/DcmConfigSet/DcmDsd/DcmDsdServiceTable/DcmDsdService) - the RID supports the operation request routine results (refer to /Dcm/DcmConfigSet/DcmDsp/DcmDspRoutine/DcmDspStopRoutineSupported) - the DcmDspRoutineUsePort is set to FALSE (i.e. call out) types (refer to /Dcm/DcmConfigSet/DcmDsp/DcmDspRoutine/DcmDspRoutineUsePort) Runtime effects: ------------------------------------ none Code ROM usage effects: ------------------------------------ none Const data ROM usage effects: ------------------------------------ none Global RAM usage effects: ------------------------------------ none Stack RAM usage effects: ------------------------------------ none
          boolean DcmDspStopRoutineSupported: set at pre-compile  # Specifies whether the RID shall support stop operation. Effect: ------------------------------------ If set to TRUE, Dcm will accept a stop operation request on this RID. Otherwise, the Dcm will reject the request with a NRC 0x12 (SubFunctionNotSupported). Constraints: ------------------------------------ none Dependencies: ------------------------------------ none Runtime effects: ------------------------------------ none Code ROM usage effects: ------------------------------------ none Const data ROM usage effects: ------------------------------------ If set to TRUE, the Dcm configuration data ROM usage will increase due to the additional data to be hold for this operation. Global RAM usage effects: ------------------------------------ none Stack RAM usage effects: ------------------------------------ none
          integer DcmDspRoutineInfoByte [0..1]: 0..255, set at pre-compile, origin=Vector Informatik, default-value=1  # Manufacturer specific value reported to the tester for the record identifiers. (OBD use cases) Effect: ------------------------------------ If this parameter exists, DCM will report it automatically to the client, without the need of application intervention. If this parameter does not exist (default), the application shall provide the RIB value if needed. Constraints: ------------------------------------ none Dependencies: ------------------------------------ none Runtime effects: ------------------------------------ If exists, the additional byte copy functionality will insignificantly increase the DCM run time usage. Code ROM usage effects: ------------------------------------ If exists, the additional byte copy functionality will insignificantly increase the DCM code ROM usage. Const data ROM usage effects: ------------------------------------ If exists, the additional configuration data is stored to each routine identifier which will slightly increase the const data ROM usage. Global RAM usage effects: ------------------------------------ none Stack RAM usage effects: ------------------------------------ none
          boolean DcmDspStopRoutineInterfaceArgumentIntegrity [0..1]: set at pre-compile, origin=Vector Informatik, default-value=false  # If this parameter is set to TRUE, the integrity of the stop routine operation parameters is ensured. Effect: ------------------------------------ Defines the value of ClientServerOperation.diagArgIntegrity for the created C/S interface respectively the callout function of the stop routine operation. Constraints: ------------------------------------ none Dependencies: ------------------------------------ Has effect only if: - the diagnostic service 0x31 (RoutineControlByIdentifier) is supported by Dcm (refer to /Dcm/DcmConfigSet/DcmDsd/DcmDsdServiceTable/DcmDsdService) Runtime effects: ------------------------------------ Enabling this feature will slightly increase the Dcm task time during the stop routine operation due to the parameter copying. Code ROM usage effects: ------------------------------------ none Const data ROM usage effects: ------------------------------------ none Global RAM usage effects: ------------------------------------ Enabling this feature leads to an increase of the Dcm static code RAM usage (depending on the size of the stop routine operation parameters). Stack RAM usage effects: ------------------------------------ none
          boolean DcmDspStartRoutineInterfaceArgumentIntegrity [0..1]: set at pre-compile, origin=Vector Informatik, default-value=false  # If this parameter is set to TRUE, the integrity of the start routine operation parameters is ensured. Effect: ------------------------------------ Defines the value of ClientServerOperation.diagArgIntegrity for the created C/S interface respectively the callout function of the start routine operation. Constraints: ------------------------------------ none Dependencies: ------------------------------------ Has effect only if: - the diagnostic service 0x31 (RoutineControlByIdentifier) is supported by Dcm (refer to /Dcm/DcmConfigSet/DcmDsd/DcmDsdServiceTable/DcmDsdService) Runtime effects: ------------------------------------ Enabling this feature will slightly increase the Dcm task time during the start routine operation due to the parameter copying. Code ROM usage effects: ------------------------------------ none Const data ROM usage effects: ------------------------------------ none Global RAM usage effects: ------------------------------------ Enabling this feature leads to an increase of the Dcm static code RAM usage (depending on the size of the start routine operation parameters). Stack RAM usage effects: ------------------------------------ none
          boolean DcmDspRequestResultsRoutineInterfaceArgumentIntegrity [0..1]: set at pre-compile, origin=Vector Informatik, default-value=false  # If this parameter is set to TRUE, the integrity of the request result routine operation parameters is ensured. Effect: ------------------------------------ Defines the value of ClientServerOperation.diagArgIntegrity for the created C/S interface respectively the callout function of the request result routine operation. Constraints: ------------------------------------ none Dependencies: ------------------------------------ Has effect only if: - the diagnostic service 0x31 (RoutineControlByIdentifier) is supported by Dcm (refer to /Dcm/DcmConfigSet/DcmDsd/DcmDsdServiceTable/DcmDsdService) Runtime effects: ------------------------------------ Enabling this feature will slightly increase the Dcm task time during the request result routine operation due to the parameter copying. Code ROM usage effects: ------------------------------------ none Const data ROM usage effects: ------------------------------------ none Global RAM usage effects: ------------------------------------ Enabling this feature leads to an increase of the Dcm static code RAM usage (depending on the size of the request result routine operation parameters). Stack RAM usage effects: ------------------------------------ none
          reference DcmDspRoutineInfoRef: set at pre-compile, destination=DcmDspRoutineInfo  # Reference to DcmDspRoutineInfo containing information on this routine.
          foreign reference DcmDspRoutineSystemTemplateDiagnosticRoutineRef [0..1]: set at pre-compile in variant post-build-loadable+pre-compile / post-build in variant post-build-selectable, origin=Vector Informatik, destination-type=DIAGNOSTIC-ROUTINE  # Reference to the DiagnosticRoutine which is represented by this DcmDspRoutine.
        container DcmDspRoutineInfo [0..*]  # This container contains the configuration (parameters) for Routine's Info.
          container DcmDspStartRoutineIn [0..1]  # Provide description of input parameter of Start sub-service for RoutineControl service
            container DcmDspStartRoutineInSignal [1..*]  # Provide description of a routine signal used in RoutineControl service.
              integer DcmDspRoutineSignalLength: 1..65535, set at pre-compile, default-value=65535  # Specifies the length of RID data in bits. If Data has variable data length, this parameter specifies the maximum data length. Effect: ------------------------------------ The sum of all data object lengths of a RID operation specifies the total RID operation length which will be validated at request reception resp. used for response composition. Constraints: ------------------------------------ The size shall always be a multiple of 8 (byte borders). Dependencies: ------------------------------------ The size parameter is either the concrete or maximum data object size, depending on the corresponding DcmDspRoutineSignalType parameter value (refer to "/Dcm/DcmConfigSet/DcmDsp/DcmDspRoutineInfo/XXX/YYY/DcmDspRoutineSignalType"). Runtime effects: ------------------------------------ none Code ROM usage effects: ------------------------------------ none Const data ROM usage effects: ------------------------------------ none Global RAM usage effects: ------------------------------------ none Stack RAM usage effects: ------------------------------------ none
              integer DcmDspRoutineSignalPos: 0..65535, set at pre-compile, default-value=0  # Specifies the position of the signal in the RID request/response. Effect: ------------------------------------ Affects the call out/service call function signature. Constraints: ------------------------------------ Shall be always zero, since only single data object configurations are supported. Dependencies: ------------------------------------ none Runtime effects: ------------------------------------ none Code ROM usage effects: ------------------------------------ none Const data ROM usage effects: ------------------------------------ none Global RAM usage effects: ------------------------------------ none Stack RAM usage effects: ------------------------------------ none
              enumeration DcmDspRoutineSignalType: {BOOLEAN, UINT8, UINT8_N, UINT16, UINT16_N, UINT32, UINT32_N, SINT8, SINT8_N, SINT16, SINT16_N, SINT32, SINT32_N, FLOAT, FLOAT_N, VARIABLE_LENGTH}, set at pre-compile, default-value=UINT8  # Specifies whether the data object has a constant (fixed) or variable length. Effect: ------------------------------------ If set to other value than VARIABLE_LENGTH, the Dcm will use the data length parameter value of a data object directly from the configuration. Otherwise, the Dcm will gather the concrete length from the application. Constraints: ------------------------------------ none Dependencies: ------------------------------------ Affects the interpretation of the corresponding DcmDspRoutineSignalLength parameter: "/Dcm/DcmConfigSet/DcmDsp/DcmDspRoutineInfo/XXX/YYY/DcmDspRoutineSignalLength". Runtime effects: ------------------------------------ none Code ROM usage effects: ------------------------------------ none Const data ROM usage effects: ------------------------------------ none Global RAM usage effects: ------------------------------------ none Stack RAM usage effects: ------------------------------------ none
              enumeration DcmDspRoutineSignalEndianness [0..1]: {LITTLE_ENDIAN, BIG_ENDIAN, OPAQUE}, set at pre-compile, origin=Vector Informatik, default-value=opaque  # Defines the endianness for all this routine signal.
          container DcmDspStartRoutineOut [0..1]  # Provide description of output parameter of Start sub-service for RoutineControl service.
            container DcmDspStartRoutineOutSignal [1..*]  # Provide description of a routine signal used in RoutineControl service.
              integer DcmDspRoutineSignalLength: 1..65535, set at pre-compile, default-value=65535  # Specifies the length of RID data in bits. If Data has variable data length, this parameter specifies the maximum data length. Effect: ------------------------------------ The sum of all data object lengths of a RID operation specifies the total RID operation length which will be validated at request reception resp. used for response composition. Constraints: ------------------------------------ The size shall always be a multiple of 8 (byte borders). Dependencies: ------------------------------------ The size parameter is either the concrete or maximum data object size, depending on the corresponding DcmDspRoutineSignalType parameter value (refer to "/Dcm/DcmConfigSet/DcmDsp/DcmDspRoutineInfo/XXX/YYY/DcmDspRoutineSignalType"). Runtime effects: ------------------------------------ none Code ROM usage effects: ------------------------------------ none Const data ROM usage effects: ------------------------------------ none Global RAM usage effects: ------------------------------------ none Stack RAM usage effects: ------------------------------------ none
              integer DcmDspRoutineSignalPos: 0..65535, set at pre-compile, default-value=0  # Specifies the position of the signal in the RID request/response. Effect: ------------------------------------ Affects the call out/service call function signature. Constraints: ------------------------------------ Shall be always zero, since only single data object configurations are supported. Dependencies: ------------------------------------ none Runtime effects: ------------------------------------ none Code ROM usage effects: ------------------------------------ none Const data ROM usage effects: ------------------------------------ none Global RAM usage effects: ------------------------------------ none Stack RAM usage effects: ------------------------------------ none
              enumeration DcmDspRoutineSignalType: {BOOLEAN, UINT8, UINT8_N, UINT16, UINT16_N, UINT32, UINT32_N, SINT8, SINT8_N, SINT16, SINT16_N, SINT32, SINT32_N, FLOAT, FLOAT_N, VARIABLE_LENGTH}, set at pre-compile, default-value=UINT8  # Specifies whether the data object has a constant (fixed) or variable length. Effect: ------------------------------------ If set to other value than VARIABLE_LENGTH, the Dcm will use the data length parameter value of a data object directly from the configuration. Otherwise, the Dcm will gather the concrete length from the application. Constraints: ------------------------------------ none Dependencies: ------------------------------------ Affects the interpretation of the corresponding DcmDspRoutineSignalLength parameter: "/Dcm/DcmConfigSet/DcmDsp/DcmDspRoutineInfo/XXX/YYY/DcmDspRoutineSignalLength". Runtime effects: ------------------------------------ none Code ROM usage effects: ------------------------------------ none Const data ROM usage effects: ------------------------------------ none Global RAM usage effects: ------------------------------------ none Stack RAM usage effects: ------------------------------------ none
              enumeration DcmDspRoutineSignalEndianness [0..1]: {LITTLE_ENDIAN, BIG_ENDIAN, OPAQUE}, set at pre-compile, origin=Vector Informatik, default-value=opaque  # Defines the endianness for all this routine signal.
          container DcmDspRoutineStopIn [0..1]  # Provide description of input parameter of Stop sub-service for RoutineControl service.
            container DcmDspRoutineStopInSignal [1..*]  # Provide description of a routine signal used in RoutineControl service.
              integer DcmDspRoutineSignalLength: 1..65535, set at pre-compile, default-value=65535  # Specifies the length of RID data in bits. If Data has variable data length, this parameter specifies the maximum data length. Effect: ------------------------------------ The sum of all data object lengths of a RID operation specifies the total RID operation length which will be validated at request reception resp. used for response composition. Constraints: ------------------------------------ The size shall always be a multiple of 8 (byte borders). Dependencies: ------------------------------------ The size parameter is either the concrete or maximum data object size, depending on the corresponding DcmDspRoutineSignalType parameter value (refer to "/Dcm/DcmConfigSet/DcmDsp/DcmDspRoutineInfo/XXX/YYY/DcmDspRoutineSignalType"). Runtime effects: ------------------------------------ none Code ROM usage effects: ------------------------------------ none Const data ROM usage effects: ------------------------------------ none Global RAM usage effects: ------------------------------------ none Stack RAM usage effects: ------------------------------------ none
              integer DcmDspRoutineSignalPos: 0..65535, set at pre-compile, default-value=0  # Specifies the position of the signal in the RID request/response. Effect: ------------------------------------ Affects the call out/service call function signature. Constraints: ------------------------------------ Shall be always zero, since only single data object configurations are supported. Dependencies: ------------------------------------ none Runtime effects: ------------------------------------ none Code ROM usage effects: ------------------------------------ none Const data ROM usage effects: ------------------------------------ none Global RAM usage effects: ------------------------------------ none Stack RAM usage effects: ------------------------------------ none
              enumeration DcmDspRoutineSignalType: {BOOLEAN, UINT8, UINT8_N, UINT16, UINT16_N, UINT32, UINT32_N, SINT8, SINT8_N, SINT16, SINT16_N, SINT32, SINT32_N, FLOAT, FLOAT_N, VARIABLE_LENGTH}, set at pre-compile, default-value=UINT8  # Specifies whether the data object has a constant (fixed) or variable length. Effect: ------------------------------------ If set to other value than VARIABLE_LENGTH, the Dcm will use the data length parameter value of a data object directly from the configuration. Otherwise, the Dcm will gather the concrete length from the application. Constraints: ------------------------------------ none Dependencies: ------------------------------------ Affects the interpretation of the corresponding DcmDspRoutineSignalLength parameter: "/Dcm/DcmConfigSet/DcmDsp/DcmDspRoutineInfo/XXX/YYY/DcmDspRoutineSignalLength". Runtime effects: ------------------------------------ none Code ROM usage effects: ------------------------------------ none Const data ROM usage effects: ------------------------------------ none Global RAM usage effects: ------------------------------------ none Stack RAM usage effects: ------------------------------------ none
              enumeration DcmDspRoutineSignalEndianness [0..1]: {LITTLE_ENDIAN, BIG_ENDIAN, OPAQUE}, set at pre-compile, origin=Vector Informatik, default-value=opaque  # Defines the endianness for all this routine signal.
          container DcmDspRoutineStopOut [0..1]  # Provide description of output parameter of Stop sub-service for RoutineControl service.
            container DcmDspRoutineStopOutSignal [1..*]  # Provide description of a routine signal used in RoutineControl service.
              integer DcmDspRoutineSignalLength: 1..65535, set at pre-compile, default-value=65535  # Specifies the length of RID data in bits. If Data has variable data length, this parameter specifies the maximum data length. Effect: ------------------------------------ The sum of all data object lengths of a RID operation specifies the total RID operation length which will be validated at request reception resp. used for response composition. Constraints: ------------------------------------ The size shall always be a multiple of 8 (byte borders). Dependencies: ------------------------------------ The size parameter is either the concrete or maximum data object size, depending on the corresponding DcmDspRoutineSignalType parameter value (refer to "/Dcm/DcmConfigSet/DcmDsp/DcmDspRoutineInfo/XXX/YYY/DcmDspRoutineSignalType"). Runtime effects: ------------------------------------ none Code ROM usage effects: ------------------------------------ none Const data ROM usage effects: ------------------------------------ none Global RAM usage effects: ------------------------------------ none Stack RAM usage effects: ------------------------------------ none
              integer DcmDspRoutineSignalPos: 0..65535, set at pre-compile, default-value=0  # Specifies the position of the signal in the RID request/response. Effect: ------------------------------------ Affects the call out/service call function signature. Constraints: ------------------------------------ Shall be always zero, since only single data object configurations are supported. Dependencies: ------------------------------------ none Runtime effects: ------------------------------------ none Code ROM usage effects: ------------------------------------ none Const data ROM usage effects: ------------------------------------ none Global RAM usage effects: ------------------------------------ none Stack RAM usage effects: ------------------------------------ none
              enumeration DcmDspRoutineSignalType: {BOOLEAN, UINT8, UINT8_N, UINT16, UINT16_N, UINT32, UINT32_N, SINT8, SINT8_N, SINT16, SINT16_N, SINT32, SINT32_N, FLOAT, FLOAT_N, VARIABLE_LENGTH}, set at pre-compile, default-value=UINT8  # Specifies whether the data object has a constant (fixed) or variable length. Effect: ------------------------------------ If set to other value than VARIABLE_LENGTH, the Dcm will use the data length parameter value of a data object directly from the configuration. Otherwise, the Dcm will gather the concrete length from the application. Constraints: ------------------------------------ none Dependencies: ------------------------------------ Affects the interpretation of the corresponding DcmDspRoutineSignalLength parameter: "/Dcm/DcmConfigSet/DcmDsp/DcmDspRoutineInfo/XXX/YYY/DcmDspRoutineSignalLength". Runtime effects: ------------------------------------ none Code ROM usage effects: ------------------------------------ none Const data ROM usage effects: ------------------------------------ none Global RAM usage effects: ------------------------------------ none Stack RAM usage effects: ------------------------------------ none
              enumeration DcmDspRoutineSignalEndianness [0..1]: {LITTLE_ENDIAN, BIG_ENDIAN, OPAQUE}, set at pre-compile, origin=Vector Informatik, default-value=opaque  # Defines the endianness for all this routine signal.
          container DcmDspRoutineRequestResIn [0..1]  # Provide description of input parameter of RequestResult sub-service for RoutineControl service.
            container DcmDspRoutineRequestResInSignal [1..*]  # Provide description of a routine signal used in RoutineControl service.
              integer DcmDspRoutineSignalLength: 1..65535, set at pre-compile, origin=Vector Informatik, default-value=65535  # Specifies the length of RID data in bits. If Data has variable data length, this parameter specifies the maximum data length. Effect: ------------------------------------ The sum of all data object lengths of a RID operation specifies the total RID operation length which will be validated at request reception resp. used for response composition. Constraints: ------------------------------------ The size shall always be a multiple of 8 (byte borders). Dependencies: ------------------------------------ The size parameter is either the concrete or maximum data object size, depending on the corresponding DcmDspRoutineSignalType parameter value (refer to "/Dcm/DcmConfigSet/DcmDsp/DcmDspRoutineInfo/XXX/YYY/DcmDspRoutineSignalType"). Runtime effects: ------------------------------------ none Code ROM usage effects: ------------------------------------ none Const data ROM usage effects: ------------------------------------ none Global RAM usage effects: ------------------------------------ none Stack RAM usage effects: ------------------------------------ none
              integer DcmDspRoutineSignalPos: 0..65535, set at pre-compile, origin=Vector Informatik, default-value=0  # Specifies the position of the signal in the RID request/response. Effect: ------------------------------------ Affects the call out/service call function signature. Constraints: ------------------------------------ Shall be always zero, since only single data object configurations are supported. Dependencies: ------------------------------------ none Runtime effects: ------------------------------------ none Code ROM usage effects: ------------------------------------ none Const data ROM usage effects: ------------------------------------ none Global RAM usage effects: ------------------------------------ none Stack RAM usage effects: ------------------------------------ none
              enumeration DcmDspRoutineSignalType: {BOOLEAN, UINT8, UINT8_N, UINT16, UINT16_N, UINT32, UINT32_N, SINT8, SINT8_N, SINT16, SINT16_N, SINT32, SINT32_N, FLOAT, FLOAT_N, VARIABLE_LENGTH}, set at pre-compile, origin=Vector Informatik, default-value=UINT8  # Specifies whether the data object has a constant (fixed) or variable length. Effect: ------------------------------------ If set to other value than VARIABLE_LENGTH, the Dcm will use the data length parameter value of a data object directly from the configuration. Otherwise, the Dcm will gather the concrete length from the application. Constraints: ------------------------------------ none Dependencies: ------------------------------------ Affects the interpretation of the corresponding DcmDspRoutineSignalLength parameter: "/Dcm/DcmConfigSet/DcmDsp/DcmDspRoutineInfo/XXX/YYY/DcmDspRoutineSignalLength". Runtime effects: ------------------------------------ none Code ROM usage effects: ------------------------------------ none Const data ROM usage effects: ------------------------------------ none Global RAM usage effects: ------------------------------------ none Stack RAM usage effects: ------------------------------------ none
              enumeration DcmDspRoutineSignalEndianness [0..1]: {LITTLE_ENDIAN, BIG_ENDIAN, OPAQUE}, set at pre-compile, origin=Vector Informatik, default-value=opaque  # Defines the endianness for all this routine signal.
          container DcmDspRoutineRequestResOut [0..1]  # Provide description of output parameter of RequestResult sub-service for RoutineControl service.
            container DcmDspRoutineRequestResOutSignal [1..*]  # Provide description of a routine signal used in RoutineControl service.
              integer DcmDspRoutineSignalLength: 1..65535, set at pre-compile, default-value=65535  # Specifies the length of RID data in bits. If Data has variable data length, this parameter specifies the maximum data length. Effect: ------------------------------------ The sum of all data object lengths of a RID operation specifies the total RID operation length which will be validated at request reception resp. used for response composition. Constraints: ------------------------------------ The size shall always be a multiple of 8 (byte borders). Dependencies: ------------------------------------ The size parameter is either the concrete or maximum data object size, depending on the corresponding DcmDspRoutineSignalType parameter value (refer to "/Dcm/DcmConfigSet/DcmDsp/DcmDspRoutineInfo/XXX/YYY/DcmDspRoutineSignalType"). Runtime effects: ------------------------------------ none Code ROM usage effects: ------------------------------------ none Const data ROM usage effects: ------------------------------------ none Global RAM usage effects: ------------------------------------ none Stack RAM usage effects: ------------------------------------ none
              integer DcmDspRoutineSignalPos: 0..65535, set at pre-compile, default-value=0  # Specifies the position of the signal in the RID request/response. Effect: ------------------------------------ Affects the call out/service call function signature. Constraints: ------------------------------------ Shall be always zero, since only single data object configurations are supported. Dependencies: ------------------------------------ none Runtime effects: ------------------------------------ none Code ROM usage effects: ------------------------------------ none Const data ROM usage effects: ------------------------------------ none Global RAM usage effects: ------------------------------------ none Stack RAM usage effects: ------------------------------------ none
              enumeration DcmDspRoutineSignalType: {BOOLEAN, UINT8, UINT8_N, UINT16, UINT16_N, UINT32, UINT32_N, SINT8, SINT8_N, SINT16, SINT16_N, SINT32, SINT32_N, FLOAT, FLOAT_N, VARIABLE_LENGTH}, set at pre-compile, default-value=UINT8  # Specifies whether the data object has a constant (fixed) or variable length. Effect: ------------------------------------ If set to other value than VARIABLE_LENGTH, the Dcm will use the data length parameter value of a data object directly from the configuration. Otherwise, the Dcm will gather the concrete length from the application. Constraints: ------------------------------------ none Dependencies: ------------------------------------ Affects the interpretation of the corresponding DcmDspRoutineSignalLength parameter: "/Dcm/DcmConfigSet/DcmDsp/DcmDspRoutineInfo/XXX/YYY/DcmDspRoutineSignalLength". Runtime effects: ------------------------------------ none Code ROM usage effects: ------------------------------------ none Const data ROM usage effects: ------------------------------------ none Global RAM usage effects: ------------------------------------ none Stack RAM usage effects: ------------------------------------ none
              enumeration DcmDspRoutineSignalEndianness [0..1]: {LITTLE_ENDIAN, BIG_ENDIAN, OPAQUE}, set at pre-compile, origin=Vector Informatik, default-value=opaque  # Defines the endianness for all this routine signal.
          container DcmDspRoutineAuthorization  # This container contains the configuration (parameters) for the Routine Authorization.
            reference DcmDspRoutineModeRuleRef [0..1]: set at pre-compile, destination=DcmModeRule  # Defines RID specific access dependency on a specific ECU mode rule (i.e. ECU run-time condition). Effect: ------------------------------------ If any mode rule is referred here, the Dcm will automatically reject any request of this service received while the mode rule condition is not satisfied. Constraints: ------------------------------------ none Dependencies: ------------------------------------ See "destination ref". Runtime effects: ------------------------------------ If a mode rule is used, the Dcm task will have a slightly longer run time at reception of a request. The mode rule evaluation time depends on the complexity of the modeled mode rule condition. Code ROM usage effects: ------------------------------------ If at least one RID has mode rule dependency, the code usage will increase slightly. Const data ROM usage effects: ------------------------------------ Refer to DcmDspModeRule description. Global RAM usage effects: ------------------------------------ none Stack RAM usage effects: ------------------------------------ During the mode rule evaluation the stack usage will slightly increase. The more complex and deep rule condition expression nesting, the more stack will be needed.
            reference DcmDspRoutineSecurityLevelRef [0..*]: set at pre-compile in variant post-build-loadable+pre-compile / post-build in variant post-build-selectable, destination=DcmDspSecurityRow  # Defines RID execution dependency to a specific security level. Effect: ------------------------------------ If any security access level is referred here, the Dcm will automatically reject any request of this service received while the security level is not unlocked. Constraints: ------------------------------------ none Dependencies: ------------------------------------ See "destination ref". Runtime effects: ------------------------------------ If at least one RID has security access level dependency, the Dcm task will have a slightly longer run time at reception of a request. Code ROM usage effects: ------------------------------------ If at least one RID has security access level dependency, the code usage will increase slightly. Const data ROM usage effects: ------------------------------------ Refer to DcmDspSecurityRow description. Global RAM usage effects: ------------------------------------ none Stack RAM usage effects: ------------------------------------ none
            reference DcmDspRoutineSessionRef [0..*]: set at pre-compile in variant post-build-loadable+pre-compile / post-build in variant post-build-selectable, destination=DcmDspSessionRow  # Defines RID execution dependency to a specific session level. Effect: ------------------------------------ If any session level is referred here, the Dcm will automatically reject any request of this service received while the session level is not active. Constraints: ------------------------------------ none Dependencies: ------------------------------------ See "destination ref". Runtime effects: ------------------------------------ none Code ROM usage effects: ------------------------------------ none Const data ROM usage effects: ------------------------------------ Refer to DcmDspSessionRow description. Global RAM usage effects: ------------------------------------ none Stack RAM usage effects: ------------------------------------ none
            reference DcmDspRoutineVehicleSystemGroupRef [0..*]: set at pre-compile, origin=Vector Informatik, destination=DcmDspVehicleSystemGroupRow  # Defines RID availability dependency to a specific VSG. Effect: ------------------------------------ If any VSG is referred here, the Dcm will automatically reject any request of this service received while the VSG is not active. If no VSG reference is defined, Dcm assumes that this service belongs to the base-VSG (i.e. always available). Constraints: ------------------------------------ none Dependencies: ------------------------------------ Reference to a "/Dcm/DcmConfigSet/DcmDsp/DcmDspVehicleSystemGroups/DcmDspVehicleSystemGroupRow" Runtime effects: ------------------------------------ none Code ROM usage effects: ------------------------------------ none Const data ROM usage effects: ------------------------------------ Refer to "/Dcm/DcmConfigSet/DcmDsp/DcmDspVehicleSystemGroups/DcmDspVehicleSystemGroupRow" description. Global RAM usage effects: ------------------------------------ none Stack RAM usage effects: ------------------------------------ none
            reference DcmDspRoutineRoleRef [0..32]: set at pre-compile, origin=Vector Informatik, destination=DcmDspAuthenticationRow  # Reference to DcmDspAuthenticationRow that defines a role in that this routine can be started, stopped and results requested. Effect: ------------------------------------ If a role is specified here, the Dcm will automatically reject any request of this service received while the role is not active. Constraints: ------------------------------------ The value has only an effect if '/Dcm/DcmConfigSet/DcmDsd/DcmDsdServiceTable/DcmDsdService' is defined for service 0x29. Dependencies: ------------------------------------ none Runtime effects: ------------------------------------ none Code ROM usage effects: ------------------------------------ none Const data ROM usage effects: ------------------------------------ none Global RAM usage effects: ------------------------------------ none Stack RAM usage effects: ------------------------------------ none
        container DcmDspSecurity  # This container includes all security access levels the Dcm shall support. Effect: ------------------------------------ For each security level to be supported by Dcm a DcmDspSecurityRow sub-container shall be defined. Note: It is not recommended to define the "Locked" level. Constraints: ------------------------------------ For each security level, there shall always be a corresponding pair of sub-services for service 0x27: - one for the "get seed" operation with sub-service identifier value equal to this parameter value (e.g. 0x03); - one for the "send key" operation with sub-service identifier value equal to this parameter value plus one (e.g. 0x04); Dependencies: ------------------------------------ Refer to "Dcm/DcmConfigSet/DcmDsd/DcmDsdServiceTable/DcmDsdService/DcmDsdSubService/DcmDsdSubServiceId". Runtime effects: ------------------------------------ none Code ROM usage effects: ------------------------------------ none Const data ROM usage effects: ------------------------------------ The Dcm configuration data ROM usage scales straight proportionally to the number of security levels defined. Global RAM usage effects: ------------------------------------ none Stack RAM usage effects: ------------------------------------ none
          boolean DcmDspSecuritySingleInstanceAttemptMonitor [0..1]: set at pre-compile, origin=Vector Informatik, default-value=false  # Specifies whether DCM module shall support a single AttemptCounter for security access levels or not. Effect: ------------------------------------ If set to TRUE, DCM will support a single/shared memory for the security AttemptCounter among all configured DcmDspSecurityRows. If not existing or FALSE, DCM will instantiate the AttemptCounter per configured DcmDspSecurityRow as per ISO14229-1:2013. Annex I. Constraints: ------------------------------------ none Dependencies: ------------------------------------ If "/Dcm/DcmConfigSet/DcmDsd/DcmDsdServiceTable/DcmDsdService" is defined for service 0x27. Runtime effects: ------------------------------------ none. Code ROM usage effects: ------------------------------------ none Const data ROM usage effects: ------------------------------------ none Global RAM usage effects: ------------------------------------ If set to TRUE, the code usage will decrease by the amount, dependent of the number of number of DcmDspSecurityRows. Stack RAM usage effects: ------------------------------------ none
          boolean DcmDspSecuritySingleInstanceDelayTimer [0..1]: set at pre-compile, origin=Vector Informatik, default-value=false  # Specifies whether DCM module shall support a single DelayTimer for security access levels or not. Effect: ------------------------------------ If set to TRUE, DCM will support a single DelayTimer among all configured DcmDspSecurityRows. If not set or FALSE, DCM will instantiate the DelayTimer per configured DcmDspSecurityRow as per ISO14229-1:2013. Annex I. Constraints: ------------------------------------ none Dependencies: ------------------------------------ If "/Dcm/DcmConfigSet/DcmDsd/DcmDsdServiceTable/DcmDsdService" is defined for service 0x27. Runtime effects: ------------------------------------ none. Code ROM usage effects: ------------------------------------ none Const data ROM usage effects: ------------------------------------ none Global RAM usage effects: ------------------------------------ If set to TRUE, the code usage will decrease by the amount, dependent of the number of number of DcmDspSecurityRows. Stack RAM usage effects: ------------------------------------ none
          boolean DcmDspSecurityResetAttemptCounterOnTimeout [0..1]: set at pre-compile, origin=Vector Informatik, default-value=false  # Specifies whether DCM module shall reset the security attempt counter when the delay timer is expired. Effect: ------------------------------------ If set to TRUE, DCM will reset the security attempt counter when the delay timer expires. If not set or FALSE, DCM will not reset the security attempt counter when the delay timer expires. DCM will reset the security attempt counter only when a successful sendKey subfunction request is performed. Constraints: ------------------------------------ none Runtime effects: ------------------------------------ none. Global RAM usage effects: ------------------------------------ none. Stack RAM usage effects: ------------------------------------ none
          boolean DcmDspSecurityBypassEnabled [0..1]: set at pre-compile, origin=Vector Informatik, default-value=false  # Specifies whether DCM module shall support a bypass mode for security access levels or not. Effect: ------------------------------------ If set to TRUE, DCM will support a bypass mode for security access levels. Constraints: ------------------------------------ none Dependencies: ------------------------------------ If "/Dcm/DcmConfigSet/DcmDsd/DcmDsdServiceTable/DcmDsdService" is defined for service 0x27. Runtime effects: ------------------------------------ Enabling this feature will slightly increase the Dcm task time. Code ROM usage effects: ------------------------------------ none Const data ROM usage effects: ------------------------------------ none Global RAM usage effects: ------------------------------------ none Stack RAM usage effects: ------------------------------------ none
          container DcmDspSecurityRow [0..31]  # Definition of a single Row of configuration for security level configuration (per security level). The name of this container is used to define the name of the R-Port through which the DCM accesses the interface SecurityAccess_{SecurityLevel}. The R-Port is named SecurityAccess_{SecurityLevel} where {SecurityLevel} is the name of the container DcmDspSecurityRow. If there is no reference, no check of security level shall be done.
            integer DcmDspSecurityADRSize [0..1]: 1..4294967295, set at pre-compile  # Specifies the size in bytes of the AccessDataRecord used in GetSeed diagnostic request of the corresponding security level. Effect: ------------------------------------ The Dcm will consider this parameter during the diagnostic request evaluation for sub-functions "get seed" of service 0x27 for the corresponding security level. Constraints: ------------------------------------ none Dependencies: ------------------------------------ Affects the minimum required Dcm buffer size ("/MICROSAR/Dcm/DcmConfigSet/DcmDsl/DcmDslBuffer/DcmDslBufferSize"). Runtime effects: ------------------------------------ none Code ROM usage effects: ------------------------------------ none Const data ROM usage effects: ------------------------------------ none Global RAM usage effects: ------------------------------------ none Stack RAM usage effects: ------------------------------------ none
            boolean DcmDspSecurityAttemptCounterEnabled: set at pre-compile, origin=Vector Informatik, default-value=false  # Dsp Security AttemptCounter Enabled | Allows to enable the external storage of the security attempt counter (e.g. to survival a reset of the ECU). Effect: ------------------------------------ If ENABLED, the Dcm will call two APIs for reading/storing the attempt counter assigned with this security level. If DISABLED, each time Dcm is initialized the counter value for the security level will be zero. Constraints: ------------------------------------ This setting will have any effect only if the security level supports attempt counter monitoring. Dependencies: ------------------------------------ - Setting "/Dcm/DcmConfigSet/DcmDsp/DcmDspSecurity/DcmDspSecurityRow/DcmDspSecurityNumAttDelay" must have the value that enables attempt counter usage for this level. Runtime effects: ------------------------------------ If ENABLED, at the corresponding get and set attempt counter APIs will be supported. This will lead to a run time usage increase in cases the attempt counter is read or updated. Code ROM usage effects: ------------------------------------ If ENABLED, the code ROM usage will increase a little bit due to the new feature activation and synchronizing mechanisms. Const data ROM usage effects: ------------------------------------ If ENABLED, the data ROM usage will slightly increased. The total amount depends on the number of security levels. Global RAM usage effects: ------------------------------------ IF ENABLED, the RAM usage will insignificantly increase. Stack RAM usage effects: ------------------------------------ If ENABLED, the stack usage will depend on the stack usage of the implemented set and get attempt counter APIs.
            function name DcmDspSecurityCompareKeyFnc [0..1]: set at pre-compile, origin=Vector Informatik  # Dsp Security CompareKey Fnc | Function name to request the result of a key comparison.
            float DcmDspSecurityDelayTime: 0..20000, set at pre-compile, default-value=0  # Specifies the delay time in seconds during which the Dcm will not accept any security access request. Effect: ------------------------------------ Dcm will start the configured time after given number of failed security access attempts has failed. Constraints: ------------------------------------ none Dependencies: ------------------------------------ Has effect only if the corresponding level DcmDspSecurityNumAttDelay parameter is not zero. Refer to: "/Dcm/DcmConfigSet/DcmDsp/DcmDspSecurity/DcmDspSecurityRow/DcmDspSecurityNumAttDelay". Runtime effects: ------------------------------------ none Code ROM usage effects: ------------------------------------ none Const data ROM usage effects: ------------------------------------ none Global RAM usage effects: ------------------------------------ none Stack RAM usage effects: ------------------------------------ none
            float DcmDspSecurityDelayTimeOnBoot: 0..20000, set at pre-compile, default-value=0  # Specifies the delay time in seconds at each Dcm power on cycle during which the Dcm will not accept any security access request. Effect: ------------------------------------ If the parameter is set to a non-zero value, the Dcm will start monitor this time once initialized until and reject any security access diagnostic request until this time is not elapsed. Constraints: ------------------------------------ none Dependencies: ------------------------------------ Has effect only if the corresponding level DcmDspSecurityNumAttDelay parameter is not zero. Refer to: "/Dcm/DcmConfigSet/DcmDsp/DcmDspSecurity/DcmDspSecurityRow/DcmDspSecurityNumAttDelay". Runtime effects: ------------------------------------ none Code ROM usage effects: ------------------------------------ none Const data ROM usage effects: ------------------------------------ none Global RAM usage effects: ------------------------------------ none Stack RAM usage effects: ------------------------------------ none
            float DcmDspSecurityDelayTimeOnFailedGetAttemptCounter [0..1]: 0..20000, set at pre-compile, origin=Vector Informatik, default-value=0  # Dsp Security Delay Time On Failed GetAttemptCounter | Specifies the delay time in seconds during which the Dcm will not accept any security access request if the GetSecurityAttemptCounter API fails to return a valid value. Effect: ------------------------------------ Once Dcm is initialized and configured to restore previous (pre-reset) AttemptCounter values, it will start reading all security level specific AttemptCounter values using the corresponding GetSecurityAttemptCounter API. If this read attempt fails, the Dcm will react depending on this configuration option: - If the time value == 0 is configured, Dcm will start the corresponding delay timer for an infinite time. During this power on cycle, no security access request will be accepted. - If a time value >0 is configured, Dcm will start the corresponding delay timer with the configured time. For this time, no security access request (for this security level) will be accepted. - if the parameter is missing (default), Dcm will assume the retrieved counter value as zero and thus will not start any power on time. A security access request will be accepted immediately. Constraints: ------------------------------------ none Dependencies: ------------------------------------ Has effect only if the corresponding level DcmDspSecurityAttemptCounterEnabled parameter is ENABLED. Refer to: "/Dcm/DcmConfigSet/DcmDsp/DcmDspSecurity/DcmDspSecurityRow/DcmDspSecurityAttemptCounterEnabled". Runtime effects: ------------------------------------ Supporting infinite delay time requires insignificantly more run time. Code ROM usage effects: ------------------------------------ Supporting infinite delay time requires insignificantly more code ROM. Const data ROM usage effects: ------------------------------------ Supporting infinite delay time requires insignificantly more data ROM. Global RAM usage effects: ------------------------------------ Supporting infinite delay time requires insignificantly more RAM. Stack RAM usage effects: ------------------------------------ none
            function name DcmDspSecurityGetAttemptCounterFnc [0..1]: set at pre-compile, origin=Vector Informatik  # Dsp Security GetAttemptCounter Fnc | Specifies the call out function name for re-storing the attempt counter. Effect: ------------------------------------ If this parameter is not empty, the Dcm will call the specified function each time Dcm is initialized (Dcm_Init is called). Constraints: ------------------------------------ none Dependencies: ------------------------------------ - the DcmDspSecurityAttemptCounterEnabled is ENABLED (refer to /Dcm/DcmConfigSet/DcmDsp/DcmDspSecurity/DcmDspSecurityRow/DcmDspSecurityAttemptCounterEnabled) - the DcmDspSecurityUsePort is set to one of the FNC (e.g. call out) types (refer to /Dcm/DcmConfigSet/DcmDsp/DcmDspSecurity/DcmDspSecurityRow/DcmDspSecurityUsePort) Runtime effects: ------------------------------------ none Code ROM usage effects: ------------------------------------ none Const data ROM usage effects: ------------------------------------ none Global RAM usage effects: ------------------------------------ none Stack RAM usage effects: ------------------------------------ none
            function name DcmDspSecurityGetSeedFnc [0..1]: set at pre-compile, origin=Vector Informatik  # Dsp Security GetSeed Fnc | Function name to request a seed.
            integer DcmDspSecurityKeySize: 1..4294967295, set at pre-compile, default-value=4  # Specifies the size in bytes of the security access key for the corresponding security level. Effect: ------------------------------------ The Dcm will consider this parameter during the diagnostic request length validation for sub-functions "send key" of service 0x27 for the corresponding security level. Constraints: ------------------------------------ The key size shall fit the configured diagnostic buffer including the diagnostic protocol request header information. Dependencies: ------------------------------------ Affects the minimum required Dcm buffer size ("/MICROSAR/Dcm/DcmConfigSet/DcmDsl/DcmDslBuffer/DcmDslBufferSize"). Runtime effects: ------------------------------------ none Code ROM usage effects: ------------------------------------ none Const data ROM usage effects: ------------------------------------ none Global RAM usage effects: ------------------------------------ none Stack RAM usage effects: ------------------------------------ none
            integer DcmDspSecurityLevel: 0..63, set at pre-compile, symbolic-name-value=true, default-value=0  # Specifies the value of the corresponding security level. Effect: ------------------------------------ This value will be used when the Dcm_GetSecurityLevel API is called from the application to report the currently active security level. Constraints: ------------------------------------ For any security level, except locked, this value must not be zero. For each security level (except locked), there shall always be a corresponding pair of sub-services for service 0x27: - one for the "get seed" operation with an odd sub-service identifier value (e.g. 0x01); - one for the "send key" operation with an even sub-service identifier value equal to "get seed" plus one (e.g. 0x02); The parameter value shall always match the "get seed/send-key" pair's sub-function id of the service 0x27 configuration container as follows: SecurityLevel = (<sub-function id> + 1) / 2 Dependencies: ------------------------------------ Refer to "Dcm/DcmConfigSet/DcmDsd/DcmDsdServiceTable/DcmDsdService/DcmDsdSubService/DcmDsdSubServiceId". Runtime effects: ------------------------------------ none Code ROM usage effects: ------------------------------------ none Const data ROM usage effects: ------------------------------------ none Global RAM usage effects: ------------------------------------ none Stack RAM usage effects: ------------------------------------ none
            integer DcmDspSecurityNumAttDelay: 0..255, set at pre-compile, default-value=0  # Specifies the number of failed security accesses after which the delay time is activated. Effect: ------------------------------------ If set to a value other than 0, the Dcm will count the failed attempts and initiate a penalty strategy on reaching the configured value. If set to 0, the Dcm will not implement any failed attempt penalty strategy and will be always be ready for a new try. Constraints: ------------------------------------ none Dependencies: ------------------------------------ If set to a non zero value, the parameters DcmDspSecurityDelayTime and DcmDspSecurityDelayTimeOnBoot shall be additionally configured. Refer to: - "/Dcm/DcmConfigSet/DcmDsp/DcmDspSecurity/DcmDspSecurityRow/DcmDspSecurityDelayTime" - "/Dcm/DcmConfigSet/DcmDsp/DcmDspSecurity/DcmDspSecurityRow/DcmDspSecurityDelayTimeOnBoot" Runtime effects: ------------------------------------ If set to a non zero value, the Dcm main function will additionally need time to monitor the configured penalty time in parallel to all other tasks it has to complete. The service 0x27 handler will take slightly more time due to the attempt counter and timer management functionality this parameter enables. Code ROM usage effects: ------------------------------------ If set to a non zero value, the Dcm code ROM usage will increase due to the attempt counter and timer management functionality this parameter enables. Const data ROM usage effects: ------------------------------------ If set to a non zero value, the Dcm configuration data ROM usage will increase due to the additional information storage this parameter enables. Global RAM usage effects: ------------------------------------ If set to a non zero value, the Dcm RAM usage will increase due to the additional information storage this parameter enables. Stack RAM usage effects: ------------------------------------ none
            integer DcmDspSecuritySeedSize: 1..4294967295, set at pre-compile, default-value=4  # Specifies the size in bytes of the security access seed for the corresponding security level. Effect: ------------------------------------ The Dcm will consider this parameter during the diagnostic response composition for sub-functions "get seed" of service 0x27 for the corresponding security level. Constraints: ------------------------------------ The key size shall fit the configured diagnostic buffer including the diagnostic protocol response header information. Dependencies: ------------------------------------ Affects the minimum required Dcm buffer size ("/MICROSAR/Dcm/DcmConfigSet/DcmDsl/DcmDslBuffer/DcmDslBufferSize"). Runtime effects: ------------------------------------ none Code ROM usage effects: ------------------------------------ none Const data ROM usage effects: ------------------------------------ none Global RAM usage effects: ------------------------------------ none Stack RAM usage effects: ------------------------------------ none
            function name DcmDspSecuritySetAttemptCounterFnc [0..1]: set at pre-compile, origin=Vector Informatik  # Dsp Security SetAttemptCounter Fnc | Specifies the call out function name for storing the attempt counter. Effect: ------------------------------------ If this parameter is not empty, the Dcm will call the specified function each time the attempt counter changes for the corresponding security level. Constraints: ------------------------------------ none Dependencies: ------------------------------------ - the DcmDspSecurityAttemptCounterEnabled is ENABLED (refer to /Dcm/DcmConfigSet/DcmDsp/DcmDspSecurity/DcmDspSecurityRow/DcmDspSecurityAttemptCounterEnabled) - the DcmDspSecurityUsePort is set to one of the FNC (e.g. call out) types (refer to /Dcm/DcmConfigSet/DcmDsp/DcmDspSecurity/DcmDspSecurityRow/DcmDspSecurityUsePort) Runtime effects: ------------------------------------ none Code ROM usage effects: ------------------------------------ none Const data ROM usage effects: ------------------------------------ none Global RAM usage effects: ------------------------------------ none Stack RAM usage effects: ------------------------------------ none
            enumeration DcmDspSecurityUsePort: {USE_ASYNCH_CLIENT_SERVER, USE_ASYNCH_FNC}, set at pre-compile, origin=Vector Informatik, default-value=USE_ASYNCH_CLIENT_SERVER  # Defines which kind of interface shall be used for security access. Effect: ------------------------------------ USE_ASYNCH_CLIENT_SERVER: The DCM will access the data using an R-Port requiring an asynchronous ClientServertInterface SecurityAccess_{SecurityLevel}. The R-Port is described in DcmDspSecurityRow description. USE_ASYNCH_FNC: The DCM will access the data using the functions that are defined in the parameters DcmDspSecurityGetSeedFnc and DcmDspSecurityCompareKeyFnc. DCM_E_PENDING return is allowed and OpStatus is existing as IN parameter. Constraints: ------------------------------------ none Dependencies: ------------------------------------ none Runtime effects: ------------------------------------ none Code ROM usage effects: ------------------------------------ none Const data ROM usage effects: ------------------------------------ none Global RAM usage effects: ------------------------------------ none Stack RAM usage effects: ------------------------------------ none
            container DcmDspSecurityFixedBytes [0..*]  # Provides a set of security fixed bytes for this security level. Effect: ------------------------------------ Optionally a security level can get a single or multiple sets of fixed bytes, that later can be accessed by the SW-C for calculating the corresponding seed or/and key. Constraints: ------------------------------------ A security level shall have multiple fixed byte sets only if there are any Vehicle System Groups (VSGs) and the sets refer to different VSGs. Dependencies: ------------------------------------ Multiple sets need VSGs: "/Dcm/DcmConfigSet/DcmDsp/DcmDspVehicleSystemGroups" Runtime effects: ------------------------------------ Since typically the SW-C will access these fixed bytes within a callout invoked by Dcm, the overall Dcm runtime processing SID 0x27 will insignificantly increase. Code ROM usage effects: ------------------------------------ By defining at least one security level related fixed byte set, the code ROM usage will slightly increase due to the activation of the new API Dcm_GetSecurityLevelFixedBytes(). Const data ROM usage effects: ------------------------------------ The Dcm configuration data ROM usage scales straight proportionally to the number of fixed bytes defined. Global RAM usage effects: ------------------------------------ none Stack RAM usage effects: ------------------------------------ Since typically the SW-C will access these fixed bytes within a callout invoked by Dcm, the overall Dcm stack RAM usage will insignificantly increase.
              integer DcmDspSecurityFixedByteValue [1..255]: 0..255, set at pre-compile, origin=Vector Informatik, requires-index=true, default-value=0  # Specifies a fixed byte value for this security level. Effect: ------------------------------------ The Dcm will provide this data at runtime via API Constraints: ------------------------------------ none Dependencies: ------------------------------------ none Runtime effects: ------------------------------------ none Code ROM usage effects: ------------------------------------ Additional code to retrieve the byte values by API is enabled, increasing the ROM usage Const data ROM usage effects: ------------------------------------ The byte values provided as well as control structures will increase the ROM consumption. Global RAM usage effects: ------------------------------------ none Stack RAM usage effects: ------------------------------------ none
              reference DcmDspSecurityFixedByteVehicleSystemGroupRef [0..*]: set at pre-compile, origin=Vector Informatik, destination=DcmDspVehicleSystemGroupRow  # Defines fixed bytes set dependency to a specific VSG. Effect: ------------------------------------ If any VSG is referred here, the Dcm will report this set within the Dcm_GetSecurityLevelFixedBytes() API call if the given VSG is active. If no VSG reference is defined, Dcm will always return this fixed bytes set. Constraints: ------------------------------------ If no VSG dependency is required, then only one fixed byte set shall be used for this security level. Dependencies: ------------------------------------ Reference to a "/Dcm/DcmConfigSet/DcmDsp/DcmDspVehicleSystemGroups/DcmDspVehicleSystemGroupRow" Runtime effects: ------------------------------------ none Code ROM usage effects: ------------------------------------ none Const data ROM usage effects: ------------------------------------ Refer to "/Dcm/DcmConfigSet/DcmDsp/DcmDspVehicleSystemGroups/DcmDspVehicleSystemGroupRow" description. Global RAM usage effects: ------------------------------------ none Stack RAM usage effects: ------------------------------------ none
          container DcmDspSecurityCallback [0..*]  # Configures a single callback to be called on security access state change. Effect: ----------------------------------------- For each available container of this type, there will be a notification call. Dcm will make a function on each security access state change (NOT on self-transitions). Constraints: ----------------------------------------- - Dependencies: ----------------------------------------- - Runtime effects: ----------------------------------------- Enabling this feature will increase the Dcm task time at any security access state change (e.g. "Locked -&amp;amp;gt; Level1" or vice versa). Code ROM usage effects: ------------------------------------ Enabling this feature leads to a minor increase of the Dcm static code ROM usage. Const data ROM usage effects: ----------------------------------------- Enabling this feature increases the Dcm configuration ROM usage. The usage scales linearly with the amount of callouts. Global RAM usage effects: ----------------------------------------- none Stack RAM usage effects: ----------------------------------------- Enabling this feature can lead to a insignificant increased stack size required by the Dcm_MainFunction.
            function name DcmDspSecurityCallbackFnc: set at pre-compile, origin=Vector Informatik  # Specifies the call out function name for notification call. Effect: ------------------------------------ Dcm calls the function which name is set here. Constraints: ------------------------------------ none Dependencies: ------------------------------------ Has effect only if service 0x27 is supported. Runtime effects: ------------------------------------ none Code ROM usage effects: ------------------------------------ none Const data ROM usage effects: ------------------------------------ none Global RAM usage effects: ------------------------------------ none Stack RAM usage effects: ------------------------------------ none
        container DcmDspSession  # This container includes all diagnostic sessions the Dcm shall support. Effect: ------------------------------------ For each diagnostic session to be supported by Dcm a DcmDspSessionRow sub-container shall be defined. Constraints: ------------------------------------ For each session level, there shall always be a corresponding sub-services for service 0x10. Dependencies: ------------------------------------ Refer to "Dcm/DcmConfigSet/DcmDsd/DcmDsdServiceTable/DcmDsdService/DcmDsdSubService/DcmDsdSubServiceId". Runtime effects: ------------------------------------ none Code ROM usage effects: ------------------------------------ none Const data ROM usage effects: ------------------------------------ The Dcm configuration data ROM usage scales straight proportionally to the number of sessions defined. Global RAM usage effects: ------------------------------------ none Stack RAM usage effects: ------------------------------------ none
          boolean DcmSessionTimerS3Enabled [0..1]: set at pre-compile, origin=Vector Informatik, default-value=true  # Specifies whether the S3 timer is supported or not. Effect: ----------------------------------------- If enabled or missing, the S3 timer is handled according to ISO 14229-2. If disabled, Dcm will never start S3 timer in a non-default sessions. In this case a S3 timeout will never occur. Constraints: ----------------------------------------- Has effect only if a non-default session is supported. Dependencies: ----------------------------------------- none Runtime effects: ----------------------------------------- none Code ROM usage effects: ------------------------------------ Disabling this feature leads to a insignificant decrease of the Dcm static code ROM usage. Const data ROM usage effects: ----------------------------------------- none Global RAM usage effects: ----------------------------------------- none Stack RAM usage effects: ----------------------------------------- none
          container DcmDspSessionRow [1..31]  # Definition of a single Row of session control configuration (per session control)
            enumeration DcmDspSessionForBoot: {DCM_NO_BOOT, DCM_OEM_BOOT, DCM_SYS_BOOT}, set at pre-compile, default-value=DCM_NO_BOOT  # This parameter defines whether the concrete diagnostic session allows to jump to bootloader (OEM bootloader or system supplier bootloader). If this diagnostic session doesn't allow to jump to Bootloader the value DCM_NO_BOOT shall be chosen. Effect: ------------------------------------ If set to any value other than "DCM_NO_BOOT", on receiving the corresponding session activation diagnostic request will cause Dcm to jump to Bootloader. Constraints: ------------------------------------ none Dependencies: ------------------------------------ none Runtime effects: ------------------------------------ none Code ROM usage effects: ------------------------------------ If all of the session levels specify for this parameter "DCM_NO_BOOT", the Dcm code ROM usage will be reduced. Const data ROM usage effects: ------------------------------------ none Global RAM usage effects: ------------------------------------ If all of the session levels specify for this parameter "DCM_NO_BOOT", the Dcm code RAM usage will be reduced. Stack RAM usage effects: ------------------------------------ For a session levels specifying for this parameter value other than "DCM_NO_BOOT", the Dcm main function stack usage may slightly increase. The total stack usage in case of jump to Bootloader depends then mostly on the implementation of the Dcm_SetProgConditions call out.
            integer DcmDspSessionLevel: 0..255, set at pre-compile, symbolic-name-value=true, default-value=0  # Specifies the value of the corresponding diagnostic session. Effect: ------------------------------------ This value will be used when the Dcm_GetSesCtrlType API is called from the application to report the currently active session. Constraints: ------------------------------------ For each session level, there shall always be a corresponding sub-services for service 0x10. Dependencies: ------------------------------------ Refer to "Dcm/DcmConfigSet/DcmDsd/DcmDsdServiceTable/DcmDsdService/DcmDsdSubService/DcmDsdSubServiceId". Runtime effects: ------------------------------------ none Code ROM usage effects: ------------------------------------ none Const data ROM usage effects: ------------------------------------ none Global RAM usage effects: ------------------------------------ none Stack RAM usage effects: ------------------------------------ none
            float DcmDspSessionP2ServerMax: 0..1000, set at pre-compile, default-value=0.05  # Dsp Session P2ServerMax | Determines the diagnostic session specific P2 time in seconds. Effect: ------------------------------------ This parameter will be reported by Dcm within the positive response to the corresponding session activation request. The really monitored time by Dcm is specified from the currently active protocol. Constraints: ------------------------------------ none Dependencies: ------------------------------------ For the real monitored time adjustment refer to "/Dcm/DcmConfigSet/DcmDsl/DcmDslProtocol/DcmDslProtocolRow/DcmTimStrP2ServerAdjust". Runtime effects: ------------------------------------ none Code ROM usage effects: ------------------------------------ none Const data ROM usage effects: ------------------------------------ none Global RAM usage effects: ------------------------------------ none Stack RAM usage effects: ------------------------------------ none
            float DcmDspSessionP2StarServerMax: 0..100000, set at pre-compile, default-value=5  # Dsp Session P2StarServerMax | Determines the diagnostic session specific P2* time in seconds. Effect: ------------------------------------ This parameter will be reported by Dcm within the positive response to the corresponding session activation request. The really monitored time by Dcm is specified from the currently active protocol. Constraints: ------------------------------------ none Dependencies: ------------------------------------ For the real monitored time adjustment refer to "/Dcm/DcmConfigSet/DcmDsl/DcmDslProtocol/DcmDslProtocolRow/DcmTimStrP2StarServerAdjust". Runtime effects: ------------------------------------ none Code ROM usage effects: ------------------------------------ none Const data ROM usage effects: ------------------------------------ none Global RAM usage effects: ------------------------------------ none Stack RAM usage effects: ------------------------------------ none
          container DcmDspSessionCallback [0..*]  # Configures a single callback to be called on diagnostic session state change. Effect: ----------------------------------------- For each available container of this type, there will be a notification call. Dcm will make a function on each diagnostic session access state change (ALSO on self-transitions). Constraints: ----------------------------------------- - Dependencies: ----------------------------------------- - Runtime effects: ----------------------------------------- Enabling this feature will increase the Dcm task time at any diagnostic session state change (e.g. "Default->Extended" or "Default->Default", etc.). Code ROM usage effects: ------------------------------------ Enabling this feature leads to a minor increase of the Dcm static code ROM usage. Const data ROM usage effects: ----------------------------------------- Enabling this feature increases the Dcm configuration ROM usage. The usage scales linearly with the amount of callouts. Global RAM usage effects: ----------------------------------------- none Stack RAM usage effects: ----------------------------------------- Enabling this feature can lead to a insignificant increased stack size required by the Dcm_MainFunction.
            function name DcmDspSessionCallbackFnc: set at pre-compile, origin=Vector Informatik  # Specifies the call out function name for notification call. Effect: ------------------------------------ Dcm calls the function which name is set here. Constraints: ------------------------------------ none Dependencies: ------------------------------------ Has effect only if service 0x10 is supported. Runtime effects: ------------------------------------ none Code ROM usage effects: ------------------------------------ none Const data ROM usage effects: ------------------------------------ none Global RAM usage effects: ------------------------------------ none Stack RAM usage effects: ------------------------------------ none
        container DcmDspTestResultByObdmid [0..1]  # This container contains the configuration (parameters) of the "Request on-board monitoring test results" service (Service $06).
          container DcmDspTestResultObdmidTid [1..*]  # This container contains the configuration (parameters) of a OBDMID and the assigned TIDs for the "Request on-board monitoring test results" service (Service $06).
            integer DcmDspTestResultObdmid: 0..255, set at pre-compile  # OBDMID for Service $06
            reference DcmDspTestResultByObdmidVehicleSystemGroupRef [0..*]: set at pre-compile, origin=Vector Informatik, destination=DcmDspVehicleSystemGroupRow  # Defines OBD OBDMID availability dependency to a specific VSG. Effect: ------------------------------------ If any VSG is referred here, the Dcm will automatically reject any request of this service received while the VSG is not active. If no VSG reference is defined, Dcm assumes that this service belongs to the base-VSG (i.e. always available). Constraints: ------------------------------------ none Dependencies: ------------------------------------ Reference to a "/Dcm/DcmConfigSet/DcmDsp/DcmDspVehicleSystemGroups/DcmDspVehicleSystemGroupRow" Runtime effects: ------------------------------------ none Code ROM usage effects: ------------------------------------ none Const data ROM usage effects: ------------------------------------ Refer to "/Dcm/DcmConfigSet/DcmDsp/DcmDspVehicleSystemGroups/DcmDspVehicleSystemGroupRow" description. Global RAM usage effects: ------------------------------------ none Stack RAM usage effects: ------------------------------------ none
            container DcmDspTestResultObdmidTids [1..*]  # This container contains the configuration (parameters) of the TIDs belonging to the OBDMID for the "Request on-board monitoring test results" service (Service $06).
              integer DcmDspTestResultObdmidTidUaSid: 0..255, set at pre-compile  # Dsp Test Result Obdmid Tid UaSid | Unit And Scaling ID for Service $06
              function name DcmDspTestResultObdmidTidFnc [0..1]: set at pre-compile, origin=Vector Informatik  # Specifies the call out function name for control. Effect: ------------------------------------ If this parameter is not empty, the Dcm will call the specified function on MIDTID reading diagnostic request. Constraints: ------------------------------------ none Dependencies: ------------------------------------ Has effect only if: - the diagnostic service 0x06 (RequesOnBoardMonitorTestResults) is supported by Dcm (refer to /Dcm/DcmConfigSet/DcmDsd/DcmDsdServiceTable/DcmDsdService) - the DcmDspDataUsePort is set to one of the FNC (e.g. call out) types (refer to /Dcm/DcmConfigSet/DcmDsp/DcmDspPid/DcmDspPidData/DcmDspPidService01/DcmDspPidDataUsePort) Runtime effects: ------------------------------------ none Code ROM usage effects: ------------------------------------ none Const data ROM usage effects: ------------------------------------ none Global RAM usage effects: ------------------------------------ none Stack RAM usage effects: ------------------------------------ none
              boolean DcmDspTestResultObdmidTidUsePort [0..1]: set at pre-compile, origin=Vector Informatik, default-value=true  # Defines which kind of interface shall be used to control. Effect: ------------------------------------ If set to TRUE, a RTE call will be required to be implemented in the Dcm application. If set to FALSE, a callout will be required to be implemented in the Dcm application. Constraints: ------------------------------------ none Dependencies: ------------------------------------ none Runtime effects: ------------------------------------ none Code ROM usage effects: ------------------------------------ none Const data ROM usage effects: ------------------------------------ none Global RAM usage effects: ------------------------------------ none Stack RAM usage effects: ------------------------------------ none
              reference DcmDspTestResultObdmidTidRef: set at pre-compile, destination=DcmDspTestResultTid  # Link to reported TIDs of this OBDMID
          container DcmDspTestResultTid [1..*]  # This container contains the configuration (parameters) of a single TID for the "Request on-board monitoring test results" service (Service $06).
            integer DcmDspTestResultTestId: 0..255, set at pre-compile  # Test Id for Service $06
        container DcmDspVehicleSystemGroups [0..1]  # This container includes all Dcm related Vehicle System Groups (VSGs). Effect: ------------------------------------ For each VSG to be supported by Dcm a DcmDspVehicleSystemGroupRow sub-container shall be defined. If this container does not exist, VSG support will be deactivated. Constraints: ------------------------------------ The Base-VSG (i.e. the one which is automatically activated at ECU power on/reset) must not to be defined! Dependencies: ------------------------------------ none Runtime effects: ------------------------------------ By defining at least one VSG, the runtime of diagnostic request processing will slightly increase (comparable with PBS runtime usage). Code ROM usage effects: ------------------------------------ By defining at least one VSG, the code ROM usage will slightly increase (comparable with PBS code ROM usage). Const data ROM usage effects: ------------------------------------ The Dcm configuration data ROM usage scales straight proportionally to the number of VSGs defined. Global RAM usage effects: ------------------------------------ By defining at least one VSG, the RAM usage will insignificantly increase. Stack RAM usage effects: ------------------------------------ By defining at least one VSG, the stack RAM usage will slightly increase (comparable with PBS stack RAM usage).
          container DcmDspVehicleSystemGroupRow [1..*]  # Represents a single Vehicle System Group (VSG) related to Dcm.
            integer DcmDspVehicleSystemGroupId: 1..65535, set at pre-compile, origin=Vector Informatik, symbolic-name-value=true  # Specifies an abstract ID of the corresponding Vehicle System Group. Effect: ------------------------------------ This ID will be used when the VSG getter/setter API are called from the application to report/change the currently active VSG(s). Constraints: ------------------------------------ For each VSG, there shall always be a unique ID. ID 0 is reserved for the the base variant (i.e. for all those diagnostic entities that are allowed in all VSGs) Dependencies: ------------------------------------ none Runtime effects: ------------------------------------ none Code ROM usage effects: ------------------------------------ none Const data ROM usage effects: ------------------------------------ none Global RAM usage effects: ------------------------------------ none Stack RAM usage effects: ------------------------------------ none
        container DcmDspVehInfo [0..*]  # This container contains the configuration (parameters) of the "Request vehicle information service" (service $09).
          integer DcmDspVehInfoInfoType: 0..255, set at pre-compile  # Specifies the identifier value of a InfoType. Effect: ------------------------------------ The Dcm only recognizes InfoTypes with the value specified in this parameter. Constraints: ------------------------------------ The InfoType value must be unique within a DcmConfigset. Dependencies: ------------------------------------ none Runtime effects: ------------------------------------ none Code ROM usage effects: ------------------------------------ none Const data ROM usage effects: ------------------------------------ none Global RAM usage effects: ------------------------------------ none Stack RAM usage effects: ------------------------------------ none
          boolean DcmDspVehInfoUsed [0..1]: set at pre-compile in variant post-build-loadable+pre-compile / post-build in variant post-build-selectable, origin=Vector Informatik, default-value=true  # Allows to activate or deactivate the usage of a VehInfoType, for multi purpose ECUs. In a single configuration the parameter can be used to temporarily disable a complete VehInfoType in the Dcm configuration without the need to delete all its configuration parameters. Effect: ------------------------------------ If set to FALSE, the VehInfoType and all its signals will not be used in the Dcm generated code. Constraints: ------------------------------------ none Dependencies: ------------------------------------ none Runtime effects: ------------------------------------ none Code ROM usage effects: ------------------------------------ none Const data ROM usage effects: ------------------------------------ If set to FALSE, no data ROM for this VehInfoType will be used in the Dcm configuration sources. Global RAM usage effects: ------------------------------------ none Stack RAM usage effects: ------------------------------------ none
          reference DcmDspVehInfoVehicleSystemGroupRef [0..*]: set at pre-compile, origin=Vector Informatik, destination=DcmDspVehicleSystemGroupRow  # Defines OBD Vehicle Info Type availability dependency to a specific VSG. Effect: ------------------------------------ If any VSG is referred here, the Dcm will automatically reject any request of this service received while the VSG is not active. If no VSG reference is defined, Dcm assumes that this service belongs to the base-VSG (i.e. always available). Constraints: ------------------------------------ none Dependencies: ------------------------------------ Reference to a "/Dcm/DcmConfigSet/DcmDsp/DcmDspVehicleSystemGroups/DcmDspVehicleSystemGroupRow" Runtime effects: ------------------------------------ none Code ROM usage effects: ------------------------------------ none Const data ROM usage effects: ------------------------------------ Refer to "/Dcm/DcmConfigSet/DcmDsp/DcmDspVehicleSystemGroups/DcmDspVehicleSystemGroupRow" description. Global RAM usage effects: ------------------------------------ none Stack RAM usage effects: ------------------------------------ none
          container DcmDspVehInfoData  # Data Item of an InfoType; post-fix of the port interface name.
            integer DcmDspVehInfoDataOrder: 0..255, set at pre-compile, default-value=0  # NOT USED
            function name DcmDspVehInfoDataReadFnc [0..1]: set at pre-compile  # Specifies the call out function name for reading the data object content. Effect: ------------------------------------ If this parameter is not empty, the Dcm will call the specified function on InfoType reading diagnostic request. Constraints: ------------------------------------ none Dependencies: ------------------------------------ Has effect only if: - the diagnostic service 0x09 (RequestVehicleInformation) is supported by Dcm (refer to /Dcm/DcmConfigSet/DcmDsd/DcmDsdServiceTable/DcmDsdService) - the DcmDspVehInfoDataUsePort is set to FALSE (e.g. call out) type (refer to /Dcm/DcmConfigSet/DcmDsp/DcmDspVehInfo/DcmDspVehInfoData/DcmDspVehInfoDataUsePort) Runtime effects: ------------------------------------ none Code ROM usage effects: ------------------------------------ none Const data ROM usage effects: ------------------------------------ none Global RAM usage effects: ------------------------------------ none Stack RAM usage effects: ------------------------------------ none
            integer DcmDspVehInfoDataSize: 2..255, set at pre-compile, default-value=255  # Specifies the length of InfoType ID data including NODI in bytes. Effect: ------------------------------------ The sum of all data object lengths of a InfoType ID and the NODI byte do specify the total InfoType ID length which used for response composition. Constraints: ------------------------------------ Since the NODI byte is always included in the data stream, and at least one data element shall be reported, the minimum data length shall be at minimum two bytes. Dependencies: ------------------------------------ The size parameter is the concrete or maximum data object size. Runtime effects: ------------------------------------ none Code ROM usage effects: ------------------------------------ none Const data ROM usage effects: ------------------------------------ none Global RAM usage effects: ------------------------------------ none Stack RAM usage effects: ------------------------------------ none
            boolean DcmDspVehInfoDataUsePort: set at pre-compile, default-value=true  # Defines which kind of interface shall be used to access the data. Effect: ------------------------------------ If set to TRUE, a RTE call will be required to be implemented in the Dcm application. If set to FALSE - a call out will be required to be implemented in the Dcm application. Constraints: ------------------------------------ none Dependencies: ------------------------------------ none Runtime effects: ------------------------------------ none Code ROM usage effects: ------------------------------------ none Const data ROM usage effects: ------------------------------------ none Global RAM usage effects: ------------------------------------ none Stack RAM usage effects: ------------------------------------ none
      container DcmGeneral  # This container contains the configuration (parameters) for Component wide parameters
        boolean DcmDevErrorDetect: set at pre-compile, default-value=true  # Specifies whether the Dcm shall monitor the API input and output parameters and internal behavior with notification to the DET BSW. Effect: ----------------------------------------- If enabled, Dcm will monitor any critical code sections for proper function in order to avoid unpredictable software behavior in situations such as: null pointers, out of boundary accesses, unexpected parameter values, etc. Constraints: ----------------------------------------- It is recommended to leave this parameter enabled during the first integration steps and test executions with Dcm for getting stable code and traceable errors. Dependencies: ----------------------------------------- none Runtime effects: ----------------------------------------- Enabling this feature will increase the overall CPU load during the Dcm task activity. Also all Dcm APIs called within an interrupt will lead to a minor increased of interrupt latency. Code ROM usage effects: ------------------------------------ Enabling this feature increases the Dcm code ROM usage due to the additional check code sections activated by this setting. Const data ROM usage effects: ----------------------------------------- none Global RAM usage effects: ----------------------------------------- Enabling this feature will lead to an insignificant increase of the RAM usage for some additional management variables. Stack RAM usage effects: ------------------------------------ none
        boolean DcmRequestManufacturerNotificationEnabled: set at pre-compile, default-value=false  # Specifies whether the diagnostic request notification mechanism for the manufacturer shall be used or not. Effect: ----------------------------------------- If enabled, Dcm will call all configured manufacturer indication functions. These will decide whether the Dcm shall proceed with the service processing or not. Constraints: ----------------------------------------- Can be enabled only if there is at least one "/Dcm/DcmConfigSet/DcmDsl/DcmDslServiceRequestManufacturerNotification" parameter defined. Dependencies: ----------------------------------------- Configuration parameters: "/Dcm/DcmConfigSet/DcmDsl/DcmDslServiceRequestManufacturerNotification" Runtime effects: ----------------------------------------- Enabling this feature will increase the Dcm task time during its first activation on any diagnostic request been received. Code ROM usage effects: ------------------------------------ Enabling this feature leads to a minor increase of the Dcm static code ROM usage. Const data ROM usage effects: ----------------------------------------- Enabling this feature increases the Dcm configuration ROM usage. The usage scales linearly with the amount of SWCs to be notified. Global RAM usage effects: ----------------------------------------- none Stack RAM usage effects: ------------------------------------ Enabling this feature can lead to a insignificant increased stack size required by the Dcm_MainFunction.
        boolean DcmRequestSupplierNotificationEnabled: set at pre-compile, default-value=false  # Specifies whether the diagnostic request notification mechanism for the suppliers shall be used or not. Effect: ----------------------------------------- If enabled, Dcm will call all configured supplier indication functions. These will decide whether the Dcm shall proceed with the service processing or not. Constraints: ----------------------------------------- Can be enabled only if there is at least one "/Dcm/DcmConfigSet/DcmDsl/DcmDslServiceRequestSupplierNotification" parameter defined. Dependencies: ----------------------------------------- Configuration parameters: "/Dcm/DcmConfigSet/DcmDsl/DcmDslServiceRequestSupplierNotification" Runtime effects: ----------------------------------------- Enabling this feature will increase the Dcm task time during its first activation on any diagnostic request been received. Code ROM usage effects: ------------------------------------ Enabling this feature leads to a minor increase of the Dcm static code ROM usage. Const data ROM usage effects: ----------------------------------------- Enabling this feature increases the Dcm configuration ROM usage. The usage scales linearly with the amount of SWCs to be notified. Global RAM usage effects: ----------------------------------------- none Stack RAM usage effects: ----------------------------------------- Enabling this feature can lead to a insignificant increased stack size required by the Dcm_MainFunction.
        boolean DcmRespondAllRequest: set at pre-compile, default-value=true  # Specifies whether Dcm shall process any received diagnostic request or not. Effect: ----------------------------------------- If enabled, Dcm will accept and process any requested service ID. If disabled, Dcm will accept the reception of any diagnostic service ID, but will not process any belonging to the range [0x40,0x7F]U[0xC0, 0xFF]. Constraints: ----------------------------------------- none Dependencies: ----------------------------------------- none Runtime effects: ----------------------------------------- Disabling this feature will lead to an insignificant runtime overhead at the end of a request reception. Code ROM usage effects: ------------------------------------ Disabling this feature leads to a insignificant increase of the Dcm static code ROM usage. Const data ROM usage effects: ----------------------------------------- Disabling this feature will lead to an insignificant ROM usage overhead due to the additional evaluation of the SID. Global RAM usage effects: ----------------------------------------- none Stack RAM usage effects: ----------------------------------------- none
        float DcmTaskTime: 0..100, set at pre-compile, default-value=0.01  # Allow to configure the time for the periodic cyclic task in seconds. Effect: ----------------------------------------- This value is used to set up the Dcm Service-Description and BSW scheduler. All diagnostic timers managed by Dcm use this setting as a base time for the internal time constants' calculation. Constraints: ----------------------------------------- The specified time shall be a multiple of the time values defined in all diagnostic timing settings in the Dcm configuration. Dependencies: ----------------------------------------- All diagnostic timing parameters. Runtime effects: ----------------------------------------- Too low values will increase the Dcm responsiveness, but will increase the CPU load. Too high values of this parameter will lead to rear Dcm task activation (lower CPU load), but the Dcm internal timers' accuracy will not be optimal. Code ROM usage effects: ------------------------------------ none Const data ROM usage effects: ----------------------------------------- none Global RAM usage effects: ----------------------------------------- none Stack RAM usage effects: ----------------------------------------- none
        boolean DcmVersionInfoApi: set at pre-compile, default-value=false  # Specifies whether Dcm shall provide access to its version information or not. Effect: ----------------------------------------- By enabling this feature, the Dcm will provide an API "Dcm_GetVersionInfo" for reading its version information. If this information is not needed within the ECU project, leave this feature disabled for minimum ROM usage. Constraints: ----------------------------------------- none Dependencies: ----------------------------------------- none Runtime effects: ----------------------------------------- none Code ROM usage effects: ------------------------------------ Enabling this feature leads to a minor increase of the Dcm static code ROM usage. Const data ROM usage effects: ----------------------------------------- Enabling this feature leads to an insignificant increase of the ROM usage, caused by the API function implementation. Global RAM usage effects: ----------------------------------------- none Stack RAM usage effects: ----------------------------------------- none
        string DcmUserConfigFile [0..1]: set at pre-compile, origin=Vector Informatik  # Path to an external user configuration file used by the Configurator 5 generation tool. Effect: ----------------------------------------- If you want to overwrite some of the settings in the generated configuration file (Dcm_Cfg.h), you can specify a path to a user defined configuration file. The user defined configuration file will be included at the end of the generated preprocessor switches. Definitions in the user defined configuration file can overwrite definitions in the generated configuration file. The path shall be a valid path to the user configuration file. For simplified and project specific user configuration files references, the following Configurator 5 environment variables can be used: $(DpaProjectFolder) Absolute directory of the loaded *.dpa file. $(EcuProjectName) Name of the project defined in the loaded *.dpa file. $(EcucFile) Absolute directory "ECUC", defined by the loaded *.dpa file, containing files $(EcuProjectName).ecuc.arxml and $(EcuProjectName).ecuc.Initial.arxml . $(EcucFolder) Parent directory of $(EcucFile). $(SipRootPath) Absolute directory "SIP", defined by the loaded *.dpa file. $(OutputFolder) (Relative) directory "GenData", defined by the loaded *.dpa file. See setting "Root Target Folder" of Configurator 5. $(ServiceSwcFolder) Absolute directory "ServiceComponents", defined by the loaded *.dpa file. Constraints: ----------------------------------------- Not all of the settings can be overwritten simply by triggering the preprocessor switch. Some of the options are complex and the code generator generates less or more code depending on the setting. USE SUCH A FILE ONLY AFTER DISCUSSION WITH VECTOR. Dependencies: ----------------------------------------- none Runtime effects: ----------------------------------------- none Code ROM usage effects: ------------------------------------ none Const data ROM usage effects: ----------------------------------------- none Global RAM usage effects: ----------------------------------------- none Stack RAM usage effects: ----------------------------------------- none
        boolean DcmDefensiveBehaviorEnabled [0..1]: set at pre-compile, origin=Vector Informatik, default-value=false  # Specifies whether the Dcm shall monitor the API input and output parameters and internal behavior, but without notifying the DET BSW. Effect: ----------------------------------------- If enabled, Dcm will monitor any critical code sections for proper function in order to avoid unpredictable software behavior in situations such as: null pointers, out of boundary accesses, unexpected parameter values, etc. Constraints: ----------------------------------------- It is recommended to leave this parameter enabled during the first integration steps and test executions with Dcm for getting stable code and traceable errors. Dependencies: ----------------------------------------- none Runtime effects: ----------------------------------------- Enabling this feature will increase the overall CPU load during the Dcm task activity. Also some Dcm APIs called within an interrupt will lead to a minor increased of interrupt latency. Code ROM usage effects: ------------------------------------ Enabling this feature leads to a major increase of the Dcm static code ROM usage. Const data ROM usage effects: ----------------------------------------- none Global RAM usage effects: ----------------------------------------- Enabling this feature will lead to an insignificant increase of the RAM usage for some additional management variables. Stack RAM usage effects: ----------------------------------------- none
        integer DcmMaxNumberIterationsPerTask [0..1]: 0..255, set at pre-compile, origin=Vector Informatik, default-value=0  # Specifies the maximum number of iterations on an external module API per single Dcm_MainFunction activation. Applicable primarily on any diagnostic service. Effect: ----------------------------------------- If any limitation value other than zero is specified, Dcm will monitor the number of internal jobs iterations per task activation to save CPU time. Note: A too low value will lead to RCR-RP responses. Refer to the technical reference for more details on this feature. Constraints: ----------------------------------------- Possible values: 0 - no limitation (default) >0 - specific number of iterations per task Dependencies: ----------------------------------------- none Runtime effects: ----------------------------------------- If a limitation is enabled, all complex diagnostic services will have an insignificantly increased runtime due to the additional monitor code. Code ROM usage effects: ------------------------------------ If a limitation is enabled, all Dem iterators will have an insignificantly increased ROM usage due to the additional monitor code. Const data ROM usage effects: ----------------------------------------- none Global RAM usage effects: ----------------------------------------- none Stack RAM usage effects: ----------------------------------------- If a limitation is enabled, the Dcm_MainFunction will require insignificantly more stack.
        boolean DcmFinalResponseToFblEnabled [0..1]: set at pre-compile, origin=Vector Informatik, default-value=true  # Specifies whether the Dcm shall support the FBL final response transmission, defined by HIS. Effect: ----------------------------------------- If enabled, the Dcm will use the "Dcm_GetProgConditions" callout to check whether a final response shall be sent or not. Constraints: ----------------------------------------- none Dependencies: ----------------------------------------- none Runtime effects: ----------------------------------------- Enabling this feature leads to an automatic activation of the Dcm task for reading the programming conditions and if needed triggering the acquired final response. Code ROM usage effects: ------------------------------------ Enabling this feature leads to an increased ROM usage for reading the programming conditions and processing the final response transmission. Const data ROM usage effects: ----------------------------------------- none Global RAM usage effects: ----------------------------------------- Enabling this feature leads to an insignificant increase of RAM usage. Stack RAM usage effects: ----------------------------------------- Enabling this feature can lead to an insignificant increase of stack usage during the first several Dcm_MainFunction activations.
        boolean DcmResetToFblAfterSessionFinalResponseEnabled [0..1]: set at pre-compile, origin=Vector Informatik, default-value=false  # Specifies whether the Dcm shall reset to the FBL before or after the final response transmission of service 0x10 (DiagnosticSessionControl). Effect: ----------------------------------------- If enabled, the Dcm will reset the ECU only after the positive response for diagnostic service 0x10 has been sent. If disabled, the Dcm will behave according to HIS - on reception of diagnostic service 0x10 with a session configured to cause a jump to the FBL, Dcm will reset the ECU without sending a final positive response for this request. The FBL later will do that. Constraints: ----------------------------------------- none Dependencies: ----------------------------------------- Has effect only if: - At least one diagnostic session has been configured to support jump to the FBL (refer to: /Dcm/DcmConfigSet/DcmDsp/DcmDspSession/DcmDspSessionRow/DcmDspSessionForBoot) Runtime effects: ----------------------------------------- none Code ROM usage effects: ------------------------------------ none Const data ROM usage effects: ----------------------------------------- none Global RAM usage effects: ----------------------------------------- none Stack RAM usage effects: ----------------------------------------- none
        boolean DcmCalibrationOfObdIdsEnabled [0..1]: set at pre-compile, origin=Vector Informatik, default-value=false  # Specifies whether the Dcm shall support calibratable OBD IDs or not. Effect: ----------------------------------------- If enabled, the Dcm will put all "availability ID" mask values (e.g. for PID 0x00, 0x20, etc.) into the calibratable memory section. Later the embedded code will use these values for knowing whether an OBD identifier is enabled or not. If disabled, the Dcm will always use only the generated configuration for each OBD ID availability. Note: These settings affects also the UDS OBD DIDs and RIDs. Constraints: ----------------------------------------- Applies only to OBD ID objects, e.g. services 0x01, 0x02, 0x06, 0x08 and 0x09. On UDS: 0x22 and 0x31. Dependencies: ----------------------------------------- OBD must be licensed. Runtime effects: ----------------------------------------- Enabling this feature leads to an additional check for enabled OBD identifier after the default lookup engine has finished its job. This will insignificantly increase the run time usage. Code ROM usage effects: ------------------------------------ Enabling this feature leads to an insignificantly increase ROM usage for the additional enabling checks. Const data ROM usage effects: ----------------------------------------- Enabling this feature leads to an insignificantly increase ROM usage for the supporting indirection tables. Global RAM usage effects: ----------------------------------------- none Stack RAM usage effects: ----------------------------------------- none
        enumeration DcmCalibrationOfObdIdsMemoryType [0..1]: {DCM_OBD_CALIB_MEM_NON_VOLATILE, DCM_OBD_CALIB_MEM_VOLATILE}, set at pre-compile, origin=Vector Informatik, default-value=DCM_OBD_CALIB_MEM_NON_VOLATILE  # Specifies the memory location of the calibratable OBD ID data. Effect: ----------------------------------------- This option determines the memory location of the OBD "availability ID" mask values: If selected memory type VOLATILE - RAM tables will be generated. These have to be initialized by the application before the DCM is initialized. If selected memory type NON_VOLATILE - the generated tables are located in a special CONST (calibratable) area. If this parameter is not set the DCM will use the backward compatible selection: NON_VOLATILE. Constraints: ----------------------------------------- Applies only to calibratable OBD ID objects, e.g. services 0x01, 0x02, 0x06, 0x08 and 0x09. On UDS: 0x22 and 0x31. Dependencies: ----------------------------------------- The following option must be enabled first: /Dcm/DcmConfigSet/DcmGeneral/DcmCalibrationOfObdIdsEnabled Runtime effects: ----------------------------------------- none Code ROM usage effects: ------------------------------------ none Const data ROM usage effects: ----------------------------------------- If selected type is NON_VOLATILE, then global ROM usage will increase according to the number of OBD IDs supported by the ECU. Global RAM usage effects: ----------------------------------------- If selected type is VOLATILE, then global RAM usage will increase according to the number of OBD IDs supported by the ECU. Stack RAM usage effects: ----------------------------------------- none
        enumeration DcmDspDataDefaultEndianness: {LITTLE_ENDIAN, BIG_ENDIAN, OPAQUE}, set at pre-compile, origin=Vector Informatik, default-value=LITTLE_ENDIAN  # Defines the default endianness for all data elements in DcmDsp.
        enumeration DcmDemApiVersion [0..1]: {DCM_DEM_API_4_02_01, DCM_DEM_API_4_03_00, DCM_DEM_API_4_03_01}, set at pre-compile, origin=Vector Informatik, default-value=DCM_DEM_API_4_03_00  # Specifies the AUTOSAR version of the integrated Dem API Effect: ------------------------------------ Switches Dcm internal Dem interaction to the corresponding AUTOSAR version specification. If this parameter is missing, the native AUTOSAR version (4.03.00) will be active. Constraints: ------------------------------------ Has effect only if the Dem related diagnostic services are handled within Dcm. Dependencies: ------------------------------------ If "/Dcm/DcmConfigSet/DcmDsd/DcmDsdServiceTable/DcmDsdService" is defined for any SID, that results in interaction between Dcm and Dem. Runtime effects: ------------------------------------ none Code ROM usage effects: ------------------------------------ Code ROM usage slightly vary between Dem AR versions due to different API specifications. Const data ROM usage effects: ------------------------------------ none Global RAM usage effects: ------------------------------------ none Stack RAM usage effects: ------------------------------------ none
        boolean DcmSecurityLevelChangeNotificationEnabled [0..1]: set at pre-compile, origin=Vector Informatik, default-value=false  # Specifies whether a SWCs will be notified or not for a changed security access level state by a mode-switch. Effect: ----------------------------------------- If enabled, Dcm will invoke a RTE mode switch on any non-self state transition e.g. for Locked->Level1, but not for Locked->Locked when for example a session transition Default->Default occurs. Constraints: ----------------------------------------- Has effect only if service 0x27 is internally handled by Dcm. Dependencies: ----------------------------------------- If "/Dcm/DcmConfigSet/DcmDsd/DcmDsdServiceTable/DcmDsdService" is defined for SID 0x27. Runtime effects: ----------------------------------------- Enabling this feature will slightly increase the Dcm task time during any security access level change. Code ROM usage effects: ------------------------------------ Enabling this feature leads to a minor increase of the Dcm static code ROM usage. Const data ROM usage effects: ----------------------------------------- Enabling this feature insignificantly increases the Dcm configuration ROM usage. The usage scales linearly with the configured amount of security access levels. Global RAM usage effects: ----------------------------------------- none Stack RAM usage effects: ------------------------------------ none.
        boolean DcmSplitTasksEnabled [0..1]: set at pre-compile, origin=Vector Informatik, default-value=false  # Specifies whether only one main-function shall be used for timing and processing or one worker- and one timer-task. Effect: ----------------------------------------- If disabled or missing the Dcm has only one main function: Dcm_MainFunction. If enabled the Dcm_MainFunction is split into to tasks: Dcm_MainFunctionTimer, Dcm_MainFunctionWorker. Constraints: ----------------------------------------- If enabled, the timer- and worker-tasks shall be scheduled as described in the technical reference. Dependencies: ----------------------------------------- If enabled, the parameter /Dcm/DcmConfigSet/DcmGeneral/DcmTaskTime can be used to set up timing for the worker task other than the DcmTaskTime. Runtime effects: ----------------------------------------- If enabled, the Dcm behavior will depend on the concrete task scheduling. It may happen that Dcm will send more RCR-RP responses as before. Code ROM usage effects: ------------------------------------ If enabled, the code ROM usage will slightly increase. Const data ROM usage effects: ----------------------------------------- If enabled, the data ROM usage will insignificantly increase. Global RAM usage effects: ----------------------------------------- none Stack RAM usage effects: ----------------------------------------- If enabled, stack usage may slightly increase due to the fact that now the Dcm_MainFunctionTimer may interrupt the Dcm_MainFunctionWorker.
        float DcmMainFunctionWorkerTaskTime [0..1]: 0..100, set at pre-compile, origin=Vector Informatik, default-value=0.01  # Allow to configure the time for the service processing task in seconds. Effect: ----------------------------------------- This value is used to set up the Dcm Service-Description and BSW scheduler. Service processing speed of DCM will depend on this setting i.e. how fast the DCM will poll the application in case of E_PENDING. If this parameter is missing, but split task is selected (/Dcm/DcmConfigSet/DcmGeneral/DcmSplitTasksEnabled = TRUE), then the worker task will be called with the time period specified in /Dcm/DcmConfigSet/DcmGeneral/DcmTaskTime. Constraints: ----------------------------------------- The specified time shall be a equal or smaller than the time in DcmTaskTime. This will prevent unnecessary RCR-RP responses. Dependencies: ----------------------------------------- Has any effect only if parameter /Dcm/DcmConfigSet/DcmGeneral/DcmSplitTasksEnabled is set to TRUE. Runtime effects: ----------------------------------------- Too low values will increase the Dcm responsiveness, but will increase the CPU load. Code ROM usage effects: ------------------------------------ none Const data ROM usage effects: ----------------------------------------- none Global RAM usage effects: ----------------------------------------- none Stack RAM usage effects: ----------------------------------------- none
        boolean DcmStateRecoveryAfterResetEnabled [0..1]: set at pre-compile, origin=Vector Informatik, default-value=false  # Specifies whether a context switch through ECU reset shall preserve some DCM internal states. Effect: ----------------------------------------- If enabled, Dcm will read after each Dcm_Init call the context information from the application in order to restore it or leave the initial state as per default. If disabled, Dcm will boot up AR manner without any recovery information acquisition process. Constraints: ----------------------------------------- - Dependencies: ----------------------------------------- - Runtime effects: ----------------------------------------- Enabling this feature will slightly increase the Dcm task time after each Dcm_Init and only if there is some context to be recovered. Code ROM usage effects: ------------------------------------ Enabling this feature leads to a minor increase of the Dcm static code ROM usage. Const data ROM usage effects: ----------------------------------------- none Global RAM usage effects: ----------------------------------------- none Stack RAM usage effects: ------------------------------------ Due to the additional calls done from within the Dcm_MainFunction for gathering the context information, the stack usage during the recovery phase (only after Dcm_Init) may increase. It will depend on the implementation of the application callback for getting recovery information.
        float DcmKeepAliveTime [0..1]: 0..20000, set at pre-compile, origin=Vector Informatik, default-value=5  # Specifies the time in seconds after each diagnostic request is processed during which the Dcm will keep the Diag-Active user in ComM registered. Effect: ------------------------------------ If this parameter exists and contains a non-zero value, Dcm will keep the Diag-User active in ComM as long as either this time has not elapsed yet OR the diagnostic session is still a non-default one. Primarily this timer has effect while the Dcm is in the default session since, in that case Dcm would deactivate the user immediately after each request processing. Constraints: ------------------------------------ none Dependencies: ------------------------------------ none Runtime effects: ------------------------------------ If additional keep alive logic is required, the run time on (un-)registering a ComM user per channel may insignificantly increase. Code ROM usage effects: ------------------------------------ If additional keep alive logic is required, the code ROM usage on (un-)registering a ComM user per channel may insignificantly increase. Const data ROM usage effects: ------------------------------------ none Global RAM usage effects: ------------------------------------ If additional keep alive logic is required, the RAM usage may insignificantly increase. Stack RAM usage effects: ------------------------------------ none
        boolean DcmSafeBswChecks: set at pre-compile, origin=Vector Informatik, default-value=false  # Specifies whether DCM will be put into SafeBSW mode. Effect: ----------------------------------------- If enabled, Dcm is considered as a ASIL component. Some features will not be supported (refer to SafetyManual for details). The code generator will automatically deactivate particular features if not yet released for ASIL application. Especially PBL configuration will be restricted to limited features. If disabled, Dcm will provide full featured support. Constraints: ----------------------------------------- none Dependencies: ----------------------------------------- none Runtime effects: ----------------------------------------- If enabled Dcm runtime usage may significantly increase due to the additional runtime checks that prevent from illegal API usage or buffer overflows. Code ROM usage effects: ------------------------------------ Enabling this feature leads to a minor increase of the Dcm static code ROM usage. Const data ROM usage effects: ----------------------------------------- none Global RAM usage effects: ----------------------------------------- none Stack RAM usage effects: ------------------------------------ none
        boolean DcmVirtualRequestEnabled [0..1]: set at pre-compile, origin=Vector Informatik, default-value=false  # Specifies whether DCM provide a means for support of virtual requests. Effect: ----------------------------------------- If enabled, Dcm will provide an API set to allow virtual requests to be made from the application (i.e. for external RoE implementation). Constraints: ----------------------------------------- none Dependencies: ----------------------------------------- none Runtime effects: ----------------------------------------- If enabled Dcm run time during request reception and diagnostic service post-processing will be insignificantly increased. Code ROM usage effects: ------------------------------------ Enabling this feature leads to a minor increase of the Dcm static code ROM usage. Const data ROM usage effects: ----------------------------------------- none Global RAM usage effects: ----------------------------------------- none Stack RAM usage effects: ------------------------------------ none
        boolean DcmSupportedIDCalculationSuppressionEnabled: set at pre-compile, origin=Vector Informatik, default-value=false  # Specifies whether DCM shall omit the automatic "supported parameter ID" calculation. Note: This option does not affect the WWH-OBD automatic calculation of the "SupportedIDs". Effect: ----------------------------------------- If enabled, Dcm will NOT calculate the "supported parameter ID" and not handle internally the corresponding reporting services. Constraints: ----------------------------------------- The "supported parameter ID" feature is only available for certain customers. For all others this option will not have any effect. Please refer to the technical reference to find out whether this option is applicable for your project or not (if not documented). Dependencies: ----------------------------------------- none Runtime effects: ----------------------------------------- none Code ROM usage effects: ------------------------------------ Enabling this feature leads to a minor decrease of the Dcm static code ROM usage. Const data ROM usage effects: ----------------------------------------- Enabling this feature leads to a minor decrease of the Dcm data ROM usage. Global RAM usage effects: ----------------------------------------- none Stack RAM usage effects: ------------------------------------ none
        boolean DcmDtrDataProvisionViaDemEnabled: set at pre-compile, origin=Vector Informatik, default-value=true  # DTR Data Provision via DEM Enabled | Specifies whether DCM or DEM handles the OBD MID DTR data acquisition. Effect: ----------------------------------------- If enabled, Dcm will interact with the Dem on each request for OBD MID DTR value retrieval (i.e. SID 0x06 or DID 0xF600). This corresponds to the behavior described in the AR 4.2.2 DCM SWS. If disabled, Dcm uses the OBD MID configuration defined by this BSWMD file and invokes the corresponding application callouts to get the DTR values. Constraints: ----------------------------------------- If this feature is enabled: - any available in the Dcm configuration OBD MIDs will be ignored. - any available in the Dcm configuration OBD MID DIDs (DID in range 0xF600-0xF6XX) will be ignored, but Dcm will redirect any request of such a DID to the Dem. - This implies that no DID in this range shall have other application than the one specified for OBD MID handling. Dependencies: ----------------------------------------- This option has any effect only if the ECU project is licensed for OBD purposes. Runtime effects: ----------------------------------------- Depending on the option state, a completely different implementation will be used for the OBD MID DTR value reading. If this option is enabled, the runtime usage will mostly depend on the Dem implementation efficiency. Code ROM usage effects: ------------------------------------ Depending on the option state, a completely different implementation will be used for the OBD MID DTR value reading. Some small increase of code ROM usage can be expected. Const data ROM usage effects: ----------------------------------------- If this option is enabled, the amount of OBD MID DIDs is drastically reduced (to a single range DID). Also DCM internal tables for MID information will no more be generated, thus the overall result is a significant ROM data usage reduction. Global RAM usage effects: ----------------------------------------- none Stack RAM usage effects: ------------------------------------ If this option is enabled, the stack usage will now include the Dem APIs stack usage which will now call the application to gather the DTR values, thus at least a small stack usage increase is expected.
        boolean DcmForeignDiagnosticRequestDetectionEnabled: set at pre-compile, origin=Vector Informatik, default-value=false  # Specifies whether DCM shall listen for diagnostic requests to other ECUs. Effect: ----------------------------------------- If enabled, Dcm will monitor for diagnostic requests, sent from one of its related clients, but addressed to other ECU on the network. Depending on the TP connection type, the effect will be to cancel any already in processing jobs from this client. Constraints: ----------------------------------------- Currently this feature shall be enabled only if: - Vector MSR3/4 CanTp is used in the ECU project AND - Dcm shall communicate over at least one "Mixed11Addressing" CanTp connection. Dependencies: ----------------------------------------- A Vector MSR4/MSR3 CanTp is used in the ECU project (not only in Configurator5). Runtime effects: ----------------------------------------- If enabled, the CanTp_RxIndication() function will take slightly longer due to the additional call to the Dcm. Code ROM usage effects: ------------------------------------ If enabled, Dcm code ROM usage will slightly increase due to the additional functionality within this TP callout. Const data ROM usage effects: ----------------------------------------- none Global RAM usage effects: ----------------------------------------- none Stack RAM usage effects: ------------------------------------ none
        boolean DcmSuppressResponseOnCanTpFuncMixedAddrRequests: set at pre-compile, origin=Vector Informatik, default-value=false  # Specifies whether DCM shall suppress any response on a functionally addressed request made over a MixedAddressing CanTp connection. Effect: ----------------------------------------- If enabled, Dcm will not send a response to a functionally addressed request from a client using ISO15765-2 MixedAddressing. This is useful for system network concepts using shared CANids for all ECUs accessible by a particular client. Constraints: ----------------------------------------- Currently this feature shall be enabled only if: - ASR CanTp is used in the ECU project AND - Dcm shall communicate over at least one "MixedAddressing" CanTp connection. AND - The ISO15765-2 design with shared Rx/Tx diagnostic CANids for all servers per single client is chosen. Dependencies: ----------------------------------------- none Runtime effects: ----------------------------------------- If enabled, the Dcm runtime usage will insignificantly increase due to the small additional code added by this functionality. Code ROM usage effects: ------------------------------------ If enabled, the Dcm code ROM usage will insignificantly increase due to the small additional code added by this functionality. Const data ROM usage effects: ----------------------------------------- If enabled, the Dcm code ROM usage will insignificantly increase due to the small additional data added by this functionality. Global RAM usage effects: ----------------------------------------- none Stack RAM usage effects: ------------------------------------ none
        boolean DcmSenderReceiverPRPortsEnabled: set at pre-compile, origin=Vector Informatik, default-value=false  # Specifies whether Dcm shall generate separate P-Port and R-port or a single PR-Port for Sender-Receiver DID that has read and write operations of data services or IO control request interfaces. Effect: ----------------------------------------- If enabled, Dcm shall generate a single PR-Port for Sender-Receiver DID that has read, write, and if configured IO control operations. If disabled, Dcm shall generate separate P-Port and R-Port for Sender-Receiver DID that has read, write, or IO control operations. Constraints: ----------------------------------------- PR-Ports for Sender-Receiver interface are not applicable in AR3. Dependencies: ----------------------------------------- none Runtime effects: ----------------------------------------- none Code ROM usage effects: ------------------------------------ none Const data ROM usage effects: ----------------------------------------- none Global RAM usage effects: ----------------------------------------- none Stack RAM usage effects: ----------------------------------------- none
        integer DcmMaxNumberOfThreads [0..1]: 1..16, set at pre-compile, origin=Vector Informatik, default-value=1  # Specifies how many thread resources will be reserved for parallel service processing. The configured value represents the limit for the number of protocols that can be processed in parallel. Effect: ----------------------------------------- Dcm allocates resources in form of global variables to be able to process multiple service requests in parallel. Constraints: ----------------------------------------- This value is only relevant for Postbuild-Loadable configurations and allows to configure additional protocols in Postbuild phase. Therefore the value must be set to the overall number of protocols inclusive the ones added during Postbuild phase. Dependencies: ----------------------------------------- Whether protocols can be processed in parallel is defined by /Dcm/DcmConfigSet/DcmGeneral/DcmParallelProtocolProcessingEnabled Runtime effects: ----------------------------------------- none Code ROM usage effects: ------------------------------------ Increasing this number leads to a slightly increase of the Dcm static code ROM usage. Const data ROM usage effects: ----------------------------------------- Increasing this number leads to a slightly increase of the Dcm data ROM usage. Global RAM usage effects: ----------------------------------------- Increasing this number leads to a massive increase of global RAM usage. Stack RAM usage effects: ----------------------------------------- none
        boolean DcmTypedDataInterfacesEnabled [0..1]: set at pre-compile, origin=Vector Informatik, default-value=false  # Specifies whether Dcm shall use typed data interfaces for DIDs in general or not. Effect: ----------------------------------------- If enabled, Dcm shall generate typed data interfaces for DID signals. If disabled, Dcm shall generate uint8-array-typed interfaces for DID signals. Constraints: ----------------------------------------- none Dependencies: ----------------------------------------- This option has only an effect if DspDataUsePort is set to either: - USE_DATA_ASYNCH_CLIENT_SERVER or - USE_DATA_SYNCH_CLIENT_SERVER or - USE_DATA_SENDER_RECEIVER or - USE_DATA_NV_DATA_INTERFACE Runtime effects: ----------------------------------------- Enabling this feature may lead to a major increase of the runtime. The amount of additional runtime depends on the DcmDspDataType and DcmDspDataSize of the configured DcmDspData elements using this feature. Code ROM usage effects: ------------------------------------ Enabling this feature leads to a minor increase of the Dcm static code ROM usage. Const data ROM usage effects: ----------------------------------------- none Global RAM usage effects: ----------------------------------------- none Stack RAM usage effects: ----------------------------------------- Enabling this feature can lead to a major increased stack size required by the Dcm_MainFunction. The amount of additional RAM usage depends on the DcmDspDataType and DcmDspDataSize of the configured DcmDspData elements using this feature.
        boolean DcmKeepAliveTimeStartOnFunc3E80 [0..1]: set at pre-compile, origin=Vector Informatik, default-value=false  # Keep Alive Time Start On Func 3E 80 | Specifies whether a functional TesterPresent request with suppressed bit set (0x3E 80) starts the KeepAliveTimer during which the Dcm will keep the Diag-Active user in ComM registered or not, when the timer was in idle before. Effect: ------------------------------------ If this parameter is enabled, a functional TesterPresent request with suppressed bit set (0x3E 80) will start the KeepAliveTimer when the ECU was in inactive diagnostic state before. Constraints: ------------------------------------ none Dependencies: ------------------------------------ This option has only an effect if DcmDspKeepAliveTime is configured and not 0. Runtime effects: ------------------------------------ none Code ROM usage effects: ------------------------------------ none Const data ROM usage effects: ------------------------------------ none Global RAM usage effects: ------------------------------------ none Stack RAM usage effects: ------------------------------------ none
        enumeration DcmAutosarVersion: {AUTOSAR_4_02_01, AUTOSAR_4_02_02}, set at pre-compile, origin=Vector Informatik, default-value=AUTOSAR_4_02_02  # Specifies whether DCM shall be based on the AUTOSAR version 4.2.1 and older, or AUTOSAR version 4.2.2 and newer. Effect: ------------------------------------ Mainly affects the signatures of some interfaces and port operations, like: - Module_DiagnosticService() - Module_DiagnosticService_SubService() - Dcm_ReadMemory() - Dcm_WriteMemory() - Xxx_GetInfoTypeValueData() Constraints: ------------------------------------ none Dependencies: ------------------------------------ This parameter has impact on the whole Dcm functionality and API parameters. Please note, that the interface towards Dem can be configured independently by DcmDemApiVersion. Runtime effects: ------------------------------------ none Code ROM usage effects: ------------------------------------ Code ROM usage slightly vary between Dcm AR versions due to different API specifications. Const data ROM usage effects: ------------------------------------ none Global RAM usage effects: ------------------------------------ none Stack RAM usage effects: ------------------------------------ none
        boolean DcmParallelProtocolProcessingEnabled [0..1]: set at pre-compile, origin=Vector Informatik, default-value=false  # Specifies whether all protocols can be processed in parallel during the Default Session. Effect: ----------------------------------------- If enabled, service requests of all protocols in default session will be processed in parallel. Dcm will not cancel ongoing service requests from protocols of lower priority. Constraints: ----------------------------------------- Not all UDS services can be processed in parallel. This feature enforces a Dem interface with AUTOSAR version 4.3.0 or newer. See the technical reference for more details. Dependencies: ----------------------------------------- The maximum number of protocols that can be processed in parallel for postbuild configurations shall be configured here: /Dcm/DcmConfigSet/DcmGeneral/DcmMaxNumberOfThreads Runtime effects: ----------------------------------------- If enabled, the runtime will insignificantly increase. Code ROM usage effects: ------------------------------------ Enabling this feature leads to a slightly increase of the Dcm static code ROM usage. Const data ROM usage effects: ----------------------------------------- Enabling this feature leads to a slightly increase of the Dcm data ROM usage. Global RAM usage effects: ----------------------------------------- Enabling this feature leads to a massive increase of the Dcm global RAM usage. Stack RAM usage effects: ----------------------------------------- none
        symbolic name reference DcmDDDIDStorageBlockIdRef [0..1]: set at pre-compile, origin=Vector Informatik, destination=NvMBlockDescriptor  # Reference to a NvM block to store the DDDID definitions non-volatile. Effect: ------------------------------------ If parameter is set to true DDDID are stored non-volatile otherwise DDDID are only maintained volatile. Constraints: ------------------------------------ none. Dependencies: ------------------------------------ - If "/Dcm/DcmConfigSet/DcmDsd/DcmDsdServiceTable/DcmDsdService" is defined for service 0x2C. - See "destination ref". Runtime effects: ------------------------------------ Enabling this feature leads to slightly increase in runtime because of calling NvM_SetRamBlockStatus() function per request. Code ROM usage effects: ------------------------------------ Enabling this feature leads to a minor increase of the Dcm static code ROM usage. Const data ROM usage effects: ------------------------------------ none. Global RAM usage effects: ------------------------------------ none. Stack RAM usage effects: ------------------------------------ none.
        container DcmSecurityEventRefs [0..1]  # Container for the references to IdsMEvent elements representing the security events that the Dcm module shall report to the IdsM in case the coresponding security related event occurs (and if DcmEnableSecurityEventReporting is set to "true").
          symbolic name reference DIAG_SEV_AUTHENTICATION_SUCCESSFUL [0..1]: set at pre-compile, origin=Vector Informatik, destination=IdsMEvent  # Successfully authenticated (via Authentication 0x29)
          symbolic name reference DIAG_SEV_CERTIFICATE_FAILURE [0..1]: set at pre-compile, origin=Vector Informatik, destination=IdsMEvent  # The tester tried an authentication with an invalid certificate.
          symbolic name reference DIAG_SEV_CLEAR_DTC_SUCCESSFUL [0..1]: set at pre-compile, origin=Vector Informatik, destination=IdsMEvent  # DTC information has been cleared by SID 0x14 ClearDTCInformation
          symbolic name reference DIAG_SEV_COMMUNICATION_CONTROL_SWITCHED_OFF [0..1]: set at pre-compile, origin=Vector Informatik, destination=IdsMEvent  # ECU communication was switched off with service CommunicationControl.
          symbolic name reference DIAG_SEV_DTC_SETTING_SWITCHED_OFF [0..1]: set at pre-compile, origin=Vector Informatik, destination=IdsMEvent  # DTC setting switched off with service 0x85 (ControlDTCSetting).
          symbolic name reference DIAG_SEV_ECU_RESET [0..1]: set at pre-compile, origin=Vector Informatik, destination=IdsMEvent  # ECU had been reset by SID 0x11 ResetECU.
          symbolic name reference DIAG_SEV_ECU_UNLOCK_SUCCESSFUL [0..1]: set at pre-compile, origin=Vector Informatik, destination=IdsMEvent  # Successfully unlocked the ECU (via Security Access 0x27), per Level
          symbolic name reference DIAG_SEV_INCORRECT_MESSAGE_LENGTH_OR_FORMAT [0..1]: set at pre-compile, origin=Vector Informatik, destination=IdsMEvent  # Received request message does not match the specified length or the format of the parameters is different from the specified ones for that service. NRC 0x13 (incorrectMessageLengthOrInvalidFormat) was returned.
          symbolic name reference DIAG_SEV_REQUEST_DOWNLOAD [0..1]: set at pre-compile, origin=Vector Informatik, destination=IdsMEvent  # A diagnostic data download sequence was requested with SID 0x34.
          symbolic name reference DIAG_SEV_REQUEST_OUT_OF_RANGE [0..1]: set at pre-compile, origin=Vector Informatik, destination=IdsMEvent  # A diagnostic request with a parameter that is out of range of the allowed bounds was received. A NRC 0x31 (requestOutOfRange) was returned.
          symbolic name reference DIAG_SEV_REQUEST_SEQUENCE_ERROR [0..1]: set at pre-compile, origin=Vector Informatik, destination=IdsMEvent  # A diagnostic service was received in the wrong sequence order. NRC 0x24 (requestSequenceError) was returned.
          symbolic name reference DIAG_SEV_REQUESTED_ACTIONS_REQUIRES_AUTHENTICATION [0..1]: set at pre-compile, origin=Vector Informatik, destination=IdsMEvent  # A diagnostic request was received while the required authentication to execute this service is not given. NRC 0x34 (authenticationRequired) was returned.
          symbolic name reference DIAG_SEV_SECURITY_ACCESS_DENIED [0..1]: set at pre-compile, origin=Vector Informatik, destination=IdsMEvent  # Tester has sent an diagnostic request without meeting the servers security level requirements for that service. NRC 0x33 (securityAccessDenied) was returned.
          symbolic name reference DIAG_SEV_SECURITY_ACCESS_INVALID_KEY [0..1]: set at pre-compile, origin=Vector Informatik, destination=IdsMEvent  # Security Access failed because the tester has sent an invalid key to the server. An NRC 0x35 (invalidKey) was returned.
          symbolic name reference DIAG_SEV_SECURITY_ACCESS_NUMBER_OF_ATTEMPTS_EXCEEDED [0..1]: set at pre-compile, origin=Vector Informatik, destination=IdsMEvent  # Security Access failed and the number of invalid attempts has been exceeded. NRC 0x36 (exceedNumberOfAttempts) was returned.
          symbolic name reference DIAG_SEV_SECURITY_ACCESS_REQUIRED_TIME_DELAY_NOT_EXPIRED [0..1]: set at pre-compile, origin=Vector Informatik, destination=IdsMEvent  # A further attempt to unlock the ECU was taken before the delay time had expired. NRC 0x37 (requiredTimeDelayNotExpired) was sent.
          symbolic name reference DIAG_SEV_SERVICE_NOT_SUPPORTED [0..1]: set at pre-compile, origin=Vector Informatik, destination=IdsMEvent  # A diagnostic service was requested that is not supported or not supported in the active session. NRC 0x11 (serviceNotSupported) or NRC 0x7F (serviceNotSupportedInActiveSession) was returned.
          symbolic name reference DIAG_SEV_SUBFUNCTION_NOT_SUPPORTED [0..1]: set at pre-compile, origin=Vector Informatik, destination=IdsMEvent  # A subfunction of a diagnostic service was requested that is not supported or not supported in the active session. NRC 0x12 (subFuntionNotSupported) or NRC 0x7E (subFunctionNotSupportedInActiveSession) was returned.
          symbolic name reference DIAG_SEV_WRITE_DATA [0..1]: set at pre-compile, origin=Vector Informatik, destination=IdsMEvent  # Diagnostic data identifier has been written by SID 0x2E.
          symbolic name reference DIAG_SEV_WRITE_INV_DATA [0..1]: set at pre-compile, origin=Vector Informatik, destination=IdsMEvent  # Tester writes invalid data with service WriteDataByIdentifier.
        container DcmSecureCoding [0..1]  # Contains references to diagnostic elements that are used for the secure coding process.
          integer DcmSecureCodingDataBufferSize: 3..4294967295, set at pre-compile, origin=Vector Informatik, default-value=3  # Provides the size of the Dcm internal buffer to store data during the secure coding sequence.
          reference DcmSecureCodingDataIdentifier [1..*]: set at pre-compile, origin=Vector Informatik, destination=DcmDspDid  # Refers to a writeable data identifier that requires the secure coding sequence to write the data.
          reference DcmSecureCodingValidationRoutine: set at pre-compile, origin=Vector Informatik, destination=DcmDspRoutine  # Refers to a routine control that triggers the secure coding validation and data update process.
          symbolic name reference DcmSecureCodingAuthenticationJobRef: set at pre-compile, origin=Vector Informatik, destination=CsmJob  # Reference to a CsmJob used to verify the authentication of the secure coding data in the Csm.
      container DcmPageBufferCfg  # This container contains the configuration (parameters) for Page Buffer handling
        boolean DcmPagedBufferEnabled: set at pre-compile, default-value=true  # Specifies whether the Dcm will use the page buffer mechanism for transmitting the response data (only for reading fault memory). Effect: ----------------------------------------- By enabling this feature Dcm will process the the fault memory reading diagnostic services in a way which reduces the need of large Dcm buffers, but can lead to a different communication behavior. Constraints: ----------------------------------------- It is recommended to leave this feature enabled if the ECU shall support large amount of DTCs and the Dcm shall handle service 0x19 internally. In some cases where the ECU has a minimum amount DTC configuration this option an be turned off to save ROM and runtime resources. Dependencies: ----------------------------------------- Makes sense to be enabled only if the diagnostic service 0x19 is available in the configuration and it is handled by Dcm internally i.e. its parameter "Dcm/DcmConfigSet/DcmDsd/DcmDsdServiceTable/DcmDsdService/DcmDsdSidTabFnc" is left empty. Runtime effects: ----------------------------------------- If enabled the Dcm task will have increased runtime usage while executing diagnostic service 0x19 with a positive response. Code ROM usage effects: ------------------------------------ Enabling this feature leads to a minor increase of the Dcm ROM usage, caused by the additional functionality. Const data ROM usage effects: ----------------------------------------- none Global RAM usage effects: ----------------------------------------- Enabling this feature leads to a minor increase of the Dcm RAM usage, caused by the additional functionality management storage. Stack RAM usage effects: ----------------------------------------- Enabling this feature can lead to a minor increase of the Dcm task stack usage, caused by the additional functions to be executed within the diagnostic service data providers.
        float DcmPagedBufferTimeout [0..0]: 0..1000, set at pre-compile, default-value=0  # NOT USED
      container DcmProcessingConditions [0..1]  # This container contains the configuration ( DSP parameter) for mode arbitration functionality of the Dcm Effect: ----------------------------------------- Using this configuration option, the Dcm will be able to verify any ECU states beyond the diagnostic session and security access before executing a diagnostic request. Constraints: ----------------------------------------- none Dependencies: ----------------------------------------- none Runtime effects: ----------------------------------------- The usage of processing conditions leads to an increase of Dcm task the runtime during the diagnostic request evaluation. The amount of time needed, depends on the condition expression complexity. Code ROM usage effects: ------------------------------------ The usage of processing conditions leads to a insignificant increase of ROM usage in the static code. Const data ROM usage effects: ----------------------------------------- The usage of processing conditions leads to a scalable increase of ROM usage in the Dcm configuration part. Global RAM usage effects: ----------------------------------------- none Stack RAM usage effects: ----------------------------------------- none
        container DcmModeCondition [1..*]  # This container contains the configuration of a mode condition which can be used as argument in DcmModeRules.
          enumeration DcmConditionType: {DCM_EQUALS, DCM_EQUALS_NOT}, set at pre-compile, default-value=DCM_EQUALS  # Specifies what kind of comparison that is made for the evaluation of the mode condition. Effect: ----------------------------------------- The generated code will reflect this parameter by using different logical expressions. Constraints: ----------------------------------------- none Dependencies: ----------------------------------------- none Runtime effects: ----------------------------------------- none Code ROM usage effects: ------------------------------------ none Const data ROM usage effects: ----------------------------------------- none Global RAM usage effects: ----------------------------------------- none Stack RAM usage effects: ----------------------------------------- none
          instance reference DcmBswModeRef [0..1]: set at pre-compile, destination-context=MODE-DECLARATION-GROUP-PROTOTYPE, destination-type=MODE-DECLARATION  # This parameter references a mode of a ModeDeclarationGroupPrototype provided by a Basic Software Module used for the condition. Effect: ----------------------------------------- The generated code will reflect this parameter by referring to different function names. Constraints: ----------------------------------------- none Dependencies: ----------------------------------------- none Runtime effects: ----------------------------------------- none Code ROM usage effects: ------------------------------------ none Const data ROM usage effects: ----------------------------------------- none Global RAM usage effects: ----------------------------------------- none Stack RAM usage effects: ----------------------------------------- none
          instance reference DcmSwcModeRef [0..1]: set at pre-compile, destination-context=ROOT-SW-COMPOSITION-PROTOTYPE SW-COMPONENT-PROTOTYPE P-PORT-PROTOTYPE MODE-DECLARATION-GROUP-PROTOTYPE, destination-type=MODE-DECLARATION  # This parameter references a mode in a particular mode request port of a software component that is used for the condition. Effect: ----------------------------------------- The generated code will reflect this parameter by referring to different function names. Constraints: ----------------------------------------- none Dependencies: ----------------------------------------- none Runtime effects: ----------------------------------------- none Code ROM usage effects: ------------------------------------ none Const data ROM usage effects: ----------------------------------------- none Global RAM usage effects: ----------------------------------------- none Stack RAM usage effects: ----------------------------------------- none
        container DcmModeRule [1..*]  # This container contains the configuration of a mode rule which represents a logical expression with DcmModeConditions or other DcmModeRules as arguments. Effect: ----------------------------------------- Using this configuration option, the Dcm will be able to verify any ECU states beyond the diagnostic session and security access before executing a diagnostic request. Constraints: ----------------------------------------- none Dependencies: ----------------------------------------- none Runtime effects: ----------------------------------------- The usage of processing conditions leads to an increase of Dcm task the runtime during the diagnostic request evaluation. The amount of time needed, depends on the condition expression complexity. Code ROM usage effects: ------------------------------------ The usage of processing conditions leads to an insignificant increase of ROM usage in the static code. Const data ROM usage effects: ----------------------------------------- The usage of processing conditions leads a scalable increase of ROM usage in the Dcm configuration part, depending on the configuration. Global RAM usage effects: ----------------------------------------- none Stack RAM usage effects: ----------------------------------------- The usage of processing conditions can lead to an minor increase of required stack size by the Dcm_MainFunction in the static code. The concrete amount depends on the configured rule cascading depth.
          enumeration DcmLogicalOperator [0..1]: {DCM_AND, DCM_OR}, set at pre-compile, default-value=DCM_AND  # This parameter specifies the logical operator to be used in the logical expression. If the expression only consists of a single condition this parameter shall not be used. Effect: ----------------------------------------- The generated code will reflect this parameter by using different logical expressions. Constraints: ----------------------------------------- none Dependencies: ----------------------------------------- none Runtime effects: ----------------------------------------- none Code ROM usage effects: ------------------------------------ none Const data ROM usage effects: ----------------------------------------- none Global RAM usage effects: ----------------------------------------- none Stack RAM usage effects: ----------------------------------------- none
          integer DcmModeRuleNrcValue [0..1]: 0..255, set at pre-compile, default-value=34  # Optional parameter which defines the NRC to be sent in case the mode rule condition is not valid. Effect: ----------------------------------------- The generated code will reflect this parameter by using different NRC return values. Constraints: ----------------------------------------- none Dependencies: ----------------------------------------- none Runtime effects: ----------------------------------------- If NRC specified, the generated rule checking function will need insignificantly longer execution time. Code ROM usage effects: ------------------------------------ If NRC specified, the generated rule checking function will need insignificantly more ROM. Const data ROM usage effects: ----------------------------------------- none Global RAM usage effects: ----------------------------------------- none Stack RAM usage effects: ----------------------------------------- If NRC specified, the generated rule checking function will need insignificantly more stack.
          choice reference DcmArgumentRef [1..*]: set at pre-compile, destination=[DcmModeCondition, DcmModeRule]  # This is a choice reference either to a mode condition or a an other mode rule serving as sub-expression. Effect: ----------------------------------------- The generated code will reflect this parameter by using different function calls. Constraints: ----------------------------------------- Cyclic loop of references shall be avoided! Dependencies: ----------------------------------------- none Runtime effects: ----------------------------------------- Depending on the amount of conditions/sub-rules to be checked, the Dcm will take less or more time to evaluate the expressions. Code ROM usage effects: ------------------------------------ The ROM usage of the generated rule checking function scales linearly with the amount of conditions/sub-rules to be checked. Code ROM usage effects: ----------------------------------------- none Global RAM usage effects: ----------------------------------------- none Stack RAM usage effects: ----------------------------------------- The amount of required stack of the Dcm_MainFunction will increase with increasing the rule cascading depth. The amount of conditions/sub-rules to be check on a single rule does not affect stack usage.
      container DcmMiscellaneous [0..1]  # This container includes all parameters that may override/disable some standard DCM features.
        boolean DcmSendingNrc7e7fOnFuncRequestEnabled [0..1]: set at pre-compile, origin=Vector Informatik, default-value=false  # Specifies whether NRC 0x7E and 0x7F shall be responded on functional requests. Effect: ----------------------------------------- By enabling this feature Dcm will respond with NRC 0x7E resp. 0x7F on functional requests. Note: This behavior contradicts with the ISO14229-1:2013. Constraints: ----------------------------------------- It is recommended to leave this feature disabled to achieve maximum ISO14229-1:2013 compliance. Dependencies: ----------------------------------------- For some OEMs DCM is already pre-configured to use the matching behavior (i.e. already enables this feature). Runtime effects: ----------------------------------------- none Code ROM usage effects: ------------------------------------ Enabling this feature leads to a very small decrease of the Dcm ROM usage, caused by the additional functionality deactivated. Const data ROM usage effects: ----------------------------------------- none Global RAM usage effects: ----------------------------------------- none Stack RAM usage effects: ----------------------------------------- none
        boolean DcmAcceptingOtherClientsDuringNonDefaultSessionEnabled [0..1]: set at pre-compile, origin=Vector Informatik, default-value=false  # Specifies whether DCM shall accept requests from clients other than the one that has initiated a non-default session. Effect: ----------------------------------------- By enabling this feature Dcm will accept also requests from other clients belonging to the same DcmDslProtocolRow while the ECU is a non-default session. Note: This behavior contradicts with the AR DCM SWS and ISO14229-1:2013. Constraints: ----------------------------------------- It is recommended to leave this feature disabled to achieve maximum AR resp. ISO14229-1:2013 compliance. Dependencies: ----------------------------------------- For some OEMs DCM is already pre-configured to use the matching behavior (i.e. already enables this feature). Runtime effects: ----------------------------------------- Enabling this feature may slightly decrease the DCM run time on request reception/processing. Code ROM usage effects: ------------------------------------ Enabling this feature leads to a small decrease of the Dcm ROM usage, caused by the additional functionality deactivated. Const data ROM usage effects: ----------------------------------------- none Global RAM usage effects: ----------------------------------------- none Stack RAM usage effects: ----------------------------------------- none
        boolean DcmOmitComControlCurrentChannelParamEnabled [0..1]: set at pre-compile, origin=Vector Informatik, default-value=false  # Specifies whether DCM shall not accept CommunicationType parameter value "current channel" (0xFx). Effect: ----------------------------------------- By enabling this feature Dcm will respond with NRC 0x31 on a valid request for SID 0x28 with communication type parameter set to 0xFx. Constraints: ----------------------------------------- It is recommended to leave this feature disabled to achieve maximum OEM/ISO14229-1:2013 and AR compatibility. Dependencies: ----------------------------------------- This switch has any effect only if SID 0x28 is to be supported by the ECU and internally handled by DCM. Runtime effects: ----------------------------------------- Enabling this feature may slightly decrease the DCM run time on request for SID 0x28. Code ROM usage effects: ------------------------------------ Enabling this feature leads to a small decrease of the Dcm ROM usage, caused by the additional functionality deactivated. Const data ROM usage effects: ----------------------------------------- none Global RAM usage effects: ----------------------------------------- none Stack RAM usage effects: ----------------------------------------- none
        boolean DcmHighPerformancePeriodicTxEnabled [0..1]: set at pre-compile, origin=Vector Informatik, default-value=false  # NOT USED
        boolean DcmSpecificCauseCodeEnabled [0..1]: set at pre-compile, origin=Vector Informatik, default-value=false  # Specifies whether DCM shall support an additional byte (specific cause code) for negative response messages. Effect: ----------------------------------------- By enabling this feature Dcm will allow the application to register an additional cause code for a negative response message. Constraints: ----------------------------------------- none Dependencies: ----------------------------------------- none Runtime effects: ----------------------------------------- none Code ROM usage effects: ------------------------------------ Enabling this feature leads to a small increase of the Dcm ROM usage, caused by the additional functionality activated. Const data ROM usage effects: ----------------------------------------- none Global RAM usage effects: ----------------------------------------- Enabling this feature leads to a small increase of the Dcm RAM usage. Stack RAM usage effects: ----------------------------------------- none
  module config Dcm_Pre: definition=Dcm
  module config Dcm_Rec: definition=Dcm
