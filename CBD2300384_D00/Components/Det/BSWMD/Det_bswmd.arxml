AUTOSAR XML (schema 00048)
# COPYRIGHT
# Copyright (c) 2022 by Vector Informatik GmbH. All rights reserved.
# This software is copyright protected and proprietary to Vector Informatik GmbH.
# Vector Informatik GmbH grants to you only those rights as set out in the license conditions.
package /MICROSAR
  module definition Det [0..1]: category=VENDOR_SPECIFIC_MODULE_DEFINITION, refined-module-def=Det, variants pre-compile  # Default Error Tracer. DET is the central error handler in the AUTOSAR architecture. All other basic software modules can report development errors, runtime errors and transient faults to the DET. #AUTOSAR #ServiceComponent
    container DetConfigSet [0..1]: multiplicity set at pre-compile  # Configuration set container for Det.
      container DetModule [0..65535]: multiplicity set at pre-compile  # This container describes a non BSW module that is using the Det via Service Interface.
        integer DetModuleId: 4096..65535, multiplicity set at pre-compile, set at pre-compile, symbolic-name-value=true, default-value=4096  # Unique identifier of the error reporting component. When reporting errors to the DET, a symbolic name derived from the moduleID has to be used to identify the reporter.
        container DetModuleInstance [0..255]: multiplicity set at pre-compile, post-build-variant-multiplicity=true  # Describes the Instance used for the according Service Port. It shall be used to differentiate software component instances when multiple instantiation is used.
          integer DetInstanceId: 0..255, multiplicity set at pre-compile, set at pre-compile, default-value=0  # This parameter describes the InstanceId used for the according Service Port. It shall be used to differentiate software component instances when multiple instantiation is used. Else it shall be set to 0.
    container DetGeneral: multiplicity set at pre-compile  # Generic configuration parameters of the Det module.
      boolean DetForwardToDlt [0..1]: multiplicity set at pre-compile, set at pre-compile, default-value=false  # This parameter controls the fowarding of DET errors to the DLT module. If the parameter is present and set to true, the DET forwards all errors to the function Dlt_DetForwardErrorTrace before other DET functionality is performed.
      boolean DetVersionInfoApi: multiplicity set at pre-compile, set at pre-compile, default-value=false  # This parameter if set to true enables the function Det_GetVersionInfo() to get major, minor and patch version information. true: Version info API enabled. false: Version info API disabled.
      boolean DetEnableDet: multiplicity set at pre-compile, origin=Vector Informatik, set at pre-compile, default-value=true  # This parameter if set to true enables reporting of development error. It can be used to disable the DET completely.
      boolean DetExtDebugSupport: multiplicity set at pre-compile, origin=Vector Informatik, set at pre-compile, default-value=false  # This parameter if set the true enables the extended debug support feature which provides additional functionality to the DET such as filtering, logging and flexible break handling. Please refer to the technical reference for details.
      integer DetGlobalFilterSize: 0..255, multiplicity set at pre-compile, origin=Vector Informatik, set at pre-compile, default-value=0  # This parameter configures the number of global filters which can be used to discard irrelevant errors. The filters are typically configured at runtime using a debugger. Please refer to the technical reference about details. This setting is only relevant if extended debug support (DetExtDebugSupport) is enabled.
      integer DetBreakFilterSize: 0..255, multiplicity set at pre-compile, origin=Vector Informatik, set at pre-compile, default-value=0  # This parameter configures the number of break handler filters which can be used to exit the DET without entering the endless loop. The filters are typically configured at runtime using a debugger. Please refer to the technical reference about details. This setting is only relevant if extended debug support (DetExtDebugSupport) is enabled.
      integer DetLogBufferSize: 0..255, multiplicity set at pre-compile, origin=Vector Informatik, set at pre-compile, default-value=0  # This parameter configures the size of the log buffer which can be used to log errors reported to the DET. The log buffer is typically accessed at runtime using a debugger. Please refer to the technical reference about details. This setting is only relevant if extended debug support (DetExtDebugSupport) is enabled.
      integer DetReportErrorRecursionLimit: 0..254, multiplicity set at pre-compile, origin=Vector Informatik, set at pre-compile, default-value=0  # This parameter configures the number of allowed recursions for calling Det_ReportError. Refer to the technical reference for details. To disable recursion detection set this value to 0.
      integer DetReportRuntimeErrorRecursionLimit: 0..254, multiplicity set at pre-compile, origin=Vector Informatik, set at pre-compile, default-value=0  # This parameter configures the number of allowed recursions for calling Det_ReportRuntimeError. Refer to the technical reference for details. To disable recursion detection set this value to 0.
      integer DetReportTransientFaultRecursionLimit: 0..254, multiplicity set at pre-compile, origin=Vector Informatik, set at pre-compile, default-value=0  # This parameter configures the number of allowed recursions for calling Det_ReportTransientFault. Refer to the technical reference for details. To disable recursion detection set this value to 0.
      integer DetDltFilterSize: 0..255, multiplicity set at pre-compile, origin=Vector Informatik, set at pre-compile, default-value=0  # This parameter configures the number of Dlt filters which can be used to suppress reporting of irrelevant errors to the Dlt module. The filters are typically configured at runtime using a debugger. Please refer to the technical reference about details. This setting is only relevant if extended debug support (DetExtDebugSupport) is enabled and if Dlt forwarding (DetForwardToDlt) is enabled.
      string DetUserConfigFile [0..1]: multiplicity set at pre-compile, origin=Vector Informatik, set at pre-compile  # Reference to an external user configuration file that will be included during generation. The content of the user configuration file will be added at the end of the generated module configuration file and allows altering or extending the generated code. Caution: User configuration files can cause the software module to malfunction and must only be used with great care!
    container DetNotification [0..1]: multiplicity set at pre-compile  # Configuration of the notification functions.
      function name DetErrorHook [0..255]: multiplicity set at pre-compile, set at pre-compile  # Optional list of functions to be called by the Default Error Tracer in context of each call of Det_ReportError. The type of these functions shall be identical the type of Det_ReportError itself: Std_ReturnType (*f)(uint16, uint8, uint8, uint8).
      function name DetReportRuntimeErrorCallout [0..255]: multiplicity set at pre-compile, set at pre-compile  # This parameter defines the existence and the names of callout functions for the corresponding runtime error handler. The type of these functions shall be identical the type of Det_ReportRuntimeError itself: Std_ReturnType (*f)(uint16, uint8, uint8, uint8)
      function name DetReportTransientFaultCallout [0..255]: multiplicity set at pre-compile, set at pre-compile  # This parameter defines the existence and the names of callout functions for the corresponding transient fault handler. The type of these functions shall be identical the type of Det_ReportTransientFault itself: Std_ReturnType (*f)(uint16, uint8, uint8, uint8)
  bsw implementation Det_Impl: programming-language=C, sw-version=14.00.01, used-code-generator=DaVinci Configurator, vendor-id=30, ar-release-version=4.05.00, behavior=DetBehavior, preconfigured-configuration=Det_Pre, recommended-configuration=Det_Rec, vendor-specific-module-def=Det
  module config Det_Pre: definition=Det
  module config Det_Rec: definition=Det
