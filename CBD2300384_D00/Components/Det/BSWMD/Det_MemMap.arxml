AUTOSAR XML (schema 00048)
# COPYRIGHT
# Copyright (c) 2021 by Vector Informatik GmbH. All rights reserved.
# This software is copyright protected and proprietary to Vector Informatik GmbH.
# Vector Informatik GmbH grants to you only those rights as set out in the license conditions.
package /MICROSAR
  bsw implementation Det_Impl
    resource consumption ResourceConsumption
      6 x memory section:
        DET_CODE: sw-addrmethod=CODE, symbol=CODE
        DET_CONST_UNSPECIFIED: alignment=UNSPECIFIED, sw-addrmethod=CONST_UNSPECIFIED, symbol=CONST_UNSPECIFIED
        DET_VAR_NOINIT_8BIT: alignment=8, sw-addrmethod=VAR_NO_INIT_8, symbol=VAR_NOINIT_8BIT
        DET_VAR_NOINIT_UNSPECIFIED: alignment=UNSPECIFIED, sw-addrmethod=VAR_NO_INIT_UNSPECIFIED, symbol=VAR_NOINIT_UNSPECIFIED
        DET_VAR_INIT_UNSPECIFIED: alignment=UNSPECIFIED, sw-addrmethod=VAR_INIT_UNSPECIFIED, symbol=VAR_INIT_UNSPECIFIED
        Det_SWC_CODE: prefix=Det_Prefix, sw-addrmethod=CODE, symbol=CODE
      section name prefix Det_Prefix: symbol=Det
