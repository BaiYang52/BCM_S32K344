AUTOSAR XML (schema 4-0-3)
# COPYRIGHT
# Copyright (c) 2017 by Vector Informatik GmbH. All rights reserved.
# This software is copyright protected and proprietary to Vector Informatik GmbH.
# Vector Informatik GmbH grants to you only those rights as set out in the license conditions.
package /MICROSAR/VTT
  bsw implementation VTTCrypto_Impl: programming-language=C, sw-version=1.00.01, used-code-generator=DaVinci Configurator, vendor-id=30, ar-release-version=4.03.00, behavior=VTTCryptoBehavior, preconfigured-configuration=VTTCrypto_Pre, recommended-configuration=VTTCrypto_Rec, vendor-api-infix=Vtt, vendor-specific-module-def=VTTCrypto
  module definition VTTCrypto [0..1]: category=VENDOR_SPECIFIC_MODULE_DEFINITION, variants pre-compile  # VTT Crypto Driver
    container CryptoDriverObjects  # Container for Crypto Driver Objects
      container CryptoDriverObject [0..*]  # Container for configuration of Crypto Driver Object. The container name serves as a symbolic name for the identifier of a Crypto Driver Object.
        integer CryptoDriverObjectId: 0..4294967295, set at pre-compile, symbolic-name-value=true, default-value=0  # Identifier of the Crypto Driver Object. The Crypto Driver Object offers different crypto primitives.
        integer CryptoDriverObjectQueueSize: 1..1, set at pre-compile, default-value=1  # Size of the queue in the Crypto Driver. Defines the maximum number of jobs in the Crypto Driver Object queue. If it is set to 0, queueing is disabled in the Crypto Driver Object. This Crypto Driver does not support queuing but uses the buffer for asynchronous processing.
        reference CryptoPrimitiveRef [1..*]: set at pre-compile, destination=CryptoPrimitive  # Refers to primitive in the CRYPTO. The CryptoPrimitive is a pre-configured container of the crypto service that shall be used.
    container CryptoGeneral  # Container for common configuration options.
      boolean CryptoVersionInfoApi: set at pre-compile, default-value=false  # Pre-processor switch to enable and disable availability of the API Crypto_GetVersionInfo(). - True: API Crypto_GetVersionInfo() is available - False: API Crypto_GetVersionInfo() is not available.
      float CryptoMainFunctionPeriod: 0..3600, set at pre-compile, default-value=0.01  # Specifies the period of main function Crypto_MainFunction in seconds.
      boolean CryptoSupportSheKeyUpdate: set at pre-compile, origin=Vector Informatik, default-value=false  # If enabled, the She key update with M1,M2 and M3 can be used for setting/updating a key. Disable to save ROM and Runtime.
      boolean CryptoDevErrorDetect: set at pre-compile, default-value=true  # Switches the development error detection and notification on or off. - True: detection and notification is enabled. - False: detection and notification is disabled. | True: Development error detection enabled. False: Development error detection disabled
      boolean CryptoSafeBswChecks: set at pre-compile, origin=Vector Informatik, default-value=false  # Selects if safety checks are used. These checks improve robustness as e.g. invalid parameters are checked before function is executed. This attribute has to be enabled for safety projects where this component is mapped to an ASIL partition.
      string CryptoVendorApiInfix [0..1]: set at pre-compile, origin=Vector Informatik, max-length=255, min-length=0  # This parameter can be used to overwrite the "ModuleName", “Vendor-ID” and “API-Infix” attributes of the real component, if necessary. Example: In general the implementation specific API name is specified as: <ModuleName>_<vendorId>_<vendorApiInfix>_<API name from module> This parameter overwrites the whole parenthesis <ModuleName>_<vendorId>_<vendorApiInfix>.
      boolean CryptoUseVStdLib: set at pre-compile, origin=Vector Informatik, default-value=true  # Use VStdLib | If enabled the VStdLib is used for copy and clear data operations. If there is no VStdLib, disable the switch to use the implementation of the Crypto.
      symbolic name reference CryptoSheMasterKeyRef [0..1]: set at pre-compile, origin=Vector Informatik, destination=CryptoKey  # Reference to a key which acts as master key in case of She Key Update is used. If the AuthicationID is 1 the she master key will be used for authentication.
      container CryptoKeyExchangePrimitves  # Configuration of a Crypto Key Exchange Primitive. If there is an algorithm configured, key exchange is usable via Crypto_KeyExchangeCalcPubVal and Crypto_KeyExchangeCalcSecret API.
        enumeration CryptoKeyExchangeAlgorithm [0..*]: {CRYPTO_KEY_EXCHANGE_ALGORITHM_X25519, CRYPTO_KEY_EXCHANGE_ALGORITHM_ANSIP256R1}, set at pre-compile, origin=Vector Informatik, default-value=CRYPTO_KEY_EXCHANGE_ALGORITHM_X25519  # Determines the algorithm used for the crypto key exchange.
      container CryptoKeyDerivePrimitives  # If enabled, key derivation is usable via Crypto_KeyDerive API. Disable to save ROM.
        enumeration CryptoKeyDeriveAlgorithm [0..*]: {CRYPTO_KDF_ALGO_ASYM_NIST_FIPS_186_4_ERB, CRYPTO_KDF_ALGO_SYM_NIST_800_108_CNT_MODE_SHA256, CRYPTO_KDF_ALGO_ISO_15118_CERTIFICATE_HANDLING, CRYPTO_KDF_ALGO_NIST_800_56_A_ONE_PASS_C1E1S_SINGLE_STEP_KDF_SHA256}, set at pre-compile, origin=Vector Informatik, default-value=CRYPTO_KDF_ALGO_SYM_NIST_800_108_CNT_MODE_SHA256  # Determines the algorithm used for the crypto key derive.
    container CryptoKeyElements [0..1]  # Container for CRYPTO key elements.
      container CryptoKeyElement [0..*]  # Configuration of a CryptoKeyElement
        integer CryptoKeyElementId: 0..4294967295, set at pre-compile, symbolic-name-value=true, default-value=1  # Identifier of the CRYPTO key element
        integer CryptoKeyElementSize: 1..4294967295, set at pre-compile, default-value=16  # Maximum size of a CRYPTO key element in bytes
        string CryptoKeyElementInitValue [0..1]: set at pre-compile, default-value=0 0 0 0 0 0 0 0 0 0 0 0 0 0 0 0  # Value which will be used to fill the element during initialization, when the element is not already initialized.
        enumeration CryptoKeyElementReadAccess: {RA_ALLOWED, RA_DENIED, RA_ENCRYPTED, RA_INTERNAL_COPY}, set at pre-compile, default-value=RA_ALLOWED  # Define the reading access rights of the key element. CRYPTO_RA_DENIED = key element cannot be read from outside the Crypto Driver CRYPTO_RA INTERNAL_COPY = key element can be copied to another key element in the same crypto driver. CRYPTO_RA_ALLOWED = key element can be read as plaintext CRYPTO_RA_ENCRYPTED = key element can be read encrypted. E.g. SHE Ram-Key export.
        boolean CryptoKeyElementAllowPartialAccess: set at pre-compile, default-value=false  # Enable or disable writing and reading the key element with data smaller than the size of the element. - True: enable partial access of the key element - False: disable partial access of the key element
        boolean CryptoKeyElementPersist: set at pre-compile, default-value=false  # Enable or disable persisting of the key element in non-volatile storage. - True: enable persisting of the key element. - False: disable persisting of the key element.
        enumeration CryptoKeyElementWriteAccess: {WA_ALLOWED, WA_DENIED, WA_ENCRYPTED, WA_INTERNAL_COPY}, set at pre-compile, default-value=WA_ALLOWED  # Define the writing access rights of the key element CRYPTO_WA_DENIED = key element cannot be written from outside the Crypto Driver CRYPTO_WA INTERNAL_COPY = key element can be filled with another key element in the same crypto driver. CRYPTO_WA_ALLOWED = key element can be rewritten as plaintext CRYPTO_WA_ENCRYPTED = key element can be written encrypted. E.g. SHE load key.
        reference CryptoKeyElementVirtualTargetRef [0..1]: set at pre-compile, destination=CryptoKeyElement  # Refers to a key element which will contain the actual data. If the Reference is configured, the key element will be a virtual key element.
    container CryptoKeyTypes [0..1]  # Container for CRYPTO key types
      container CryptoKeyType [0..*]  # Configuration of a CryptoKeyType
        reference CryptoKeyElementRef [1..*]: set at pre-compile, destination=CryptoKeyElement  # Refers to a pointer in the CRYPTO Key Element, which holds the data of the crypto key element.
    container CryptoKeys [0..1]  # Container for CRYPTO keys
      container CryptoKey [0..*]  # Configuration of a CryptoKey
        integer CryptoKeyId: 0..4294967295, set at pre-compile, symbolic-name-value=true, default-value=0  # Identifier of the CRYPTO key
        integer CryptoKeyDeriveIterations: 1..4294967295, set at pre-compile, default-value=1  # Holds the number of iterations to be performed by the key derivation primitive
        reference CryptoKeyTypeRef: set at pre-compile, destination=CryptoKeyType  # Refers to a pointer in the CRYPTO to a CryptoKeyType. The CryptoKeyType provides the information which key elements are contained in a CryptoKey.
    container CryptoPrimitives [0..1]  # Container for CRYPTO primitives
      container CryptoPrimitive [0..*]  # Configuration of a CryptoPrimitive
        enumeration CryptoPrimitiveAlgorithmFamily [1..*]: {CRYPTO_ALGOFAM_NOT_SET, CRYPTO_ALGOFAM_SHA1, CRYPTO_ALGOFAM_SHA2_224, CRYPTO_ALGOFAM_SHA2_256, CRYPTO_ALGOFAM_SHA2_384, CRYPTO_ALGOFAM_SHA2_512, CRYPTO_ALGOFAM_SHA2_512_224, CRYPTO_ALGOFAM_SHA2_512_256, CRYPTO_ALGOFAM_SHA3_224, CRYPTO_ALGOFAM_SHA3_256, CRYPTO_ALGOFAM_SHA3_384, CRYPTO_ALGOFAM_SHA3_512, CRYPTO_ALGOFAM_SHAKE128, CRYPTO_ALGOFAM_SHAKE256, CRYPTO_ALGOFAM_RIPEMD160, CRYPTO_ALGOFAM_BLAKE_1_256, CRYPTO_ALGOFAM_BLAKE_1_512, CRYPTO_ALGOFAM_BLAKE_2s_256, CRYPTO_ALGOFAM_BLAKE_2s_512, CRYPTO_ALGOFAM_3DES, CRYPTO_ALGOFAM_AES, CRYPTO_ALGOFAM_CHACHA, CRYPTO_ALGOFAM_RSA, CRYPTO_ALGOFAM_ED25519, CRYPTO_ALGOFAM_BRAINPOOL, CRYPTO_ALGOFAM_ECCNIST, CRYPTO_ALGOFAM_SECURECOUNTER, CRYPTO_ALGOFAM_RNG, CRYPTO_ALGOFAM_SIPHASH, CRYPTO_ALGOFAM_ECIES, CRYPTO_ALGOFAM_CUSTOM, CRYPTO_ALGOFAM_CUSTOM_ECCANSI, CRYPTO_ALGOFAM_CUSTOM_ECCSEC}, set at pre-compile, default-value=CRYPTO_ALGOFAM_NOT_SET  # Determines the algorithm family used for the crypto service.
        enumeration CryptoPrimitiveAlgorithmMode [1..*]: {CRYPTO_ALGOMODE_NOT_SET, CRYPTO_ALGOMODE_ECB, CRYPTO_ALGOMODE_CBC, CRYPTO_ALGOMODE_CFB, CRYPTO_ALGOMODE_OFB, CRYPTO_ALGOMODE_CTR, CRYPTO_ALGOMODE_GCM, CRYPTO_ALGOMODE_XTS, CRYPTO_ALGOMODE_RSAES_OAEP, CRYPTO_ALGOMODE_RSAES_PKCS1_v1_5, CRYPTO_ALGOMODE_RSASSA_PSS, CRYPTO_ALGOMODE_RSASSA_PKCS1_v1_5, CRYPTO_ALGOMODE_8ROUNDS, CRYPTO_ALGOMODE_12ROUNDS, CRYPTO_ALGOMODE_20ROUNDS, CRYPTO_ALGOMODE_HMAC, CRYPTO_ALGOMODE_CMAC, CRYPTO_ALGOMODE_GMAC, CRYPTO_ALGOMODE_CTRDRBG, CRYPTO_ALGOMODE_SIPHASH_2_4, CRYPTO_ALGOMODE_SIPHASH_4_8, CRYPTO_ALGOMODE_CUSTOM, CRYPTO_ALGOMODE_CUSTOM_P256R1}, set at pre-compile, default-value=CRYPTO_ALGOMODE_NOT_SET  # Determines the algorithm mode used for the crypto service
        enumeration CryptoPrimitiveService [1..*]: {CRYPTO_MAC_VERIFY, CRYPTO_MAC_GENERATE, CRYPTO_SIGNATURE_VERIFY, CRYPTO_SIGNATURE_GENERATE, CRYPTO_ENCRYPT, CRYPTO_DECRYPT, CRYPTO_AEADENCRYPT, CRYPTO_AEADDECRYPT, CRYPTO_HASH, CRYPTO_RANDOM}, set at pre-compile, default-value=CRYPTO_MAC_VERIFY  # Determines the crypto service used for defining the capabilities
        enumeration CryptoPrimitiveAlgorithmSecondaryFamily [1..*]: {CRYPTO_ALGOFAM_NOT_SET, CRYPTO_ALGOFAM_SHA1, CRYPTO_ALGOFAM_SHA2_224, CRYPTO_ALGOFAM_SHA2_256, CRYPTO_ALGOFAM_SHA2_384, CRYPTO_ALGOFAM_SHA2_512, CRYPTO_ALGOFAM_SHA2_512_224, CRYPTO_ALGOFAM_SHA2_512_256, CRYPTO_ALGOFAM_SHA3_224, CRYPTO_ALGOFAM_SHA3_256, CRYPTO_ALGOFAM_SHA3_384, CRYPTO_ALGOFAM_SHA3_512, CRYPTO_ALGOFAM_SHAKE128, CRYPTO_ALGOFAM_SHAKE256, CRYPTO_ALGOFAM_RIPEMD160, CRYPTO_ALGOFAM_BLAKE_1_256, CRYPTO_ALGOFAM_BLAKE_1_512, CRYPTO_ALGOFAM_BLAKE_2s_256, CRYPTO_ALGOFAM_BLAKE_2s_512, CRYPTO_ALGOFAM_3DES, CRYPTO_ALGOFAM_AES, CRYPTO_ALGOFAM_CHACHA, CRYPTO_ALGOFAM_RSA, CRYPTO_ALGOFAM_ED25519, CRYPTO_ALGOFAM_BRAINPOOL, CRYPTO_ALGOFAM_ECCNIST, CRYPTO_ALGOFAM_SECURECOUNTER, CRYPTO_ALGOFAM_RNG, CRYPTO_ALGOFAM_SIPHASH, CRYPTO_ALGOFAM_ECIES, CRYPTO_ALGOFAM_CUSTOM}, set at pre-compile, default-value=CRYPTO_ALGOFAM_NOT_SET  # Determines the algorithm secondary family used for the crypto service
  module config VTTCrypto_Pre: definition=VTTCrypto
  module config VTTCrypto_Rec: definition=VTTCrypto
