AUTOSAR XML (schema 4-0-3)
# COPYRIGHT
# Copyright (c) 2022 by Vector Informatik GmbH. All rights reserved.
# This software is copyright protected and proprietary to Vector Informatik GmbH.
# Vector Informatik GmbH grants to you only those rights as set out in the license conditions.
package /MICROSAR
  bsw implementation EcuM_Impl: programming-language=C, sw-version=13.00.00, used-code-generator=DaVinci Configurator, vendor-id=30, ar-release-version=4.00.03, behavior=EcuMBehavior, preconfigured-configuration=EcuM_Pre, recommended-configuration=EcuM_Rec, vendor-specific-module-def=EcuM
  module definition EcuM [0..1]: category=VENDOR_SPECIFIC_MODULE_DEFINITION, refined-module-def=EcuM, variants pre-compile/post-build-loadable/post-build-selectable  # Configuration of the ECU State Manager (EcuM) module. The EcuM manages the intialization and de-initialization of OS, SchM, BswM and other base SW modules. It is responisble for startup, shutdown, sleep modes and wakeup sources of the ECU. #ModeManagement #Startup #Shutdown #Wakeup #AUTOSAR #ServiceComponent
    container EcuMConfiguration  # This container includes the configuration (parameters) of the ECU State Manager.
      container EcuMCommonConfiguration  # This container includes the common configuration (parameters) of the ECU State Manager.
        integer EcuMConfigConsistencyHash [0..1]: 0..18446744073709551615, set at pre-compile, default-value=0  # This value specifies a hash value generated across all pre-compile and link-time parameters of all BSW modules. This hash value is compared against a field in the EcuM_ConfigType and hence allows checking the consistency of the entire configuration.
        reference EcuMDefaultAppMode: set at post-build in variant post-build-loadable+post-build-selectable / pre-compile in variant pre-compile, destination=OsAppMode  # Reference to the default application mode in the OS configuration, loaded when the ECU comes out of reset.
        reference EcuMOSResource [1..*]: set at pre-compile, destination=OsResource  # Reference to an OS resource which is used to block the scheduler during a sleep phase. In the case of a multicore system the scheduler on the slave core must also be blocked during a sleep phase. | In case of multi core each core shall have an own OsResource.
        container EcuMDefaultShutdownTarget  # This container includes the default shutdown target to be selected by EcuM. The actual shutdown target may be overridden by the EcuM_SelectShutdownTarget service.
          enumeration EcuMDefaultState: {EcuMStateOff, EcuMStateReset, EcuMStateSleep}, set at post-build in variant post-build-loadable+post-build-selectable / pre-compile in variant pre-compile, default-value=EcuMStateOff  # This parameter defines the state part of the default shutdown target selected when the ECU comes out of reset. If EcuMStateSleep is selected, the parameter EcuMDefaultSleepModeRef selects the specific sleep mode. If EcuMStateReset is selected, the parameter EcuMDefaultResetModeRef selects the specific reset mode.
          symbolic name reference EcuMDefaultResetModeRef [0..1]: set at pre-compile in variant post-build-loadable+pre-compile / post-build in variant post-build-selectable, destination=EcuMResetMode  # Reference to a reset mode configuration within this module. If EcuMDefaultShutdownTarget is EcuMStateReset, this parameter selects the default reset mode. Otherwise this parameter may be ignored.
          symbolic name reference EcuMDefaultSleepModeRef [0..1]: set at pre-compile in variant post-build-loadable+pre-compile / post-build in variant post-build-selectable, destination=EcuMSleepMode  # Reference to a sleep mode configuration within this module. If EcuMDefaultShutdownTarget is EcuMStateSleep, this parameter selects the default sleep mode. Otherwise this parameter may be ignored.
        container EcuMDemEventParameterRefs [0..1]  # This container includes references to DemEventParameter elements which shall be invoked using the API Dem_ReportErrorStatus in case the corresponding error occurs. The EventId is taken from the referenced DemEventParameter's DemEventId value. | The standardized errors are provided in this container and can be extended by vendor specific error references.
          symbolic name reference ECUM_E_ALL_RUN_REQUESTS_KILLED [0..1]: set at pre-compile, destination=DemEventParameter  # Reference to a DemEventParameter which shall be issued when the error "ECUM_E_ALL_RUN_REQUESTS_KILLED" has occured. This reference is only relevant for EcuM Fixed
          symbolic name reference ECUM_E_CONFIGURATION_DATA_INCONSISTENT [0..1]: set at pre-compile, destination=DemEventParameter  # Reference to the DemEventParameter which shall be issued when the error "ECUM_E_CONFIGURATION_DATA_INCONSISTENT" has occurred.
          symbolic name reference ECUM_E_RAM_CHECK_FAILED [0..1]: set at pre-compile, destination=DemEventParameter  # Reference to the DemEventParameter which shall be issued when the error "ECUM_E_RAM_CHECK_FAILED" has occurred.
          symbolic name reference ECUM_E_IMPROPER_CALLER [0..1]: set at pre-compile, origin=Vector Informatik, destination=DemEventParameter  # Reference to the DemEventParameter which shall be issued when the error "ECUM_E_IMPROPER_CALLER" has occurred.
        container EcuMDriverInitListOne [0..1]  # This container includes a list of initialization items that will be handled after a reset from within EcuM_Init function after the module has entered the state ECUM_STATE_STARTUP_ONE. All items in this list are initialized before the post-build configuration has been loaded and the OS is initialized. Therefore none of these items may use post-build configuration. | This container holds a list of module IDs that will be initialized. Each module in the list will be called for initialisation in the list order. All modules in this list are initialized before the OS is started and so these modules require no OS support.
          container EcuMDriverInitItem [0..*]  # These containers include the configuration of one initialization item. This may either be a module initialization function or any user defined code.
            string EcuMModuleID: set at pre-compile  # Short name of the module to be initialized, e.g. Mcu, Gpt etc. For user defined code given in EcuMAdditionalInitCode 'Code' has to be given.
            string EcuMModuleService [0..1]: set at pre-compile  # This parameter defines the service to be called to initialize that module, e.g. Init, PreInit, Start etc. If the service is Init and the parameter EcuMModuleConfigurationRef has been set for that module, the corresponding pointer to the init structure (<Module>_ConfigType) and in case of multiple instantiation an uint8 value to identify the instance of the module(<MSN>_CtrlIdx) are be passed as arguments. | If the service is Init and the parameter EcuMModuleConfigurationRef has been set for that module, the corresponding pointer to the init structure (<Module>_ConfigType) and in case of multiple instantiation an uint8 value to identify the instance of the module(<MSN>_CtrlIdx) shall be passed as arguments.
            string EcuMAdditionalInitCode [0..1]: set at pre-compile, origin=Vector Informatik  # This parameter defines an additional code in the callout function, e.g. Mcu_InitClock(). If this code needs other header files, they can be included via the parameter EcuMAdditionalIncludes. RESTRICTIONS: 'EcuMAdditionalInitCode' is only available, if 'EcuMModuleID' is set to 'Code'.
            string EcuMModuleHeader [0..1]: set at pre-compile, origin=Vector Informatik  # This parameter defines a header file needed for this driver init item.
        container EcuMDriverInitListZero [0..1]  # This container includes a list of initialization items that will be handled after a reset almost directly after EcuM_Init has been called. All items in this list are initialized before the post-build configuration has been loaded and the OS is initialized. Therefore none of these items may use post-build configuration. | This container holds a list of module IDs that will be initialized. Each module in the list will be called for initialisation in the list order. All modules in this list are initialized before the post-build configuration has been loaded and the OS is initialized. Therefore, these modules may not use post-build configuration.
          container EcuMDriverInitItem [0..*]  # These containers include the configuration of one initialization item. This may either be a module initialization function or any user defined code.
            string EcuMModuleID: set at pre-compile  # Short name of the module to be initialized, e.g. Mcu, Gpt etc. For user defined code given in EcuMAdditionalInitCode 'Code' has to be given.
            string EcuMModuleService [0..1]: set at pre-compile  # This parameter defines the service to be called to initialize that module, e.g. Init, PreInit, Start etc. If the service is Init and the parameter EcuMModuleConfigurationRef has been set for that module, the corresponding pointer to the init structure (<Module>_ConfigType) and in case of multiple instantiation an uint8 value to identify the instance of the module(<MSN>_CtrlIdx) are be passed as arguments. | If the service is Init and the parameter EcuMModuleConfigurationRef has been set for that module, the corresponding pointer to the init structure (<Module>_ConfigType) and in case of multiple instantiation an uint8 value to identify the instance of the module(<MSN>_CtrlIdx) shall be passed as arguments.
            string EcuMAdditionalInitCode [0..1]: set at pre-compile, origin=Vector Informatik  # This parameter defines additional code in the callout function, e.g. Mcu_InitClock(). If this code needs other header files, they can be included via the parameter EcuMAdditionalIncludes. RESTRICTIONS: 'EcuMAdditionalInitCode' is only available, if 'EcuMModuleID' is set to 'Code'.
            string EcuMModuleHeader [0..1]: set at pre-compile, origin=Vector Informatik  # This parameter defines a header file needed for this driver init item.
        container EcuMDriverRestartList [0..1]  # This container includes a list of initialization items that will be handled after a restart from SLEEP mode occurred. EcuMDriverRestartList shall normally do the same initialization calls listed in the order in which they occur in the EcuMDriverInitListZero and EcuMDriverInitListOne. | EcuM2719: A configuration tool shall fill the callout EcuM_AL_DriverRestart with initialization calls to the listed drivers in the order in which they occur in the list. EcuM2720: Entries in this list must appear in the same order as in the combined list of EcuM_DriverInitListOne and EcuM_DriverInitListTwo. This list may be a real subset though. In all other cases, the generation tool shall report an error. The included container has the same structure as EcuM_DriverInitItem
          container EcuMDriverInitItem [0..*]  # These containers include the configuration of one initialization item. This may either be a module initialization function or any user defined code.
            string EcuMModuleID: set at pre-compile  # Short name of the module to be initialized, e.g. Mcu, Gpt etc. For user defined code given in EcuMAdditionalInitCode 'Code' has to be given.
            string EcuMModuleService [0..1]: set at pre-compile  # The service to be called to initialize that module, e.g. Init, PreInit, Start etc. | If the service is Init and the parameter EcuMModuleConfigurationRef has been set for that module, the corresponding pointer to the init structure (<Module>_ConfigType) and in case of multiple instantiation an uint8 value to identify the instance of the module(<MSN>_CtrlIdx) shall be passed as arguments.
            string EcuMAdditionalInitCode [0..1]: set at pre-compile, origin=Vector Informatik  # This parameter defines additional code in the callout function, e.g. Mcu_InitClock(). If this code needs other header files, they can be included via the parameter EcuMAdditionalIncludes. RESTRICTIONS: 'EcuMAdditionalInitCode' is only available, if 'EcuMModuleID' is set to 'Code'.
            string EcuMModuleHeader [0..1]: set at pre-compile, origin=Vector Informatik  # This parameter defines a header file needed for driver init items.
        container EcuMSleepMode [0..*]: post-build-changeable=true  # This container includes the configuration of one sleep modes. The name of this container specify the symbolic name of a sleep mode and identifies the corresponding sources which should be active during this sleep phase. | The names of these containers specify the symbolic names of the different sleep modes.
          integer EcuMSleepModeId: 0..255, set at pre-compile, symbolic-name-value=true, default-value=0  # This value specifies the identifier of this sleep mode in services like EcuM_SelectShutdownTarget.
          boolean EcuMSleepModeSuspend [0..1]: set at pre-compile, default-value=false  # Not used! This parameter defines if the CPU is suspended, halted or powered off in the sleep mode. If the CPU keeps running in this sleep mode, then this flag must be set to false.
          symbolic name reference EcuMSleepModeMcuModeRef: set at pre-compile, destination=McuModeSettingConf  # Reference to the corresponding MCU mode for this sleep mode.
          symbolic name reference EcuMWakeupSourceMask [1..*]: set at pre-compile, destination=EcuMWakeupSource  # References to the wakeup sources in this module that shall be enabled for this sleep mode.
        container EcuMWakeupSource [1..*]: post-build-changeable=true  # This container includes the configuration of a wakeup source.
          float EcuMValidationTimeout [0..1]: 0..65.535, set at post-build in variant post-build-loadable+post-build-selectable / pre-compile in variant pre-compile, default-value=0  # The validation timeout (period for which the ECU State Manager will wait for the validation of a wakeup event) can be defined for each wakeup source independently. If the parameter is not defined or is defined to 0 the wakeup validation is disabled for this wakeup source. | When the timeout is not instantiated, there is no validation routine and the ECU Manager shall not validate the wakeup source.
          integer EcuMWakeupSourceId: 0..31, set at pre-compile, symbolic-name-value=true, default-value=0  # This value specifies the identifier of this wakeup source.
          boolean EcuMWakeupSourcePolling: set at post-build in variant post-build-loadable+post-build-selectable / pre-compile in variant pre-compile, default-value=false  # This parameter defines if the wakeup source needs polling.
          float EcuMCheckWakeupTimeout [0..1]: 0..10, set at post-build in variant post-build-loadable+post-build-selectable / pre-compile in variant pre-compile, origin=Vector Informatik, default-value=0  # This parameter specifies the maximum time between the call of EcuM_CheckWakeup and an asynchronous call of EcuM_SetWakeupEvent of the same wakeup source. If the timeout expires the ECU is allowed to go to sleep state. For wakeup sources where it is ensured that the EcuM_SetWakeupEvent is called before EcuM_CheckWakeup function ends the timeout value shall be 0 or the parameter shall be deleted.
          symbolic name reference EcuMComMChannelRef [0..*]: set at post-build in variant post-build-loadable+post-build-selectable / pre-compile in variant pre-compile, destination=ComMChannel  # ComM Channel Reference | Reference to multiple Networks (channels) defined in the Communication Manager. No reference indicates that the wakeup source is not a communication channel.
          symbolic name reference EcuMResetReasonRef [0..1]: set at pre-compile, destination=McuResetReasonConf  # Reference to a reset reason detected by the MCU driver.
          symbolic name reference EcuMComMPNCRef [0..*]: set at post-build in variant post-build-loadable+post-build-selectable / pre-compile in variant pre-compile, origin=Vector Informatik, destination=ComMPnc  # ComM PNC Reference | Reference to one or more PNC's defined in the Communication Manager. No reference indicates that the wakeup source is not assigned to a partial network.
      container EcuMFixedConfiguration [0..1]  # This container includes the configuration (parameters) of the EcuMFixed.
        float EcuMNvramReadallTimeout [0..1]: 0..60, set at pre-compile, default-value=60  # Not used! Period given in seconds for which the ECU State Manager will wait until it considers a ReadAll job of the NVRAM Manager as failed.
        float EcuMNvramWriteallTimeout: 0..60, set at post-build in variant post-build-loadable+post-build-selectable / pre-compile in variant pre-compile, default-value=60  # Period given in seconds for which the ECU State Manager will wait until it considers a WriteAll job of the NVRAM Manager as failed.
        float EcuMRunMinimumDuration: 0..60, set at post-build in variant post-build-loadable+post-build-selectable / pre-compile in variant pre-compile, default-value=5  # Duration given in seconds for which the ECU State Manager will | stay in RUN state even when no one requests RUN. This duration should be long at least as long as a SW-Cs needs to request RUN.
        float EcuMNvmCancelWriteAllTimeout [0..1]: 0..60, set at post-build in variant post-build-loadable+post-build-selectable / pre-compile in variant pre-compile, origin=Vector Informatik, default-value=60  # This parameter specifies the time in seconds which shall be waited for NvM_WriteAll in case NvM_CancelWriteAll was called due to a wakeup event. | The following coding is used: [0] - immediately abort the waiting mechanism. EcuM will switch immediately into RUN state or calls the optional NvM_KillWriteAll API before switching to RUN state. [60] - the maximum waiting time before the EcuM will continue with the wakeup sequence
        choice reference EcuMFixedModuleConfigurationRef [0..*]: set at pre-compile, destination=[AdcConfigSet, CanConfigSet, CanIfInitCfg, CanNmGlobalConfig, CanSMConfiguration, CanTpConfig, CanTrcvConfigSet, ComConfig, ComMConfigSet, DbgMultipleConfigurationContainer, DcmConfigSet, DemConfigSet, DioConfig, DltMultipleConfigurationContainer, EepInitConfiguration, EthConfigSet, EthIfConfigSet, EthTrcvConfigSet, FiMConfigSet, FlsConfigSet, FlsTstConfigSet, FrArTpMultipleConfig, FrIfConfig, FrMultipleConfiguration, FrNmChannelConfig, FrSMConfig, FrTpMultipleConfig, GptChannelConfigSet, IcuConfigSet, IpduMConfig, J1939TpConfiguration, LinGlobalConfig, LinIfGlobalConfig, LinSMConfigSet, LinTpGlobalConfig, McuModuleConfiguration, PduRRoutingTables, PortConfigSet, PwmChannelConfigSet, RtePostBuildVariantConfiguration, SoAdDoIpConfig, SpiDriver, UdpNmGlobalConfig, WdgMConfigSet, WdgSettingsConfig, XcpConfig]  # These parameters contain references to the init structure of the corresponding BSW module.
        symbolic name reference EcuMComMCommunicationAllowedList [0..*]: set at pre-compile in variant post-build-loadable+pre-compile / post-build in variant post-build-selectable, destination=ComMChannel  # ComM Communication Allowed | These parameters contain references to the ComMChannels for which EcuM has to call ComM_CommunicationAllowed.
        symbolic name reference EcuMNormalMcuModeRef: set at pre-compile, destination=McuModeSettingConf  # This parameter is a reference to the normal MCU mode to be restored after a sleep.
        container EcuMDriverInitListThree [0..1]  # Container for Init Block III. | This container holds a list of module IDs that will be initialized. Each module in the list will be called for initialisation in the list order. All modules in this list are initialized after the OS is started and so these modules may use OS support. These modules may also rely on the Nvram ReadAll job to have provided all data.
          container EcuMDriverInitItem [0..*]  # These containers describe the entries in a driver init list.
            string EcuMModuleID: set at pre-compile  # Short name of the module to be initialized, e.g. Mcu, Gpt etc.
            string EcuMModuleService: set at pre-compile  # The service to be called to initialize that module, e.g. Init, PreInit, Start etc. | If the service is Init and the parameter EcuMModuleConfigurationRef has been set for that module, the corresponding pointer to the init structure (<Module>_ConfigType) and in case of multiple instantiation an uint8 value to identify the instance of the module(<MSN>_CtrlIdx) shall be passed as arguments.
            string EcuMAdditionalInitCode [0..1]: set at pre-compile, origin=Vector Informatik  # This parameter defines an additional code in the callout function, e.g. Mcu_InitClock(). If this code needs other header files, they can be included via the parameter EcuMAdditionalIncludes. RESTRICTIONS: 'EcuMAdditionalInitCode' is only available, if 'EcuMModuleID' is set to 'Code'.
            string EcuMModuleHeader [0..1]: set at pre-compile, origin=Vector Informatik  # This parameter defines a header file needed for driver init items.
        container EcuMDriverInitListTwo [0..1]  # Container for Init Block II. | This container holds a list of module IDs that will be initialized. Each module in the list will be called for initialisation in the list order. All modules in this list are initialized after the OS is started and so these modules may use OS support. These modules may not rely on the Nvram ReadAll job to have provided all data.
          container EcuMDriverInitItem [0..*]  # These containers describe the entries in a driver init list.
            string EcuMModuleID: set at pre-compile  # Short name of the module to be initialized, e.g. Mcu, Gpt etc.
            string EcuMModuleService: set at pre-compile  # The service to be called to initialize that module, e.g. Init, PreInit, Start etc. | If the service is Init and the parameter EcuMModuleConfigurationRef has been set for that module, the corresponding pointer to the init structure (<Module>_ConfigType) and in case of multiple instantiation an uint8 value to identify the instance of the module(<MSN>_CtrlIdx) shall be passed as arguments.
            string EcuMAdditionalInitCode [0..1]: set at pre-compile, origin=Vector Informatik  # This parameter defines an additional code in the callout function, e.g. Mcu_InitClock(). If this code needs other header files, they can be included via the parameter EcuMAdditionalIncludes. RESTRICTIONS: 'EcuMAdditionalInitCode' is only available, if 'EcuMModuleID' is set to 'Code'.
            string EcuMModuleHeader [0..1]: set at pre-compile, origin=Vector Informatik  # This parameter defines a header file needed for driver init items.
        container EcuMFixedUserConfig [1..*]  # These containers describe the identifiers that are needed to refer to a software component or another appropriate entity in the system which is designated to request the RUN state. Application requestors refer to entities above RTE, system requestors to entities below RTE (e.g. Communication Manager).
          integer EcuMFixedUser: 0..255, set at pre-compile, symbolic-name-value=true, default-value=0  # Parameter used to identify one user.
        container EcuMTTII [0..*]  # Not used! These containers describe the structures and the following configuration items describe its elements. These structures are concatenated to build a list as indicated by Figure 27 - Configuration Container Diagram. | The list must contain at least one element when ECUM_TTII_ENABLED is set to true.
          integer EcuMDivisor: 0..18446744073709551615, set at pre-compile  # This parameter defines the divisor pre load value.
          symbolic name reference EcuMSleepModeRef: set at pre-compile, destination=EcuMSleepMode  # This configuration parameter is a reference to a configured sleep mode that is used for TTII.
          symbolic name reference EcuMSuccessorRef [0..1]: set at pre-compile, destination=EcuMSleepMode  # This parameter is a reference to the next sleep mode in the TTII protocol.
      container EcuMFlexConfiguration [0..1]  # This container includes the configuration (parameters) of the EcuMFlex. | Only applicable if EcuMFlex is implemented.
        choice reference EcuMFlexModuleConfigurationRef [0..*]: set at pre-compile in variant post-build-loadable+pre-compile / post-build in variant post-build-selectable, destination=[AdcConfigSet, CanConfigSet, DemConfigSet, FlsConfigSet, GptChannelConfigSet, IcuConfigSet, LinGlobalConfig, McuModuleConfiguration, PortConfigSet, PwmChannelConfigSet, SpiDriver, WdgMConfigSet, WdgSettingsConfig]  # References to the initialization structure of the corresponding BSW module.
        symbolic name reference EcuMNormalMcuModeRef: set at pre-compile in variant post-build-loadable+pre-compile / post-build in variant post-build-selectable, destination=McuModeSettingConf  # Reference to the normal MCU mode to be restored after a sleep.
        reference EcuMGptChannelRef [0..1]: set at pre-compile in variant post-build-loadable+pre-compile / post-build in variant post-build-selectable, origin=Vector Informatik, destination=GptChannelConfiguration  # Reference to a GPT Channel which serves as the timebase for the EcuM Clock.The GPT Channel must be a Channel in GPT_CH_MODE_CONTINUOUS to guarantee permanent and exact counting of the EcuM clock.
        reference EcuMPartitionRef [0..*]: set at pre-compile, origin=Vector Informatik, destination=EcucPartition  # Reference denotes the partition a EcuM and SchM shall run inside. Please note that in case of a multicore ECU this reference is mandatory and it is expected that the SchM and the EcuM run only once per core.
        container EcuMAlarmClock [0..*]  # These containers include the configured alarm clocks. | The name of these containers allows giving a symbolic name to one alarm clock.
          integer EcuMAlarmClockId: 0..255, set at pre-compile, symbolic-name-value=true, default-value=0  # This ID identifies this alarmclock.
          float EcuMAlarmClockTimeOut: 0..Inf, set at pre-compile, default-value=0  # This parameter allows to define a timeout for this alarm clock. Not Used
          symbolic name reference EcuMAlarmClockUser: set at pre-compile, destination=EcuMFlexUserConfig  # This parameter allows an alarm to be assigned to a user.
        container EcuMFlexUserConfig [0..*]  # This container includes the identifiers that are needed to refer to a software component or another appropriate entity in the system which uses the EcuMFlex Interfaces. This container is only needed if the parameter EcuMEnableDefBehaviour is active.
          integer EcuMFlexUser: 0..255, set at pre-compile, symbolic-name-value=true, default-value=0  # This value specifies the identifier of the EcuMFlex user.
          integer EcuMGoDownRequestID [0..1]: 1..65535, set at pre-compile, origin=Vector Informatik, default-value=42  # This value specifies the corresponding BSW or SWC ModuleID. The parameter is necessary to translate the caller ID of the API EcuM_GoDown into an EcuM_FlexUser ID. This value depends on the configuration item EcuMEnableDefBehaviour. If (EcuMEnableDefBehaviour == true) then this parameter is optional configurable otherwise this parameter is ignored.
          reference EcuMFlexEcucPartitionRef [0..0]: set at pre-compile, destination=EcucPartition  # Not used! Denotes in which "EcucPartition" the user of the EcuM is executed.
        container EcuMGoDownAllowedUsers [0..1]  # This container includes the collection of allowed users which are allowed to call the EcuM_GoDown API.
          symbolic name reference EcuMGoDownAllowedUserRef [1..*]: set at pre-compile, destination=EcuMFlexUserConfig  # References to the users which are allowed to call the EcuM_GoDown API. If a reference to an EcuM_User is set, this user must have a configured EcuMGoDownRequestID to translate the caller ID in the routine EcuM_GoDown.
        container EcuMResetMode [1..*]  # These containers include the configured reset modes. | The name of these containers allows one of the following symbolic names to be given to the different reset modes: - ECUM_RESET_MCU - ECUM_RESET_WDGM - ECUM_RESET_IO.
          integer EcuMResetModeId: 0..255, set at pre-compile, symbolic-name-value=true, default-value=0  # This value specifies the identifier to be used in services like EcuM_SelectShutdownTarget.
        container EcuMSetClockAllowedUsers [0..1]  # This container includes the collection of allowed users which are allowed to call the EcuM_SetClock API.
          symbolic name reference EcuMSetClockAllowedUserRef [1..*]: set at pre-compile, destination=EcuMFlexUserConfig  # References to the users which are allowed to call the EcuM_SetClock API.
        container EcuMShutdownCause [1..*]  # These containers include the configured shut down or reset causes. | The name of these containers allows to give one of the following symbolic names to the different shut down causes: - ECUM_CAUSE_ECU_STATE - ECU state machine entered a state for shutdown, - ECUM_CAUSE_WDGM - WdgM detected failure, - ECUM_CAUSE_DCM - Dcm requests shutdown (split into UDS services?), - and values from configuration.
          integer EcuMShutdownCauseId: 0..255, set at pre-compile, symbolic-name-value=true, default-value=0  # This values specifies the identifier for API calls for this shut down cause.
        container EcuMShutdownTarget [0..*]  # This container is not used including the parameters. These containers include the configured shut down targets. | The name of these containers allows to give symbolic names to the different shut down targets.
          integer EcuMShutdownTargetId: 0..255, set at pre-compile, symbolic-name-value=true, default-value=0  # This value specifies the identifier used for this shut down target in services like EcuM_SelectShutdownTarget.
        container EcuMDriverInitListBswM [0..*]  # Driver Init List BswM | This container includes a list of initialization items that will be handled after the BswM has been initialized.
          container EcuMDriverInitItem [0..*]  # These containers include the configuration of one initialization item. This may either be a module initialization function or any user defined code.
            string EcuMModuleID: set at pre-compile, origin=Vector Informatik  # Short name of the module to be initialized, e.g. Mcu, Gpt etc. For user defined code given in EcuMAdditionalInitCode 'Code' has to be given.
            string EcuMModuleService [0..1]: set at pre-compile, origin=Vector Informatik  # This parameter defines the service to be called to initialize that module, e.g. Init, PreInit, Start etc. If the service is Init and the parameter EcuMModuleConfigurationRef has been set for that module, the corresponding pointer to the init structure (<Module>_ConfigType) and in case of multiple instantiation an uint8 value to identify the instance of the module(<MSN>_CtrlIdx) are be passed as arguments. | If the service is Init and the parameter EcuMModuleConfigurationRef has been set for that module, the corresponding pointer to the init structure (<Module>_ConfigType) and in case of multiple instantiation an uint8 value to identify the instance of the module(<MSN>_CtrlIdx) shall be passed as arguments.
            string EcuMAdditionalInitCode [0..1]: set at pre-compile, origin=Vector Informatik  # This parameter defines an additional code in the callout function, e.g. Mcu_InitClock(). If this code needs other header files, they can be included via the parameter EcuMAdditionalIncludes. RESTRICTIONS: 'EcuMAdditionalInitCode' is only available, if 'EcuMModuleID' is set to 'Code'.
            string EcuMModuleHeader [0..1]: set at pre-compile, origin=Vector Informatik  # This parameter defines a header file needed for driver init items.
    container EcuMFixedGeneral [0..1]  # This container holds the general, pre-compile configuration parameters for the EcuMFixed. | Only applicable if EcuMFixed is implemented.
      boolean EcuMIncludeComM: set at pre-compile in variant post-build-loadable+pre-compile / post-build in variant post-build-selectable, default-value=true  # Include ComM | This configuration parameter defines whether the communication manager is supported by EcuM. This feature is presented for development purpose to compile out the communication manager in the early debugging phase.
      boolean EcuMIncludeNvM [0..1]: set at pre-compile, default-value=false  # Include NvM | Not used! This configuration parameter defines whether the non volatile memory manager is supported by EcuM. This feature is presented for development purpose to compile out the volatile memory manager in the early debugging phase.
      boolean EcuMIncludeNvramMgr: set at pre-compile, default-value=true  # This configuration parameter defines whether the non volatile memory manager is supported by EcuM. If this parameter is active, NvM_WriteAll() handling will be done by EcuM.
      boolean EcuMTTIIEnabled [0..1]: set at pre-compile, default-value=false  # Not used! Boolean switch to enable / disable TTII
      boolean EcuMIncludeRte: set at pre-compile, origin=Vector Informatik, default-value=true  # Enable/disables the use of the Rte.
      boolean EcuMGenModeSwitchPort: set at pre-compile, origin=Vector Informatik, default-value=true  # This parameter enables the generation of the EcuM_CurrentMode sender-receiver interface within the SW-C description and the usage of a callback function for mode switch notification. If this parameter is set to ON the ECUM will use the provided RTE function Rte_Switch_currentMode_currentMode().
      boolean EcuMModeSwitchRteAck: set at pre-compile, origin=Vector Informatik, default-value=true  # This parameter enables the synchronisation mechanism with RTE. In case this parameter is enabled, the EcuM waits on defined synchronistion points until the Rte switches into coresponding ECU mode. After receiving the ACK, EcuM will continue.
      boolean EcuMIncludeDem: set at pre-compile, origin=Vector Informatik, default-value=true  # Enable/disables the use of the Dem.
      symbolic name reference EcuMTTIIWakeupSourceRef [0..1]: set at pre-compile, destination=EcuMWakeupSource  # Not used! This configuration parameter references the initial sleep mode to be used by TTII when TTII is activated after a RUN mode. | EcuM2785: Whenever RUN mode is reached, the TTII protocol shall be reset to use the wakeup source referenced by this parameter. This configuration parameter is a human readable name for a TTII wakeup source which is only needed by the configuration tool. For imlementation on the ECU, this parameter may be dropped and replaced by a generated list index of EcuM_TTII.
    container EcuMFlexGeneral [0..1]  # General configuration parameters of the EcuMFlex. | Only applicable if EcuMFlex is implemented.
      boolean EcuMAlarmClockPresent: set at pre-compile, default-value=false  # This flag indicates whether the optional AlarmClock feature is present.
      boolean EcuMEnableDefBehaviour [0..1]: set at pre-compile, default-value=false  # This parameter defines if the defensive behavior is enabled.
      boolean EcuMResetLoopDetection [0..1]: set at pre-compile, default-value=false  # Not used! If false, no reset loop detection is performed.
      boolean EcuMModeHandling [0..1]: set at pre-compile, origin=Vector Informatik, default-value=false  # Defines if the mode handling is enabled.
      symbolic name reference EcuMAlarmWakeupSource [0..1]: set at pre-compile, destination=EcuMWakeupSource  # This parameter describes the reference to the EcuMWakeupSource being used for the EcuM AlarmClock.
    container EcuMGeneral  # General configuration parameters of the ECUM.
      boolean EcuMDevErrorDetect: set at pre-compile, default-value=true  # This parameter switches the Development Error Detection and Notification ON or OFF. true: Development error detection is enabled. false: Development error detection is disabled. Note: In general, the development error detection is recommended during pre-test phase. It is not recommended to enable the development error detection in production code due to increased runtime and ROM needs.
      boolean EcuMIncludeDem: set at pre-compile, default-value=false  # Not used! This parameter defines if the header of the DEM module will be included within the source of the ECU State Manager.
      boolean EcuMIncludeDet: set at pre-compile, default-value=false  # Not used! If defined, the according BSW module will be initialized by the ECU State Manager
      float EcuMMainFunctionPeriod: 0.001..0.255, set at pre-compile, default-value=0.01  # This value specifies the schedule period of EcuM_MainFunction. | Unit: [s]
      boolean EcuMVersionInfoApi: set at pre-compile, default-value=false  # This parameter enables/disables the function EcuM_GetVersionInfo() to get major, minor and patch version information.
      string EcuMAdditionalIncludes [0..*]: set at pre-compile, origin=Vector Informatik  # This parameter defines header files needed for driver init lists.
      string EcuMUserConfigurationFile [0..1]: set at pre-compile, origin=Vector Informatik  # Reference to an external text file that will be included during generation to <Module>_Cfg.h. The content of the user configuration file will be added at the end of the generated module configuration file and allows altering or extending the generated code. Caution: User configuration files can cause the software module to malfunction and must only be used with great care!
      boolean EcuMDeferredBswMNotification: set at pre-compile, origin=Vector Informatik, default-value=false  # Deferred BswM Notification | Notification to the BswM via BswM_EcuM_CurrentWakeup is done immediate in the context of the EcuM API EcuM_SetWakeupEvent or EcuM_ValidateWakeupEvent. This APIs are often called in the context of an interrupt and the BswM notification will extend the interrupt runtime. If the value is True, the notification will be done deferred in the next EcuM_MainFunction.
      boolean EcuMSlaveCoreHandling: set at pre-compile, origin=Vector Informatik, default-value=true  # This parameter indicates if in case of a MultiCore Ecu the MasterCore synchronizes with the slave cores in sleep and off modes. If synchronization is active the MasterCore waits on the way to ECUM_STATE_SLEEP and ECUM_STATE_OFF till the SlaveCores has entered their state.
      boolean EcuMEnableFixBehavior: set at pre-compile, origin=Vector Informatik, default-value=false  # Enables or Disables the EcuM Fixed Behavior. The EcuM Fixed Behavior does automatically control ECU phases like Startup / Run / PostRun / Sleep or Off.
      integer EcuMBswCoreId [0..1]: 0..255, set at pre-compile, origin=Vector Informatik, default-value=0  # Specifies on which core the BSW shall run. This parameter is only relevant if more than one core is configured in the OS configuration.
      boolean EcuMNonChannelWakeupInRun: set at pre-compile, origin=Vector Informatik, default-value=false  # Allows wakeups for wakeup sources without referenced communication channel during the RUN phase. If this parameter is false, only wakeup sources with a communication channel refernce lead to a valid wakeup event.
      boolean EcuMSchMStartInitialization: set at pre-compile, origin=Vector Informatik, default-value=true  # SchM Start | In case that this parameter is set, the EcuM uses the SchM and BswM initialization sequence SchM_Start(); SchM_Init(); BswM_Init(); SchM_StartTiming(); which uses additional SchM init functions defined in ASR 4.3.0 but keeps the old order of execution of SchM_Init and BswM_Init If the parameter is false, the initialization sequence is SchM_Init(); BswM_Init();
      boolean EcuMSafeBswChecks: set at pre-compile, origin=Vector Informatik, default-value=false  # Selects if safety checks are used. These checks improve robustness as e.g. invalid parameters are checked before function is executed. This attribute has to be enabled for safety projects.
      container EcuMGeneration  # Contains the generation configuration parameters of the module EcuM.
        boolean EcuMOutOfBoundsWriteSanitizer: set at pre-compile, origin=Vector Informatik, default-value=false  # This parameter activates/deactivates the generation of runtime checks which call a DET error notification function to find easily out of bounds write problems. FALSE: no checks are generated in the data access. TRUE: the data access is enriched with DET checks to validate indexes. For more details, refer to TechnicalReference_ComStackLib.pdf
        boolean EcuMOutOfBoundsReadSanitizer: set at pre-compile, origin=Vector Informatik, default-value=false  # This parameter activates/deactivates the generation of runtime checks which call a DET error notification function to find easily out of bounds read problems. FALSE: no checks are generated in the data access. TRUE: the data access is enriched with DET checks to validate indexes. For more details, refer to TechnicalReference_ComStackLib.pdf
        boolean EcuMInterfacesForDeactivatedData: set at pre-compile, origin=Vector Informatik, default-value=false  # This parameter activates/deactivates the capability to generate bsw data interfaces for deactivated data elements. This is an advantage for the BSW developer to reduce the time to market with a development environment using auto completition. FALSE: data interfaces are not generated if the data elementis deactivated. TRUE: data interfaces are generated as e.g. emty macros. For more details, refer to TechnicalReference_ComStackLib.pdf
  module config EcuM_Pre: definition=EcuM
    EcuMConfiguration
      EcuMCommonConfiguration
        5 x EcuMWakeupSource, all with EcuMValidationTimeout=0, EcuMCheckWakeupTimeout=0:
          ECUM_WKSOURCE_POWER: EcuMWakeupSourceId=0
          ECUM_WKSOURCE_RESET: EcuMWakeupSourceId=1
          ECUM_WKSOURCE_INTERNAL_RESET: EcuMWakeupSourceId=2
          ECUM_WKSOURCE_INTERNAL_WDG: EcuMWakeupSourceId=3
          ECUM_WKSOURCE_EXTERNAL_WDG: EcuMWakeupSourceId=4
  module config EcuM_Rec: definition=EcuM
  module config EcuM_Pre_Class1: definition=EcuM
    EcuMConfiguration
      EcuMFlexConfiguration
        3 x EcuMResetMode:
          ECUM_RESET_MCU: EcuMResetModeId=0
          ECUM_RESET_WDG: EcuMResetModeId=1
          ECUM_RESET_IO: EcuMResetModeId=2
        4 x EcuMShutdownCause:
          ECUM_CAUSE_UNKNOWN: EcuMShutdownCauseId=0
          ECUM_CAUSE_ECU_STATE: EcuMShutdownCauseId=1
          ECUM_CAUSE_WDGM: EcuMShutdownCauseId=2
          ECUM_CAUSE_DCM: EcuMShutdownCauseId=3
        ECUM_RESET_WAKEUP (EcuMResetMode): EcuMResetModeId=3
