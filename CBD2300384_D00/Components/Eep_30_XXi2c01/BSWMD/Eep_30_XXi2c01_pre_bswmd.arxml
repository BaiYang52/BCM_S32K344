AUTOSAR XML (schema 4-0-3)
# COPYRIGHT
# Copyright (c) by Vector Informatik GmbH. All rights reserved.
# This software is copyright protected and proprietary to Vector Informatik GmbH.
# Vector Informatik GmbH grants to you only those rights as set out in the license conditions.
package /MICROSAR/Eep_30_XXi2c01
  module config Eep_30_XXi2c01_Pre: definition=Eep
    58 x EepDeviceInformation:
      Giantec_GT24C256B: EepAllowedWriteCycles=4000000, EepMinimumAddressType=16, EepTotalSize=32768, EepWriteTime=0.005, EepPageSize=EepPageSize128  # Giantec GT24C256B
      Microchip_24AA02: EepAllowedWriteCycles=1000000, EepMinimumAddressType=8, EepTotalSize=256, EepWriteTime=0.005, EepPageSize=EepPageSize8  # Microchip 24AA02
      Microchip_24AA64: EepAllowedWriteCycles=1000000, EepMinimumAddressType=16, EepTotalSize=8192, EepWriteTime=0.005, EepPageSize=EepPageSize32  # Microchip 24AA64
      Microchip_24AA128: EepAllowedWriteCycles=1000000, EepMinimumAddressType=16, EepTotalSize=16384, EepWriteTime=0.005, EepPageSize=EepPageSize64  # Microchip 24AA128
      Microchip_24AA256: EepAllowedWriteCycles=1000000, EepMinimumAddressType=16, EepTotalSize=32768, EepWriteTime=0.005, EepPageSize=EepPageSize64  # Microchip 24AA256
      Microchip_24AA512: EepAllowedWriteCycles=1000000, EepMinimumAddressType=16, EepTotalSize=65536, EepWriteTime=0.005, EepPageSize=EepPageSize128  # Microchip 24AA512
      Microchip_24C65: EepAllowedWriteCycles=1000000, EepMinimumAddressType=16, EepTotalSize=8192, EepWriteTime=0.005, EepPageSize=EepPageSize64
      Microchip_24FC02: EepAllowedWriteCycles=1000000, EepMinimumAddressType=8, EepTotalSize=256, EepWriteTime=0.005, EepPageSize=EepPageSize8  # Microchip 24FC02
      Microchip_24LC02B: EepAllowedWriteCycles=1000000, EepMinimumAddressType=8, EepTotalSize=256, EepWriteTime=0.005, EepPageSize=EepPageSize8  # Microchip 24LC02B
      Microchip_24LC08B: EepAllowedWriteCycles=1000000, EepMinimumAddressType=8, EepTotalSize=1024, EepWriteTime=0.005, EepPageSize=EepPageSize16  # Microchip 24LC08B
      Microchip_24LC64: EepAllowedWriteCycles=1000000, EepMinimumAddressType=16, EepTotalSize=8192, EepWriteTime=0.005, EepPageSize=EepPageSize32  # Microchip 24LC64
      Microchip_24LC128: EepAllowedWriteCycles=1000000, EepMinimumAddressType=16, EepTotalSize=16384, EepWriteTime=0.005, EepPageSize=EepPageSize64  # Microchip 24LC128
      Microchip_24LC256: EepAllowedWriteCycles=1000000, EepMinimumAddressType=16, EepTotalSize=32768, EepWriteTime=0.005, EepPageSize=EepPageSize64  # Microchip 24LC256
      Microchip_24LC512: EepAllowedWriteCycles=1000000, EepMinimumAddressType=16, EepTotalSize=65536, EepWriteTime=0.005, EepPageSize=EepPageSize128  # Microchip 24LC512
      ONSemiconductor_CAT24C32: EepAllowedWriteCycles=1000000, EepMinimumAddressType=16, EepTotalSize=4096, EepWriteTime=0.005, EepPageSize=EepPageSize32  # ON Semiconductor CAT24C32
      ONSemiconductor_CAT24C64: EepAllowedWriteCycles=1000000, EepMinimumAddressType=16, EepTotalSize=8192, EepWriteTime=0.005, EepPageSize=EepPageSize32  # ON Semiconductor CAT24C64
      ONSemiconductor_CAT24C256: EepAllowedWriteCycles=1000000, EepMinimumAddressType=16, EepTotalSize=32768, EepWriteTime=0.005, EepPageSize=EepPageSize64  # ON Semiconductor CAT24C256
      ONSemiconductor_CAV24C02: EepAllowedWriteCycles=1000000, EepMinimumAddressType=8, EepTotalSize=256, EepWriteTime=0.005, EepPageSize=EepPageSize16  # ON Semiconductor CAV24C02
      ONSemiconductor_CAV24C04: EepAllowedWriteCycles=1000000, EepMinimumAddressType=8, EepTotalSize=512, EepWriteTime=0.005, EepPageSize=EepPageSize16  # ON Semiconductor CAV24C04
      ONSemiconductor_CAV24C08: EepAllowedWriteCycles=1000000, EepMinimumAddressType=8, EepTotalSize=1024, EepWriteTime=0.005, EepPageSize=EepPageSize16  # ON Semiconductor CAV24C08
      ONSemiconductor_CAV24C16: EepAllowedWriteCycles=1000000, EepMinimumAddressType=16, EepTotalSize=2048, EepWriteTime=0.005, EepPageSize=EepPageSize16  # ON Semiconductor CAV24C16
      ONSemiconductor_CAV24C32: EepAllowedWriteCycles=1000000, EepMinimumAddressType=16, EepTotalSize=4096, EepWriteTime=0.005, EepPageSize=EepPageSize32  # ON Semiconductor CAV24C32
      ONSemiconductor_CAV24C64: EepAllowedWriteCycles=1000000, EepMinimumAddressType=16, EepTotalSize=8192, EepWriteTime=0.005, EepPageSize=EepPageSize32  # ON Semiconductor CAV24C64
      ONSemiconductor_CAV24C128: EepAllowedWriteCycles=1000000, EepMinimumAddressType=16, EepTotalSize=16384, EepWriteTime=0.005, EepPageSize=EepPageSize64  # ON Semiconductor CAV24C128
      ONSemiconductor_CAV24C256: EepAllowedWriteCycles=1000000, EepMinimumAddressType=16, EepTotalSize=32768, EepWriteTime=0.005, EepPageSize=EepPageSize64  # ON Semiconductor CAV24C256
      ONSemiconductor_CAV24M01: EepAllowedWriteCycles=1000000, EepMinimumAddressType=16, EepTotalSize=131072, EepWriteTime=0.005, EepPageSize=EepPageSize256  # ON Semiconductor CAV24M01
      ONSemiconductor_N24C32: EepAllowedWriteCycles=1000000, EepMinimumAddressType=16, EepTotalSize=4096, EepWriteTime=0.004, EepPageSize=EepPageSize32  # ON Semiconductor N24C32
      ONSemiconductor_N24C64: EepAllowedWriteCycles=1000000, EepMinimumAddressType=16, EepTotalSize=8192, EepWriteTime=0.004, EepPageSize=EepPageSize32  # ON Semiconductor N24C64
      ONSemiconductor_NV24C32: EepAllowedWriteCycles=1000000, EepMinimumAddressType=16, EepTotalSize=4096, EepWriteTime=0.005, EepPageSize=EepPageSize32  # ON Semiconductor NV24C32
      ONSemiconductor_NV24C64: EepAllowedWriteCycles=1000000, EepMinimumAddressType=16, EepTotalSize=8192, EepWriteTime=0.005, EepPageSize=EepPageSize32  # ON Semiconductor NV24C64
      ONSemiconductor_NV24C256: EepAllowedWriteCycles=1000000, EepMinimumAddressType=16, EepTotalSize=32768, EepWriteTime=0.005, EepPageSize=EepPageSize64  # ON Semiconductor NV24C256
      ONSemiconductor_NV24C512: EepAllowedWriteCycles=1000000, EepMinimumAddressType=16, EepTotalSize=64512, EepWriteTime=0.005, EepPageSize=EepPageSize128  # ON Semiconductor NV24C512
      Rohm_BR24G64: EepAllowedWriteCycles=1000000, EepMinimumAddressType=16, EepTotalSize=8192, EepWriteTime=0.005, EepPageSize=EepPageSize32  # Rohm BR24G64
      Rohm_BR24G128: EepAllowedWriteCycles=1000000, EepMinimumAddressType=16, EepTotalSize=16384, EepWriteTime=0.005, EepPageSize=EepPageSize64  # Rohm BR24G128
      Rohm_BR24L16: EepAllowedWriteCycles=1000000, EepMinimumAddressType=16, EepTotalSize=2048, EepWriteTime=0.005, EepPageSize=EepPageSize16  # Rohm BR24L16
      Rohm_BR24T08: EepAllowedWriteCycles=1000000, EepMinimumAddressType=16, EepTotalSize=1024, EepWriteTime=0.005, EepPageSize=EepPageSize8  # Rohm BR24T08
      Rohm_BR24T16: EepAllowedWriteCycles=1000000, EepMinimumAddressType=16, EepTotalSize=2048, EepWriteTime=0.005, EepPageSize=EepPageSize16  # Rohm BR24T16
      Rohm_BR24T32: EepAllowedWriteCycles=1000000, EepMinimumAddressType=16, EepTotalSize=4096, EepWriteTime=0.005, EepPageSize=EepPageSize32  # Rohm BR24T32
      Rohm_BR24T64: EepAllowedWriteCycles=1000000, EepMinimumAddressType=16, EepTotalSize=8192, EepWriteTime=0.005, EepPageSize=EepPageSize32  # Rohm BR24T64
      Ablic_S24C64C: EepAllowedWriteCycles=1000000, EepMinimumAddressType=16, EepTotalSize=8192, EepWriteTime=0.005, EepPageSize=EepPageSize32  # Ablic S24C64C
      Seiko_S24C128CH: EepAllowedWriteCycles=1000000, EepMinimumAddressType=16, EepTotalSize=16384, EepWriteTime=0.005, EepPageSize=EepPageSize64  # Seiko S24C128CH
      STMicroelectronics_M24C02: EepAllowedWriteCycles=4000000, EepMinimumAddressType=16, EepTotalSize=256, EepWriteTime=0.004, EepPageSize=EepPageSize16  # ST Microelectronics M24C02
      STMicroelectronics_M24C04: EepAllowedWriteCycles=4000000, EepMinimumAddressType=16, EepTotalSize=512, EepWriteTime=0.005, EepPageSize=EepPageSize16  # ST Microelectronics M24C04
      STMicroelectronics_M24C16: EepAllowedWriteCycles=4000000, EepMinimumAddressType=16, EepTotalSize=2048, EepWriteTime=0.005, EepPageSize=EepPageSize16  # ST Microelectronics M24C16
      STMicroelectronics_M24C32: EepAllowedWriteCycles=4000000, EepMinimumAddressType=16, EepTotalSize=4096, EepWriteTime=0.005, EepPageSize=EepPageSize32  # ST Microelectronics M24C32
      STMicroelectronics_M24C64: EepAllowedWriteCycles=4000000, EepMinimumAddressType=16, EepTotalSize=8192, EepWriteTime=0.005, EepPageSize=EepPageSize32  # ST Microelectronics M24C64
      STMicroelectronics_M24128: EepAllowedWriteCycles=4000000, EepMinimumAddressType=16, EepTotalSize=16384, EepWriteTime=0.004, EepPageSize=EepPageSize64  # ST Microelectronics M24128
      STMicroelectronics_M24256: EepAllowedWriteCycles=4000000, EepMinimumAddressType=16, EepTotalSize=32768, EepWriteTime=0.005, EepPageSize=EepPageSize64  # ST Microelectronics M24256
      STMicroelectronics_M24512: EepAllowedWriteCycles=4000000, EepMinimumAddressType=16, EepTotalSize=65536, EepWriteTime=0.005, EepPageSize=EepPageSize128  # ST Microelectronics M24512
      STMicroelectronics_M24M01: EepAllowedWriteCycles=4000000, EepMinimumAddressType=16, EepTotalSize=131072, EepWriteTime=0.005, EepPageSize=EepPageSize256  # ST Microelectronics M24M01
      STMicroelectronics_M24M02: EepAllowedWriteCycles=4000000, EepMinimumAddressType=16, EepTotalSize=262144, EepWriteTime=0.005, EepPageSize=EepPageSize256  # ST Microelectronics M24M02
      STMicroelectronics_ST24C16: EepAllowedWriteCycles=4000000, EepMinimumAddressType=16, EepTotalSize=2048, EepWriteTime=0.005, EepPageSize=EepPageSize32  # ST Microelectronics ST24C16
      Atmel_AT24C01: EepAllowedWriteCycles=1000000, EepMinimumAddressType=8, EepTotalSize=128, EepWriteTime=0.005, EepPageSize=EepPageSize8  # Atmel AT24C01
      Atmel_AT24C02: EepAllowedWriteCycles=1000000, EepMinimumAddressType=8, EepTotalSize=256, EepWriteTime=0.005, EepPageSize=EepPageSize8  # Atmel AT24C02
      Atmel_AT24C08: EepAllowedWriteCycles=1000000, EepMinimumAddressType=16, EepTotalSize=1024, EepWriteTime=0.005, EepPageSize=EepPageSize16  # Atmel AT24C08
      Atmel_AT24C32: EepAllowedWriteCycles=1000000, EepMinimumAddressType=16, EepTotalSize=4096, EepWriteTime=0.01, EepPageSize=EepPageSize32  # Atmel AT24C32
      Atmel_AT24C64: EepAllowedWriteCycles=1000000, EepMinimumAddressType=16, EepTotalSize=8192, EepWriteTime=0.01, EepPageSize=EepPageSize32  # Atmel AT24C64
      Atmel_AT24C256C: EepAllowedWriteCycles=1000000, EepMinimumAddressType=16, EepTotalSize=32768, EepWriteTime=0.005, EepPageSize=EepPageSize64  # Atmel AT24C256C
  module config Eep_30_XXi2c01_Rec: definition=Eep, implementation-config-variant=VARIANT-PRE-COMPILE
