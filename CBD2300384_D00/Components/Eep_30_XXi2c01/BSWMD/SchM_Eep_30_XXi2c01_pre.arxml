AUTOSAR XML (schema 3.1.4)
# COPYRIGHT
# Copyright (c) by Vector Informatik GmbH. All rights reserved.
# This software is copyright protected and proprietary to Vector Informatik GmbH.
# Vector Informatik GmbH grants to you only those rights as set out in the license conditions.
package /MICROSAR
  module config SchM_Rec: definition=SchM, implementation-config-variant=VARIANT-PRE-COMPILE  # Configuration of the SchM (BSW Scheduler) module.
    Eep_30_XXi2c01 (SchMModuleConfiguration): SchMModuleLiteral=Eep_30_XXi2c01, SchMModuleInclude=Eep_30_XXi2c01.h, SchMModuleConfigVersion=1.0.1, SchMModuleImplementationRef=SchM_Impl
      SCHM_EEP_30_XXI2C01_INSTANCE_0 (InstanceConfiguration): SchMInstanceLiteral=SCHM_EEP_30_EEP_30_XXI2C01_INSTANCE_0
        EEP_30_XXI2C01_EXCLUSIVE_AREA_0 (ExclusiveAreaConf): SchMExclusiveAreaLiteral=EEP_30_EEP_30_XXI2C01_EXCLUSIVE_AREA_0, SchMExclusiveAreaDescription=protection against interrupts
    Eep_30_XXi2c01_MainFunction (SchMMainFunctionMapping): SchMMainFunctionSymbol=Eep_30_XXi2c01_MainFunction, SchMModuleRef=Eep_30_XXi2c01
      SchMBswEvent
        SchMBswTimingEvent: SchMMainFunctionPeriod=0.005
