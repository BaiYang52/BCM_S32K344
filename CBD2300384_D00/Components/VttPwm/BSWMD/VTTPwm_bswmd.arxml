AUTOSAR XML (schema 4-0-3)
package /MICROSAR/VTT
  bsw implementation VTTPwm_Impl: programming-language=C, sw-version=2.07.00, used-code-generator=cMSR, vendor-id=30, ar-release-version=4.00.03, preconfigured-configuration=VTTPwm_Pre, recommended-configuration=VTTPwm_Rec, vendor-specific-module-def=VTTPwm
  module definition VTTPwm [0..*]: category=VENDOR_SPECIFIC_MODULE_DEFINITION, variants pre-compile  # Pulse Width Modulation. PWM driver provides functions for initialization and control of the microcontroller internal PWM stage (pulse width modulation). The module generates pulses with variable pulse width. It allows the selection of the duty cycle and the signal period time. #VTT #Driver #AUTOSAR
    container PwmChannelConfigSet [0..1]: multiple-configuration-container=true  # This container includes the configuration of the Pwm channels.
      container PwmChannel [0..255]  # This container includes the configuration of an individual PWM channel.
        enumeration PwmChannelClass: set at pre-compile, default-value=PWM_FIXED_PERIOD  # This parameter defines the class of PWM Channel. PWM_FIXED_PERIOD: Only the duty cycle can be changed. PWM_VARIABLE_PERIOD: Duty Cycle and period can be changed. Not supported: (PWM_FIXED_PERIOD_SHIFTED: Only the duty cycle can be changed. The period is shifted (only if supported by hardware)) | ImplementationType: Pwm_ChannelClassType
          PWM_FIXED_PERIOD  # Fixed Period
          PWM_VARIABLE_PERIOD  # Variable Period
        integer PwmChannelId [0..1]: 0..4294967295, set at pre-compile, symbolic-name-value=true  # Parameter not used. This parameter defines the channel Id of the PWM channel. This value will be assigned to the symbolic name derived of the PwmChannel container short name.
        integer PwmDutycycleDefault: 0..32768, set at pre-compile, default-value=0  # This parameter defines the value of duty cycle used for initialization. Note: 0x0 represents 0% 0x8000 represents 100% | 0, represents 0% 0x8000 represents 100%
        enumeration PwmIdleState: set at pre-compile, default-value=PWM_LOW  # This parameter defines the output state of the PWM after the signal is stopped (e.g. call of Pwm_SetOutputToIdle). PWM_HIGH: The PWM channel output will be set to high (3V or 5V) in idle state. PWM_LOW: The PWM channel output will be set to low (0V) in idle state.
          PWM_HIGH  # High
          PWM_LOW  # Low
        function name PwmNotification [0..1]: set at pre-compile  # This parameter defines the the callback function. If no notification should be called, please use one of the following capabilities: - Delete the parameter PwmNotification - Leave the parameter empty - Configure the parameter with "NULL_PTR" If the parameter has an invalid expression, the behaviour is undefined. In case of an invalid synchronization from the real target, the parameter has to be set user defined and one of the capabilities above should be followed.
        float PwmPeriodDefault: 0.0001..10, set at pre-compile, default-value=0.01  # This parameter defines the value of period used for initialization (in seconds).
        enumeration PwmPolarity: set at pre-compile, default-value=PWM_LOW  # This parameter defines the starting polarity of each PWM channel. PWM_HIGH: The PWM channel output is high at the beginning of the cycle and then goes low when the duty count is reached. PWM_LOW: The PWM channel output is low at the beginning of the cycle and then goes high when the duty count is reached.
          PWM_HIGH  # High
          PWM_LOW  # Low
    container PwmConfigurationOfOptApiServices  # This container includes the configuration parameters for API services.
      boolean PwmDeInitApi: set at pre-compile, default-value=true  # This parameter defines whether the function Pwm_DeInit() is enabled or disabled. True: API Pwm_DeInit() is supported (function provided) False: API Pwm_DeInit() is not supported (function not provided)
      boolean PwmGetOutputState: set at pre-compile, default-value=true  # This parameter defines whether the function Pwm_GetOutputState() is enabled or disabled. True: API Pwm_GetOutputState() is supported (function provided) False: API Pwm_GetOutputState() is not supported (function not provided)
      boolean PwmSetDutyCycle: set at pre-compile, default-value=true  # This parameter defines whether the function Pwm_SetDutyCycle() is enabled or disabled. True: API Pwm_SetDutyCycle() is supported (function provided) False: API Pwm_SetDutyCycle() is not supported (function not provided)
      boolean PwmSetOutputToIdle: set at pre-compile, default-value=true  # This parameter defines whether the function Pwm_SetOutputToIdle() is enabled or disabled. True: API Pwm_SetOutputToIdle() is supported (function provided) False: API Pwm_SetOutputToIdle() is not supported (function not provided)
      boolean PwmSetPeriodAndDuty: set at pre-compile, default-value=true  # This parameter defines whether the function Pwm_SetPeriodAndDuty() is enabled or disabled. True: API Pwm_SetPeriodAndDuty() is supported (function provided) False: API Pwm_SetPeriodAndDuty() is not supported (function not provided)
      boolean PwmVersionInfoApi: set at pre-compile, default-value=false  # This parameter defines whether the function Pwm_GetVersionInfo() is enabled or disabled. True: API Pwm_GetVersionInfo() is supported (function provided) False: API Pwm_GetVersionInfo() is not supported (function not provided)
    container PwmGeneral  # General configuration parameteres of the PWM module.
      boolean PwmDevErorDetect: set at pre-compile, default-value=true  # This parameter switches the Development Error Detection and Notification ON or OFF. True: Development error detection is enabled. False: Development error detection is disabeld. Note: In general, the development error detection is recommended during pre-test phase. It is not recommended to enable the development error detection in production code due to increased runtime and ROM needs.
      boolean PwmDutycycleUpdatedEndperiod: set at pre-compile, default-value=true  # This parameter defines whether the duty cycle parameter should be updated at the end of the currend period or immediately. True: update of duty cycle is done at the end of period of currently generated waveform (current waveform is finished) False: update of duty cycle is done immediately (just after service call, current waveform is cut) | TRUE: update of duty cycle is done at the end of period of currently generated waveform (current waveform is finished). FALSE: update of duty cycle is done immediately (just after service call, current waveform is cut).
      integer PwmIndex [0..1]: 0..4294967295, set at pre-compile  # Parameter not used. This parameter defines the InstanceId of this module instance. If only one instance is present it shall have the Id 0.
      boolean PwmNotificationSupported: set at pre-compile, default-value=true  # This paramater defines whether notifications are supported.
      boolean PwmPeriodUpdatedEndperiod: set at pre-compile, default-value=true  # This parameter defines whether the period parameter should be updated at the end of the currend period or immediately. True: Update of duty cycle is done at the end of period of currently generated waveform (current waveform is finished) False: Update of duty cycle is done immediately (just after service call, current waveform is cut) | TRUE: update of period/duty cycle is done at the end of period of currently generated waveform (current waveform is finished). FALSE: update of period/duty cycle is done immediately (just after service call, current waveform is cut).
      boolean PwmSafeBswChecks: set at pre-compile, origin=Vector Informatik, default-value=false  # Selects if safety checks are used. These checks improve robustness as e.g. invalid parameters are checked before function is executed. This attribute has to be enabled for safety projects where this component is mapped to an ASIL partition.
      string PwmPrefix [0..1]: set at pre-compile, origin=Vector Informatik, max-length=255, min-length=0  # Pwm Prefix | This parameter can be used to overwrite the "ModuleName", “Vendor-ID” and “API-Infix” attributes of the real component, if necessary. Example: In general the implementation specific API name is specified as: <ModuleName>_<vendorId>_<vendorApiInfix>_<API name of module> This parameter overwrites the whole parenthesis <ModuleName>_<vendorId>_<vendorApiInfix>.
  module config VTTPwm_Pre: definition=VTTPwm
  module config VTTPwm_Rec: definition=VTTPwm
