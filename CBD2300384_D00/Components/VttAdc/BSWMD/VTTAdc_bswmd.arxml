AUTOSAR XML (schema 4-0-3)
package /MICROSAR/VTT
  bsw implementation VTTAdc_Impl: programming-language=C, sw-version=2.06.00, used-code-generator=cMSR, vendor-id=30, ar-release-version=4.00.03, preconfigured-configuration=VTTAdc_Pre, recommended-configuration=VTTAdc_Rec, vendor-specific-module-def=VTTAdc
  module definition VTTAdc [0..1]: category=VENDOR_SPECIFIC_MODULE_DEFINITION, variants pre-compile  # Analogue Digital Converter. Adc initializes and control the internal ADC unit(s) of the microcontroller. It provides services to start and stop a conversion respectively to enable and disable the trigger source for a conversion. #VTT #Driver #AUTOSAR
    container AdcConfigSet [0..1]: multiple-configuration-container=true  # This container includes the post-build selectable configuration parameters.
      container AdcHwUnit [0..50]  # This container includes the driver configuration (parameters) depending on grouping of channels. | This container could contain HW specific parameters which are not defined in the Standardized Module Definition. They must be added in the Vendor Specific Module Definition.
        enumeration AdcClockSource [0..*]: set at pre-compile  # Parameter not used. This parameter defines an ADC module specific clock input for the conversion unit. | statically be configured to select different clock sources if provided by hardware. Enumeration literals are defined vendor specific.
        enumeration AdcHwUnitId: set at pre-compile, default-value=Hw0  # This parameter defines the numeric ID of the HW Unit. This symbolic name allows accessing HwUnit data.
          Hw{0..49}  # Hardware Unit {0..49}
        integer AdcPrescale: 1..255, set at pre-compile, default-value=10  # This parameter defines an optional ADC module specific clock prescale factor, if supported by hardware. | ImplementationType: Adc_PrescaleType
        container AdcChannel [0..255]  # This container includes the channel configuration (parameters) depending on the hardware capability. | The organization of this data structure could contain dependencies to the microcontroller so this is left up to the implementer and its location is left up to the configuration. Note: Since a AdcChannel can be part of several AdcGroups, this container is not realized as a subcontainer of AdcGroup but instead as a subcontainer of AdcHwUnit.
          integer AdcChannelConvTime: 0..18446744073709551615, set at pre-compile, default-value=1000  # This parameter defines the conversion time, i.e. the time during which the analogue value is converted into digital representation, (in clock cycles) for each channel, if supported by hardware. | ImplementationType: Adc_ConversionTimeType
          integer AdcChannelHighLimit [0..1]: 0..18446744073709551615, set at pre-compile, default-value=5  # Parameter not used. This parameter defines the high limit (used for limit checking).
          integer AdcChannelId [0..1]: 0..1024, set at pre-compile, default-value=0  # This parameter defines the assignment of the channel to the physical ADC hardware channel. | ImplementationType: Adc_ChannelType
          boolean AdcChannelLimitCheck [0..1]: set at pre-compile, default-value=false  # Parameter not used. This parameter defines whether limit checking for an ADC channel is enabled or disabled. True: Limit checking is enabled. False: Limit checking is disabled.
          integer AdcChannelLowLimit [0..1]: 0..18446744073709551615, set at pre-compile, default-value=0  # Parameter not used. This parameter defines the low limit (used for limit checking).
          enumeration AdcChannelRangeSelect [0..1]: {ADC_RANGE_ALWAYS, ADC_RANGE_BETWEEN, ADC_RANGE_NOT_BETWEEN, ADC_RANGE_NOT_OVER_HIGH, ADC_RANGE_NOT_UNDER_LOW, ADC_RANGE_OVER_HIGH, ADC_RANGE_UNDER_LOW}, set at pre-compile, default-value=ADC_RANGE_BETWEEN  # Parameter not used. This parameter defines which conversion values are taken into account related to the boarders defined with AdcChannelLowLimit and AdcChannelHighLimit (Only in case of active limit checking). ADC_RANGE_ALWAYS: Complete range - independent from channel limit settings. ADC_RANGE_BETWEEN: Range between low limit and high limit - high limit value included. ADC_RANGE_NOT_BETWEEN: Range above high limit or below low limit value - low limit value included ADC_RANGE_NOT_OVER_HIGH: Range below high limit - high limit value included. ADC_RANGE_NOT_UNDER_LOW: Range above low limit. ADC_RANGE_NOT_OVER_HIGH: Range above high limit. ADC_RANGE_UNDER_LOW: Range below limit - low limit value included. | Implementation Type: Adc_ChannelRangeSelectType
          enumeration AdcChannelRefVoltsrcHigh: set at pre-compile, default-value=ADC_5V  # This parameter defines the upper reference voltage source for each channel. | Enumeration literals are defined vendor specific.
            ADC_3V3  # 3.3V
            ADC_5V  # 5V
          enumeration AdcChannelRefVoltsrcLow: set at pre-compile, default-value=ADC_0V  # This parameter defines the lower reference voltage source for each channel. | Enumeration literals are defined vendor specific.
            ADC_0V  # 0V
          integer AdcChannelResolution: 1..63, set at pre-compile, default-value=10  # This parameter defines the channel resolution in bits. | ImplementationType: Adc_ResolutionType
          integer AdcChannelSampTime: 1..65535, set at pre-compile, default-value=1000  # This parameter defines the sampling time, i.e. the time during which the value is sampled, (in clock cycles) for each channel, if supported by hardware. | ImplementationType: Adc_SamplingTimeType
        container AdcGroup [0..255]  # This container includes the AdcGroup configuration (parameters).
          enumeration AdcGroupAccessMode: set at pre-compile, default-value=ADC_ACCESS_MODE_SINGLE  # This parameter defines the type of access mode to group conversion results. ADC_ACCESS_MODE_SINGLE: Single values access mode. ADC_ACCESS_MODE_STREAMING: Streaming access mode. | ImplementationType: Adc_GroupAccessModeType
            ADC_ACCESS_MODE_SINGLE  # Single values access mode
            ADC_ACCESS_MODE_STREAMING  # Streaming access mode
          enumeration AdcGroupConversionMode: set at pre-compile, default-value=ADC_CONV_MODE_ONESHOT  # This parameter defines the type of conversion mode supported by the driver. ADC_CONV_MODE_CONTINIOUS: Conversions of an ADC channel group are performed continuously after a software API call (start). The conversions itself are running automaticall (no additional software or hardware trigger needed). ADC_CONV_MODE_ONESHOT: The conversion of an ADC channel group is performed once after a trigger. | ImplementationType: Adc_GroupConvModeType
            ADC_CONV_MODE_CONTINUOUS  # Continuous
            ADC_CONV_MODE_ONESHOT  # One Shot
          integer AdcGroupId [0..1]: 0..4294967295, set at pre-compile, symbolic-name-value=true  # Parameter not used. This parameter defines the numeric ID of the group. This parameter is the symbolic name to be used on the API. This symbolic name allows accessing Channel Group data. This value will be assigned to the symbolic name derived of the AdcGroup container shortName. | ImplementationType: Adc_GroupType
          integer AdcGroupPriority [0..1]: 0..255, set at pre-compile, default-value=0  # This parameter defines the priority level of the AdcGroup. | ImplementationType: Adc_GroupPriorityType
          enumeration AdcGroupReplacement [0..*]: {ADC_GROUP_REPL_ABORT_RESTART, ADC_GROUP_REPL_SUSPEND_RESUME}, set at pre-compile  # This parameter defines the replacement mechanism, which is used on ADC group level, if a group conversion is interrupted by a group which has a higher priority. ADC_GROUP_REPL_ABORT_RESTART: Abort/Restart mechanism is used on group level, if a group is interrupted by a higher priority group. The complete conversion round of the interrupted group (all group channels) is restarted after the higher priority group conversion is finished. If the group is configured in streaming access mode, only the results of the interrupted conversion round are discarded. Results of pervious conversion rounds which are already written to the result buffer are not affected. ADC_GROUP_REPL_SUSPEND_RESUME: Suspend/Resume mechanism is used on group level, if a group is interrupted by a converions round (conversion of all group channels) of the inttupted group is competed after the higher priority group conversion is finished. If the group is configured in streaming access mode, only the results of the interrupted conversion round are discarded. Results of previous conversion rounds which are already written to the result buffer are not affected. | ImplementationType: Adc_GroupReplacementType
          enumeration AdcGroupTriggSrc: set at pre-compile, default-value=ADC_TRIGG_SRC_SW  # This parameter defines the type of source event that starts a group conversion. ADC_TRIG_SRV_HW: Group is triggered by a hardware event. ADC_TRIGG_SRV_SW: Group is triggered by a software API call. | ImplementationType: Adc_TriggerSourceType
            ADC_TRIGG_SRC_HW  # Hardware Event
            ADC_TRIGG_SRC_SW  # Software API Call
          enumeration AdcHwTrigSignal [0..1]: set at pre-compile, default-value=ADC_HW_TRIG_FALLING_EDGE  # This parameter defines on which edge of the hardware trigger signal the driver should react, i.e. start the conversion (only if supported by the ADC hardware). ADC_HW_TRIG_BOTH_EDGES: React on both edges of the hardware trigger signal (only if supported by the ADC hardware). ADC_HW_TRIG_FALLING_EDGE: React on falling edge of the hardware trigger signal (only if supported by the ADC hardware). ADC_HW_TRIG_RISING_EDGE: React on the rising edge of the hardware trigger signal (only if supported by the ADC hardware). | ImplementationType: Adc_HwTriggerSignalType
            ADC_HW_TRIG_BOTH_EDGES  # Both Edges
            ADC_HW_TRIG_FALLING_EDGE  # Falling Edge
            ADC_HW_TRIG_RISING_EDGE  # Rising Edge
          integer AdcHwTrigTimer [0..*]: 0..18446744073709551615, set at pre-compile  # Parameter not used. This parameter defines the reload value of the ADC module embedded timer (only if supported by ADC hardware). | ImplementationType: Adc_HwTriggerTimerType
          function name AdcNotification [0..1]: set at pre-compile  # This parameter defines the name of a callback function for each group. If no notification should be called for this group, please use one of the following capabilities: - Delete the parameter AdcNotification - Leave the parameter empty - Configure the parameter with "NULL_PTR" If the parameter has an invalid expression, the behaviour is undefined. In case of an invalid synchronization from the real target, the parameter has to be set user defined and one of the capabilities above should be followed.
          enumeration AdcStreamingBufferMode: set at pre-compile, default-value=ADC_STREAM_BUFFER_LINEAR  # This parameter defines the streaming buffer mode. ADC_STREAM_BUFFER_CIRULAR: The ADC Driver continues the conversion even if the stream buffer is full (number of samples reached) by wrapping around the stream buffer itstelf. ADC_STREAM_BUFFER_LINEAR: The ADC Driver stops the conversion as soon as the stream buffer is full (number of samples reached). | ImplementationType: Adc_StreamBufferModeType
            ADC_STREAM_BUFFER_CIRCULAR  # Circular
            ADC_STREAM_BUFFER_LINEAR  # Linear
          integer AdcStreamingNumSamples: 1..1023, set at pre-compile, default-value=1  # This parameter defines the number of ADC values to be acquired per channel in streaming access mode. | Note: in single access mode this parameter assumes value 1, since only one sample per channel is processed. ImplementationType: Adc_StreamNumSampleType
          reference AdcGroupDefinition [1..255]: set at pre-compile, destination=AdcChannel  # Reference to AdcChannels of the AdcGroups. (Assignement) | ImplementationType: Adc_GroupDefType
    container AdcGeneral  # General configuration parameteres of the ADC module.
      boolean AdcDeInitApi: set at pre-compile, default-value=true  # This parameter defines whether the function Adc_DeInit() for deinitialization of ADC module and hardware is enabled or disabled. True: API Adc_DeInit() is supported (function provided) False: API Adc_DeInit() is not supported (function not provided) | true: Adc_DeInit() can be used. false: Adc_DeInit() can not be used.
      boolean AdcDevErrorDetect: set at pre-compile, default-value=true  # This parameter switches the Development Error Detection and Notification ON or OFF. True: Development error detection is enabled. False: Development error detection is disabeld. Note: In general, the development error detection is recommended during pre-test phase. It is not recommended to enable the development error detection in production code due to increased runtime and ROM needs. | true: Enabled. false: Disabled.
      boolean AdcEnableLimitCheck: set at pre-compile, default-value=false  # This parameter defines whether the limit checking feature in the ADC driver is enabled or disabled. True: Limit checking feature is enabled. False: Limit checking feature is disabled.
      boolean AdcEnableQueuing: set at pre-compile, default-value=false  # This parameter defines whether the queuing mechanism is active in case of priority mechanism diabled. True: Queuing mechanism is active in case of priority mechanism disabled False: Queuing mechanism is not active in case of priority mechanism disabled. | Note: If priority mechanism is enabled, queuing mechanism is always active and the parameter ADC_ENABLE_QUEUING is not evaluated. true: Enabled. false: Disabled.
      boolean AdcEnableStartStopGroupApi: set at pre-compile, default-value=true  # This parameter defines whether the functions Adc_StartGroupConversion() and Adc_StopGroupConversion() are enabled or disabled. True: APIs Adc_StartGroupConversion() and Adc_StopGroupConversion() are supported (functions provided) False: APIs Adc_StartGroupConversion() and Adc_StopGroupConversion() are not supported (functions not provided) | true: Adc_StartGroupConversion() and Adc_StopGroupConversion() can be used. false: Adc_StartGroupConversion() and Adc_StopGroupConversion() can not be used.
      boolean AdcGrpNotifCapability: set at pre-compile, default-value=true  # This parameter defines whether the the group notification mechanism (the functions to enable and disable the notifications) is available at runtime. True: Group notification mechanism is available at runtime False: Group notification mechanism is not available at runtime | true: Enabled. false: Disabled.
      boolean AdcHwTriggerApi: set at pre-compile, default-value=true  # This parameter defines whether the functions Adc_EnableHardwareTrigger() and Adc_DisableHardwareTrigger() are enabled or disabled. True: APIs Adc_EnableHardwareTrigger() and Adc_DisableHardwareTrigger() are supported (functions provided) False: APIs Adc_EnableHardwareTrigger() and Adc_DisableHardwareTrigger() are not supported (functions not provided) | true: Adc_EnableHardwareTrigger() and Adc_DisableHardwareTrigger() can be used. false: Adc_EnableHardwareTrigger() and Adc_DisableHardwareTrigger() can not be used.
      enumeration AdcPriorityImplementation: set at pre-compile, default-value=ADC_PRIORITY_HW  # This parameter defines whether a priority mechanism is available for prioritization of the conversion requests and if available, the type of prioritization mechanism. The selection applies for groups with trigger source software and trigger source hardware. ADC_PRIORITY_HW: Hardware priority mechanism is available only. ADC_PRIORITY_HW_SW: Hardware and software priority mechanism is available. ADC_PRIORITY_NONE: Priority mechanism is not available. | types of prioritization mechanism can be selected. The hardware prioritization mechanism (AdcPriorityHw) uses the ADC hardware features for prioritization of the software conversion requests and hardware trigger signals for groups with trigger source hardware. The mixed hardware and software prioritization mechanism (AdcPriorityHwSw) uses the ADC hardware features for prioritization of ADC hardware trigger for groups with trigger source hardware and a software implemented prioritization mechanism for groups with trigger source software. The group priorities for software triggered groups are typically configured with lower priority levels than the group priorities for hardware triggered groups. ImplementationType: Adc_PriorityImplementationType
        ADC_PRIORITY_HW  # HW priority
        ADC_PRIORITY_HW_SW  # HW and SW Priority
        ADC_PRIORITY_NONE  # No priority
      boolean AdcReadGroupApi: set at pre-compile, default-value=true  # This parameter defines whether the function Adc_ReadGroup() is enabled or disabled. True: API Adc_ReadGroup() is supported (function provided) False: API Adc_ReadGroup() is not supported (function not provided) | true: Adc_ReadGroup() can be used. false: Adc_ReadGroup() can not be used.
      enumeration AdcResultAlignment: set at pre-compile, default-value=ADC_ALIGN_RIGHT  # This parameter defines the alignment of ADC raw results in ADC result buffer. ADC_ALIGN_LEFT: Left alignment ADC_ALIGN_RIGH: Right alignment | Implementation Type: Adc_ResultAlignmentType
        ADC_ALIGN_LEFT  # Left
        ADC_ALIGN_RIGHT  # Right
      boolean AdcVersionInfoApi: set at pre-compile, default-value=false  # This parameter enables/disables the function Adc_GetVersionInfo() to get major, minor and patch version information. | true: Adc_GetVersionInfo() can be used. false: Adc_GetVersionInfor() can not be used.
      boolean AdcSafeBswChecks: set at pre-compile, origin=Vector Informatik, default-value=false  # Selects if safety checks are used. These checks improve robustness as e.g. invalid parameters are checked before function is executed. This attribute has to be enabled for safety projects where this component is mapped to an ASIL partition.
      string AdcPrefix [0..1]: set at pre-compile, origin=Vector Informatik, max-length=255, min-length=0  # Adc Prefix | This parameter can be used to overwrite the "ModuleName", “Vendor-ID” and “API-Infix” attributes of the real component, if necessary. Example: In general the implementation specific API name is specified as: <ModuleName>_<vendorId>_<vendorApiInfix>_<API name of module> This parameter overwrites the whole parenthesis <ModuleName>_<vendorId>_<vendorApiInfix>.
    container AdcPublishedInformation  # This container includes additional published parameters not covered by CommonPublishedInformation container. | Note that these parameters do not have any configuration class setting, since they are published information.
      boolean AdcChannelValueSigned: set at published-information, default-value=false  # Adc Channel Value Signed | This parameter defines whether the result value of the ADC driver has signed information (true) or not (false). If the result shall be interpreted as signed value it shall apply to C-language rules. True: result value of ADC driver has a signed information. False: result value of ADC driver has a unsigned information.
      boolean AdcGroupFirstChannelFixed: set at published-information, default-value=false  # First Channel Fixed | This parameter defines whether the first channel of an ADC Channel group can be configured or is fixed to a value determined by the ADC HW Unit. True: First channel of an ADC Channel group is fixed to a value determined by the ADC HW Unit. False: First channel of an ADC Channel group can be configured to a value determined by the ADC HW Unit.
      integer AdcMaxChannelResolution: 32..32, set at published-information, default-value=32  # This parameter defines the maximum channel resolution in bits (does not specify accuracy).
  module config VTTAdc_Pre: definition=VTTAdc, implementation-config-variant=VARIANT-PRE-COMPILE
  module config VTTAdc_Rec: definition=VTTAdc
