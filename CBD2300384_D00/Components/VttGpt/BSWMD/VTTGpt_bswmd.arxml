AUTOSAR XML (schema 4-0-3)
package /MICROSAR/VTT
  module definition VTTGpt [0..1]: category=VENDOR_SPECIFIC_MODULE_DEFINITION, variants pre-compile  # General Purpose Timer. The driver provides services for starting and stopping of hardware timers, gettin time values and controlling time triggered interrupt notifications and wakeup interrupts. #VTT #Driver #AUTOSAR
    container GptChannelConfigSet [0..1]  # This container includes the configuration set which contains the configured GPT channels. This way, different configuration sets can be defined for post-build process.
      container GptChannelConfiguration [0..50]  # This container includes the configuration of an individual GPT channel.
        integer GptChannelId [0..1]: 0..4294967295, set at pre-compile, symbolic-name-value=true, default-value=0  # Parameter not used. This parameter defines the channel Id of the GPT channel. This value will be assigned to the symbolic name derived of the GptChannelConfiguration container short name.
        enumeration GptChannelMode: set at pre-compile, default-value=GPT_CH_MODE_ONESHOT  # This parameter defines the behaviour of the timer channel after the target time is reached. GPT_MODE_CONTINOUS: Timerchannel is restarted automatically after reaching its end value. GPT_MODE_ONESHOT: Timerchannel stops after reaching its end value.
          GPT_CH_MODE_CONTINUOUS  # Continuous
          GPT_CH_MODE_ONESHOT  # One Shot
        float GptChannelTickFrequency: 0..4294967295, set at pre-compile, symbolic-name-value=true, default-value=1000000  # This parameter defines the tick frequency of the timer channel in Hz. Hint: CANoe always runs at 1MHz (1000000Hz).
        integer GptChannelTickValueMax: 0..4294967295, set at pre-compile, default-value=4294967295  # Parameter not used. This parameter defines the maximum value in ticks, the timer channel is able to count. With the next tick, the timer rolls over to zero.
        boolean GptEnableWakeup: set at pre-compile, default-value=false  # This parameter defines whether the wakeup capability of MCU for a channel is enabled. True: Wakeup capability of MCU for a channel is enabled. False: Wakeup capability of MCU for a channel is not enabled.
        function name GptNotification [0..1]: set at pre-compile  # This parameter defines a function pointer to callback function (for non-wakeup notification). If no notification should be called, please use one of the following capabilities: - Delete the parameter GptNotification - Leave the parameter empty - Configure the parameter with "NULL_PTR" If the parameter has an invalid expression, the behaviour is undefined. In case of an invalid synchronization from the real target, the parameter has to be set user defined and one of the capabilities above should be followed.
        reference GptChannelClkSrcRef [0..1]: set at pre-compile, destination=GptClockReferencePoint  # Parameter not used. Reference to the GptClockReferencePoint from which the channel | clock is derived.
        container GptWakeupConfiguration [0..1]  # This container includes configuration data for wakeup configuration.
          symbolic name reference GptWakeupSourceRef: set at pre-compile, destination=EcuMWakeupSource  # Reference to Ecu State Manager. In case the wakeup-capability is true this value is transmitted to the Ecu State Manager. | Implementation Type: reference to EcuM_WakeupSourceType
    container GptConfigurationOfOptApiServices  # This container includes all configuration switches for configuring optional API services of the GPT driver.
      boolean GptDeinitApi: set at pre-compile, default-value=true  # This parameter defines whether the function Gpt_DeInit() is enabled or disabled. True: API Gpt_DeInit() is supported (function provided) False: API Gpt_DeInit() is not supported (function not provided)
      boolean GptEnableDisableNotificationApi: set at pre-compile, default-value=true  # This parameter defines whether the functions Gpt_EnableNotification() and Gpt_DisableNotification() are enabled or disabled. True: APIs Gpt_EnableNotification() and Gpt_DisableNotification() are supported (functions provided) False: APIs Gpt_EnableNotification() and Gpt_DisableNotification() are not supported (functions not provided)
      boolean GptTimeElapsedApi: set at pre-compile, default-value=true  # This parameter defines whether the function Gpt_GetTimeElapsed() is enabled or disabled. True: API Gpt_GetTimeElapsed() is supported (function provided) False: API Gpt_GetTimeElapsed() is not supported (function not provided)
      boolean GptTimeRemainingApi: set at pre-compile, default-value=true  # This parameter defines whether the function Gpt_GetTimeRemaining() is enabled or disabled. True: API Gpt_GetTimeRemaining() is supported (function provided) False: API Gpt_GetTimeRemaining() is not supported (function not provided)
      boolean GptVersionInfoApi: set at pre-compile, default-value=false  # This parameter enables/disables the function Gpt_GetVersionInfo() to get major, minor and patch version information.
      boolean GptWakeupFunctionalityApi: set at pre-compile, default-value=true  # This parameter defines whether the functions Gpt_SetMode(), Gpt_EnableWakeup(), Gpt_DisableWakeup() and Gpt_CheckWakeup() is enabled or disabled. True: APIs Gpt_SetMode(), Gpt_EnableWakeup(), Gpt_DisableWakeup() and Gpt_CheckWakeup() are supported (functions provided). False: APIs Gpt_SetMode(), Gpt_EnableWakeup(), Gpt_DisableWakeup() and Gpt_CheckWakeup() are not supported (functions not provided)
    container GptDriverConfiguration  # General configuration parameteres of the GPT module.
      boolean GptDevErrorDetect: set at pre-compile, default-value=true  # This parameter switches the Development Error Detection and Notification ON or OFF. True: Development error detection is enabled. False: Development error detection is disabeld. Note: In general, the development error detection is recommended during pre-test phase. It is not recommended to enable the development error detection in production code due to increased runtime and ROM needs.
      boolean GptReportWakeupSource: set at pre-compile, default-value=false  # This parameter defines whether wakeup source reporting is enabled or disabled. True: Wakeup source reporting is enabled. False: Wakeup source reporting is disabled.
      boolean GptSafeBswChecks: set at pre-compile, origin=Vector Informatik, default-value=false  # Selects if safety checks are used. These checks improve robustness as e.g. invalid parameters are checked before function is executed. This attribute has to be enabled for safety projects where this component is mapped to an ASIL partition.
      string GptPrefix [0..1]: set at pre-compile, origin=Vector Informatik, max-length=255, min-length=0  # Gpt Prefix | This parameter can be used to overwrite the "ModuleName", “Vendor-ID” and “API-Infix” attributes of the real component, if necessary. Example: In general the implementation specific API name is specified as: <ModuleName>_<vendorId>_<vendorApiInfix>_<API name of module> This parameter overwrites the whole parenthesis <ModuleName>_<vendorId>_<vendorApiInfix>.
      container GptClockReferencePoint [1..*]  # This container includes a parameter, which represents a reference to a container of the type McuClockReferencePoint (defined in module MCU). | A container is needed to support multiple clock references (hardware dependent).
        reference GptClockReference [0..1]: set at pre-compile, destination=McuClockReferencePoint  # Parameter not used. Reference to a container of the type McuClockReferencePoint, to select an input clock. | The configuration editor for the GPT module can support the integrator by only allowing a selection of those clock reference points that can be connected physically to the GPT hardware peripheral. The desired frequency (desired by GPT) has to be the same as the selected and provided frequency of the MCU configuration. This has to be checked automatically.
  bsw implementation VTTGpt_Impl: programming-language=C, sw-version=2.07.00, used-code-generator=cMSR, vendor-id=30, ar-release-version=4.00.03, preconfigured-configuration=VTTGpt_Pre, recommended-configuration=VTTGpt_Rec, vendor-specific-module-def=VTTGpt
  module config VTTGpt_Pre: definition=VTTGpt, implementation-config-variant=VARIANT-PRE-COMPILE
  module config VTTGpt_Rec: definition=VTTGpt, implementation-config-variant=VARIANT-PRE-COMPILE
