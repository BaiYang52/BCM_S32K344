AUTOSAR XML (schema 4-0-3)
# COPYRIGHT
# Copyright (c) 2022 by Vector Informatik GmbH. All rights reserved.
# This software is copyright protected and proprietary to Vector Informatik GmbH.
# Vector Informatik GmbH grants to you only those rights as set out in the license conditions.
package /MICROSAR
  module definition Ea [0..1]: category=VENDOR_SPECIFIC_MODULE_DEFINITION, refined-module-def=Ea, variants pre-compile  # Eeprom Abstraction | EEPROM abstraction. Provides access to EEPROM for reading and storing data persistently. #NVRAM #NVMemory #DataStorage #EEPROM #AUTOSAR | The module shall abstract from the device specific addressing scheme and segmentation and provide the upper layers with a virtual addressing scheme and segmentation as well as a 'virtually' unlimited number of erase cycles.
    container EaBlockConfiguration [1..*]  # Block Configuration | This container includes the configuration of block specific parameters for the EEPROM abstraction module.
      integer EaBlockNumber: 1..65534, set at pre-compile, symbolic-name-value=true, default-value=1  # Block Number | This value specifies the block identifier (handle). | 0x0000 and 0xFFFF shall not be used for block numbers (see EA006). Range: min = 2^NVM_DATASET_SELECTION_BITS max = 0xFFFF -2^NVM_DATASET_SELECTION_BITS Note: Depending on the number of bits set aside for dataset selection several other block numbers shall also be left out to ease implementation.
      integer EaBlockSize: 1..65535, set at pre-compile, default-value=8  # Block Size | This value specifies the size of a logical block in bytes.
      boolean EaImmediateData: set at pre-compile, default-value=false  # Immediate Data | This parameter defines if this block has high priority data. | true: Block contains immediate data. false: Block does not contain immediate data.
      integer EaNumberOfWriteCycles: 0..4294967295, set at pre-compile  # Number Of Write Cycles | This value specifies the number of write cycles required for this block.
      integer EaNumberOfDatasets: 1..255, set at link, origin=Vector Informatik, default-value=1  # Number Of Datasets | This value specifies the number of datasets/clones. This specfies how often an individual block exists. Additional information related to the block configuration in the NvM : Native block in the NvM means 1 Dataset is configured. Redundant block in the NvM means 2 Datasets are configured. Dataset block in the NvM means N Datasets can be configured. Maximum value depends on parameter NvMDatasetSelectionBits.
      integer EaNumberOfInstances: 1..255, set at link, origin=Vector Informatik, default-value=1  # Number Of Instances | This value specifies the number of instances needed for one dataset/clone. The value depends on the number of write cycles the EEPROM supports and the number of write cycles of the specific dataset/clone.
      boolean EaVerifyWrittenData: set at link, origin=Vector Informatik, default-value=false  # Verify Written Data | This parameter defines if the written data shall be verified for consistency.
      integer EaBlockId: 0..65534, set at pre-compile, origin=Vector Informatik, default-value=65534  # Block Id | This value specifies the BlockID which indicates the base (aka: "tag") of a Block within its associated partition. The Block can be uniquely identified using partition. The ID must be unique within block's partition; blocks within different partitions may share the same value.
      symbolic name reference EaDeviceIndex [0..1]: set at pre-compile, destination=EepGeneral  # Device Index | Not used! Reference to EEP Driver. | Range: 0 .. 254 (0xFF reserved for broadcast call to GetStatus function).
      reference EaPartition: set at pre-compile, origin=Vector Informatik, destination=EaPartitionConfiguration  # Partition | Reference to the partition within the EA configuration.
    container EaGeneral  # General | General configuration parameters of the EA.
      boolean EaDevErrorDetect: set at pre-compile, default-value=true  # Development Error Detection | This parameter switches the Development Error Detection and Reporting ON or OFF. true: Development error detection and reporting is enabled. false: Development error detection and reporting is disabled. Note: In general, the development error detection is recommended during pre-test phase. It is not recommended to enable the development error detection in production code due to increased runtime and ROM needs. | true: Development error detection enabled. false: Development error detection disabled.
      integer EaIndex: 0..254, set at pre-compile, default-value=0  # Index | This value specifies the InstanceId of this module instance. If only one instance is present it shall have the Id 0.
      function name EaNvmJobEndNotification [0..1]: set at pre-compile, default-value=NvM_JobEndNotification  # NvMJobEnd Notification | This parameter defines the job end notification routine provided by the upper layer module (normally NvM_JobEndNotification).
      function name EaNvmJobErrorNotification [0..1]: set at pre-compile, default-value=NvM_JobErrorNotification  # NvMJobError Notification | This parameter defines the job error notification routine provided by the upper layer module (normally NvM_JobErrorNotification).
      boolean EaPollingMode: set at pre-compile, default-value=true  # Polling Mode | This parameter defines if the polling mode for this module is enabled. | true: Polling mode enabled, callback functions (provided to EEP module) disabled. false: Polling mode disabled, callback functions (provided to EEP module) enabled.
      boolean EaSetModeSupported: set at pre-compile, default-value=true  # Set Mode Api | This parameter defines if the function Ea_SetMode API is available.
      boolean EaVersionInfoApi: set at pre-compile, default-value=false  # Version Info Api | This parameter enables/disables the function Ea_GetVersionInfo() to get major, minor and patch version information. | true: Version info API enabled. false: Version info API disabled.
      integer EaVirtualPageSize: 1..65535, set at pre-compile, default-value=8  # Virtual Page Size | Not used! EA provides configuration of partitions with different address and write alignments due to the fact that multiple EEP modules can be referenced and their alignments may not match. EaBlocks are always assigned to a certain EaPartition. Therefore, EaBlocks are aligned to EaPartitionAddressAlignment of its EaPartitions.
      string EaNvMCallbackIncludeFile: set at pre-compile, origin=Vector Informatik, default-value=NvM_Cbk.h  # NvM Cbk Include File | This parameter defines the name of the include file for callback function declaration of the NvM.
      boolean EaCorrectSingleBitFlips: set at pre-compile, origin=Vector Informatik, default-value=true  # Correct Single Bit Flips | This parameter defines if the correction of single bit flips is enabled.
      float EaMainFunctionPeriod: 0.0001..1, set at pre-compile, origin=Vector Informatik, default-value=0.005  # Specify fixed call cycle for Ea_MainFunction. This information affects RTE's (SchM's) settings. It is not necessary to trigger Ea faster than its lower layer (EEP). The faster you want Ea_MainFunction being triggered, the smaller this value should be and vice versa.
      enumeration EaMainFunctionTriggering: set at published-information, origin=Vector Informatik, default-value=FixedCycleTime  # The MainFunction can be scheduled in different ways, which allows adapting the runtime behavior - FixedCycleTime: All activities are executed in the MainFunction with the defined cycle time. - BackgroundTask: Activities that do not require a fixed cycle time run in the background task. The response time of such activities will depend on the current CPU load. Note If the system is overloaded, it may happen that the background task is no longer called.
        FixedCycleTime  # Task for Fixed Cycle Time
        BackgroundTask  # Background Task
      boolean EaSafeBswChecks: set at pre-compile, origin=Vector Informatik, default-value=false  # Safe Bsw Checks | Selects if safety checks are used. These checks improve robustness as e.g. invalid parameters are checked before function is executed. This attribute has to be enabled for safety projects where this component is mapped to an ASIL partition.
      container EaEepApi [0..*]  # Eep Api | This container is used to announce the API service names and the include file of an Eep instance manually. API service names and include file can be typed manually and assigned to the corresponding Eep instance via "Eeprom Device" reference.
        string EaEepIncludeFile: set at pre-compile, origin=Vector Informatik, default-value=Eep.h  # Eep Include File | This parameter defines the name of the header file of the EEPROM Driver.
        function name EaEepSetMode: set at pre-compile, origin=Vector Informatik, default-value=Eep_SetMode  # Eep SetMode API | This parameter defines the name of the EEPROM SetMode API.
        function name EaEepRead: set at pre-compile, origin=Vector Informatik, default-value=Eep_Read  # Eep Read API | This parameter defines the name of the EEPROM Read API
        function name EaEepWrite: set at pre-compile, origin=Vector Informatik, default-value=Eep_Write  # Eep Write API | This parameter defines the name of the EEPROM Write API.
        function name EaEepCancel: set at pre-compile, origin=Vector Informatik, default-value=Eep_Cancel  # Eep Cancel API | This parameter defines the name of the EEPROM Cancel API.
        function name EaEepGetStatus: set at pre-compile, origin=Vector Informatik, default-value=Eep_GetStatus  # Eep GetStatus API | This parameter defines the name of the EEPROM GetStatus API.
        function name EaEepGetJobResult: set at pre-compile, origin=Vector Informatik, default-value=Eep_GetJobResult  # Eep GetJobResult API | This parameter defines the name of the EEPROM GetJobResult API.
        function name EaEepErase: set at pre-compile, origin=Vector Informatik, default-value=Eep_Erase  # Eep Erase API | This parameter defines the name of the EEPROM Erase API.
        function name EaEepCompare: set at pre-compile, origin=Vector Informatik, default-value=Eep_Compare  # Eep Compare API | This parameter defines the name of the EEPROM Compare API.
        symbolic name reference EaDeviceIndex: set at pre-compile, origin=Vector Informatik, destination=EepGeneral  # Eeprom Device | Reference to an EEP driver.
    container EaPublishedInformation  # Published Information | This container includes additional published parameters. | Note that these parameters do not have any configuration class setting, since they are published information.
      integer EaBlockOverhead: 0..65535, set at published-information, default-value=2  # Block Overhead | Not used! This value specifies the management overhead per logical block. | Note: If the management overhead depends on the block size or block location a formula has to be provided that allows the configurator to calculate the management overhead correctly.
      float EaMaximumBlockingTime: 0..Inf, set at published-information, default-value=0  # Maximum Blocking Time | Not used! This value specifies the maximum time the EA module's API routines shall be blocked (delayed) by internal operations. | Note: Internal operations in that case means operations that are not explicitly invoked from the upper layer module but need to be handled for proper operation of this module or the underlying memory driver.
      integer EaPageOverhead: 0..65535, set at published-information, default-value=0  # Page Overhead | Not used! This value specifies the management overhead per page. | Note: If the management overhead depends on the block size or block location a formula has to be provided that allows the configurator to calculate the management overhead correctly.
    container EaPartitionConfiguration [1..256]  # Partition Configuration | This container includes the configuration of partition specific parameters for the EEPROM abstraction module.
      integer EaPartitionStartAddress: 0..4294967295, set at pre-compile, origin=Vector Informatik, default-value=0  # Partition Start Address | This value specifies the physical start address of the partition.
      integer EaPartitionSize: 0..4294967295, set at pre-compile, origin=Vector Informatik, default-value=256  # Partition Size | This value specifies size of the partition in bytes.
      integer EaPartitionAddressAlignment: 1..65535, set at pre-compile, origin=Vector Informatik, default-value=1  # Address Alignment | Address Alignment influences the way EA stores data entities in EEPROM. All single entities will start at addresses being an integral multiple of EaPartitionAddressAlignment. This alignment itself must be equal to or greater than this partition's write alignment.
      integer EaPartitionWriteAlignment: 1..65535, set at pre-compile, origin=Vector Informatik, default-value=1  # Write Alignment | Page size of EEPROM device for write jobs in bytes. This is the alignment of Eep_Write requests the EA issues to the EEPROM: Both EEP addresses and lengths are always multiples of this value. This value shall be at least equal to EEPROM's write unit size.
      reference EaPartitionDevice: set at pre-compile, origin=Vector Informatik, destination=EepInitConfiguration  # Partition Device | Reference to the EEP module.
  bsw implementation Ea_Impl: programming-language=C, sw-version=4.00.00, used-code-generator=DaVinci Configurator, vendor-id=30, ar-release-version=4.00.03, behavior=EaBehavior, preconfigured-configuration=Ea_Pre, recommended-configuration=Ea_Rec, vendor-specific-module-def=Ea
  module config Ea_Pre: definition=Ea
    EaGeneral: EaSetModeSupported=1
  module config Ea_Rec: definition=Ea
