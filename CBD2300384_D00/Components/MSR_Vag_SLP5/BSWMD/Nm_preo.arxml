AUTOSAR XML (schema 4-0-3)
# COPYRIGHT
# Copyright (c) 2015 by Vector Informatik GmbH. All rights reserved.
# This software is copyright protected and proprietary to Vector Informatik GmbH.
# Vector Informatik GmbH grants to you only those rights as set out in the license conditions.
package /MICROSAR
  module config Nm_Pre: definition=Nm
    NmGlobalConfig
      NmGlobalFeatures: NmBusSynchronizationEnabled=0, NmCoordinatorSyncSupport=0, NmNodeDetectionEnabled=0, NmStateChangeIndEnabled=1
      NmGlobalProperties: NmVersionInfoApi=1
  module config Nm_Rec: definition=Nm, implementation-config-variant=VARIANT-PRE-COMPILE
    NmGlobalConfig
      NmGlobalFeatures:
        NmCarWakeUpRxEnabled = 0
        NmComControlEnabled = 1
        NmCoordinatorSupportEnabled = 0
        NmMacroLayerEnabled = 0
        NmNodeIdEnabled = 1
        NmPassiveModeEnabled = 0
        NmPduRxIndicationEnabled = 0
        NmRemoteSleepIndEnabled = 0
        NmUserDataEnabled = 0
  module config Nm_Rec_Class1: definition=Nm
    NmChannelConfig: NmStateReportEnabled=1
