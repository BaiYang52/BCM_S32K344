AUTOSAR XML (schema 4-0-3)
# COPYRIGHT
# Copyright (c) 2016 by Vector Informatik GmbH. All rights reserved.
# This software is copyright protected and proprietary to Vector Informatik GmbH.
# Vector Informatik GmbH grants to you only those rights as set out in the license conditions.
package /MICROSAR
  module config FrSM_Pre: definition=FrSM
    FrSMGeneral: FrSMEcuPassiveMode=0, FrSMVersionInfoApi=1
    FrSMConfig
  module config FrSM_Rec: definition=FrSM
    FrSMGeneral
    FrSMConfig
  module config FrSM_Pre_Class1: definition=FrSM
    FrSMConfig
      FrSMCluster:
        FrSMDelayStartupWithoutWakeup = 0
        FrSMDurationT1 = 0
        FrSMDurationT2 = 0.34
        FrSMIsWakeupEcu = 1
        FrSMNumWakeupPatterns = 4
        FrSMStartupRepetitions = 65534
        FrSMStartupRepetitionsUnlimited = 1
        FrSMStartupRepetitionsWithWakeup = 65534
        FrSMStartupRepetitionsWithWakeupUnlimited = 1
  module config FrSM_Rec_Class1: definition=FrSM
    FrSMConfig
      FrSMCluster: FrSMDurationT3=15, FrSMDurationT4=0.25, FrSMMainFunctionCycleTime=0.005
