AUTOSAR XML (schema 4-0-3)
# COPYRIGHT
# Copyright (c) 2015 by Vector Informatik GmbH. All rights reserved.
# This software is copyright protected and proprietary to Vector Informatik GmbH.
# Vector Informatik GmbH grants to you only those rights as set out in the license conditions.
package /MICROSAR
  module config Fee_Rec: definition=Fee, implementation-config-variant=VARIANT-PRE-COMPILE
    FeeSpecificFeatures: FeeApplErrorCallbackFunction=Appl_FeeCriticalErrorCallback, FeeApplErrorCallbackIncludeFile=ApplMain.h
    FeeGeneral: FeePollingMode=1
  module config Fee_Rec_Class1: definition=Fee
    FeeBlockConfiguration: FeeBlockIdFixed=0, FeeBlockIsCritical=0, FeeImmediateData=0, FeeNumberOfChunkInstances=1
  module config Fee_Pre: definition=Fee
    FeeGeneral: FeeVersionInfoApi=1
