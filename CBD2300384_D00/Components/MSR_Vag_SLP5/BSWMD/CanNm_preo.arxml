AUTOSAR XML (schema 4-0-3)
# COPYRIGHT
# Copyright (c) 2015 by Vector Informatik GmbH. All rights reserved.
# This software is copyright protected and proprietary to Vector Informatik GmbH.
# Vector Informatik GmbH grants to you only those rights as set out in the license conditions.
package /MICROSAR
  module config CanNm_Rec: definition=CanNm, implementation-config-variant=VARIANT-PRE-COMPILE
    CanNmGlobalConfig:
      CanNmApiOptimization = 0
      CanNmComControlEnabled = 1
      CanNmImmediateRestartEnabled = 0
      CanNmNodeIdEnabled = 1
      CanNmPassiveModeEnabled = 0
      CanNmPduRxIndicationEnabled = 0
      CanNmPnResetTime = 0.5
      CanNmRemoteSleepIndEnabled = 0
      CanNmUserDataEnabled = 0
  module config CanNm_Pre: definition=CanNm
    CanNmGlobalConfig:
      CanNmBusLoadReductionEnabled = 0
      CanNmBusSynchronizationEnabled = 0
      CanNmCanIfRangeConfigDLCCheck = 0
      CanNmImmediateTxconfEnabled = 0
      CanNmNodeDetectionEnabled = 0
      CanNmRepeatMsgIndEnabled = 0
      CanNmStateChangeIndEnabled = 1
      CanNmVersionInfoApi = 1
  module config CanNm_Rec_Class1: definition=CanNm
    CanNmGlobalConfig
      CanNmChannelConfig:
        CanNmActiveWakeupBitEnabled = 1
        CanNmCarWakeUpBitPosition = 6
        CanNmCarWakeUpBytePosition = 2
        CanNmCarWakeUpFilterEnabled = 1
        CanNmCarWakeUpFilterNodeId = 16
        CanNmCarWakeUpRxEnabled = 0
        CanNmImmediateNmTransmissions = 10
        CanNmImmediateNmCycleTime = 0.01
        CanNmMsgCycleTime = 0.2
        CanNmRemoteSleepIndTime = 1
  module config CanNm_Pre_Class1: definition=CanNm
    CanNmGlobalConfig
      CanNmChannelConfig: CanNmBusLoadReductionActive=0, CanNmMsgReducedTime=0.001, CanNmRepeatMessageTime=4, CanNmTimeoutTime=1, CanNmWaitBusSleepTime=0.75
