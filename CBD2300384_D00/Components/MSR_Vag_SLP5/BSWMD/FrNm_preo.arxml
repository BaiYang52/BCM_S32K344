AUTOSAR XML (schema 4-0-3)
# COPYRIGHT
# Copyright (c) 2016 by Vector Informatik GmbH. All rights reserved.
# This software is copyright protected and proprietary to Vector Informatik GmbH.
# Vector Informatik GmbH grants to you only those rights as set out in the license conditions.
package /MICROSAR
  module config FrNm_Pre: definition=FrNm
    FrNmGlobalConfig
      FrNmGlobalFeatures:
        FrNmBusSynchronizationEnabled = 0
        FrNmControlBitVectorEnabled = 1
        FrNmHwVoteEnable = 0
        FrNmNodeDetectionEnabled = 0
        FrNmRepeatMessageBitEnabled = 0
        FrNmStateChangeIndicationEnabled = 1
      FrNmGlobalProperties: FrNmMainAcrossFrCycle=0, FrNmVersionInfoApi=1
    FrNmChannelConfig
  module config FrNm_Rec: definition=FrNm
    FrNmGlobalConfig
      FrNmGlobalFeatures:
        FrNmPassiveModeEnabled = 0
        FrNmPduRxIndicationEnabled = 0
        FrNmPnResetTime = 0.5
        FrNmRemoteSleepIndicationEnabled = 0
        FrNmSourceNodeIdentifierEnabled = 1
        FrNmUserDataEnabled = 0
      FrNmGlobalProperties
      FrNmVendorSpecific: FrNmApiOptimization=1, FrNmImmediateTransmissionOnly=0
  module config FrNm_Pre_Class1: definition=FrNm
    FrNmChannelConfig
      FrNmChannel
        FrNmChannelIdentifiers: FrNmPduScheduleVariant=FRNM_PDU_SCHEDULE_VARIANT_2
  module config FrNm_Pre_Class2: definition=FrNm
    FrNmChannelConfig
      FrNmChannel
        FrNmChannelTiming:
          FrNmDataCycle = FRNM_CYCLE_VALUE_8
          FrNmReadySleepCnt = 12
          FrNmRepeatMessageTime = 4
          FrNmRepetitionCycle = FRNM_CYCLE_VALUE_16
          FrNmSyncPduTxRequestCycleOffset = 6
          FrNmVotingCycle = FRNM_CYCLE_VALUE_8
  module config FrNm_Rec_Class1: definition=FrNm
    FrNmChannelConfig
      FrNmChannel
        FrNmChannelIdentifiers: FrNmCarWakeUpBitPosition=6, FrNmCarWakeUpBytePosition=2, FrNmCarWakeUpFilterEnabled=1, FrNmCarWakeUpFilterNodeId=16, FrNmCarWakeUpRxEnabled=0
  module config FrNm_Rec_Class2: definition=FrNm
    FrNmChannelConfig
      FrNmChannel
        FrNmChannelTiming: FrNmRemoteSleepIndTime=0, FrNmMsgTimeoutTime=0.2
