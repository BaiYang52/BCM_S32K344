AUTOSAR XML (schema 4-0-3)
# COPYRIGHT
# Copyright (c) 2015 by Vector Informatik GmbH. All rights reserved.
# This software is copyright protected and proprietary to Vector Informatik GmbH.
# Vector Informatik GmbH grants to you only those rights as set out in the license conditions.
package /MICROSAR
  module config Dcm_Pre: definition=Dcm
    DcmConfigSet
      DcmGeneral: DcmVersionInfoApi=1
  module config Dcm_Rec: definition=Dcm, implementation-config-variant=VARIANT-PRE-COMPILE
    DcmConfigSet
      DcmGeneral: DcmAutosarVersion=AUTOSAR_4_02_02
