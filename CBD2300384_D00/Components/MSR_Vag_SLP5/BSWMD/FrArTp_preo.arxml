AUTOSAR XML (schema 4-0-3)
# COPYRIGHT
# Copyright (c) 2023 by Vector Informatik GmbH. All rights reserved.
# This software is copyright protected and proprietary to Vector Informatik GmbH.
# Vector Informatik GmbH grants to you only those rights as set out in the license conditions.
package /MICROSAR
  module config FrArTp_Pre: definition=FrArTp
    FrArTpGeneral: FrArTpDisableSyncSFReception=0, FrArTpHaveAckRt=0, FrArTpHaveGrpSeg=0, FrArTpVersionInfoApi=1
  module config FrArTp_Rec: definition=FrArTp
    FrArTpGeneral: FrArTpHaveLm=1, FrArTpHaveRc=1, FrArTpHaveTc=1, FrArTpMainFuncCycle=0.005, FrArTpPaddingByte=170
  module config FrArTp_Pre_Class1: definition=FrArTp
    FrArTpMultipleConfig
      FrArTpChannel: FrArTpAckType=FRARTP_NO, FrArTpGrpSeg=0, FrArTpMaxAr=0, FrArTpMaxAs=0, FrArTpMaxBs=0, FrArTpMaxFrIf=0, FrArTpMaxRn=0, FrArTpTimeFrIf=0
  module config FrArTp_Rec_Class1: definition=FrArTp
    FrArTpMultipleConfig
      FrArTpChannel
        FrArTpConnection: FrArTpMultRec=0
  module config FrArTp_Rec_Class2: definition=FrArTp
    FrArTpMultipleConfig
      FrArTpChannel:
        FrArTpAdrType = FRARTP_TB
        FrArTpConcurrentConns = 0
        FrArTpLm = FRARTP_ISO
        FrArTpStMin = 0
        FrArTpTc = 1
        FrArTpTimeBr = 0.8
        FrArTpTimeCs = 0.8
        FrArTpTimeoutAr = 1
        FrArTpTimeoutAs = 1
        FrArTpTimeoutBs = 1.15
        FrArTpTimeoutCr = 1.15
        FrArTpUsePduFc = 0
