AUTOSAR XML (schema 4-0-3)
# COPYRIGHT
# Copyright (c) 2015 by Vector Informatik GmbH. All rights reserved.
# This software is copyright protected and proprietary to Vector Informatik GmbH.
# Vector Informatik GmbH grants to you only those rights as set out in the license conditions.
package /MICROSAR
  module config NvM_Pre: definition=NvM
    NvMCommon: NvMVersionInfoApi=1
  module config NvM_Rec: definition=NvM, implementation-config-variant=VARIANT-PRE-COMPILE
  module config NvM_Rec_Class1: definition=NvM
    NvMBlockDescriptor: NvMUseJobendCallback=0, NvMBlockUseCrc=1
