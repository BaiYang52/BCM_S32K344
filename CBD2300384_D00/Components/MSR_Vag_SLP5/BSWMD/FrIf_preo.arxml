AUTOSAR XML (schema 4-0-3)
# COPYRIGHT
# Copyright (c) 2016 by Vector Informatik GmbH. All rights reserved.
# This software is copyright protected and proprietary to Vector Informatik GmbH.
# Vector Informatik GmbH grants to you only those rights as set out in the license conditions.
package /MICROSAR
  module config FrIf_Pre: definition=FrIf
    FrIfGeneral:
      FrIfDualChannelRedundancySupport = 0
      FrIfGetNmVectorSupport = 0
      FrIfGlobalUniformUpdateBytePos = 0
      FrIfNumClstSupported = 1
      FrIfNumCtrlSupported = 1
      FrIfUniformUpdateBytePos = 0
      FrIfUnusedBitValue = 0
      FrIfVersionInfoApi = 1
  module config FrIf_Rec: definition=FrIf
    FrIfGeneral:
      FrIfAbortCommunicationDisable = 0
      FrIfCancelTransmitSupport = 0
      FrIfDelayedTxConfirmationSupport = 0
      FrIfEnablePrepareLpdu = 0
      FrIfFreeOpCallbackSupport = 0
      FrIfGetSyncFrameListSupport = 0
      FrIfJobConcatenationEnable = 1
      FrIfJobsUseFreeOpCallback = 0
      FrIfPduDirtyByteUsage = 1
      FrIfReadCCConfigApi = 1
      FrIfReconfigLPduSupport = 0
      FrIfSetWakeupChannelDisable = 0
      FrIfSingleChannelAPI = 1
      FrIfWrapperAPIsAsMacro = 1
  module config FrIf_Pre_Class2: definition=FrIf
    FrIfConfig
      FrIfCluster
        FrIfJobList
          FrIfJob
            FrIfCommunicationOperation: FrIfManualAssignedLPdu=0
  module config FrIf_Rec_Class1: definition=FrIf
    FrIfConfig
      FrIfCluster
        FrIfController
          FrIfFrameTriggering: FrIfAllowDynamicLSduLength=0
  module config FrIf_Rec_Class2: definition=FrIf
    FrIfConfig
      FrIfCluster
        FrIfJobList
          FrIfJob: FrIfDelayedTxConfirmation=0
