AUTOSAR XML (schema 4-0-3)
# COPYRIGHT
# Copyright (c) 2017 by Vector Informatik GmbH. All rights reserved.
# This software is copyright protected and proprietary to Vector Informatik GmbH.
# Vector Informatik GmbH grants to you only those rights as set out in the license conditions.
package /MICROSAR/Crypto_30_LibCv
  module config Crypto_Pre: definition=Crypto
    CryptoKeyElements
      Crypto_30_LibCv_KeyDerivation_Label (CryptoKeyElement): CryptoKeyElementInitValue=0x56, 0x4b, 0x4d, 0x53
    CryptoGeneral
      CryptoKeyDerivePrimitives: CryptoKeyDeriveAlgorithm=CRYPTO_KDF_ALGO_ASYM_NIST_FIPS_186_4_ERB, CryptoKeyDeriveAlgorithm=CRYPTO_KDF_ALGO_SYM_NIST_800_108_CNT_MODE_SHA256
