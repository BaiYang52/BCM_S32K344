AUTOSAR XML (schema 4-0-3)
# COPYRIGHT
# Copyright (c) 2015 by Vector Informatik GmbH. All rights reserved.
# This software is copyright protected and proprietary to Vector Informatik GmbH.
# Vector Informatik GmbH grants to you only those rights as set out in the license conditions.
package /MICROSAR
  module config CanTp_Pre: definition=CanTp
    CanTpGeneral: CanTpVersionInfoApi=1
  module config CanTp_Rec: definition=CanTp, implementation-config-variant=VARIANT-PRE-COMPILE
    CanTpGeneral:
      CanTpEnableConstantBS = 1
      CanTpIgnoreCfWithWrongSN = 1
      CanTpIgnoreFcOvflAndInvalidFS = 1
      CanTpRcNotifyAlways = 0
      CanTpTcNotifyAlways = 0
      CanTpEnableTransmitQueue = 0
      CanTpUseOnlyFirstFc = 1
      CanTpOnlyNotifyInformedAppl = 1
