AUTOSAR XML (schema 4-0-3)
# COPYRIGHT
# Copyright (c) 2015 by Vector Informatik GmbH. All rights reserved.
# This software is copyright protected and proprietary to Vector Informatik GmbH.
# Vector Informatik GmbH grants to you only those rights as set out in the license conditions.
package /MICROSAR
  module config EcuM_Pre: definition=EcuM
    EcuMGeneral: EcuMVersionInfoApi=1
  module config EcuM_Rec: definition=EcuM, implementation-config-variant=VARIANT-PRE-COMPILE
    EcuMFlexGeneral: EcuMAlarmClockPresent=0, EcuMResetLoopDetection=0, EcuMEnableDefBehaviour=0
