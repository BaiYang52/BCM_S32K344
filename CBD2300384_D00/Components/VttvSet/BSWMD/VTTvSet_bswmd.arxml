AUTOSAR XML (schema 4-3-0)
package /MICROSAR/VTT
  bsw implementation VTTvSet_Impl: programming-language=C, used-code-generator=DaVinci Configurator, vendor-id=30, ar-release-version=4.03.00, preconfigured-configuration=VTTvSet_Pre, recommended-configuration=VTTvSet_Rec, vendor-specific-module-def=VTTvSet
  module definition VTTvSet: category=VENDOR_SPECIFIC_MODULE_DEFINITION, post-build-variant-support=true, variants pre-compile  # VTT vSet | The virtual Vector Common Settings module collects global and ECU specific configuration information.
    container vSetGeneral: multiplicity set at pre-compile  # General | General parameters.
      enumeration vSetDummyStatementKind [0..1]: {None, VoidCast, SelfAssignment, UserDefined}, scope=ECU, multiplicity set at pre-compile, origin=Vector Informatik, set at pre-compile, default-value=None  # Dummy Statement Kind | Dummy statements used to avoid compiler warnings about e.g. unused parameters.
    container vSetPlatform: multiplicity set at pre-compile  # Platform | General platform and compiler specific parameters.
      enumeration vSetByteOrder [0..1]: scope=ECU, multiplicity set at pre-compile, origin=Vector Informatik, set at pre-compile  # Byte Order | Byte order on memory level.
        BIG_ENDIAN  # Big Endian
        LITTLE_ENDIAN  # Little Endian
      enumeration vSetBitOrder [0..1]: scope=ECU, multiplicity set at pre-compile, origin=Vector Informatik, set at pre-compile  # Bit Order | Bit order on register level.
        LSB_to_MSB  # LSB to MSB
        MSB_to_LSB  # MSB to LSB
      enumeration vSetCPUType [0..1]: scope=ECU, multiplicity set at pre-compile, origin=Vector Informatik, set at pre-compile  # CPU Type | Register width of the CPU in bit.
        CPU8Bit  # 8 Bit
        CPU16Bit  # 16 Bit
        CPU32Bit  # 32 Bit
        CPU64Bit  # 64 Bit
      enumeration vSetSizeOfEnum [0..1]: scope=ECU, multiplicity set at pre-compile, origin=Vector Informatik, set at pre-compile  # Size Of Enum | Size of type enum in bit.
        Size8Bit  # 8 Bit
        Size16Bit  # 16 Bit
        Size32Bit  # 32 Bit
      enumeration vSetSizeOfInt [0..1]: scope=ECU, multiplicity set at pre-compile, origin=Vector Informatik, set at pre-compile  # Size Of Int | Size of type int in bit.
        Size16Bit  # 16 Bit
        Size32Bit  # 32 Bit
      enumeration vSetSizeOfROMPointer [0..1]: scope=ECU, multiplicity set at pre-compile, origin=Vector Informatik, set at pre-compile  # Size Of ROM Pointer | Size of ROM pointer in bit.
        Size16Bit  # 16 Bit
        Size24Bit  # 24 Bit
        Size32Bit  # 32 Bit
        Size64Bit  # 64 Bit
      enumeration vSetSizeOfRAMPointer [0..1]: scope=ECU, multiplicity set at pre-compile, origin=Vector Informatik, set at pre-compile  # Size Of RAM Pointer | Size of RAM pointer in bit.
        Size16Bit  # 16 Bit
        Size24Bit  # 24 Bit
        Size32Bit  # 32 Bit
        Size64Bit  # 64 Bit
    container vSetCalibration: multiplicity set at pre-compile  # Calibration | General calibration specific parameters.
      integer vSetPBCalibrationVirtualStartAddress [0..1]: 0..4294967295, scope=ECU, multiplicity set at pre-compile, origin=Vector Informatik, set at pre-compile, default-value=0  # PB Calibration Virtual Start Address | Start address of the virtual memory segment for calibration of post-build loadable parameters. The memory segment is used by standard calibration tools like vCDMStudio to display and manage post-build loadable parameters in a physical representation. The segment is only available in the HEX-file and the data base of the calibration tool. It is not transferred to the ECU's memory. The address should not lie in the address range of the ECU. Recommended is an address beyond the ECU's address range because the virtual memory segment size depends on the concrete configuration and is calculated automatically.
    container vSetBswInitialization [0..1]: multiplicity set at pre-compile  # Bsw Initialization | General BSW initialization specific parameters.
      container vSetInitFunction [0..*]: multiplicity set at pre-compile  # Init Function | Name of the init function. E.g. ComM_Init
        string vSetHeader: scope=ECU, multiplicity set at pre-compile, origin=Vector Informatik, set at pre-compile  # Header | Header which declares function and types.
        string vSetConfigType [0..1]: scope=ECU, multiplicity set at pre-compile, origin=Vector Informatik, set at pre-compile  # Config Type | Name of ConfigType
        string vSetConfigPtrClass [0..1]: scope=ECU, multiplicity set at pre-compile, origin=Vector Informatik, set at pre-compile  # Config Ptr Class | Memory class of Config Pointer.
        foreign reference vSetModuleRef: scope=ECU, multiplicity set at pre-compile, origin=Vector Informatik, set at pre-compile, destination-type=ECUC-MODULE-CONFIGURATION-VALUES  # Module Ref | Reference to module for initialization.
        container vSetInitFunctionInstance [0..*]: multiplicity set at pre-compile  # Init Function Instance | This container represents an instance of the Init Function. For each partition which needs initialization, one container instance needs to be created.
          enumeration vSetInitPhase: {NO_INIT, INIT_MEMORY, INIT_ZERO, INIT_ONE_EARLY, INIT_ONE, INIT_ONE_LATE, INIT_TWO_MCAL, INIT_TWO_TRCV, INIT_TWO_DRV, INIT_TWO_IF, INIT_TWO_COM, INIT_TWO_SM, INIT_TWO_NM, INIT_TWO_TP, INIT_TWO_SYS, INIT_TWO_POST_NVMREADALL, INIT_THREE}, scope=ECU, multiplicity set at pre-compile, origin=Vector Informatik, post-build-variant-value=true, set at pre-compile, default-value=INIT_TWO_POST_NVMREADALL  # Init Phase | Phase in which this init function shall be called.
          string vSetAdditionalInitCode [0..1]: scope=ECU, multiplicity set at pre-compile, origin=Vector Informatik, set at pre-compile  # Additional Init Code | Specify additional code which can be referenced from the initialization callouts of EcuM and BswM. E.g.: Mcu_InitClock() If it is necessary to call a function with a module pointer from the global postbuild-loadable configuration, the placeholder %CONFIGPTR% can be used: E.g.: Mcu_Init(%CONFIGPTR%)
          string vSetConfigPtrName [0..1]: scope=ECU, multiplicity set at pre-compile, origin=Vector Informatik, post-build-variant-value=true, set at pre-compile  # Config Ptr Name | Name of Config Pointer which shall be passed to function. If Empty no parameter is passed. If Init Function has a pointer, at least a NULL_PTR should be inserted here.
          reference vSetEcuCPartitionRef [0..1]: scope=ECU, multiplicity set at pre-compile, origin=Vector Informatik, set at pre-compile, destination=EcucPartition  # EcuC Partition Ref | Reference to the EcuC Partition this init function belongs to.
  module config VTTvSet_Pre: definition=VTTvSet
    vSetPlatform: vSetByteOrder=LITTLE_ENDIAN
  module config VTTvSet_Rec: definition=VTTvSet
    vSetPlatform: vSetBitOrder=LSB_to_MSB
