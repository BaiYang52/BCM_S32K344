AUTOSAR XML (schema 4-0-3)
package /MICROSAR/VTT
  bsw implementation VTTMcu_Impl: programming-language=C, sw-version=2.05.00, used-code-generator=cMSR, vendor-id=30, ar-release-version=4.00.03, preconfigured-configuration=VTTMcu_Pre, recommended-configuration=VTTMcu_Rec, vendor-specific-module-def=VTTMcu
  module definition VTTMcu [0..1]: category=VENDOR_SPECIFIC_MODULE_DEFINITION, variants pre-compile  # Micro Controller Unit. The driver provides services for basic microcontroller initialization, power down functionality, reset and microcontroller specific functions required by other MCAL software modules. #VTT #Driver #AUTOSAR
    container McuModuleConfiguration [0..1]: multiple-configuration-container=true  # This container includes the configuration (parameters) of the MCU driver
      enumeration McuClockSrcFailureNotification [0..1]: {DISABLED, ENABLED}, set at pre-compile  # Parameter not used. This parameter defines whether the clock failure notification is enabled or disabled. In case this feature is not supportet by HW the setting should be disabled. DISABLED: Clock failure notification is disabled. ENABLED: Clock failure notification is enabled.
      integer McuNumberOfMcuModes [0..1]: 1..255, set at pre-compile  # Parameter not used. This parameter defines the number of modes available for the MCU. | calculationFormula = Number of configured McuModeSettingConf
      integer McuRamSectors [0..1]: 1..4294967295, set at pre-compile  # Parameter not used. This parameter defines the number of RAM sectors available for the MCU. | calculationFormula = Number of configured McuRamSectorSettingConf
      integer McuResetSetting [0..1]: 1..255, set at pre-compile  # Parameter not used. This parameter relates to the MCU specific reset configuration. This applies to the function Mcu_PerformReset, which performs a microcontroller reset using the hardware feature of the microcontroller.
      container McuClockSettingConfig [0..*]  # This container includes the configuration (parameters) for the clock settings of the MCU.
        integer McuClockSettingId [0..1]: 0..255, set at pre-compile, symbolic-name-value=true, default-value=0  # Parameter not used. This parameter defines the Id of this McuClockSettingConfig to be used as argument for the API call "Mcu_InitClock".
        container McuClockReferencePoint [0..*]  # Container not used. This container includes a reference point in the Mcu Clock tree. It defines the frequency which then can be used by other modules as an input value. Lower multiplictiy is 1, as even in the simpliest case (only one frequency is used), there is one frequency to be defined.
          float McuClockReferencePointFrequency [0..1]: 0..1.7976931348623157E+308, set at pre-compile, default-value=80000000  # Parameter not used. This parameter defines the frequency for the specific instance of the McuClockReferencePoint container. It shall be given in Hz.
      container McuDemEventParameterRefs [0..1]  # Container not used. This container includes references to DemEventParameter elements which shall be invoked using the API Dem_ReportErrorStatus API in case the corresponding error occurs. The EventId is taken from the referenced DemEventParameter's DemEventId value. The standardized errors are provided in the container and can be extended by vendor specific error references.
        symbolic name reference MCU_E_CLOCK_FAILURE [0..1]: set at pre-compile, destination=DemEventParameter  # Reference to configured DEM event to report "Clock source failure".
      container McuModeSettingConf [0..*]  # This container includes the configuration (parameters) for the Mode setting of the MCU. Please see MCU035 for more information on the MCU mode settings.
        integer McuMode: 0..255, set at pre-compile, symbolic-name-value=true, default-value=0  # The parameter defines the MCU Mode settings.
        enumeration McuVttMode: {VTTMCU_MODE_NORMAL, VTTMCU_MODE_SLEEP, VTTMCU_MODE_RESET, VTTMCU_MODE_POWER_OFF}, set at pre-compile, origin=Vector Informatik, default-value=MCU_MODE_NORMAL  # This parameter defines the corresponding mode for emulation.
      container McuRamSectorSettingConf [0..*]  # This container includes the configuration (parameters) for the RAM Sector setting.
        integer McuRamDefaultValue [0..1]: 0..255, set at pre-compile  # Parameter not used. This parameter defines the data pre-setting to be initialized
        integer McuRamSectionBaseAddress [0..1]: 0..4294967295, set at pre-compile  # Parameter not used. This parameter defines the MCU RAM section base address
        integer McuRamSectionSize [0..1]: 0..4294967295, set at pre-compile  # Parameter not used. This parameter defines the MCU RAM Section size in bytes.
    container McuPublishedInformation  # This container includes all MCU specific published information parameters.
      container McuResetReasonConf [0..*]  # Container not used. This container includes the configuration for the different type of reset reason that can be retrieved from Mcu_GetResetReason Api.
        integer McuResetReason: 0..255, set at published-information, symbolic-name-value=true  # Parameter not used. This parameter defines the different types of reset that a microcontroller supports. This parameter is referenced by the parameter EcuMResetReason in the ECU State manager module.
    container McuGeneralConfiguration  # General configuration parameteres of the MCU module.
      boolean McuDevErrorDetect: set at pre-compile, default-value=true  # This parameter switches the Development Error Detection and Notification ON or OFF. True: Development error detection is enabled. False: Development error detection is disabeld. Note: In general, the development error detection is recommended during pre-test phase. It is not recommended to enable the development error detection in production code due to increased runtime and ROM needs.
      boolean McuGetRamStateApi: set at pre-compile, default-value=false  # This parameter defines whether the function Mcu_GetRamState() is enabled or disabled. True: API Mcu_GetRamState() is supported (function provided) False: API Mcu_GetRamState() is not supported (functions not provided) | (e.g. If the H/W does not support the functionality, this parameter can be used to disable the Api).
      boolean McuInitClock: set at pre-compile, default-value=true  # This parameter defines the responsibility of clock initialization. True: The MCU driver is responisble of the clock initialization. False: The clock initialization has to be disabled from the MCU driver.
      boolean McuNoPll: set at pre-compile, default-value=true  # This parameter defines whether the HW does not have a PLL. If the HW does not have a PLL or the PLL circuitry is enabled after the power on without S/W intervention the functions MCU_DistributePllClock has to be disabled and MCU-GetPllStatus has to return MCC_PLL_STATUS_UNDEFINED. True: HW does not have a PLL or the PLL circuitry is enabled after the power on without S/W intervention False: HW does have a PLL.
      boolean McuPerformResetApi: set at pre-compile, default-value=true  # This parameter defines whether the function Mcu_PerformReset() is enabled or disabled. True: API Mcu_PerformReset() is supported (function provided) False: API Mcu_PerformReset() is not supported (function not provided)
      boolean McuVersionInfoApi: set at pre-compile, default-value=false  # This parameter defines whether the function Mcu_GetVersionInfo() is enabled or disabled. True: API Mcu_GetVersionInfo() is supported (function provided) False: API Mcu_GetVersionInfo() is not supported (function not provided)
      boolean McuSafeBswChecks: set at pre-compile, origin=Vector Informatik, default-value=false  # Selects if safety checks are used. These checks improve robustness as e.g. invalid parameters are checked before function is executed. This attribute has to be enabled for safety projects where this component is mapped to an ASIL partition.
      string McuPrefix [0..1]: set at pre-compile, origin=Vector Informatik, max-length=255, min-length=0  # Mcu Prefix | This parameter can be used to overwrite the "ModuleName", “Vendor-ID” and “API-Infix” attributes of the real component, if necessary. Example: In general the implementation specific API name is specified as: <ModuleName>_<vendorId>_<vendorApiInfix>_<API name of module> This parameter overwrites the whole parenthesis <ModuleName>_<vendorId>_<vendorApiInfix>.
  module config VTTMcu_Pre: definition=VTTMcu
  module config VTTMcu_Rec: definition=VTTMcu
