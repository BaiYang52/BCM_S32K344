AUTOSAR XML (schema 00048)
# COPYRIGHT
# Copyright (c) 2022 by Vector Informatik GmbH. All rights reserved.
# This software is copyright protected and proprietary to Vector Informatik GmbH.
# Vector Informatik GmbH grants to you only those rights as set out in the license conditions.
package /MICROSAR
  bsw implementation E2E_Impl
    required-artifacts:
      dependency on artifact E2E_MemMap: category=MEMMAP, artifact-descriptor={short-label=E2E_MemMap.h, category=SWHDR}
    resource consumption ResourceConsumption
      memory section E2E_CODE: sw-addrmethod=CODE, symbol=CODE
      section name prefix E2E_Prefix: symbol=E2E
