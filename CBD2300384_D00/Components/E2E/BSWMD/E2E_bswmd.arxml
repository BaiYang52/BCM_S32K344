AUTOSAR XML (schema 4-3-0)
package /MICROSAR
  bsw implementation E2E_Impl: programming-language=C, vendor-specific-module-def=E2E
  module definition E2E [0..1]: category=VENDOR_SPECIFIC_MODULE_DEFINITION, variants pre-compile
