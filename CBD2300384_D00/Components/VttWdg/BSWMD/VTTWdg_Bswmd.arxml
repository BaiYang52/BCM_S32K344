AUTOSAR XML (schema 4-0-3)
package /MICROSAR/VTT
  bsw implementation VTTWdg_Impl: programming-language=C, sw-version=3.04.00, used-code-generator=cMSR, vendor-id=30, ar-release-version=4.00.03, preconfigured-configuration=VTTWdg_Pre, recommended-configuration=VTTWdg_Rec, vendor-specific-module-def=VTTWdg
  module definition VTTWdg [0..*]: category=VENDOR_SPECIFIC_MODULE_DEFINITION, variants pre-compile  # Watchdog driver. The driver provides services for initialization, changing the operation mode and setting the trigger condition (timeout). #VTT #Driver #AUTOSAR
    container WdgDemEventParameterRefs [0..1]  # This container includes the references to DemEventParameter elements which shall be invoked using the API Dem_ReportErrorStatus in case the corresponding error occurs. The EventId is taken from the referenced DemEventParameter's DemEventId value. | The standardized errors are provided in the container and can be extended by vendor-specific error references.
      symbolic name reference WDG_E_DISABLE_REJECTED [0..1]: set at pre-compile, destination=DemEventParameter  # Reference to the DemEventParameter which shall be issued when the error "Initialization or mode switch failed because it would disable the watchdog" has occurred.
      symbolic name reference WDG_E_MODE_FAILED [0..1]: set at pre-compile, destination=DemEventParameter  # Parameter not used. Reference to the DemEventParameter which shall be issued when the error "Setting a watchdog mode failed (during initialization or mode switch)" has occurred.
    container WdgGeneral  # General configuration parameteres of the Wdg module.
      boolean WdgDevErrorDetect: set at pre-compile, default-value=true  # This parameter switches the Development Error Detection and Notification ON or OFF. True: Development error detection is enabled. False: Development error detection is disabeld. Note: In general, the development error detection is recommended during pre-test phase. It is not recommended to enable the development error detection in production code due to increased runtime and ROM needs. | True: Development error detection enabled False: Development error detection disabled
      boolean WdgDisableAllowed: set at pre-compile, default-value=true  # This parameter defines whether disabling the watchdog driver during runtime is allowed or not. True: Disabling the watchdog driver during runtime is allowed. False: Disabling the watchdog driver during runtime is not allowed. | True: Disabling the watchdog driver at runtime is allowed. False: Disabling the watchdog driver at runtime is not allowed.
      integer WdgIndex: 0..255, set at pre-compile, symbolic-name-value=true, default-value=0  # This parameter defines the watchdog driver's ID so that it can be referenced by the watchdog interface.
      float WdgInitialTimeout: 0..65535, set at pre-compile, default-value=1  # This parameter defines the initial timeout for the trigger condition to be initialized during Init function. It shall be not larger than WdgMaxTimeout.
      float WdgMaxTimeout [0..1]: 0..65535, set at pre-compile  # Parameter not used. This parameter defines the maximum timeout to which the watchdog trigger condition can be initialized.
      enumeration WdgRunArea [0..1]: {RAM, ROM}, set at pre-compile  # Parameter not used. This parameter defines the watchdog driver execution area. RAM: Watchdog driver to be executed out of RAM area. ROM: Watchdog driver to be executed out of ROM area.
      function name WdgTriggerLocation [0..1]: set at pre-compile  # Parameter not used. This parameter defines the location (memory address) of the watchdog trigger routine.
      boolean WdgVersionInfoApi: set at pre-compile, default-value=false  # This parameter enables/disables the function Wdg_GetVersionInfo() to get major, minor and patch version information. | * True: API enabled * False: API disabled
      boolean WdgSafeBswChecks: set at pre-compile, origin=Vector Informatik, default-value=false  # Selects if safety checks are used. These checks improve robustness as e.g. invalid parameters are checked before function is executed. This attribute has to be enabled for safety projects where this component is mapped to an ASIL partition.
      string WdgPrefix [0..1]: set at pre-compile, origin=Vector Informatik, max-length=255, min-length=0  # Wdg Prefix | This parameter can be used to overwrite the "ModuleName", “Vendor-ID” and “API-Infix” attributes of the real component, if necessary. Example: In general the implementation specific API name is specified as: <ModuleName>_<vendorId>_<vendorApiInfix>_<API name of module> This parameter overwrites the whole parenthesis <ModuleName>_<vendorId>_<vendorApiInfix>.
    container WdgPublishedInformation  # This container includes all Wdg specific published information parameters.
      enumeration WdgTriggerMode [0..1]: {WDG_BOTH, WDG_TOGGLE, WDG_WINDOW}, set at published-information  # Parameter not used. This parameter defines the Watchdog trigger mode (toggle/window/both).
    container WdgSettingsConfig [0..1]: multiple-configuration-container=true  # This container includes configuration items for the different watchdog settings, also those for external watchdog hardware. | Note: All postbuild parameters are handled via this container.
      enumeration WdgDefaultMode: set at pre-compile, default-value=WDGIF_SLOW_MODE  # This parameter defines the default mode for watchdog driver initialization. WDGIF_FAST_MODE: Default watchdog mode is "fast". WDGIF_OFF_MODE: Default watchdog mode is "off". WDGIF_SLOW_MODE: Default watchdog mode is "slow. | ImplementationType: WdgIf_ModeType
        WDGIF_FAST_MODE  # Fast
        WDGIF_OFF_MODE  # Off
        WDGIF_SLOW_MODE  # Slow
      container WdgExternalConfiguration [0..1]  # Container not used. This container includes configuration items for an external watchdog hardware.
        choice reference WdgExternalContainerRef [0..1]: set at pre-compile, destination=[DioChannelGroup, SpiSequence]  # Reference to either - a DioChannelGroup container in case the hardware watchdog is connected via DIO pins. - an SpiSequenceConfiguration container in case the watchdog hardware is accessed via SPI. | - a DioChannelGroup container in case the hardware watchdog is connected via DIO pins - an SpiSequenceConfiguration container in case the watchdog hardware is accessed via SPI
      container WdgSettingsFast  # This conatainer includes hardware dependent settings for the watchdog driver's "fast" mode.
        integer WdgTimerrateFast: 10..1000000, set at pre-compile, origin=Vector Informatik, default-value=50000  # This parameter defines the timeout of the watchdog in Fast Mode (in microseconds).
      container WdgSettingsOff  # This container includes hardware dependent settings for the watchdog driver's "off" mode.
      container WdgSettingsSlow  # This container includes hardware dependent settings for the watchdog driver's "slow" mode.
        integer WdgTimerrateSlow: 10..1000000, set at pre-compile, origin=Vector Informatik, default-value=100000  # This parameter defines the timeout of the watchdog in Slow Mode (in microseconds).
  module config VTTWdg_Pre: definition=VTTWdg
  module config VTTWdg_Rec: definition=VTTWdg
