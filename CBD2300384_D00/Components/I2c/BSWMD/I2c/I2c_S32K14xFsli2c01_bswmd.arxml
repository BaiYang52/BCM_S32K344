AUTOSAR XML (schema 4-0-3)
# COPYRIGHT
# Copyright (c) 2021 by Vector Informatik GmbH. All rights reserved.
# This software is copyright protected and proprietary to Vector Informatik GmbH.
# Vector Informatik GmbH grants to you only those rights as set out in the license conditions.
package /MICROSAR/I2c_S32K14xFsli2c01
  module definition I2c: category=VENDOR_SPECIFIC_MODULE_DEFINITION, refined-module-def=I2c, variants pre-compile/post-build-selectable  # Inter-Integrated Circuit. The driver provides services for reading from and writing to devices connected via I2c buses. It provides access to I2c communication to several users (e.g. EEPROM, Watchdog, I/O ASICs) and the required mechanism to configure the onchip I2c peripheral. #I2c #Driver #MICROSAR #Vector
    container I2cConfigSet [1..*]  # This container includes the base for a multiple configuration set.
      container I2cChannel [1..*]  # Channel specific configuration parameters of the I2c.
        integer I2cChannelId: 0..255, set at pre-compile, origin=Vector Informatik, symbolic-name-value=true, default-value=0  # This parameter specifies the identifier of a channel.
        integer I2cDeviceAddress: 0..1023, set at pre-compile, origin=Vector Informatik, default-value=0  # This parameter specifies the address of a slave device which is accessed by the master. Note: Values bigger than 0x7F (127) lead to Extended Addressing.
        boolean I2cChainChannel: set at pre-compile, origin=Vector Informatik, default-value=false  # This parameter defines whether the channel is chained. True: The channel is chained. False: The channel is not chained. Note: A chained channel requires follow up to be set. It does not set a restart condition and the retransmission of the slave address is ommited.
        integer I2cDefaultData: 0..255, set at pre-compile, origin=Vector Informatik, default-value=255  # This parameter specifies the default value of the channel. Note: The default data is transmitted in case of TxBuffer and RxBuffer of the channel is set to NULL_PTR (e.g. via API I2c_SetupEB).
      container I2cBus [1..*]  # Bus specific configuration parameters of the I2c.
        integer I2cBusId: 0..255, set at pre-compile, origin=Vector Informatik, symbolic-name-value=true, default-value=0  # This parameter specifies the identifier of a bus.
        integer I2cTransferRate: 100..400, set at pre-compile, origin=Vector Informatik, default-value=100  # This parameter specifies the baudrate of the bus in KHz.
        float I2cTimeout: 0.001..10, set at pre-compile, origin=Vector Informatik, default-value=0.01  # This parameter specifies the timeout for I2c in s. Note: If the timeout expires, the driver applies the configured timeout handling (via API I2c_SetTimeoutHandling).
        float I2cSclTimeout: 0..0.002, set at pre-compile, origin=Vector Informatik, default-value=0  # This parameter specifies the timeout of the SCL line for I2c in s. The SCL timeout functionality can be disabled by setting this vaule to 0.
        integer I2cSclRiseTime: 20..1000, set at pre-compile, origin=Vector Informatik, default-value=300  # This parameter specifies the time in ns, that it takes for the SCL signal to rise. This parameter is used for the clock calculation of the CLKHI and CLKLO bitfield of the Master Clock COnfiguration Register 0 (MCCR0). As the latency varies depending on electrical parameter of the bus (e.g. pull-up resistance, capacitance) the latency can be set manually in order to accomplish a more precise baudrate.
        reference I2cHwUnitAssignment: set at pre-compile, origin=Vector Informatik, destination=I2cHardwareUnit  # Reference to the I2cHardwareUnit to which the bus is assigned.
      container I2cHardwareUnit [1..*]  # Hardware unit specific configuration parameters of the I2c.
        integer I2cUnitId: 0..10, set at pre-compile, origin=Vector Informatik, symbolic-name-value=true, default-value=0  # This parameter specifies the identifier of the hardware unit.
        float I2cClockFrequencyManual [0..1]: 1..1.7976931348623157E+308, set at pre-compile, origin=Vector Informatik, default-value=8000000  # This parameter specifies the clock rate (in Hz) of the I2C hardware unit. Note: This parameter is used to calculate baudrate settings in case the reference I2cClockConfiguration is not configured.
        boolean I2cDebugMode: set at pre-compile, origin=Vector Informatik, default-value=false  # Enables or disables the debug mode of the I2C peripheral.
        reference I2cHardwareConfigurationRef: set at pre-compile, origin=Vector Informatik, destination=I2cHardwareConfiguration  # Reference to a hardware configuration.
        choice reference I2cClockConfiguration [0..1]: set at pre-compile, origin=Vector Informatik, destination=[McuClockReferencePoint, McuClockReferencePoint]  # Reference to a McuClockReferencePoint which is used to calculate the baudrate settings for transmissions on a hardware unit. Note: If this parameter is set the clock is derived from the MCU.
        container I2cRecovery  # This container includes parameters which are required to perform I2c bus free.
          choice reference I2cPortPinScl: set at pre-compile, origin=Vector Informatik, destination=[PortPin, PortPin]  # Reference to the PortPin which is used for pin mode switching. Note: In case the module needs to apply the 'bus free' procedure the referenced PortPin is set do Dio mode and used to generate clock pulses. After the 'bus free' procedure the pin automatically gets set back to I2C mode.
          choice reference I2cDioSclPin: set at pre-compile, origin=Vector Informatik, destination=[DioChannel, DioChannel, DioChannel, DioChannel]  # Reference to the Dio pin, which is used for Bus Free and read the status of the SCL pin. Note: Must be the same pin which is used from the I2C unit as SCL.
          container I2cPinMode  # This container includes the configuration parameters to switch the SCL pin between DIO/I2C function.
            string I2cPortPinModeI2c: set at pre-compile, origin=Vector Informatik  # This parameter defines the symbolic define from the generated PORT files for the pin mode which is used for switching the pin into I2C mode. Example value: PORT_ALT3_FUNC_MODE
            string I2cPortPinModeDio: set at pre-compile, origin=Vector Informatik  # This parameter defines the symbolic define from the generated PORT files for the pin mode which is used for switching the pin into DIO mode. Example value: PORT_GPIO_MODE
      container I2cDemEventParameterRefs [0..1]  # This container includes the configuration of the DemEvents.
        choice reference I2C_E_ADDRESSING_FAILURE: set at pre-compile, origin=Vector Informatik, destination=[DemEventParameter, DemEventParameter]  # Reference to the configured DEM event to report "Addressing failure". Note: "Addressing failure" occurs in case a NACK response is detected and the corresponding sequence is configured to handle NACK as error.
        choice reference I2C_E_ARBITRATION_FAILURE: set at pre-compile, origin=Vector Informatik, destination=[DemEventParameter, DemEventParameter]  # Reference to the configured DEM event to report "Arbitration failure". Note: "Arbitration failure" occurs in case the master loses arbitration. This usually happens if the SDA is stuck low.
        choice reference I2C_E_BUS_FAILURE: set at pre-compile, origin=Vector Informatik, destination=[DemEventParameter, DemEventParameter]  # Reference to the configured DEM event to report "Bus failure". Note: "Bus failure" occurs in case SCL line is stuck low.
      container I2cSequence [1..*]  # Sequence specific configuration parameters of the I2c.
        integer I2cPriority: 0..255, set at pre-compile, origin=Vector Informatik, default-value=1  # Priority of a sequence | This parameter specifies the priority of a sequence. Going from 0 (highest) to 255 (lowest).
        function name I2cEndNotification: set at pre-compile, origin=Vector Informatik, default-value=NULL_PTR  # Transmission end notification | This parameter specifies the transmission end notification to inform the user that a transmission request has been serviced.
        integer I2cSequenceId: 0..254, set at pre-compile, origin=Vector Informatik, symbolic-name-value=true, default-value=0  # This parameter specifies the Id of a I2c Sequence.
        boolean I2cHandleNackAsError: set at pre-compile, origin=Vector Informatik, default-value=true  # Handle missing ACK as error | This parameter defines whether a NACK is handeld as error. True: NACK is handled as error (I2cErrorNotification callback is called, DEM event is reported). False: NACK is not handled as error (I2cEndNotification is called).
        function name I2cErrorNotification: set at pre-compile, origin=Vector Informatik, default-value=NULL_PTR  # Transmission error notification | This parameter specifies the transmission error notification to inform the user that a transmission request has failed.
        reference I2cAssignedBus: set at pre-compile, origin=Vector Informatik, destination=I2cBus  # Assign bus | References the bus which is assigned to the channel
        container I2cChannelList [1..*]  # References to channels and their order within the Sequence.
          integer I2cChannelIndex: 0..255, set at pre-compile, origin=Vector Informatik, default-value=0  # This parameter specifies the position of a channel in list. A channel with index 0 is processed first. The index is incremented an the next channel is processed. The index shall not have gaps.
          reference I2cChannelAssignment: set at pre-compile, origin=Vector Informatik, destination=I2cChannel  # Reference to a channel.
    container I2cGeneral  # General configuration parameters of the I2c.
      boolean I2cDevErrorDetect: set at pre-compile, origin=Vector Informatik, default-value=true  # This parameter switches the Development Error Detection and Notification ON or OFF. True: Development error detection is enabled. False: Development error detection is disabled.
      boolean I2cGetStatusApi: set at pre-compile, origin=Vector Informatik, default-value=true  # This parameter enables/disables the function I2c_GetStatus() to get the status of a channel.
      boolean I2cCancelApi: set at pre-compile, origin=Vector Informatik, default-value=true  # This parameter enables/disables the function I2c_Cancel() to cancel the transmission request of a sequence.
      boolean I2cVersionInfoApi: set at pre-compile, origin=Vector Informatik, default-value=true  # This parameter enables/disables the function I2c_GetVersionInfo() to get major, minor and patch version information.
      string I2cUserCallbackHeaderFile [0..*]: set at pre-compile, origin=Vector Informatik, default-value=NULL  # This parameter defines header file name which will be included by the I2c.
      enumeration I2cIrqType: {I2C_ISR_VOID, I2C_ISR_CAT1, I2C_ISR_CAT2}, set at pre-compile, origin=Vector Informatik, default-value=I2C_ISR_CAT2  # This parameter defines the type of the generated ISR functions. I2C_ISR_VOID: void function (void) I2C_ISR_CAT1: CAT1 interrupt (__isr void function(void)) I2C_ISR_CAT2: CAT2 interrupt (ISR(function))
      integer I2cQueueDepth: 1..255, set at pre-compile, origin=Vector Informatik, default-value=10  # This parameter specifies the depth of the queue.
      float I2cMainFunctionPeriod: 0.001..10, set at pre-compile, origin=Vector Informatik, default-value=0.01  # This parameter specifies the main function period of the I2c in s.
      boolean I2cProtectedMode: set at pre-compile, origin=Vector Informatik, default-value=false  # This parameter specifies whether the module should use osPeripheralAccess-API (e.g. because memory access is restricted by MMU) to access memory mapped registers. True: Module uses APIs provided by OS to access memory mapped registers. False: Module uses direct memory access to access memory mapped registers.
      boolean I2cSafeBswChecks: set at pre-compile, origin=Vector Informatik, default-value=false  # Selects if safety checks are used. These checks improve robustness as e.g. invalid parameters are checked before function is executed. This attribute has to be enabled for safety projects where this component is mapped to an ASIL partition.
      string I2cUserConfigFile: set at pre-compile, origin=Vector Informatik  # Reference to an external text file that will be included during generation to I2c_Cfg.h. The content of the user configuration file will be added at the end of the generated module configuration file and allows altering or extending the generated code. Caution: User configuration files can cause the software module to malfunction and must only be used with great care!
      string I2cUserDefinedHeaderFile [0..*]: set at pre-compile, origin=Vector Informatik, default-value=NULL  # This parameter defines header file names, which will be included by the I2c.
      string I2cMcalPortSetPinMode: set at pre-compile, origin=Vector Informatik, default-value=Port_SetPinMode  # This parameter specifies the name of the function for changing the mode of the pin. The function will be provided by the Port module of the MCAL. Note: Add the dependend header file to the user defined header files.
      string I2cMcalDioWriteChannel: set at pre-compile, origin=Vector Informatik, default-value=Dio_WriteChannel  # This parameter specifies the name of the function for changing the channel level of a pin. The function will be provided by the Dio module of the MCAL. Note: Add the dependend header file to the user defined header files.
      integer I2cMaxHwLoopCycles: 1.., set at pre-compile, origin=Vector Informatik, default-value=1000  # The maximum amount of HW-loop cycles waited (e.g. for a register to reach a value), before a DEM-error is thrown.
    container I2cHardwareConfiguration [1..*]  # This container includes the hardware specific configuration.
      integer I2cUnitBase: 0..4294967296, set at pre-compile, origin=Vector Informatik, default-value=0  # This value specifies the hardware unit base address. Caution: An incorrect address may lead to system crash.
      integer I2cUnitEnd [0..1]: 0..4294967296, set at pre-compile, origin=Vector Informatik, default-value=0  # This value specifies the hardware unit end address.
      reference I2cPeripheralRegion [0..1]: set at pre-compile, origin=Vector Informatik, destination=OsPeripheralRegion  # Reference to a I2cPeripheralRegion defined in the OS. Only necessary, if the I2cProtectedMode is enabled.
  bsw implementation I2c_Impl: programming-language=C, sw-version=2.00.00, used-code-generator=DaVinci Configurator, vendor-id=30, ar-release-version=4.00.03, behavior=I2c_Behavior, preconfigured-configuration=I2c_Pre, recommended-configuration=I2c_Rec, vendor-specific-module-def=I2c
