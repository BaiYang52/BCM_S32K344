AUTOSAR XML (schema 4-0-3)
# COPYRIGHT
# Copyright (c) 2021 by Vector Informatik GmbH. All rights reserved.
# This software is copyright protected and proprietary to Vector Informatik GmbH.
# Vector Informatik GmbH grants to you only those rights as set out in the license conditions.
package /MICROSAR/I2c_S32K14xFsli2c01
  module config I2c_Pre: definition=I2c
    4 x I2cHardwareConfiguration:
      S32K14x_I2c_Unit0: I2cUnitBase=1074159616, I2cUnitEnd=1074159999
      S32K148_I2c_Unit1: I2cUnitBase=1074163712, I2cUnitEnd=1074164095
      S32K3xx_I2c_Unit0: I2cUnitBase=1077215232, I2cUnitEnd=1077215615
      S32K3xx_I2c_Unit1: I2cUnitBase=1077231616, I2cUnitEnd=1077231999
