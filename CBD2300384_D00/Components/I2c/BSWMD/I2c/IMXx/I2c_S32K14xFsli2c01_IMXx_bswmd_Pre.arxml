AUTOSAR XML (schema 4-0-3)
# COPYRIGHT
# Copyright (c) 2021 by Vector Informatik GmbH. All rights reserved.
# This software is copyright protected and proprietary to Vector Informatik GmbH.
# Vector Informatik GmbH grants to you only those rights as set out in the license conditions.
package /MICROSAR/I2c_S32K14xFsli2c01
  module config I2c_Pre: definition=I2c
    20 x I2cHardwareConfiguration:
      iMX8QM_SCU_LPCG_LPI2C: I2cUnitBase=862126080, I2cUnitEnd=862126463
      iMX8QM_SCU_LPI2C: I2cUnitBase=857931776, I2cUnitEnd=857932159
      iMXRT117x_LPI2C1: I2cUnitBase=1074806784, I2cUnitEnd=1074807167
      iMXRT117x_LPI2C2: I2cUnitBase=1074823168, I2cUnitEnd=1074823551
      iMXRT117x_LPI2C3: I2cUnitBase=1074839552, I2cUnitEnd=1074839935
      iMXRT117x_LPI2C4: I2cUnitBase=1074855936, I2cUnitEnd=1074856319
      iMXRT117x_LPI2C5: I2cUnitBase=1086537728, I2cUnitEnd=1086538111
      iMXRT117x_LPI2C6: I2cUnitBase=1086554112, I2cUnitEnd=1086554495
      iMX8DXL_SCU_LPCG_LPI2C: I2cUnitBase=862126080, I2cUnitEnd=862126463
      iMX8DXL_SCU_LPI2C: I2cUnitBase=857931776, I2cUnitEnd=857932159
      iMX8QXP_SCU_LPCG_LPI2C: I2cUnitBase=862126080, I2cUnitEnd=862126463
      iMX8QXP_SCU_LPI2C: I2cUnitBase=857931776, I2cUnitEnd=857932159
      iMX8DXP_SCU_LPI2C: I2cUnitBase=857931776, I2cUnitEnd=857932159
      iMX8DXP_SCU_LPCG_LPI2C: I2cUnitBase=862126080, I2cUnitEnd=862126463
      iMX8DX_SCU_LPI2C: I2cUnitBase=857931776, I2cUnitEnd=857932159
      iMX8DX_SCU_LPCG_LPI2C: I2cUnitBase=862126080, I2cUnitEnd=862126463
      iMX8QP_SCU_LPCG_LPI2C: I2cUnitBase=862126080, I2cUnitEnd=862126463
      iMX8QP_SCU_LPI2C: I2cUnitBase=857931776, I2cUnitEnd=857932159
      iMX8SXL_SCU_LPCG_LPI2C: I2cUnitBase=862126080, I2cUnitEnd=862126463
      iMX8SXL_SCU_LPI2C: I2cUnitBase=857931776, I2cUnitEnd=857932159
