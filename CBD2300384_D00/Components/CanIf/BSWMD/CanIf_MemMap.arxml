AUTOSAR XML (schema 00048)
# COPYRIGHT
# Copyright (c) 2022 by Vector Informatik GmbH. All rights reserved.
# This software is copyright protected and proprietary to Vector Informatik GmbH.
# Vector Informatik GmbH grants to you only those rights as set out in the license conditions.
package /MICROSAR
  bsw implementation CanIf_Impl
    required-artifacts:
      dependency on artifact CanIf_MemMap: category=MEMMAP, artifact-descriptor={short-label=CanIf_MemMap.h, category=SWHDR}
    resource consumption ResourceConsumption
      37 x memory section:
        CANIF_CODE: sw-addrmethod=CODE, symbol=CODE
        CANIF_APPL_CODE: sw-addrmethod=CODE, symbol=APPL_CODE
        CANIF_PBCFG: sw-addrmethod=CONST_PBCFG, symbol=PBCFG
        CANIF_CONST_8BIT: alignment=8, sw-addrmethod=CONST_8, symbol=CONST_8BIT
        CANIF_CONST_16BIT: alignment=16, sw-addrmethod=CONST_16, symbol=CONST_16BIT
        CANIF_CONST_32BIT: alignment=32, sw-addrmethod=CONST_32, symbol=CONST_32BIT
        CANIF_CONST_UNSPECIFIED: alignment=UNSPECIFIED, sw-addrmethod=CONST_UNSPECIFIED, symbol=CONST_UNSPECIFIED
        CANIF_CONST_FAST_8BIT: alignment=8, sw-addrmethod=CONST_FAST_8, symbol=CONST_FAST_8BIT
        CANIF_CONST_FAST_16BIT: alignment=16, sw-addrmethod=CONST_FAST_16, symbol=CONST_FAST_16BIT
        CANIF_CONST_FAST_32BIT: alignment=32, sw-addrmethod=CONST_FAST_32, symbol=CONST_FAST_32BIT
        CANIF_CONST_FAST_UNSPECIFIED: alignment=UNSPECIFIED, sw-addrmethod=CONST_FAST_UNSPECIFIED, symbol=CONST_FAST_UNSPECIFIED
        CANIF_VAR_PBCFG: sw-addrmethod=VAR_PBCFG, symbol=VAR_PBCFG
        CANIF_VAR_NOINIT_8BIT: alignment=8, sw-addrmethod=VAR_NO_INIT_8, symbol=VAR_NOINIT_8BIT
        CANIF_VAR_NOINIT_16BIT: alignment=16, sw-addrmethod=VAR_NO_INIT_16, symbol=VAR_NOINIT_16BIT
        CANIF_VAR_NOINIT_32BIT: alignment=32, sw-addrmethod=VAR_NO_INIT_32, symbol=VAR_NOINIT_32BIT
        CANIF_VAR_NOINIT_64BIT: alignment=UNSPECIFIED, sw-addrmethod=VAR_NO_INIT_UNSPECIFIED, symbol=VAR_NOINIT_64BIT
        CANIF_VAR_NOINIT_UNSPECIFIED: alignment=UNSPECIFIED, sw-addrmethod=VAR_NO_INIT_UNSPECIFIED, symbol=VAR_NOINIT_UNSPECIFIED
        CANIF_VAR_INIT_8BIT: alignment=8, sw-addrmethod=VAR_INIT_8, symbol=VAR_INIT_8BIT
        CANIF_VAR_INIT_16BIT: alignment=16, sw-addrmethod=VAR_INIT_16, symbol=VAR_INIT_16BIT
        CANIF_VAR_INIT_32BIT: alignment=32, sw-addrmethod=VAR_INIT_32, symbol=VAR_INIT_32BIT
        CANIF_VAR_INIT_UNSPECIFIED: alignment=UNSPECIFIED, sw-addrmethod=VAR_INIT_UNSPECIFIED, symbol=VAR_INIT_UNSPECIFIED
        CANIF_VAR_ZERO_INIT_8BIT: alignment=8, sw-addrmethod=VAR_CLEARED_8, symbol=VAR_ZERO_INIT_8BIT
        CANIF_VAR_ZERO_INIT_16BIT: alignment=16, sw-addrmethod=VAR_CLEARED_16, symbol=VAR_ZERO_INIT_16BIT
        CANIF_VAR_ZERO_INIT_32BIT: alignment=32, sw-addrmethod=VAR_CLEARED_32, symbol=VAR_ZERO_INIT_32BIT
        CANIF_VAR_ZERO_INIT_UNSPECIFIED: alignment=UNSPECIFIED, sw-addrmethod=VAR_CLEARED_UNSPECIFIED, symbol=VAR_ZERO_INIT_UNSPECIFIED
        CANIF_VAR_FAST_NOINIT_8BIT: alignment=8, sw-addrmethod=VAR_FAST_NO_INIT_8, symbol=VAR_FAST_NOINIT_8BIT
        CANIF_VAR_FAST_NOINIT_16BIT: alignment=16, sw-addrmethod=VAR_FAST_NO_INIT_16, symbol=VAR_FAST_NOINIT_16BIT
        CANIF_VAR_FAST_NOINIT_32BIT: alignment=32, sw-addrmethod=VAR_FAST_NO_INIT_32, symbol=VAR_FAST_NOINIT_32BIT
        CANIF_VAR_FAST_NO_INIT_UNSPECIFIED: alignment=UNSPECIFIED, sw-addrmethod=VAR_FAST_NO_INIT_UNSPECIFIED, symbol=VAR_FAST_NOINIT_UNSPECIFIED
        CANIF_VAR_FAST_INIT_8BIT: alignment=8, sw-addrmethod=VAR_FAST_INIT_8, symbol=VAR_FAST_INIT_8BIT
        CANIF_VAR_FAST_INIT_16BIT: alignment=16, sw-addrmethod=VAR_FAST_INIT_16, symbol=VAR_FAST_INIT_16BIT
        CANIF_VAR_FAST_INIT_32BIT: alignment=32, sw-addrmethod=VAR_FAST_INIT_32, symbol=VAR_FAST_INIT_32BIT
        CANIF_VAR_FAST_INIT_UNSPECIFIED: alignment=UNSPECIFIED, sw-addrmethod=VAR_FAST_INIT_UNSPECIFIED, symbol=VAR_FAST_INIT_UNSPECIFIED
        CANIF_VAR_FAST_ZERO_INIT_8BIT: alignment=8, sw-addrmethod=VAR_FAST_CLEARED_8, symbol=VAR_FAST_ZERO_INIT_8BIT
        CANIF_VAR_FAST_ZERO_INIT_16BIT: alignment=16, sw-addrmethod=VAR_FAST_CLEARED_16, symbol=VAR_FAST_ZERO_INIT_16BIT
        CANIF_VAR_FAST_ZERO_INIT_32BIT: alignment=32, sw-addrmethod=VAR_FAST_CLEARED_32, symbol=VAR_FAST_ZERO_INIT_32BIT
        CANIF_VAR_FAST_ZERO_INIT_UNSPECIFIED: alignment=UNSPECIFIED, sw-addrmethod=VAR_FAST_CLEARED_UNSPECIFIED, symbol=VAR_FAST_ZERO_INIT_UNSPECIFIED
