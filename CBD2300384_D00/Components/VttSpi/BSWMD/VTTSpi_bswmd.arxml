AUTOSAR XML (schema 4-0-3)
package /MICROSAR/VTT
  module definition VTTSpi [0..1]: category=VENDOR_SPECIFIC_MODULE_DEFINITION, variants pre-compile  # Serial Peripheral Interface. The driver provides services for reading from and writing to devices connected via SPI busses. It provides access to SPI communication to several users (e.g. EEPROM, Watchdog, I/O ASICs) and the required mechanism to configure the onchip SPI peripheral. #VTT #Driver #AUTOSAR
    container SpiDriver [0..1]: multiple-configuration-container=true  # This container includes the configuration of one instance (if multiplicity is 1, it is the sole configuration) of an SPI driver.
      integer SpiMaxChannel [0..1]: 0..255, set at pre-compile  # Parameter not used. This parameter defines the number of channels configured. It will be gathered by tools during the configuration stage.
      integer SpiMaxJob [0..1]: 0..65535, set at pre-compile  # Parameter not used. This parameter defines the total number of jobs configured.
      integer SpiMaxSequence [0..1]: 0..255, set at pre-compile  # Parameter not used. This parameter defines the total number of sequences configured.
      container SpiChannel [0..*]  # This container includes all data needed to configure one SPI-channel
        integer SpiChannelId: 0..255, set at pre-compile, symbolic-name-value=true, default-value=0  # This parameter defines the SPI Channel ID, used as parameter in SPI API functions.
        enumeration SpiChannelType: set at pre-compile, default-value=EB  # This parameter defines the buffer usage with EB/IB channel. EB: External Buffer IB: Spi Handler/Driver Internal Buffer
          EB  # External Buffer
          IB  # Internal Buffer
        integer SpiDataWidth [0..1]: 1..32, set at pre-compile, default-value=8  # Parameter not used. This parameter defines the width of a transmitted data unit.
        integer SpiDefaultData: 0..255, set at pre-compile, default-value=255  # This parameter defines the default data to be transmitted when (for internal buffer or external buffer) the pointer passed to Spi_WriteIB (for internal buffer) or to Spi_SetupEB (for external buffer) is NULL.
        integer SpiEbMaxLength [0..1]: 0..65535, set at pre-compile, default-value=1  # This parameter defines the maximum size (in bytes) of data buffers in case of EB Channels and only.
        integer SpiIbNBuffers [0..1]: 0..65535, set at pre-compile, default-value=1  # This parameter defines the maximum number of data buffers in case of IB Channels and only.
        enumeration SpiTransferStart: {LSB, MSB}, set at pre-compile, default-value=LSB  # This parameter defines the first starting bit for transmission. LSB: Transmission starts with Least Significant Bit first. MSB: Transmission starts with Most Significant Bit first.
      container SpiDemEventParameterRefs [0..1]  # Container not used. This container includes the references to DemEventParameter elements which shall be invoked using the API Dem_ReportErrorStatus API in case the corresponding error occurs. The EventId is taken from the referenced DemEventParameter's DemEventId value. The standardized errors are provided in the container and can be extended by vendor specific error references.
        symbolic name reference SPI_E_HARDWARE_ERROR [0..1]: set at pre-compile, destination=DemEventParameter  # Reference to the DemEventParameter which shall be issued when a hardware error was detected. If the reference is not configured the error shall not be reported.
      container SpiExternalDevice [0..*]  # This container includes the communication settings of an external device. Closely linked to SpiJob.
        float SpiBaudrate [0..1]: 0..Inf, set at pre-compile  # Parameter not used. This parameter defines the communication baudrate. | using a range of values, from the point of view of configuration tools, from Hz up to MHz.
        string SpiCsIdentifier [0..1]: set at pre-compile, symbolic-name-value=true  # Parameter not used. This parameter defines the symbolic name to identify the Chip Select (CS) allocated to this Job.
        enumeration SpiCsPolarity [0..1]: {HIGH, LOW}, set at pre-compile  # Parameter not used. This parameter defines the active polarity of chip select.
        enumeration SpiCsSelection [0..1]: {CS_VIA_GPIO, CS_VIA_PERIPHERAL_ENGINE}, set at pre-compile, default-value=CS_VIA_PERIPHERAL_ENGINE  # Parameter not used. When the chip select handling is enabled (see SpiEnableCs), then this parameter specifies if the chip select is handled automatically by Peripheral HW engine or via general purpose IO by Spi driver.
        enumeration SpiDataShiftEdge [0..1]: {LEADING, TRAILING}, set at pre-compile  # Parameter not used. This parameter defines the SPI data shift edge.
        boolean SpiEnableCs: set at pre-compile, default-value=true  # This parameter defines whether the chip select handling functions are enabled or disabled. True: Chip select handling functions are enabled. False: Chip select handling functions are disabled.
        enumeration SpiHwUnit: {CSIB0, CSIB1, CSIB2, CSIB3, CSIB4, CSIB5, CSIB6, CSIB7, CSIB8, CSIB9, CSIB10, CSIB11}, set at pre-compile, default-value=CSIB0  # This parameter is the symbolic name to identify the HW SPI Hardware microcontroller peripheral allocated to this Job. | microcontroller peripheral allocated to this Job.
        enumeration SpiShiftClockIdleLevel [0..1]: {HIGH, LOW}, set at pre-compile  # Parameter not used. This parameter defines the SPI shift clock idle level.
        float SpiTimeClk2Cs [0..1]: 0..1E-4, set at pre-compile  # Parameter not used. This parameter defines the timing between clock and chip select (in seconds) - This parameter allows to use a range of values from 0 up to 0.0001 seconds. | The real configuration-value used in software BSW-SPI is calculated out of this by the generator-tools
      container SpiJob [0..*]  # This container includes all data needed to configure one SPI-Job, amongst others the connection between the internal SPI unit and the special settings for an external device is done.
        enumeration SpiHwUnitSynchronous [0..1]: {ASYNCHRONOUS, SYNCHRONOUS}, set at pre-compile  # This parameter defines whether the SpiJob should use its containing SpiDriver in a sychnronous or assynchronos manner. If the parameter is not set, the SpiChannel uses the driver in an asynchronous way. SYNCHRONOUS: The the SpiJob uses its containing SpiDriver in a synchronous manner. ASYNCHRONOUS: The the SpiJob uses its containing SpiDriver in a asynchronous manner.
        function name SpiJobEndNotification [0..1]: set at pre-compile  # This parameter defines the name of a callback function for job end notification. If no notification should be called for job end notification, please use one of the following capabilities: - Delete the parameter SpiJobEndNotification - Leave the parameter empty - Configure the parameter with "NULL_PTR" If the parameter has an invalid expression, the behaviour is undefined. In case of an invalid synchronization from the real target, the parameter has to be set user defined and one of the capabilities above should be followed.
        integer SpiJobId: 0..65535, set at pre-compile, symbolic-name-value=true, default-value=0  # Parameter not used. This parameter defines the SPI Job ID, used as parameter in SPI API functions.
        integer SpiJobPriority: 0..3, set at pre-compile, default-value=0  # This parameter defines the job priority: 0, lowest, 3, highest priority
        reference SpiDeviceAssignment: set at pre-compile, destination=SpiExternalDevice  # Reference to the external device used by this job
        container SpiChannelList [0..*]  # This container includes references to SPI channels and their order within the job.
          integer SpiChannelIndex: 0..255, set at pre-compile  # Parameter not used. This parameter defines the order of channels within the job.
          reference SpiChannelAssignment: set at pre-compile, destination=SpiChannel  # Reference to an SPI channel.
      container SpiSequence [0..*]  # This container includes all data needed to configure one SPI-sequence.
        boolean SpiInterruptibleSequence: set at pre-compile, default-value=false  # This parameter defines whether this sequence can be suspended by another one. True: This sequence can be suspended by another one. False: This sequence can not be suspended by another one.
        function name SpiSeqEndNotification [0..1]: set at pre-compile  # This parameter defines the name of a callback function for sequence end notification. If no notification should be called for sequence end notification, please use one of the following capabilities: - Delete the parameter SpiSeqEndNotification - Leave the parameter empty - Configure the parameter with "NULL_PTR" If the parameter has an invalid expression, the behaviour is undefined. In case of an invalid synchronization from the real target, the parameter has to be set user defined and one of the capabilities above should be followed.
        integer SpiSequenceId: 0..255, set at pre-compile, symbolic-name-value=true, default-value=0  # This parameter defines the SPI Sequence ID, used as parameter in SPI API functions.
        reference SpiJobAssignment [1..*]: set at pre-compile, destination=SpiJob  # Reference to an SpiJob (A sequence references several jobs, which are executed during a communication sequence)
    container SpiGeneral  # General configuration parameteres of the SPI module.
      boolean SpiCancelApi: set at pre-compile, default-value=true  # This parameter defines whether the function Spi_Cancel() is enabled or disabled. True: API Spi_Cancel() is supported (function provided) False: API Spi_Cancel() is not supported (function not provided)
      integer SpiChannelBuffersAllowed: 0..2, set at pre-compile, default-value=2  # This parameter defines whether the SPI Handler/Driver Channel Buffers usage is allowed and delivered. 0: The SPI Handler/Driver manages only Internal Buffers 1: The SPI Handler/Driver manages only External Buffers 2: The SPI Handler/Driver manages both buffers types | delivered. IB = 0; EB = 1; IB/EB = 2;
      boolean SpiDevErrorDetect: set at pre-compile, default-value=true  # This parameter switches the Development Error Detection and Notification ON or OFF. True: Development error detection is enabled. False: Development error detection is disabeld. Note: In general, the development error detection is recommended during pre-test phase. It is not recommended to enable the development error detection in production code due to increased runtime and ROM needs.
      boolean SpiHwStatusApi: set at pre-compile, default-value=true  # This parameter defines whether the function Spi_GetHWUnitStatus() is enabled or disabled. True: API Spi_GetHWUnitStatus() is supported (function provided) False: API Spi_GetHWUnitStatus() is not supported (function not provided)
      boolean SpiInterruptibleSeqAllowed: set at pre-compile, default-value=true  # This paramater defines whether the Interruptible Sequences handling functionality is ON or OFF. True: Interruptible Sequences handling functionality is ON. False: Interruptible Sequences handling functionality is OFF.
      integer SpiLevelDelivered: 0..2, set at pre-compile, default-value=2  # This parameter defines the SPI Handler/Driver level of scalable functionality that is available and delivered. LEVEL 0, Simple Synchronous SPI Handler/Driver LEVEL 1, Basic Asynchronous SPI Handler/Driver LEVEL 2, Enhanced (Synchronous/Asynchronous) SPI Handler/Driver | available and delivered.
      boolean SpiSupportConcurrentSyncTransmit [0..1]: set at pre-compile, default-value=false  # Parameter not used. This parameter defines whether concurrent Spi_SyncTransmit() calls for different sequences shall be configurable.
      boolean SpiVersionInfoApi: set at pre-compile, default-value=false  # This parameter enables/disables the function Spi_GetVersionInfo() to get major, minor and patch version information.
      float SpiMainFunctionPeriod: 1E-07..1, set at pre-compile, origin=Vector Informatik, default-value=0.01  # This parameter defines the cycle time of the function Spi_MainFunction_Handling in seconds. The parameter is not used by the driver it self, but it is used by upper layer.
      boolean SpiSafeBswChecks: set at pre-compile, origin=Vector Informatik, default-value=false  # Selects if safety checks are used. These checks improve robustness as e.g. invalid parameters are checked before function is executed. This attribute has to be enabled for safety projects where this component is mapped to an ASIL partition.
      string SpiPrefix [0..1]: set at pre-compile, origin=Vector Informatik, max-length=255, min-length=0  # Spi Prefix | This parameter can be used to overwrite the "ModuleName", “Vendor-ID” and “API-Infix” attributes of the real component, if necessary. Example: In general the implementation specific API name is specified as: <ModuleName>_<vendorId>_<vendorApiInfix>_<API name of module> This parameter overwrites the whole parenthesis <ModuleName>_<vendorId>_<vendorApiInfix>.
    container SpiPublishedInformation  # This container includes all SPI specific published information parameters.
      integer SpiMaxHwUnit: 0..18446744073709551615, set at published-information, default-value=12  # This parameter defines the number of different SPI hardware microcontroller peripherals (units/busses) available and handled by this SPI Handler/Driver module.
  bsw implementation VTTSpi_Impl: programming-language=C, sw-version=2.06.00, used-code-generator=cMSR, vendor-id=30, ar-release-version=4.00.03, behavior=SpiBehavior, preconfigured-configuration=VTTSpi_Pre, recommended-configuration=VTTSpi_Rec, vendor-specific-module-def=VTTSpi
  module config VTTSpi_Pre: definition=VTTSpi
  module config VTTSpi_Rec: definition=VTTSpi
