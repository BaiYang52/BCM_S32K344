AUTOSAR XML (schema 4-0-3)
# The material contained in this specification is protected by copyright and
# other types of Intellectual Property Rights. The commercial exploitation of
# the material contained in this specification requires a license to such
# Intellectual Property Rights.
# This specification may be utilized or reproduced without any modification, in
# any form or by any means, for informational purposes only.
# For any other purpose, no part of the specification may be utilized or
# reproduced, in any form or by any means, without permission in writing from
# the publisher.
# licensed under the same rules as applicable to the AUTOSAR Standard.
package /AUTOSAR/EcucDefs
  module definition Dem [0..1]: variants post-build/pre-compile  # Configuration of the Dem (Diagnostic Event Manager) module.
    container DemConfigSet: multiple-configuration-container=true  # This container contains the configuration parameters and sub containers of the Dem module supporting multiple configuration sets. This container is a MultipleConfigurationContainer, i.e. this container and its sub-containers exist once per configuration set.
      container DemDTCClass [0..65535]  # This container contains the configuration (parameters) for DTCClass.
        integer DemDTCFunctionalUnit [0..1]: 0..255, set at pre-compile  # DTCFuncitonalUnit is a 1-byte value which identifies the corresponding basic vehicle / system function which reports the DTC. This parameter is necessary for the report of severity information. | If this parameter is configured for no DTC, the Dem provides no DTC functional unit information.
        enumeration DemDTCSeverity [0..1]: {DEM_DTC_SEV_CHECK_AT_NEXT_HALT, DEM_DTC_SEV_IMMEDIATELY, DEM_DTC_SEV_MAINTENANCE_ONLY, DEM_DTC_SEV_NO_SEVERITY}, set at pre-compile, default-value=DEM_DTC_SEV_NO_SEVERITY  # DTC severity according to ISO 14229-1. This parameter depends on the automotive manufacturer. | If it is not configured, the value is counted as 'no severity'. If this parameter is configured for no DTC, the Dem provides no DTC severity information.
        boolean DemImmediateNvStorage: set at pre-compile  # Switch to enable immediate storage triggering of an according event memory entriy persistently to NVRAM. | true: immediate non-volatile storage triggering enabled false: immediate non-volatile storage triggering disabled
        integer DemJ1939DTC [0..1]: 1..16777214, set at post-build in variant post-build / pre-compile in variant pre-compile  # Unique Diagnostic Trouble Code value for J1939 (consiting of SPN and FMI)
        integer DemObdDTC [0..1]: 1..65535, set at post-build in variant post-build / pre-compile in variant pre-compile  # Unique Diagnostic Trouble Code value for OBD
        integer DemUdsDTC [0..1]: 1..16777214, set at post-build in variant post-build / pre-compile in variant pre-compile  # Unique Diagnostic Trouble Code value for UDS | (Range: 0x000000 and 0xFFFFFF are reserved for DTC groups by ISO 14229-1)
        reference DemJ1939DTC_NodeAddressRef [0..1]: set at post-build in variant post-build / pre-compile in variant pre-compile, destination=DemJ1939NodeAddress  # Reference to a J1939 NodeAddress
        container DemCallbackInitMForF [0..*]  # In case the container has a DemCallbackInitMForFFnc, this parameter defines the name of the function that the Dem will call. In case there is no DemCallbackInitMForFFnc, the Dem will have an R-Port requiring the interface CallbackInitMonitorForFunction, whose name is generated by using the unique callback-prefix followed by the event name.
          function name DemCallbackInitMForFFnc [0..1]: set at pre-compile  # Function name of prototype "InitMonitorForFunction".
      container DemDtr [0..1]  # This container holds the configuration of one individual DTR.
        float DemDtrCompuDenominator0: set at pre-compile  # Part of the conversion between the binary representation and the physical meaning analogous to the SW-C Template conversion CompuRationalCoeffs with 2 numerator coefficients and 1 denominator coefficient in the direction compuInternalToPhys. | This is the only one supported denominator value, a constant divisor. The value 0 is not allowed.
        float DemDtrCompuNumerator0: set at pre-compile  # Part of the conversion between the binary representation and the physical meaning analogous to the SW-C Template conversion CompuRationalCoeffs with 2 numerator coefficients and 1 denominator coefficient in the direction compuInternalToPhys. | This is the first numerator value, which is multiplied with x^0, i.e., the offset.
        float DemDtrCompuNumerator1: set at pre-compile  # Part of the conversion between the binary representation and the physical meaning analogous to the SW-C Template conversion CompuRationalCoeffs with 2 numerator coefficients and 1 denominator coefficient in the direction compuInternalToPhys. | This is the second numerator value, which is multiplied with x^1, i.e., the factor.
        integer DemDtrId: 0..65535, set at pre-compile, symbolic-name-value=true  # The index identifier value assigned to this DTR. The value is generated during the Dem configuration process.
        integer DemDtrMid: 0..255, set at post-build in variant post-build / pre-compile in variant pre-compile  # The OBDMID of the DTR. | The values 0x00, 0x20, 0x40, 0x60, 0x80, 0xA0, 0xC0, 0xE0 are reserved.
        integer DemDtrTid: 0..255, set at post-build in variant post-build / pre-compile in variant pre-compile  # The OBDTID of the DTR.
        integer DemDtrUasid: 0..255, set at post-build in variant post-build / pre-compile in variant pre-compile  # The UaSId the DTR data shall be scaled to, and reported together with the rescaled DTR data.
        enumeration DemDtrUpdateKind [0..1]: {DEM_DTR_UPDATE_ALWAYS, DEM_DTR_UPDATE_STEADY}, set at pre-compile  # Update conditions applied by the Dem to reports of DTR values. Only supported if a related Event is configured. If no related Event is configured, the Dem behaves as if DemDtrUpdateKind is configured to "DEM_DTR_UPDATE_ALWAYS".
        reference DemDtrEventRef [0..1]: set at pre-compile, destination=DemEventParameter  # Reference to the DemEventParameter this DTR is related to. If the related event is not configured, the Dem cannot ensure consistency between the DTR and the event.
      container DemEventParameter [1..65535]  # This container contains the configuration (parameters) for events. | Note that this container definition does not explicitly define a symbolic name parameter. Instead, the short name of the container will be used in the Ecu Configuration Description to specify the symbolic name of the diagnostic event.
        boolean DemEventAvailable: set at post-build in variant post-build / pre-compile in variant pre-compile  # This parameter configures an Event as unavailable. | It is treated by Dem as if it does not exist. true = Event is available false = Event is not available
        integer DemEventId: 1..65535, set at pre-compile, symbolic-name-value=true  # Unique identifier of a diagnostic event. | This parameter should not be changeable by user, because the Id should be generated by Dem itself to prevent gaps and multiple use of an Id. The events should be sequentially ordered beginning with 1 and no gaps in between.
        enumeration DemEventKind: {DEM_EVENT_KIND_BSW, DEM_EVENT_KIND_SWC}, set at pre-compile  # This parameter is used to distinguish between SW-C and BSW events. SW-C events are reported by Dem_SetEventStatus API and BSW events are reported by Dem_ReportErrorStatus API.
        integer DemMaxNumberFreezeFrameRecords [0..1]: 0..255, set at pre-compile  # This parameter defines the number of according freeze frame records, which can maximal be stored for this event. Therefore all these freeze frame records have the same freeze frame class. | This parameter is only required for calculated record numeration (refer to DemTypeOfFreezeFrameRecordNumeration).
        reference DemDTCClassRef [0..1]: set at pre-compile, destination=DemDTCClass  # This parameter defines the DTC configuration associated with the diagnostic event. | It is allowed to have events without a DTC (e.g. for ECU-internal events triggering safety reactions without being reported via diagnostic communication). The same DemDTCClass can be used from several events, to combine these (refer to chapter "Combination of diagnostic event").
        reference DemExtendedDataClassRef [0..1]: set at pre-compile, destination=DemExtendedDataClass  # This reference defines the link to an extended data class sampler.
        reference DemFreezeFrameClassRef [0..1]: set at pre-compile, destination=DemFreezeFrameClass  # These references define the links to a freeze frame class sampler.
        reference DemFreezeFrameRecNumClassRef [0..1]: set at pre-compile, destination=DemFreezeFrameRecNumClass  # This parameter defines the list of dedicated freeze frame record numbers associated with the diagnostic event. These record numbers are assigned to the freeze frame records (instead of calculated record numbers). | This parameter is only required for configured record numeration (refer to DemTypeOfFreezeFrameRecordNumeration).
        reference DemJ1939ExpandedFreezeFrameClassRef [0..1]: set at pre-compile, destination=DemJ1939FreezeFrameClass  # These references define the links to a J1939 freeze frame class sampler.
        reference DemJ1939FreezeFrameClassRef [0..1]: set at pre-compile, destination=DemJ1939FreezeFrameClass  # These references define the links to a J1939 freeze frame class sampler.
        reference DemOBDGroupingAssociativeEventsRef [0..1]: set at pre-compile, destination=DemEventParameter  # This parameter defines a reference which points to a representative event of one group of associate events. | The "reverence event" must refer to it self. Note: One event is only allowed to be reverenced to only one group of associate events.
        container DemCallbackClearEventAllowed [0..1]  # The presence of this container indicates that the Dem has access to a "ClearEventAllowed" callback. | In case there is a DemCallbackClearEventAllowedFnc, this parameter defines the name of the function that the Dem will call. In case there is no DemCallbackClearEventAllowedFnc, the Dem will have an R-Port requiring the interface CallbackClearEventAllowed whose name is generated by using the unique callback-prefix followed by the event name.
          function name DemCallbackClearEventAllowedFnc [0..1]: set at pre-compile  # Function name of prototype "ClearEventAllowed".
          enumeration DemClearEventAllowedBehavior: {DEM_NO_STATUS_BYTE_CHANGE, DEM_ONLY_THIS_CYCLE_AND_READINESS}, set at pre-compile, default-value=DEM_NO_STATUS_BYTE_CHANGE  # Defines the resulting UDS status byte for the related event, which must not be cleared according to the ClearEventAllowed callback.
        container DemCallbackEventDataChanged [0..1]  # The presence of this container indicates that the Dem has access to an "EventDataChanged" callback. | In case there is a DemCallbackEventDataChangedFnc, this parameter defines the name of the function that the Dem will call. In case there is no DemCallbackEventDataChangedFnc, the Dem will have an R-Port requiring the interface CallbackEventDataChanged whose name is generated by using the unique callback-prefix followed by the event name.
          function name DemCallbackEventDataChangedFnc [0..1]: set at pre-compile  # Function name of prototype "EventDataChanged"
        container DemCallbackEventStatusChanged [0..*]  # The presence of this container indicates, that the Dem has access to an "EventStatusChanged" callback, which the Dem will call to notify other components about the change in the status of an event. | In case there is a DemCallbackEvenStatusChangedFnc, this parameter defines the name of the function that the Dem will call. In case there is no DemCallbackEvenStatusChangedFnc, the Dem will have an R-Port requiring the interface CallbackEventStatusChanged, whose name is generated by using the unique callback-prefix followed by the event name.
          function name DemCallbackEventStatusChangedFnc [0..1]: set at pre-compile  # Function name of prototype "EventStatusChanged"
        container DemCallbackInitMForE [0..1]  # The presence of this container indicates, that the Dem has access to an "InitMonitorForEvent" callback, which the Dem will call to initialize a monitor. | In case the container has a DemCallbackInitMForEFnc, this parameter defines the name of the function that the Dem will call. In case there is no DemCallbackInitMForEFnc, the Dem will have an R-Port requiring the interface CallbackInitMonitorForEvent, whose name is generated by using the unique callback-prefix followed by the event name.
          function name DemCallbackInitMForEFnc [0..1]: set at pre-compile  # Function name of prototype "InitMonitorForEvent".
        container DemEventClass  # This container contains the configuration (parameters) for EventClass
          boolean DemAgingAllowed: set at pre-compile  # Switch to allow aging/unlearning of the event or not. | true: aging allowed false: aging not allowed
          integer DemAgingCycleCounterThreshold [0..1]: 1..256, set at pre-compile  # Number of aging cycles needed to unlearn/delete the event.
          boolean DemConsiderPtoStatus: set at pre-compile  # This parameter is TRUE, when the event is affected by the Dem PTO handling.
          enumeration DemEventDestination [0..4]: {DEM_DTC_ORIGIN_MIRROR_MEMORY, DEM_DTC_ORIGIN_PRIMARY_MEMORY, DEM_DTC_ORIGIN_SECONDARY_MEMORY}, set at pre-compile  # The event destination assigns events to none, one or multiple origins. | If no event destination is assigned to a specific event, the event is handled internally and is not visible externally to the Dcm. If more than one event destination is assigned to a specific event, the event can be present in the corresponding origins.
          integer DemEventFailureCycleCounterThreshold [0..1]: 1..256, set at pre-compile  # Defines the number of failure cycles for the event based fault confirmation. | If this parameter is enabled, fault confirmation of the event is enabled accordingly.
          integer DemEventMemoryEntryFdcThresholdStorageValue [0..1]: 0..255, set at pre-compile  # Threshold to allocate an event memory entry and to capture the Freeze Frame.
          enumeration DemEventOBDReadinessGroup [0..1]: {DEM_OBD_RDY_AC, DEM_OBD_RDY_BOOSTPR, DEM_OBD_RDY_CAT, DEM_OBD_RDY_CMPRCMPT, DEM_OBD_RDY_EGSENS, DEM_OBD_RDY_ERG, DEM_OBD_RDY_EVAP, DEM_OBD_RDY_FLSYS, DEM_OBD_RDY_FLSYS_NONCONT, DEM_OBD_RDY_HCCAT, DEM_OBD_RDY_HTCAT, DEM_OBD_RDY_MISF, DEM_OBD_RDY_NONE, DEM_OBD_RDY_NOXCAT, DEM_OBD_RDY_O2SENS, DEM_OBD_RDY_O2SENSHT, DEM_OBD_RDY_PMFLT, DEM_OBD_RDY_SECAIR}, set at pre-compile  # This parameter specifies the Event OBD Readiness group for PID $01 and PID $41 computation. | This parameter is only applicable for emission-related ECUs.
          integer DemEventPriority: 1..256, set at pre-compile  # Priority of the event, in view of full event buffer.
          enumeration DemEventSignificance [0..1]: {DEM_EVENT_SIGNIFICANCE_FAULT, DEM_EVENT_SIGNIFICANCE_OCCURRENCE}, set at pre-compile  # Significance of the event, which indicates additional information concerning fault classification and resolution. | It can be mapped as Dem-internal data element. It shall be configured, if it is a part of event related data.
          boolean DemFFPrestorageSupported: set at pre-compile  # If this parameter is set to true, then the Prestorage of FreezeFrames is supported by the assigned event. This parameter is useful to calculate the buffer size.
          choice reference DemAgingCycleRef [0..1]: set at pre-compile, origin=AUTOSAR_ECUC V1.0.0, destination=[DemAgingCycle, DemOperationCycle]  # Reference to the cycle which is triggering the aging of the event. This can either be the same as the operation cycle of the event, or a separate aging cycle reported via API Dem_SetAgingCycleState. If external aging is configured (refer to DemAgingCycleCounterProcessing), this parameter is not used.
          reference DemEnableConditionGroupRef [0..1]: set at pre-compile, origin=AUTOSAR_ECUC V1.0.0, destination=DemEnableConditionGroup  # References an enable condition group.
          reference DemEventFailureCycleRef [0..1]: set at pre-compile, origin=AUTOSAR_ECUC V1.0.0, destination=DemOperationCycle  # Kind of failure cycle for the event based fault confirmation. | If fault confirmation of an event is enabled, but this parameter is disabled, the operation cycle (refer to DemOperationCycleRef) is used for fault confirmation.
          reference DemOperationCycleRef: set at pre-compile, origin=AUTOSAR_ECUC V1.0.0, destination=DemOperationCycle  # Kind of operation cycle for the event (e.g. power cycle, driving cycle, ...)
          reference DemStorageConditionGroupRef [0..1]: set at pre-compile, origin=AUTOSAR_ECUC V1.0.0, destination=DemStorageConditionGroup  # References a storage condition group.
          choice container DemDebounceAlgorithmClass  # Debounce algorithm class: counter based, time based, or monitor internal.
            container DemDebounceCounterBased [0..1]  # This container contains the configuration (parameters) for counter based debouncing.
              enumeration DemDebounceBehavior: {DEM_DEBOUNCE_FREEZE, DEM_DEBOUNCE_RESET}, set at pre-compile  # This parameter defines how the event debounce algorithm will behave, if a related enable condition is not fulfilled or ControlDTCSetting of the related event is disabled.
              integer DemDebounceCounterDecrementStepSize: 1..32768, set at pre-compile  # Defines the step size for decrementation of the internal debounce counter (PREPASSED).
              integer DemDebounceCounterFailedThreshold: 1..32767, set at pre-compile  # Defines the value of the internal debounce counter, which indicates the failed status.
              integer DemDebounceCounterIncrementStepSize: 1..32767, set at pre-compile  # Defines the step size for incrementation of the internal debounce counter (PREFAILED).
              boolean DemDebounceCounterJumpDown: set at pre-compile  # Switch for the activation of Jump-Down. | true: Jump-Down activated false: Jump-Down deactivated
              integer DemDebounceCounterJumpDownValue: -32768..32767, set at pre-compile, default-value=0  # Jump-Down value of the internal debounce counter which is taken as initialization value for the counter when the respective step-down occurs.
              boolean DemDebounceCounterJumpUp: set at pre-compile  # Switch for the activation of Jump-Up. | true: Jump-Up activated false: Jump-Up deactivated
              integer DemDebounceCounterJumpUpValue: -32768..32767, set at pre-compile, default-value=0  # Jump-Up value of the internal debounce counter which is taken as initialization value for the counter when the respective step-up occurs.
              integer DemDebounceCounterPassedThreshold: -32768..-1, set at pre-compile  # Defines the value of the internal debounce counter, which indicates the passed status.
              boolean DemDebounceCounterStorage: set at pre-compile, default-value=false  # Switch to store the debounce counter value non-volatile or not. | true: debounce counter value shall be stored non-volatile false: debounce counter value is volatile
            container DemDebounceMonitorInternal [0..1]  # This container contains the configuration (parameters) for monitor internal debouncing.
              container DemCallbackGetFDC [0..1]  # The presence of this container indicates, that the Dem has access to a "GetFaultDetectionCounter" callback, which the Dem will call to obtain the value of the fault detection counter. | In case the container has a DemCallbackGetFDCFnc, this parameter defines the name of the function that the Dem will call. In case there is no DemCallbackGetFDCFnc, the Dem will have a R-Port requiring the interface CallbackGetFaultDetectionCounter, whose name is generated by using the unique callback-prefix followed by the event name.
                function name DemCallbackGetFDCFnc [0..1]: set at pre-compile  # Function name of prototype "GetFaultDetectionCounter".
            container DemDebounceTimeBase [0..1]  # This container contains the configuration (parameters) for time based debouncing.
              enumeration DemDebounceBehavior: {DEM_DEBOUNCE_FREEZE, DEM_DEBOUNCE_RESET}, set at pre-compile  # This parameter defines how the event debounce algorithm will | behave, if a related enable condition is not fulfilled or ControlDTCSetting of the related event is disabled.
              float DemDebounceTimeFailedThreshold: 0.001..3600, set at pre-compile  # Defines the time out duration for "Event Failed" qualification. | The AUTOSAR configuration standard is to use SI units, so this parameter is defined as float value in seconds. Dem configuration tools must convert this float value to the appropriate value format for the use in the software implementation of Dem.
              float DemDebounceTimePassedThreshold: 0.001..3600, set at pre-compile  # Defines the time out duration for "Event Passed" qualification. | The AUTOSAR configuration standard is to use SI units, so this parameter is defined as float value in seconds. Dem configuration tools must convert this float value to the appropriate value format for the use in the software implementation of Dem.
          container DemIndicatorAttribute [0..255]  # This container contains the event specific configuration of Indicators.
            enumeration DemIndicatorBehaviour: {DEM_INDICATOR_BLINKING, DEM_INDICATOR_BLINK_CONT, DEM_INDICATOR_CONTINUOUS, DEM_INDICATOR_FAST_FLASH, DEM_INDICATOR_SLOW_FLASH}, set at post-build in variant post-build / pre-compile in variant pre-compile  # Behaviour of the linked indicator
            integer DemIndicatorFailureCycleCounterThreshold [0..1]: 0..255, set at pre-compile  # Defines the number of failure cycles for the WarningIndicatorOnCriteria.
            enumeration DemIndicatorFailureCycleSource: {DEM_FAILURE_CYCLE_EVENT, DEM_FAILURE_CYCLE_INDICATOR}, set at pre-compile  # This parameter defines, which failure cycle is used for the WarningIndicatorOnCriteria handling.
            integer DemIndicatorHealingCycleCounterThreshold: 0..255, set at pre-compile  # Defines the number of healing cycles for the WarningIndicatorOffCriteria.
            reference DemIndicatorFailureCycleRef [0..1]: set at pre-compile, destination=DemOperationCycle  # Kind of failure cycle for the indicator controlled by the according event used for the WarningIndicatorOnCriteria.
            reference DemIndicatorHealingCycleRef: set at pre-compile, destination=DemOperationCycle  # Kind of healing cycle for the indicator controlled by the according event used for the WarningIndicatorOffCriteria.
            reference DemIndicatorRef: set at pre-compile, destination=DemIndicator  # Reference to the used indicator.
      container DemJ1939NodeAddress [0..255]: post-build-changeable=true  # Contains the parameters for the support of a logical J1939 node (identified by an ECU address).
        symbolic name reference DemJ1939NmNodeRef [1..255]: set at post-build in variant post-build / pre-compile in variant pre-compile, destination=J1939NmNode  # Reference to the corresponding J1939Nm node.
      container DemPidClass [0..255]  # This container contains the different PIDs for the single global OBD relevant freeze frame class. It is assembled out of one or several data elements.
        integer DemPidIdentifier: 0..255, set at post-build in variant post-build / pre-compile in variant pre-compile  # identifier of the PID
        container DemPidDataElement [1..255]  # This container contains the different data elements contained in the specific PID.
          choice reference DemPidDataElementClassRef: set at post-build in variant post-build / pre-compile in variant pre-compile, destination=[DemExternalCSDataElementClass, DemExternalSRDataElementClass, DemInternalDataElementClass]  # This reference contains the link to a data element class.
    container DemGeneral  # This container contains the configuration (parameters) of the BSW Dem
      enumeration DemAgingCycleCounterProcessing: {DEM_PROCESS_AGINGCTR_EXTERN, DEM_PROCESS_AGINGCTR_INTERN}, set at pre-compile  # This configuration switch defines, whether the aging counter is calculated Dem-internally or provided via Dem_SetAgingCycleCounterValue.
      boolean DemAgingRequieresTestedCycle: set at pre-compile  # Defines if the aging cycle counter is processed every aging cycles or if only tested aging cycle are considered. | true: only tested aging cycle are considered for aging cycle counter false: aging cycle counter is processed every aging cycle
      enumeration DemAvailabilitySupport: {DEM_EVENT_AVAILABILITY, DEM_NO_AVAILABILITY}, set at pre-compile  # This configuration switch defines, whether support for availability is enabled or not.
      integer DemBswErrorBufferSize: 0..255, set at pre-compile  # Maximum number of elements in buffer for handling of BSW errors (ref. to Dem107).
      enumeration DemClearDTCBehavior: {DEM_CLRRESP_NONVOLATILE_FINISH, DEM_CLRRESP_NONVOLATILE_TRIGGER, DEM_CLRRESP_VOLATILE}, set at pre-compile  # Defines the clearing process of diagnostic information for volatile and non-volatile memory and the positive response handling for the Dcm module.
      enumeration DemClearDTCLimitation: {DEM_ALL_SUPPORTED_DTCS, DEM_ONLY_CLEAR_ALL_DTCS}, set at pre-compile, default-value=DEM_ALL_SUPPORTED_DTCS  # Defines the supported Dem_<...>ClearDTC API scope.
      enumeration DemDataElementDefaultEndianness: {BIG_ENDIAN, LITTLE_ENDIAN, OPAQUE}, set at pre-compile  # Defines the default endianness of the data belonging to a data element which is applicable if the DemExternalSRDataElementClass does not define a endianness.
      boolean DemDebounceCounterBasedSupport: set at pre-compile  # This configuration switch defines, whether support for counter based debouncing is enabled or not. | true: counter based debouncing support is enabled false: counter based debouncing support is disabled
      boolean DemDebounceTimeBasedSupport: set at pre-compile  # This configuration switch defines, whether support for time based debouncing is enabled or not. | true: time based debouncing support is enabled false: time based debouncing support is disabled
      boolean DemDevErrorDetect: set at pre-compile  # Activate/Deactivate the Development Error Detection and Notification. | true: Development Error Detection and Notification activated false: Development Error Detection and Notification deactivated
      integer DemDtcStatusAvailabilityMask: 0..255, set at pre-compile  # Mask for the supported DTC status bits by the Dem. This mask is used by UDS service 0x19.
      boolean DemEnableConditionSupport: set at pre-compile  # This configuration switch defines, whether support for enable conditions is enabled or not. | true: support for enable conditions is enabled false: support for enable conditions is disabled
      enumeration DemEventCombinationSupport: {DEM_EVCOMB_DISABLED, DEM_EVCOMB_TYPE1, DEM_EVCOMB_TYPE2}, set at pre-compile  # This parameter defines the type of event combination supported by the Dem.
      enumeration DemEventDisplacementStrategy: {DEM_DISPLACEMENT_FULL, DEM_DISPLACEMENT_NONE, DEM_DISPLACEMENT_PRIO_OCC}, set at pre-compile  # This configuration switch defines, whether support for event displacement is enabled or not, and which displacement strategy is followed.
      enumeration DemEventMemoryEntryStorageTrigger: {DEM_STORAGE_ON_CONFIRMED, DEM_STORAGE_ON_FDC_THRESHOLD, DEM_STORAGE_ON_PENDING, DEM_STORAGE_ON_TEST_FAILED}, set at pre-compile, default-value=DEM_STORAGE_ON_TEST_FAILED  # Configures the primary trigger to allocate an event memory entry.
      enumeration DemExtendedDataCapture [0..1]: {DEM_TRIGGER_EVENT_MEMORY_STORAGE, DEM_TRIGGER_TESTFAILED}, set at pre-compile  # This parameter defines the point in time, when the extended data collection is done for the initial event memory entry.
      enumeration DemFreezeFrameCapture [0..1]: {DEM_TRIGGER_EVENT_MEMORY_STORAGE, DEM_TRIGGER_TESTFAILED}, set at pre-compile  # This parameter defines the point in time, when the freeze frame data collection is done for the initial event memory entry.
      boolean DemGeneralInterfaceSupport: set at pre-compile  # The interfaces GeneralEvtInfo, GeneralCallbackEventDataChanged and GeneralCallbackEventStatusChange are provided if DemGeneralInterfaceSupport is equal to true.
      string DemHeaderFileInclusion [0..*]: set at pre-compile, regular-expression=[a-zA-Z0-9_]([a-zA-Z0-9\._])*  # Name of the header file(s) to be included by the Dem module containing the used C-callback declarations.
      integer DemImmediateNvStorageLimit [0..1]: 1..255, set at pre-compile  # This parameter defines the maximum number of occurrences, a specific event memory entry is allowed, to be stored in NVRAM immediately (refer to DemImmediateNvStorage).
      integer DemMaxNumberEventEntryMirror: 0..255, set at pre-compile  # Maximum number of events which can be stored in the mirror memory
      integer DemMaxNumberEventEntryPermanent: 0..255, set at pre-compile  # Maximum number of events which can be stored in the permanent memory. | The assignment of an event to this memory type is dynamic and used for emission-related events only.
      integer DemMaxNumberEventEntryPrimary: 1..255, set at pre-compile  # Maximum number of events which can be stored in the primary memory
      integer DemMaxNumberEventEntrySecondary: 0..255, set at pre-compile  # Maximum number of events which can be stored in the secondary memory
      integer DemMaxNumberPrestoredFF: 0..255, set at pre-compile  # Defines the maximum number for prestored freeze frames. | If set to 0, then freeze frame prestorage is not supported by the ECU.
      enumeration DemOBDSupport: {DEM_OBD_DEP_SEC_ECU, DEM_OBD_MASTER_ECU, DEM_OBD_NO_OBD_SUPPORT, DEM_OBD_PRIMARY_ECU}, set at pre-compile  # This configuration switch defines OBD support and kind of OBD ECU.
      enumeration DemOccurrenceCounterProcessing: {DEM_PROCESS_OCCCTR_CDTC, DEM_PROCESS_OCCCTR_TF}, set at pre-compile  # This configuration switch defines the consideration of the fault confirmation process for the occurrence counter. For OBD and mixed systems (OBD/non OBD, refer to DemOBDSupport) configuration switch shall always set to DEM_PROCESS_OCCCTR_TF.
      enumeration DemOperationCycleProcessing [0..1]: {DEM_PROCESS_OPCYC_COUNTER, DEM_PROCESS_OPCYC_STATE}, set at pre-compile, default-value=DEM_PROCESS_OPCYC_STATE  # This configuration switch defines, whether the operation cycles are triggered by DEM_CYCLE_STATE_START or collecting an external counter value, which results in respective state changes. Tags: atp.Status=obsolete, atp.StatusComment=This parameter is obsolete since the option DEM_PROCESS_OPCYC_COUNTER is not longer supported by AUTOSAR., atp.StatusRevisionBegin=4.1.1 | This parameter is obsolete since the option DEM_PROCESS_OPCYC_COUNTER is not longer supported by AUTOSAR. This element is obsolete and will be removed in a future revision.
      boolean DemOperationCycleStatusStorage: set at pre-compile  # Defines if the operation cycle state is available over the power cycle (stored non-volatile) or not. | true: the operation cycle state is stored non-volatile false: the operation cycle state is only stored volatile
      boolean DemPTOSupport: set at pre-compile  # This configuration switch defines, whether PTO support (and therefore PID $1E support) is enabled or not.
      boolean DemResetConfirmedBitOnOverflow: set at pre-compile, default-value=true  # This configuration switch defines, whether the confirmed bit is reset or not while an event memory entry will be displaced.
      enumeration DemStatusBitHandlingTestFailedSinceLastClear: {DEM_STATUS_BIT_AGING_AND_DISPLACEMENT, DEM_STATUS_BIT_NORMAL}, set at pre-compile  # This configuration switch defines, whether the aging and displacement mechanism shall be applied to the "TestFailedSinceLastClear" status bits.
      boolean DemStatusBitStorageTestFailed: set at pre-compile  # Activate/Deactivate the permanent storage of the "TestFailed" status bits. | true: storage activated false: storage deactivated
      boolean DemStorageConditionSupport: set at pre-compile  # This configuration switch defines, whether support for storage conditions is enabled or not. | true: support for storage conditions is enabled false: support for storage conditions is disabled
      enumeration DemSuppressionSupport: {DEM_DTC_SUPPRESSION, DEM_EVENT_AND_DTC_SUPPRESSION, DEM_EVENT_SUPPRESSION, DEM_NO_SUPPRESSION}, set at pre-compile  # This configuration switch defines, whether support for suppression is enabled or not.
      float DemTaskTime: 0.001..0.1, set at pre-compile, origin=AUTOSAR_ECUC V1.0.0  # Allow to configure the time for the periodic cyclic task. Please note: This configuration value shall be equal to the value in the Basic Software Scheduler configuration of the RTE module. | The AUTOSAR configuration standard is to use SI units, so this parameter is defined as float value in seconds. Dem configuration tools must convert this float value to the appropriate value format for the use in the software implementation of Dem. min: A negative value is not allowed. max: After event status was reported, processing shall be completed within 100ms in order to have the fault entry status information updated as soon as possible (e.g. for PID $01). upperMultiplicity: Exactly one TaskTime must be specified per configuration. lowerMultiplicity: Exactly one TaskTime must be specified per configuration.
      boolean DemTriggerDcmReports: set at pre-compile  # Activate/Deactivate the notification to the Diagnostic Communication Manager for ROE processing. | true: Dcm ROE notification activated false: Dcm ROE notification deactivated
      boolean DemTriggerDltReports: set at pre-compile  # Activate/Deactivate the notification to the Diagnostic Log and Trace. | true: Dlt notification activated false: Dlt notification deactivated
      boolean DemTriggerFiMReports: set at pre-compile  # Activate/Deactivate the notification to the Function Inhibition Manager. | true: FiM notification activated false: FiM notification deactivated
      boolean DemTriggerMonitorInitBeforeClearOk: set at pre-compile  # Defines if the monitor re-initialization has to be triggered before or after the Dem module returns DEM_CLEAR_OK. | true: trigger re-initialization before DEM_CLEAR_OK false: trigger re-initialization after DEM_CLEAR_OK
      enumeration DemTypeOfDTCSupported: {DEM_DTC_TRANSLATION_ISO11992_4, DEM_DTC_TRANSLATION_ISO14229_1, DEM_DTC_TRANSLATION_ISO15031_6, DEM_DTC_TRANSLATION_SAEJ1939_73}, set at pre-compile  # This parameter defines the format returned by Dem_DcmGetTranslationType and does not relate to/influence the supported Dem functionality.
      enumeration DemTypeOfFreezeFrameRecordNumeration: {DEM_FF_RECNUM_CALCULATED, DEM_FF_RECNUM_CONFIGURED}, set at pre-compile  # This parameter defines the type of assigning freeze frame record numbers for event-specific freeze frame records.
      boolean DemVersionInfoApi: set at pre-compile  # Activate/Deactivate the version information API. | true: version information activated false: version information deactivated
      reference DemMILIndicatorRef [0..1]: set at pre-compile, destination=DemIndicator  # This parameter defines the indicator representing the MIL. | This parameter is mandatory for ECUs supporting OBD (refer to DemOBDSupport).
      container DemAgingCycle [0..256]  # Note that this container definition does not explicitly define a symbolic name parameter. Instead, the short name of the container will be used in the Ecu Configuration Description to specify the symbolic name of the aging cycle name. These aging cycles are reported via API Dem_SetAgingCycleState only.
      container DemCallbackDTCStatusChanged [0..*]  # The presence of this container indicates, that the Dem has access to a "DTCStatusChanged" callback, which the Dem will call to notify other components about the change in the status of a DTC. | In case there is a DemCallbackDTCStatusChangedFnc, this parameter defines the name of the function that the Dem will call. In case there is no DemCallbackDTCStatusChangedFnc, the Dem will have an R-Port requiring the interface CallbackDTCStatusChanged whose name is generated by using the unique callback-prefix followed by the event name. Status change notifications are supported for DTCs in primary memory only.
        function name DemCallbackDTCStatusChangedFnc [0..1]: set at pre-compile  # Function name of prototype "DTCStatusChanged". | Note: If the parameter DemTriggerDcmReports is enabled, this parameter shall not be "Dcm_DemTriggerOnDTCStatus".
      choice container DemDataElementClass [0..255]  # This container contains the configuration (parameters) for an internal/external data element class.
        container DemExternalCSDataElementClass [0..1]  # This container contains the configuration (parameters) for an external client/server based data element class. | It defines, how the Dem can obtain the value of the data element from either a SW-C or another BSW module. Whether a client/server port or a C function-call is used, is defined by DemDataElementUsePort.
          integer DemDataElementDataSize: 1..255, set at pre-compile  # Defines the size of the data element in bytes.
          function name DemDataElementReadFnc [0..1]: set at pre-compile  # In case of DemDataElementUsePort is false, this parameter defines the prototype of the C function "ReadDataElement" used to get the according value.
          boolean DemDataElementUsePort: set at pre-compile  # If the parameter is set to True, a R-Port is generated, to obtain the data element (interface DataServices_<SyncDataElement>). | If the parameter is set to False, the information is obtained by C function-call on another BSW module specified by the parameter DemDataElementReadFnc.
        container DemExternalSRDataElementClass [0..1]  # This container contains the configuration (parameters) for an external sender/receiver based data element class. It defines, how the Dem can obtain the value of the data element from a SW-C, by using a sender/receiver port.
          integer DemDataElementDataSize: 1..255, set at pre-compile  # Defines the size of the data element in bits.
          enumeration DemDataElementDataType [0..1]: {BOOLEAN, SINT16, SINT32, SINT8, UINT16, UINT32, UINT8}, set at pre-compile  # Provide the implementation data type of data belonging to a external data.
          enumeration DemDataElementEndianness [0..1]: {BIG_ENDIAN, LITTLE_ENDIAN, OPAQUE}, set at pre-compile  # Defines the endianness of the data belonging to an external data. | If no DemDataElementEndianness is defined the value of DemDataElementDefaultEndianness is applicable.
          choice container DemDiagnosisScaling [0..1]  # This container contains the configuration (parameters) of an alternative Diagnosis Representation. Out if this the scaling between Diagnosis and ECU internal representation and vice versa can be calculated.
            container DemAlternativeDataInterface [0..1]  # This container contains the configuration (parameters) of an alternative Diagnosis Representation by the means of a VariableDataPrototoype in a DataInterface. | Additionally a reference to PortInterfaceMapping can be defined which provide already the mapping rules between the VariableDataPrototoype in a DataInterface used by the software component (DemSRDataElementClass) and the intended Diagnosis Representation defined by DemExternalSRDataElementClass.
              foreign reference DemDataElement: set at pre-compile, destination-type=VARIABLE-DATA-PROTOTYPE  # Alternative Diagnosis Representation for the data defined by the means of a VariableDataPrototoype in a DataInterface.
              foreign reference DemPortInterfaceMapping [0..1]: set at pre-compile, destination-type=PORT-INTERFACE-MAPPING  # Optional reference to PortInterfaceMapping which defines the mapping rules.
            container DemAlternativeDataProps [0..1]  # This container contains the configuration (parameters) of an alternative Diagnosis Representation by the means of ECU configuration parameters. | The physical unit of the alternative data representation is defined by the DataPrototype referenced by DemSRDataElementClass. Additionally the definition of a text table mapping can be a defined for DemDataTypeCategory TEXTTABLE and SCALE_LINEAR_AND_TEXTTABLE
              enumeration DemDataTypeCategory: {SCALE_LINEAR_AND_TEXTTABLE, TEXTTABLE}, set at pre-compile  # Data category of the alternative Diagnosis Representation.
              container DemLinearScale [0..1]  # This container contains the configuration (parameters) of an linear scale of the alternative Diagnosis Representation.
                float DemDiagnosisRepresentationDataLowerRange: set at pre-compile  # Lower Range for this scale of the data in the alternative Diagnosis Representation.
                float DemDiagnosisRepresentationDataOffset: 0..Inf, set at pre-compile, default-value=0  # Data offset of the alternative Diagnosis Representation for this scale.
                float DemDiagnosisRepresentationDataResolution: 0..Inf, set at pre-compile  # Data resolution of the alternative Diagnosis Representation for this scale.
                float DemDiagnosisRepresentationDataUpperRange: set at pre-compile  # Upper Range for this scale of the data in the alternative Diagnosis Representation.
              container DemTextTableMapping [0..*]  # This container contains the configuration (parameters) of the mapping a DataPrototype typed by AutosarDataType that refer to a CompuMethods of category TEXTTABLE or SCALE_LINEAR_AND_TEXTTABLE. | Each DemTextTableMapping defines a value pair which is used to map the ECU internal value (DemInternalDataValue) to the vale used in the diagnosis representation (DemDiagnosisRepresentationDataValue) and vice versa. The set of all DemTextTableMapping defines the whole mapping of an data.
                integer DemDiagnosisRepresentationDataValue: 0..18446744073709551615, set at pre-compile  # The data value in the diagnosis representation.
                integer DemInternalDataValue: 0..18446744073709551615, set at pre-compile  # The ECU internal data value.
            container DemAlternativeDataType [0..1]  # This container contains the configuration (parameters) of an alternative Diagnosis Representation by the means of an ApplicationDataType. | Additionally the definition of a text table mapping can be a defined for ApplicationDataTypes of category TEXTTABLE and SCALE_LINEAR_AND_TEXTTABLE.
              foreign reference DemApplicationDataType: set at pre-compile, destination-type=APPLICATION-PRIMITIVE-DATA-TYPE  # Alternative Diagnosis Representation for the data defined by the means of a ApplicationPrimitiveDataType of category VALUE or BOOLEAN.
              container DemTextTableMapping [0..*]  # This container contains the configuration (parameters) of the mapping a DataPrototype typed by AutosarDataType that refer to a CompuMethods of category TEXTTABLE or SCALE_LINEAR_AND_TEXTTABLE. | Each DemTextTableMapping defines a value pair which is used to map the ECU internal value (DemInternalDataValue) to the vale used in the diagnosis representation (DemDiagnosisRepresentationDataValue) and vice versa. The set of all DemTextTableMapping defines the whole mapping of an data.
                integer DemDiagnosisRepresentationDataValue: 0..18446744073709551615, set at pre-compile  # The data value in the diagnosis representation.
                integer DemInternalDataValue: 0..18446744073709551615, set at pre-compile  # The ECU internal data value.
          choice container DemSRDataElementClass  # This container defines the source of data in a provided port which shall be read for a external data element | This container shall contain either one DemSubElementInDataElementInstance OR DemDataElementInstance OR DemSubElementInImplDataElementInstance reference.
            container DemDataElementInstance [0..1]  # Instance Reference to the primitive data in a port where the data element is typed with an ApplicationPrimitveDataType or an ImplementationDataType.
              instance reference DemDataElementInstanceRef: set at pre-compile, destination-context=ROOT-SW-COMPOSITION-PROTOTYPE SW-COMPONENT-PROTOTYPE PORT-PROTOTYPE, destination-type=AUTOSAR-DATA-PROTOTYPE  # Instance Reference to the primitive data which shall be read or written. | Supported are VariableDataPrototypes in SenderReceiverInterfaces and NvDataInterfaces and ParameterDataPrototypes in ParameterInterfaces (read only). This reference is applicable if the AutosarDataPrototype is typed with a ApplicationPrimitiveDataType of category VALUE or BOOLEAN or if the AutosarDataPrototype is typed with a ImplementationDataType of category VALUE or TYPE_REFERENCE that in turn boils down to VALUE
            container DemSubElementInDataElementInstance [0..1]  # Instance Reference to the primitve sub-element (at any level) of composite data in a port where the data element is typed with an ApplicationCompositeDataType.
              instance reference DemSubElementInDataElementInstanceRef: set at pre-compile, destination-context=ROOT-SW-COMPOSITION-PROTOTYPE SW-COMPONENT-PROTOTYPE PORT-PROTOTYPE AUTOSAR-DATA-PROTOTYPE APPLICATION-COMPOSITE-ELEMENT-DATA-PROTOTYPE*, destination-type=AUTOSAR-DATA-PROTOTYPE  # Instance Reference to the primitve sub-element (at any level) of composite data in a port which shall be read or written. | Supported are VariableDataPrototypes in SenderReceiverInterfaces and NvDataInterfaces and ParameterDataPrototypes in ParameterInterfaces (read only). This reference is applicable if the AutosarDataPrototype is typed with a ApplicationCompositeDataType.
            container DemSubElementInImplDataElementInstance [0..1]  # Instance Reference to the primitve sub-element (at any level) of composite data in a port where the data element is typed with an ImplementationDataType of category STRUCTURE or ARRAY.
              instance reference DemSubElementInImplDataElementInstanceRef: set at pre-compile, destination-context=ROOT-SW-COMPOSITION-PROTOTYPE SW-COMPONENT-PROTOTYPE PORT-PROTOTYPE AUTOSAR-DATA-PROTOTYPE IMPLEMENTATION-DATA-TYPE-ELEMENT*, destination-type=IMPLEMENTATION-DATA-TYPE-ELEMENT  # Instance Reference to the primitve sub-element (at any level) of composite data in a port which shall be read or written. | Supported are VariableDataPrototypes in SenderReceiverInterfaces and NvDataInterfaces and ParameterDataPrototypes in ParameterInterfaces (read only). This reference is applicable if the AutosarDataPrototype is typed with a ImplementationDataType of category STRUCTURE or ARRAY. Please note that in case of ARRAY the index attribute in the target reference has to be set to select a single array element.
        container DemInternalDataElementClass [0..1]  # This container contains the configuration (parameters) for an internal data element class.
          integer DemDataElementDataSize: 1..255, set at pre-compile  # Defines the size of the data element in bytes.
          enumeration DemInternalDataElement: {DEM_AGINGCTR_DOWNCNT, DEM_AGINGCTR_UPCNT, DEM_CURRENT_FDC, DEM_CYCLES_SINCE_FIRST_FAILED, DEM_CYCLES_SINCE_LAST_FAILED, DEM_FAILED_CYCLES, DEM_MAX_FDC_DURING_CURRENT_CYCLE, DEM_MAX_FDC_SINCE_LAST_CLEAR, DEM_OCCCTR, DEM_OVFLIND, DEM_SIGNIFICANCE}, set at pre-compile  # This parameter defines the Dem-internal data value, which is mapped to the data element.
      container DemDidClass [0..255]  # This container contains the configuration (parameters) for a data Id class. It is assembled out of one or several data elements.
        integer DemDidIdentifier: 0..65535, set at pre-compile  # Identifier of the Data ID.
        choice reference DemDidDataElementClassRef [1..255]: set at pre-compile, destination=[DemExternalCSDataElementClass, DemExternalSRDataElementClass, DemInternalDataElementClass]  # This reference contains the link to a data element class.
      container DemEnableCondition [0..255]  # This container contains the configuration (parameters) for enable conditions.
        integer DemEnableConditionId: 0..255, set at pre-compile, symbolic-name-value=true  # Defines a unique enable condition Id. | This parameter should not be changeable by user, because the Id should be generated by Dem itself to prevent gaps and multiple use of an Id. The enable conditions should be sequentially ordered beginning with 0 and no gaps in between.
        boolean DemEnableConditionStatus: set at pre-compile  # Defines the initial status for enable or disable of acceptance of event reports of a diagnostic event. | The value is the initialization after power up (before this condition is reported the first time). true: acceptance of a diagnostic event enabled false: acceptance of a diagnostic event disabled
      container DemEnableConditionGroup [0..255]  # This container contains the configuration (parameters) for enable condition groups.
        reference DemEnableConditionRef [1..255]: set at pre-compile, origin=AUTOSAR_ECUC V1.0.0, destination=DemEnableCondition  # References an enable condition.
      container DemExtendedDataClass [0..*]  # This class contains the combinations of extended data records for an extended data class.
        reference DemExtendedDataRecordClassRef [1..253]: set at pre-compile, destination=DemExtendedDataRecordClass  # This reference contains the link to an extended data class record.
      container DemExtendedDataRecordClass [0..253]  # This container contains the configuration (parameters) for an extended data record class. | It is assembled out of one or several data elements.
        integer DemExtendedDataRecordNumber: 0..253, set at pre-compile  # This configuration parameter specifies an unique identifier for an extended data record. | One or more extended data records can be assigned to one diagnostic event/DTC. 0xFF and 0xFE are reserved by ISO (therefore the maximal value equals 253).
        enumeration DemExtendedDataRecordTrigger [0..1]: {DEM_EXTENDED_DATA_CAPTURE_ON_CONFIRMED, DEM_EXTENDED_DATA_CAPTURE_ON_FDC_THRESHOLD, DEM_EXTENDED_DATA_CAPTURE_ON_PENDING, DEM_EXTENDED_DATA_CAPTURE_ON_TEST_FAILED}, set at pre-compile  # Configures the primary trigger to allocate an event memory entry.
        enumeration DemExtendedDataRecordUpdate [0..1]: {DEM_UPDATE_RECORD_NO, DEM_UPDATE_RECORD_YES}, set at pre-compile  # This extended data record is captured if the configured trigger condition in "DemExtendedDataRecordTrigger" is fulfilled.
        choice reference DemDataElementClassRef [1..255]: set at pre-compile, destination=[DemExternalCSDataElementClass, DemExternalSRDataElementClass, DemInternalDataElementClass]  # This reference contains the link to a data element class.
      container DemFreezeFrameClass [0..255]  # This container contains the combinations of DIDs for a non OBD relevant freeze frame class.
        reference DemDidClassRef [1..255]: set at pre-compile, destination=DemDidClass  # For OBD relevant data | Multiple PIDs can be relevant per freeze frame.
      container DemFreezeFrameRecNumClass [0..255]  # This container contains a list of dedicated, different freeze frame record numbers assigned to an event. The order of record numbers in this list is assigned to the chronological order of the according freeze frame records. | dependency: DemTypeOfFreezeFrameRecordNumeration = DEM_FF_RECNUM_CONFIGURED
        reference DemFreezeFrameRecordClassRef [1..254]: set at pre-compile, destination=DemFreezeFrameRecordClass  # This parameter references record number(s) for a freeze frame record.
      container DemFreezeFrameRecordClass [0..255]  # This container contains a list of dedicated, different freeze frame record numbers.
        integer DemFreezeFrameRecordNumber: 1..254, set at pre-compile  # This parameter defines a record number for a freeze frame record. This record number is unique per freeze frame record number class. | The range of this value is defined by ISO 14229-1 (0x01 .. 0xFE).
        enumeration DemFreezeFrameRecordTrigger: {DEM_FREEZE_FRAME_CAPTURE_ON_CONFIRMED, DEM_FREEZE_FRAME_CAPTURE_ON_FDC_THRESHOLD, DEM_FREEZE_FRAME_CAPTURE_ON_PENDING, DEM_FREEZE_FRAME_CAPTURE_ON_TEST_FAILED}, set at pre-compile  # Configures the primary trigger to allocate an event memory entry.
        enumeration DemFreezeFrameRecordUpdate: {DEM_UPDATE_RECORD_NO, DEM_UPDATE_RECORD_YES}, set at pre-compile  # This parameter defines the case, when the freeze frame record is stored/updated. Tags: atp.Status=obsolete, atp.StatusRevisionBegin=4.1.1
      container DemGeneralJ1939 [0..1]  # This container contains the general J1939-specific configuration (parameters) of the Dem module. | If the container exists the J1939 support is enabled.
        boolean DemJ1939ClearDtcSupport: set at pre-compile  # This configuration switch defines whether clearing J1939 DTCs (DM3 und DM11) is supported or not. | This switches on and off the API Dem_J1939DcmClearDTC.
        boolean DemJ1939Dm31Support: set at pre-compile  # This configuration switch defines whether J1939 DM31 is supported or not. | This switches on and off the APIs Dem_J1939DcmFirstDTCwithLampStatus and Dem_J1939DcmGetNextDTCwithLampStatus. .
        boolean DemJ1939ExpandedFreezeFrameSupport: set at pre-compile  # This configuration switch defines whether J1939 expanded freeze frames are supported or not. | This switches on and off the APIs Dem_J1939DcmSetFreezeFrameFilter, Dem_J1939DcmGetNextFreezeFrame and Dem_J1939DcmGetNextSPNInFreezeFrame.
        boolean DemJ1939FreezeFrameSupport: set at pre-compile  # This configuration switch defines whether J1939 freeze frames are supported or not. | This switches on and off the APIs Dem_J1939DcmSetFreezeFrameFilter and Dem_J1939DcmGetNextFreezeFrame.
        boolean DemJ1939RatioSupport: set at pre-compile  # This configuration switch defines whether J1939 performance ratios are supported or not. | This switches on and off the APIs Dem_J1939DcmSetRatioFilter and Dem_J1939DcmGetNextFilteredRatio.
        boolean DemJ1939Readiness1Support: set at pre-compile  # This configuration switch defines whether J1939 diagnostic readiness 1 is supported or not. | This switches on and off the API Dem_J1939DcmReadDiagnosticReadiness1.
        boolean DemJ1939Readiness2Support: set at pre-compile  # This configuration switch defines whether J1939 diagnostic readiness 2 is supported or not. | This switches on and off the API Dem_J1939DcmReadDiagnosticReadiness2.
        boolean DemJ1939Readiness3Support: set at pre-compile  # This configuration switch defines whether J1939 diagnostic readiness 3 is supported or not. | This switches on and off the API Dem_J1939DcmReadDiagnosticReadiness3.
        boolean DemJ1939ReadingDtcSupport: set at pre-compile  # This configuration switch defines whether J1939 DTC readout is supported or not. | This switches on and off the APIs Dem_J1939DcmSetDTCFilter, Dem_J1939DcmGetNumberOfFilteredDTC and Dem_J1939DcmGetNextFilteredDTC.
        reference DemAmberWarningLampIndicatorRef [0..1]: set at pre-compile, destination=DemIndicator  # This parameter defines the indicator representing the AmberWarningLamp . This parameter may be used for ECUs supporting J1939.
        reference DemProtectLampIndicatorRef [0..1]: set at pre-compile, destination=DemIndicator  # This parameter defines the indicator representing the ProtectLamp. This parameter may be used for ECUs supporting J1939.
        reference DemRedStopLampIndicatorRef [0..1]: set at pre-compile, destination=DemIndicator  # This parameter defines the indicator representing the RedStopLamp. This parameter may be used for ECUs supporting J1939.
        container DemCallbackJ1939DTCStatusChanged [0..*]  # The presence of this container indicates, that the Dem has access to a "DTCStatusChanged" callback, which the Dem will call to notify other components about the change in the status of a DTC. | In case there is a DemCallbackDTCStatusChangedFnc, this parameter defines the name of the function that the Dem will call. In case there is no DemCallbackDTCStatusChangedFnc, the Dem will have an R-Port requiring the interface CallbackDTCStatusChanged whose name is generated by using the unique callback-prefix followed by the event name. Status change notifications are supported for DTCs in primary memory only.
          function name DemCallbackDTCStatusChangedFnc [0..1]: set at pre-compile  # Function name of prototype "DTCStatusChanged". | Note: If the parameter DemTriggerDcmReports is enabled, this parameter shall not be "Dcm_DemTriggerOnDTCStatus".
        container DemJ1939FreezeFrameClass [0..255]  # This container contains the combinations of SPNs s for a J1939 relevant freeze frame.
          reference DemSPNClassRef [1..255]: set at pre-compile, destination=DemSPNClass  # Reference to an SPN. This reference defines requiresIndex = true since it represents a ordered list of references where the order describes the order of single SPNs in the J1939 Freeze Frame.
        container DemSPNClass [0..*]  # This container contains the configuration (parameters) for a SPN.
          integer DemSPNId: 0..524287, set at pre-compile  # Suspect parameter number
          choice reference DemSPNDataElementClassRef: set at pre-compile, destination=[DemExternalCSDataElementClass, DemExternalSRDataElementClass, DemInternalDataElementClass]  # This reference contains the link to a data element class.
      container DemGeneralOBD [0..1]  # This container contains the general OBD-specific configuration (parameters) of the Dem module.
        boolean DemOBDCentralizedPID21Handling: set at pre-compile  # Switch to enable the centralized handling of PID $21. | true: centralized handling of PID $21 enabled false: centralized handling of PID $21 disabled
        boolean DemOBDCentralizedPID31Handling: set at pre-compile  # Switch to enable the centralized handling of PID $31. | true: centralized handling of PID $31 enabled false: centralized handling of PID $31 disabled
        integer DemOBDCompliancy: 0..255, set at post-build in variant post-build / pre-compile in variant pre-compile  # Configuration value to define the appropriate value to PID$1C "OBD requirements to which vehicle or engine is certified." according to the respective standards, e.g. OBD, OBDII, JOBD etc. | Notice as well J1979 or the "DiagnosticReadiness 1" DM5 message of J1939-73
        enumeration DemOBDDestinationOfEvents: {DEM_DTC_ORIGIN_PRIMARY_MEMORY, DEM_DTC_ORIGIN_SECONDARY_MEMORY}, set at pre-compile  # The destination of events assigns where the OBD events shall be stored.
        boolean DemOBDEventDisplacement: set at pre-compile  # Activate/Deactivate a different displacement behavior for OBD events. | OBD events with special Conditions (e.g. Pending, MIL_On…) shall not be displaced.
        choice reference DemOBDInputAcceleratorPedalInformation [0..1]: set at pre-compile, destination=[DemExternalCSDataElementClass, DemExternalSRDataElementClass]  # Input variable for the accelerator padal information, which is assigned to a specific data element used as interface for the Dem-internal PID calculations.
        choice reference DemOBDInputAmbientPressure [0..1]: set at pre-compile, destination=[DemExternalCSDataElementClass, DemExternalSRDataElementClass]  # Input variable for the ambient pressure, which is assigned to a specific data element used as interface for the Dem-internal PID calculations.
        choice reference DemOBDInputAmbientTemperature [0..1]: set at pre-compile, destination=[DemExternalCSDataElementClass, DemExternalSRDataElementClass]  # Input variable for the ambient temperature, which is assigned to a specific data element used as interface for the Dem-internal PID calculations.
        choice reference DemOBDInputDistanceInformation [0..1]: set at pre-compile, destination=[DemExternalCSDataElementClass, DemExternalSRDataElementClass]  # Input variable for the distance information, which is assigned to a specific data element used as interface for the Dem-internal PID calculations.
        choice reference DemOBDInputEngineSpeed [0..1]: set at pre-compile, destination=[DemExternalCSDataElementClass, DemExternalSRDataElementClass]  # Input variable for the engine speed, which is assigned to a specific data element used as interface for the Dem-internal PID calculations.
        choice reference DemOBDInputEngineTemperature [0..1]: set at pre-compile, destination=[DemExternalCSDataElementClass, DemExternalSRDataElementClass]  # Input variable for the engine temperature, which is assigned to a specific data element used as interface for the Dem-internal PID calculations.
        choice reference DemOBDInputProgrammingEvent [0..1]: set at pre-compile, destination=[DemExternalCSDataElementClass, DemExternalSRDataElementClass]  # Input variable for the programming event, which is assigned to a specific data element used as interface for the Dem-internal PID calculations.
        choice reference DemOBDInputVehicleSpeed [0..1]: set at pre-compile, destination=[DemExternalCSDataElementClass, DemExternalSRDataElementClass]  # Input variable for the vehicle speed, which is assigned to a specific data element used as interface for the Dem-internal PID calculations.
        choice reference DemOBDTimeSinceEngineStart [0..1]: set at pre-compile, destination=[DemExternalCSDataElementClass, DemExternalSRDataElementClass, DemInternalDataElementClass]  # Input variable for the Time Since Engine Start information, which is assigned to a specific data element.
        container DemCallbackOBDDTCStatusChanged [0..*]  # The presence of this container indicates, that the Dem has access to a "DTCStatusChanged" callback, which the Dem will call to notify other components about the change in the status of a DTC. | In case there is a DemCallbackDTCStatusChangedFnc, this parameter defines the name of the function that the Dem will call. In case there is no DemCallbackDTCStatusChangedFnc, the Dem will have an R-Port requiring the interface CallbackDTCStatusChanged whose name is generated by using the unique callback-prefix followed by the event name. Status change notifications are supported for DTCs in primary memory only.
          function name DemCallbackDTCStatusChangedFnc [0..1]: set at pre-compile  # Function name of prototype "DTCStatusChanged". | Note: If the parameter DemTriggerDcmReports is enabled, this parameter shall not be "Dcm_DemTriggerOnDTCStatus".
      container DemGroupOfDTC [0..255]  # This container contains the configuration (parameters) for DTC groups.
        integer DemGroupDTCs: 0..16777214, set at pre-compile, symbolic-name-value=true  # DTC value of the selected group of DTC | (Range: 3 byte, 0x000000 is only available for the emission-related DTC group, 0xFFFFFF is reserved for 'all DTCs', according to ISO14229-1 Annex D.1,) The DTC group 'all DTCs' is always available and will not be configured.
      container DemIndicator [0..255]  # This container contains the configuration (parameters) for Indicators. | Note that this container definition does not explicitly define a symbolic name parameter. Instead, the short name of the container will be used in the Ecu Configuration Description to specify the symbolic name of the INDICATOR_NAME.
        integer DemIndicatorID: 0..255, set at pre-compile, symbolic-name-value=true  # Unique identifier of an indicator.
      container DemNvRamBlockId [0..*]  # This container contains the configuration (parameters) for a non-volatile memory block, which is used from the Dem. If no permanent storage of event memory entries is required, no block needs to be configured. | The number of blocks which are necessary depends on the implementation and configuration (e.g. number of used event memories) of the Dem module.
        symbolic name reference DemNvRamBlockIdRef: set at pre-compile, origin=AUTOSAR_ECUC V1.0.0, destination=NvMBlockDescriptor  # This reference contains the link to a non-volatile memory block. For post build time configurations worst case scenario shall be used.
      container DemOperationCycle [1..256]  # Note that this container definition does not explicitly define a symbolic name parameter. Instead, the short name of the container will be used in the Ecu Configuration Description to specify the symbolic name of the operation cycle name.
        boolean DemOperationCycleAutomaticEnd: set at pre-compile, default-value=false  # If DemOperationCycleAutomaticEnd is configured to TRUE, Dem shall automatically end the driving cycle at either Dem_Shutdown() or Dem_Init().
        boolean DemOperationCycleAutostart: set at pre-compile, default-value=false  # The autostart property defines if the operation cycles is automatically (re-)started during Dem_PreInit.
        enumeration DemOperationCycleType: {DEM_OPCYC_IGNITION, DEM_OPCYC_OBD_DCY, DEM_OPCYC_OTHER, DEM_OPCYC_POWER, DEM_OPCYC_TIME, DEM_OPCYC_WARMUP}, set at pre-compile  # Operation cycles types for the Dem to be supported by cycle-state APIs. | Further cycle types can be specified as part of the Dem delivery.
      container DemRatio [0..65535]  # This container contains the OBD-specific in-use-monitor performance ratio configuration. | It is related to a specific event, a FID, and an IUMPR group.
        enumeration DemIUMPRDenGroup: {DEM_IUMPR_DEN_500MILL, DEM_IUMPR_DEN_COLDSTART, DEM_IUMPR_DEN_EVAP, DEM_IUMPR_DEN_NONE, DEM_IUMPR_DEN_PHYS_API}, set at pre-compile  # This parameter specifies the assigned denominator type which is applied in addition to the General Denominator conditions.
        enumeration DemIUMPRGroup: {DEM_IUMPR_BOOSTPRS, DEM_IUMPR_CAT1, DEM_IUMPR_CAT2, DEM_IUMPR_EGR, DEM_IUMPR_EGSENSOR, DEM_IUMPR_EVAP, DEM_IUMPR_FLSYS, DEM_IUMPR_NMHCCAT, DEM_IUMPR_NOXADSORB, DEM_IUMPR_NOXCAT, DEM_IUMPR_OXS1, DEM_IUMPR_OXS2, DEM_IUMPR_PMFILTER, DEM_IUMPR_PRIVATE, DEM_IUMPR_SAIR, DEM_IUMPR_SECOXS1, DEM_IUMPR_SECOXS2}, set at pre-compile  # This parameter specifies the assigned IUMPR group of the ratio Id.
        integer DemRatioId: 0..65535, set at pre-compile, symbolic-name-value=true  # Defines a unique ratio Id. | This parameter should not be changeable by user, because the Id should be generated by Dem itself to prevent gaps and multiple use of an Id. The ratio Ids should be sequentially ordered beginning with 0 and no gaps in between.
        enumeration DemRatioKind: {DEM_RATIO_API, DEM_RATIO_OBSERVER}, set at pre-compile  # This parameter defines whether the ratio will be calculated API or observer based.
        reference DemDiagnosticEventRef: set at pre-compile, destination=DemEventParameter  # This reference contains the link to a diagnostic event.
        symbolic name reference DemFunctionIdRef: set at pre-compile, destination=FiMFID  # This reference contains the link to a function identifier within the FiM which is used as a primary FID.
        symbolic name reference DemSecondaryFunctionIdRef [0..*]: set at pre-compile, destination=FiMFID  # This reference contains the link to a function identifier within the FiM which is used as a secondary FID. | The "primary" and all "secondary" FID inhibitions are combined by "OR".
      container DemStorageCondition [0..255]  # This container contains the configuration (parameters) for storage conditions.
        integer DemStorageConditionId: 0..255, set at pre-compile, symbolic-name-value=true  # Defines a unique storage condition Id. This parameter should not be changeable by user, because the Id should be generated by Dem itself to prevent gaps and multiple use of an Id. The storage conditions should be sequentially ordered beginning with 0 and no gaps in between.
        boolean DemStorageConditionStatus: set at pre-compile  # Defines the initial status for enable or disable of storage of a diagnostic event. | The value is the initialization after power up (before this condition is reported the first time). true: storage of a diagnostic event enabled false: storage of a diagnostic event disabled
      container DemStorageConditionGroup [0..255]  # This container contains the configuration (parameters) for storage condition groups.
        reference DemStorageConditionRef [1..255]: set at pre-compile, origin=AUTOSAR_ECUC V1.0.0, destination=DemStorageCondition  # References an enable condition.
      container DemClient [1..255]  # This container contains possible clients that are using the Dem APIs.
        integer DemClientId: 0..255, symbolic-name-value=true  # Defines a unique identifier for a Dem client. This number is used by this client in the ClientID parameter in all API with this parameter.
