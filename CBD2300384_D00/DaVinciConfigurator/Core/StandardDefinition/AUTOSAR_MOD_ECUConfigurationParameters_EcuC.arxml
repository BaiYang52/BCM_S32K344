AUTOSAR XML (schema 4-0-3)
# The material contained in this specification is protected by copyright and
# other types of Intellectual Property Rights. The commercial exploitation of
# the material contained in this specification requires a license to such
# Intellectual Property Rights.
# This specification may be utilized or reproduced without any modification, in
# any form or by any means, for informational purposes only.
# For any other purpose, no part of the specification may be utilized or
# reproduced, in any form or by any means, without permission in writing from
# the publisher.
# licensed under the same rules as applicable to the AUTOSAR Standard.
package /AUTOSAR/EcucDefs
  module definition EcuC [0..1]: variants post-build/pre-compile  # Virtual module to collect ECU Configuration specific / global configuration information.
    container EcucPartitionCollection [0..1]  # Collection of Partitions defined for this ECU.
      container EcucPartition [0..*]  # Definition of one Partition on this ECU. | One Partition will be implemented using one Os-Application.
        boolean EcucPartitionBswModuleExecution: set at pre-compile  # Denotes that this partition will execute all BSW Modules. BSW Modules can only be executed in one partition.
        boolean PartitionCanBeRestarted: set at pre-compile  # Specifies the requirement whether the Partition can be restarted. If set to true all software executing in this partition shall be capable of handling a restart.
        instance reference EcucPartitionSoftwareComponentInstanceRef [0..*]: set at pre-compile, destination-context=ROOT-SW-COMPOSITION-PROTOTYPE, destination-type=SW-COMPONENT-PROTOTYPE  # References the SW Component instances from the Ecu Extract that shall be executed in this partition.
    container EcucPduCollection [0..1]  # Collection of all Pdu objects flowing through the Com-Stack.
      enumeration PduIdTypeEnum: {UINT16, UINT8}  # The PduIdType is used within the entire AUTOSAR Com Stack except for bus drivers. The size of this global type depends on the maximum number of PDUs used within one software module. If no software module deals with more PDUs that 256, this type can be set to uint8. If at least one software module handles more than 256 PDUs, this type must be set to uint16. See AUTOSAR_SWS_CommunicationStackTypes for more details.
      enumeration PduLengthTypeEnum: {UINT16, UINT32, UINT8}  # The PduLengthType is used within the entire AUTOSAR Com Stack except for bus drivers. The size of this global type depends on the maximum length of PDUs to be sent by an ECU. If no segmentation is used the length depends on the maximum payload size of a frame of the underlying communication system (for FlexRay maximum size is 255 bytes, therefore uint8). If segementation is used it depends on the maximum length of a segmeneted N-PDU (in general uint16 is used). See AUTOSAR_SWS_CommunicationStackTypes for more details.
      container Pdu [0..*]  # One Pdu flowing through the COM-Stack. | This Pdu is used by all Com-Stack modules to agree on referencing the same Pdu.
        integer PduLength: 0..4095, set at post-build in variant post-build / pre-compile in variant pre-compile  # Length of the Pdu in bytes. It should be noted that in former AUTOSAR releases (Rel 2.1, Rel 3.0, Rel 3.1, Rel 4.0 Rev. 1) this parameter was defined in bits.
        foreign reference SysTPduToFrameMappingRef [0..1]: set at pre-compile, destination-type=PDU-TO-FRAME-MAPPING  # Optional reference to the PduToFrameMapping from the SystemTemplate which this Pdu represents.
        reference EcucPduDefaultPartitionRef [0..1]: set at pre-compile, origin=Vector Informatik, destination=EcucPartition  # Reference to EcucPartition, where the according Pdu is assigned to.
        container EcucPduDedicatedPartition [0..*]  # Module specific container for Pdu to partition assignment.
          foreign reference EcucPduDedicatedPartitionBswModuleRef: set at pre-compile, origin=Vector Informatik, destination-type=ECUC-MODULE-CONFIGURATION-VALUES  # Reference to BSW module, for which the according dedicated Pdu assignment is valid.
          reference EcucPduDedicatedPartitionRef: set at pre-compile, origin=Vector Informatik, destination=EcucPartition  # Module specific reference to EcucPartition, where the according Pdu is assigned to. The dedicated partition reference shall overrule the default partition reference for the respective module.
    container EcucVariationResolver [0..1]  # Collection of PredefinedVariant elements containing definition of values for SwSystemconst which shall be applied when resolving the variability during ECU Configuration.
      foreign reference PredefinedVariantRef [1..*]: set at pre-compile, destination-type=PREDEFINED-VARIANT
    container EcucHardware [0..1]  # Hardware definition of this Ecu.
      container EcucCoreDefinition [0..*]  # Definition of one Core on this Ecu.
        integer EcucCoreId: 0..65535, set at pre-compile, symbolic-name-value=true  # ID of the core.
        foreign reference EcucCoreHwRef [0..1]: set at pre-compile, destination-type=HW-ELEMENT  # Optional reference to the HwElement of HwCategory ProcessingUnit that represents this Core in the ECU Resource Template.
