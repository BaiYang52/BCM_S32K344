AUTOSAR XML (schema 4-0-3)
# The material contained in this specification is protected by copyright and
# other types of Intellectual Property Rights. The commercial exploitation of
# the material contained in this specification requires a license to such
# Intellectual Property Rights.
# This specification may be utilized or reproduced without any modification, in
# any form or by any means, for informational purposes only.
# For any other purpose, no part of the specification may be utilized or
# reproduced, in any form or by any means, without permission in writing from
# the publisher.
# licensed under the same rules as applicable to the AUTOSAR Standard.
package /AUTOSAR/EcucDefs
  module definition EthIf [0..1]: variants link-time/post-build/pre-compile  # Configuration of the EthIf (Ethernet Interface) module.
    container EthIfConfigSet: multiple-configuration-container=true  # Collecting container for all parameters with post-build configuration classes.
      container EthIfController [1..*]  # This container contains the configuration of EthIfController.
        integer EthIfCtrlIdx: 0..255, set at link in variant link-time / post-build in variant post-build / pre-compile in variant pre-compile, symbolic-name-value=true  # This parameter provides a zero-based consecutive index of the Ethernet Communication Controllers. Upper layer BSW modules and the EthIf itself use this index to identify a Ethernet CC.
        integer EthIfCtrlMtu: 64..9000, set at link in variant link-time / post-build in variant post-build / pre-compile in variant pre-compile  # Specifies the maximum transmission unit (MTU) of the EthIfCtrl in [bytes]. | Note: in case a VLAN tag is used for the EthIfCtrl, the MTU is 4 bytes smaller than the maximum payload size of an Ethernet frame which can be transmitted on the network.
        integer EthIfVlanId: 0..4095, set at link in variant link-time / post-build in variant post-build / pre-compile in variant pre-compile  # A virtual-LAN is identified by this attribute according to IEEE 802.1Q.
        symbolic name reference EthIfPhysControllerRef: set at link in variant link-time / post-build in variant post-build / pre-compile in variant pre-compile, destination=EthCtrlConfig  # Reference to the Ethernet controller used for sending/receiving Ethernet frames and controlled by the EthIf mode management.
        symbolic name reference EthIfTransceiverRef: set at link in variant link-time / post-build in variant post-build / pre-compile in variant pre-compile, destination=EthTrcvConfig  # Reference to the Ethernet transceiver used to retrieve the link state and controlled by the EthIf mode management.
        symbolic name reference EthIfSwitchRef [0..*]: set at pre-compile, destination=EthIfSwitch  # Reference to the Ethernet switch controlled by the EthIf mode management.
        symbolic name reference EthIfSwitchPortGroupRef [0..1]: set at pre-compile, destination=EthIfSwitchPortGroup
      container EthIfFrameOwnerConfig [1..*]  # Configuration of Ethernet frame owner
        integer EthIfFrameType: 0..65535, set at link in variant link-time / post-build in variant post-build / pre-compile in variant pre-compile  # Selects the Ethernet frame type.
        integer EthIfOwner: 0..255, set at link in variant link-time / post-build in variant post-build / pre-compile in variant pre-compile  # Selects the owner of an Ethernet frame type. The owner is a zero based index into the callback function configuration 'EthIfRxIndicationConfig'. I.e. an Ethernet frame of type IPv4 (0x800) at index 0 will call the first callback function configured in 'EthIfRxIndicationConfig'.
      container EthIfRxIndicationConfig [1..*]  # Configuration of receive callback functions.
        function name EthIfRxIndicationFunction: set at link in variant link-time / post-build in variant post-build / pre-compile in variant pre-compile  # Specifies receive indication callback function.
      container EthIfTrcvLinkStateChgConfig [1..*]  # Specifies link state change callback function
        function name EthIfTrcvLinkStateChgFunction: set at link in variant link-time / post-build in variant post-build / pre-compile in variant pre-compile  # Specifies link state change callback function
      container EthIfTxConfirmationConfig [1..*]  # Configuration of transmit indication callback functions.
        function name EthIfTxConfirmationFunction: set at link in variant link-time / post-build in variant post-build / pre-compile in variant pre-compile  # Specifies transmit indication callback function
      container EthIfSwitch [0..*]  # This container is used to globally index all hardware switches that are used by the Ethernet Interface. The index may be used by upper layers like the DHCP server component as a unique identifier when calling a Ethernet Interface API. Besides the global index a reference to a hardware switch configuration container resides in this container.
        integer EthIfSwitchIndex: 0..255, set at pre-compile, symbolic-name-value=true, default-value=0  # This value specifies a globally unique index for each hardware Ethernet Switch that is used by the Ethernet Interface. The index is zero-based and incremented by one for each hardware switch.
        symbolic name reference EthIfEthSwtRef: set at pre-compile, destination=EthSwtConfig  # Reference to a Ethernet Switch configuration container.
    container EthIfGeneral  # This container contains the general configuration parameters of the Ethernet Interface.
      boolean EthIfDevErrorDetect: set at pre-compile  # Enables / Disables development error detection.
      boolean EthIfEnableRxInterrupt: set at pre-compile  # Enables / Disables receive interrupt.
      boolean EthIfEnableTxInterrupt: set at pre-compile  # Enables / Disables the transmit interrupt.
      boolean EthIfGetBaudRate: set at pre-compile  # Enables / Disables GetBaudRate API.
      boolean EthIfGetCounterState: set at pre-compile  # Enables / Disables GetCounterState API.
      float EthIfMainFunctionPeriod: 0..Inf, set at pre-compile  # Specifies the period of main function EthIf_MainFunctionRx and EthIf_MainFunctionTx in seconds. Ethernet Interface does not require this information but the BSW scheduler.
      float EthIfMainFunctionRxTimeout: 0..Inf, set at pre-compile  # Timeout in seconds after which the EthIf stops to receive frames in an EthIfMainFunctionRx period.
      integer EthIfMaxTrcvsTotal: 1..255, set at pre-compile  # Limits the total number of transceivers.
      integer EthIfMaxTxBufsTotal: 1..255, set at pre-compile  # Limits the total number of transmit buffers.
      string EthIfPublicCddHeaderFile [0..*]: set at pre-compile, max-length=32, min-length=1  # Defines header files for callback functions which shall be included in case of CDDs. Range of characters is 1.. 32.
      integer EthIfRxIndicationIterations: 0..65535, set at pre-compile  # Maximum number of Ethernet frames per Ethernet controller polled from the Ethernet driver within EthIf_MainFunctionRx.
      boolean EthIfStartAutoNegotiation: set at pre-compile  # Enables / Disables StartAutoNegotiation API.
      integer EthIfTrcvLinkStateChgMainReload: 1..255, set at pre-compile  # Specifies the frequency of transceiver link state change checks in each | period of main function EthIf_MainFunctionTx.
      boolean EthIfVersionInfoApi: set at pre-compile  # Enables / Disables version info API
      boolean EthIfVersionInfoApiMacro: set at pre-compile  # Enables / Disables version info API macro implementation.
