AUTOSAR XML (schema 4-0-3)
# The material contained in this specification is protected by copyright and
# other types of Intellectual Property Rights. The commercial exploitation of
# the material contained in this specification requires a license to such
# Intellectual Property Rights.
# This specification may be utilized or reproduced without any modification, in
# any form or by any means, for informational purposes only.
# For any other purpose, no part of the specification may be utilized or
# reproduced, in any form or by any means, without permission in writing from
# the publisher.
# licensed under the same rules as applicable to the AUTOSAR Standard.
package /AUTOSAR/EcucDefs
  ecuc definition collection AUTOSARParameterDefinition: module=[Adc, BswM, Cal, Can, CanIf, CanNm, CanSM, CanTp, CanTrcv, Cdd, Com, ComM, CorTst, Crc, Csm, Dbg, Dcm, Dem, Det, Dio, Dlt, DoIP, Ea, Ecom, EcuC, EcuM, Eep, Eth, EthIf, EthSM, EthSwt, EthTrcv, Fee, FiM, Fls, FlsTst, Fr, FrArTp, FrIf, FrNm, FrSM, FrTp, FrTrcv, Gpt, Icu, IdsM, IpduM, J1939Dcm, J1939Nm, J1939Rm, J1939Tp, KeyM, Lin, LinIf, LinNm, LinSM, LinTp, LinTrcv, Mcu, MemIf, MemMap, Nm, NvM, Os, PduR, Port, Pwm, RamTst, Rte, Sd, SecOC, SoAd, Spi, StbM, TcpIp, UdpNm, Wdg, WdgIf, WdgM, Xcp]
