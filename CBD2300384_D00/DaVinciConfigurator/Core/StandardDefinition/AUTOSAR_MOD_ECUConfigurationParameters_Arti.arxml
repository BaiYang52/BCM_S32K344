AUTOSAR XML (schema 00049)
package /AUTOSAR/EcucDefs
  module definition Arti [0..1]  # The Arti Module serves as a superordinate container collecting all information and parameters concerning ARTI.
    container ArtiGeneric [0..1]  # The ArtiGeneric container contains definitions for generic objects, i.e. not belonging to a standard AUTOSAR module.
      container ArtiGenericComponentClass [0..*]  # The class definition describes the layout of the object (similar to a "class" definition in C).
        string ArtiGenericComponentClassName  # Name of the class.
        container ArtiGenericComponentClassParameter [0..*]  # Parameter definition of a class.
          string ArtiGenericComponentClassParameterName  # Name of the parameter.
          reference ArtiGenericComponentClassParameterTypeMapRef [0..1]: destination=ArtiParameterTypeMap  # Refers to a parameter type to interpret the parameter value.
      container ArtiGenericComponentInstance [0..*]  # The instance definition describes a specific instantiated object.
        string ArtiGenericComponentInstanceName  # Name of the instance.
        reference ArtiGenericComponentInstanceClassRef: destination=ArtiGenericComponentClass  # Refers to a ArtGenericClass of which this object is instantiated.
        container ArtiGenericComponentInstanceParameter [0..*]  # Parameter definition of an instance.
          reference ArtiGenericComponentInstanceParameterClassParameterRef [0..*]: destination=ArtiGenericComponentClassParameter  # Refers to an ArtiGenericComponentClassParameter that defines this parameter.
          reference ArtiGenericComponentInstanceParameterConstantRef [0..1]: destination=ArtiConstant  # Refers to an ArtiConstant that represents the value of this parameter.
          reference ArtiGenericComponentInstanceParameterExpressionRef [0..1]: destination=ArtiExpression  # Refers to an ArtiExpression that evaluates the value of this parameter.
          reference ArtiGenericComponentInstanceParameterHookRef [0..1]: destination=ArtiHook  # Refers to a hook that records this parameter.
    container ArtiHardware [0..1]  # The ArtiHardware container contains ARTI extensions to the EcucHardware module.
      container ArtiHardwareCoreClass [0..1]  # Contains the layout of an ARTI "Core" object, extending the EcucCoreDefinition.
        reference ArtiHardwareCoreClassCurrentApplicationRef: destination=ArtiObjectClassParameter  # Refers to the ArtiObjectClassParameter that defines the ArtiCurrentApplicationInstance parameter.
        reference ArtiHardwareCoreClassCurrentIsrRef [0..1]: destination=ArtiObjectClassParameter  # Refers to the ArtiObjectClassParameter that defines the ArtiCurrentIsrInstance parameter.
        reference ArtiHardwareCoreClassCurrentTaskRef: destination=ArtiObjectClassParameter  # Refers to the ArtiObjectClassParameter that defines the ArtiCurrentTaskInstance parameter.
        reference ArtiHardwareCoreClassGenericComponentRef [0..1]: destination=ArtiGenericComponentClass  # Refers to an ArtiGenericComponentClass that extends the core description.
        reference ArtiHardwareCoreClassLastErrorRef [0..1]: destination=ArtiObjectClassParameter  # Refers to the ArtiObjectClassParameter that defines the ArtiLastErrorInstance parameter.
        reference ArtiHardwareCoreClassRunningTaskPriorityRef [0..1]: destination=ArtiObjectClassParameter  # Refers to the ArtiObjectClassParameter that defines the ArtiHwCoreInstanceRunningTaskPriority parameter. This attribute specifies how to evaluate the current priority of the task referred by RUNNINGTASK. The current priority can be different from the static task priority as a result of priority ceiling protocol. This attribute differs from ArtiCurrentTask->ArtiOsTaskClassPriority as here is a single variable while in multiple tasks there is a single variable per task.
      container ArtiHardwareCoreInstance [0..*]  # Description: Represents an instance of an ARTI "Core" object, extending the EcucCoreDefinition. When using ARTI for debugging or hardware based tracing, this is mandatory (i.e. multiplicity 1..*), else optional.
        integer ArtiHardwareCoreInstanceCoreId: 0..18446744073709551615  # This parameter represents the "CoreID" as given by the OS, returned by GetCoreID().
        reference ArtiHardwareCoreInstanceCurrentApplicationRef: destination=ArtiObjectInstanceParameter  # Refers to the ArtiObjectInstanceParameter that contains the evaluation for the "current application" that is running on this core.
        reference ArtiHardwareCoreInstanceCurrentIsrRef [0..1]: destination=ArtiObjectInstanceParameter  # Refers to the ArtiObjectInstanceParameter that contains the evaluation for the "current ISR" that is running on this core.
        reference ArtiHardwareCoreInstanceCurrentTaskRef: destination=ArtiObjectInstanceParameter  # Refers to the ArtiObjectInstanceParameter that contains the evaluation for the "current task" that is running on this core.
        reference ArtiHardwareCoreInstanceEcucCoreRef: destination=EcucCoreDefinition  # Refers to the EcucCoreDefinition of this core.
        reference ArtiHardwareCoreInstanceGenericComponentRef [0..1]: destination=ArtiGenericComponentInstance  # Refers to an ArtiGenericComponentInstance that extends a core.
        reference ArtiHardwareCoreInstanceLastErrorRef [0..1]: destination=ArtiObjectInstanceParameter  # Refers to the ArtiObjectInstanceParameter that contains the evaluation for the "last error" that happened on this core.
        reference ArtiHardwareCoreInstanceRunningTaskPriorityRef [0..1]: destination=ArtiObjectInstanceParameter  # Refers to the ArtiObjectInstanceParameter that contains the evaluation for the "running task priority" that is on this core.
        reference ArtiHardwareCoreInstanceValidRef [0..1]: destination=ArtiObjectInstanceParameter  # Refers to the ArtiObjectInstanceParameter that contains the evaluation for the "validity" of this ArtiHwCoreInstance. Every object declaration may contain a VALID attribute telling the debugger whether the object's attributes are currently valid. It may have an integer type of any size. Its possible values are 0 (invalid) and non zero (object is valid).
    container ArtiOs [0..1]  # The ArtiOs container contains ARTI extensions to the EcucDefs/Os module.
      container ArtiOsAlarmClass [0..1]  # Contains the layout of an ArtiOsAlarm object.
        reference ArtiOsAlarmClassGenericComponentClassRef [0..1]: destination=ArtiGenericComponentClass  # Refers to an ArtiGenericComponentClass that extends the ArtiOsAlarmClass.
        reference ArtiOsAlarmClassStateRef [0..1]: destination=ArtiObjectClassParameter  # Refers to the ArtiObjectClassParameter that declares the attribute ArtiOsAlarmStateRef in ArtiOsAlarmInstances. This attribute specifies if an alarm is "RUNNING" or "STOPPED". The refered ArtiObjectClassParameter does include the mapping from integer to human readable "RUNNING" or "STOPPED".
      container ArtiOsAlarmInstance [0..*]  # Represents an instance of an ArtiOsAlarm object, extending the EcuC OsTaskAlarm.
        string ArtiOsAlarmInstanceAction [0..1]  # This attribute provides a string with a description of the action when the alarm expires, e.g. "ActivateTask TaskA".
        string ArtiOsAlarmInstanceCounter [0..1]  # This attribute provides a string containing the name of the counter used by this alarm.
        reference ArtiOsAlarmInstanceAlarmTimeRef [0..1]: destination=ArtiObjectInstanceParameter  # This attribute specifies how to evaluate the time until the alarm expires next. The time should be represented in seconds.
        reference ArtiOsAlarmInstanceCycleTimeRef [0..1]: destination=ArtiObjectInstanceParameter  # This attribute specifies how to evaluate the cycle time for cyclic alarms. The value of "cycle time" is 0 for non-cyclic alarms. The time should be represendet in seconds.
        reference ArtiOsAlarmInstanceEcuCRef [0..1]: destination=OsAlarm  # Refers to an EcuC OsAlarm that is beeing extended.
        reference ArtiOsAlarmInstanceGenericComponentInstanceRef [0..1]: destination=ArtiGenericComponentInstance  # Refers to an ArtiGenericComponentInstance that extends the ArtiOsAlarmInstance.
        reference ArtiOsAlarmInstanceStateRef [0..1]: destination=ArtiObjectInstanceParameter  # Refers to the ArtiObjectInstanceParameter that contains the evaluation for the "state" of this alarm. The result then is mapped with the typemap of the ArtiOsAlarmStateRef of the ArtiOsAlarmClass.
        reference ArtiOsAlarmInstanceValidRef [0..1]: destination=ArtiObjectInstanceParameter  # Refers to the ArtiObjectInstanceParameter that contains the evaluation for the "validity" of this alarm. Every object declaration may contain a VALID attribute telling the debugger whether the object's attributes are currently valid. It may have an integer type of any size. Its possible values are 0 (invalid) and non zero (object is valid).
      container ArtiOsClass [0..1]  # Contains the layout of an ARTI "Os" object, extending the EcuC OsOS.
        reference ArtiOsClassAppModeRef: destination=ArtiObjectClassParameter  # Refers to the ArtiObjectClassParameter that defines the ArtiOsAppModeInstance parameter.
        reference ArtiOsClassGenericComponentRef [0..1]: destination=ArtiGenericComponentClass  # Refers to an ArtiGenericComponentClass that extends the OS description.
        reference ArtiOsClassServiceTraceRef [0..1]: destination=ArtiObjectClassParameter  # Refers to the ArtiObjectClassParameter that defines the ArtiOsInstanceServiceTrace parameter. This attribute indicates the entry or exit of a service routine and the ID of this service routine. The value of this attribute must be evaluated from one single memory location.
      container ArtiOsContextClass [0..1]  # Contains the layout of an ARTI "OsContext" object.
        reference ArtiOsContextClassGenericComponentClassRef [0..1]: destination=ArtiGenericComponentClass  # Refers to an ArtiGenericComponentClass that extends the ArtiOsContextClass.
      container ArtiOsContextInstance [0..*]  # Represents an instance of an "ArtiContext" object.
        reference ArtiOsContextInstanceAddressRef [0..1]: destination=ArtiObjectInstanceParameter  # Refers to the ArtiObjectInstanceParameter that contains the evaluation for the "address" of this context.
        reference ArtiOsContextInstanceGenericComponentInstanceRef [0..1]: destination=ArtiGenericComponentInstance  # Refers to an ArtiGenericComponentInstance that extends the ArtiOsContext.
        reference ArtiOsContextInstanceSizeRef [0..1]: destination=ArtiObjectInstanceParameter  # Refers to the ArtiObjectInstanceParameter that contains the evaluation for the "size" of this context.
        reference ArtiOsContextInstanceValidRef [0..1]: destination=ArtiObjectInstanceParameter  # Refers to the ArtiObjectInstanceParameter that contains the evaluation for the "validity" of this context. Every object declaration may contain a VALID attribute telling the debugger whether the object's attributes are currently valid. It may have an integer type of any size. Its possible values are 0 (invalid) and non zero (object is valid).
      container ArtiOsInstance [0..1]  # Represents an instance of an ARTI "Os" object, extending the EcuC OsOS.
        reference ArtiOsInstanceAppModeRef: destination=ArtiObjectInstanceParameter  # Refers to the ArtiObjectInstanceParameter that contains the evaluation for the "application mode" of this OS.
        reference ArtiOsInstanceEcucRef: destination=OsOS  # Refers to the EcucDefs/Os/OsOS of this OS.
        reference ArtiOsInstanceGenericComponentRef [0..1]: destination=ArtiGenericComponentInstance  # Refers to an ArtiGenericComponentInstance that extends the OS.
        reference ArtiOsInstanceHookRef [0..*]: destination=ArtiHook  # Refers to a hook defined in the OS.
        reference ArtiOsInstanceServiceTraceRef [0..1]: destination=ArtiObjectInstanceParameter  # Refers to a hook defined in the OS.
        reference ArtiOsInstanceValidRef [0..1]: destination=ArtiObjectInstanceParameter  # Refers to the ArtiObjectInstanceParameter that contains the evaluation for the "validity" of this ArtiOsInstance. Every object declaration may contain a VALID attribute telling the debugger whether the object's attributes are currently valid. It may have an integer type of any size. Its possible values are 0 (invalid) and non zero (object is valid).
      container ArtiOsIsrClass [0..1]  # Contains the layout of an ARTI "OsIsr" object, extending the EcuC OsIsr.
        reference ArtiOsIsrClassGenericComponentRef [0..1]: destination=ArtiGenericComponentClass  # Refers to an optional ArtiGenericComponentClass that extends the OsIsr with additional parameters.
      container ArtiOsIsrInstance [0..*]  # Represents an instance of an ARTI "OsIsr" object, extending the EcuC OsIsr.
        enumeration ArtiOsIsrInstanceCategory [0..1]: {CATEGORY_1, CATEGORY_2}  # Specifies category of this ISR. If omitted the instance is related to a CATEGORY_2.
        function name ArtiOsIsrInstanceFunction [0..1]  # This parameter represents the C function name of the ISR routine.
        integer ArtiOsIsrInstanceId: 0..18446744073709551615  # This parameter represents the "ISRID" as given by the OS, returned by GetISRID().
        reference ArtiOsIsrInstanceEcucRef [0..1]: destination=OsIsr  # Refers to the EcucDefs/Os/OsIsr of this ISR.
        reference ArtiOsIsrInstanceGenericComponentRef [0..1]: destination=ArtiGenericComponentInstance  # Refers to an optional ArtiGenericComponentInstance that extends this OsIsr with additional parameters.
        reference ArtiOsIsrInstanceValidRef [0..1]: destination=ArtiObjectInstanceParameter  # Refers to the ArtiObjectInstanceParameter that contains the evaluation for the "validity" of this ArtiOsIsrInstance. Every object declaration may contain a VALID attribute telling the debugger whether the object's attributes are currently valid. It may have an integer type of any size. Its possible values are 0 (invalid) and non zero (object is valid).
      container ArtiOsMessageContainerClass [0..1]  # Contains the layout of an ARTI "OsMessageContainer" object. The "OsMessageContainer" object represents an existing combination of OSEK messages.
        reference ArtiOsMessageContainerClassGenericComponentClassRef [0..1]: destination=ArtiGenericComponentClass  # Refers to an ArtiGenericComponentClass that extends the ArtiOsMessageContainerClass.
      container ArtiOsMessageContainerInstance [0..*]  # Represents an instance of an "ArtiMessageContainer" object.
        string ArtiOsMessageContainerInstanceMsgName [0..1]  # This attribute provides the name of the message as defined in OIL file.
        string ArtiOsMessageContainerInstanceMsgType [0..1]  # This attribute provides the type of the message.
        reference ArtiOsMessageContainerInstanceFirstElementRef [0..1]: destination=ArtiObjectInstanceParameter  # Refers to the ArtiObjectInstanceParameter that contains the evaluation for the "firstelement" of this "ArtiOsMessageContainer". This attribute provides the formula for evaluation of address of first valid message. This message will be received next. If no message is in the queue the value is zero.
        reference ArtiOsMessageContainerInstanceGenericComponentInstanceRef [0..1]: destination=ArtiGenericComponentInstance  # Refers to an ArtiGenericComponentInstance that extends the ArtiOsMessageContainerInstance.
        reference ArtiOsMessageContainerInstanceQueueCountRef [0..1]: destination=ArtiObjectInstanceParameter  # Refers to the ArtiObjectInstanceParameter that contains the evaluation for the "queuecount" of this "ArtiOsMessageContainer". This attribute provides the number of valid messages in the queue and "1" for unqueued messages.
        reference ArtiOsMessageContainerInstanceQueueSizeRef [0..1]: destination=ArtiObjectInstanceParameter  # Refers to the ArtiObjectInstanceParameter that contains the evaluation for the "queuesize" of this "ArtiOsMessageContainer". This attribute provides the size of the queue for queued messages and "1" for unqueued messages.
        reference ArtiOsMessageContainerInstanceValidRef [0..1]: destination=ArtiObjectInstanceParameter  # Refers to the ArtiObjectInstanceParameter that contains the evaluation for the "validity" of this ArtiOsMessageContainerInstance. Every object declaration may contain a VALID attribute telling the debugger whether the object's attributes are currently valid. It may have an integer type of any size. Its possible values are 0 (invalid) and non zero (object is valid).
      container ArtiOsResourceClass [0..1]  # Contains the layout of an ArtiOsResource object. The ArtiOsResource object represents an OSEK resource.
        reference ArtiOsResourceClassGenericComponentClassRef [0..1]: destination=ArtiGenericComponentClass  # Refers to an ArtiGenericComponentClass that extends the ArtiOsResourceClass.
        reference ArtiOsResourceClassLockerRef [0..1]: destination=ArtiObjectClassParameter  # Refers to the ArtiObjectClassParameter that declares the attribute ArtiOsResourceLockerRef in ArtiOsResourceInstances. This attribute indicates the locking ArtiOsTaskInstance or ArtiOsIsrInstance.
        reference ArtiOsResourceClassStateRef [0..1]: destination=ArtiObjectClassParameter  # Refers to the ArtiObjectClassParameter that declares the attribute ArtiOsResourceStateRef in ArtiOsResourceInstances. This attribute represents the state of a resource ("LOCKED"/"UNLOCKED"). The ArtiObjectClassParameter does include the mapping from integer to human readable "LOCKED" or "UNLOCKED".
      container ArtiOsResourceInstance [0..*]  # Represents an instance of an ArtiOsResource object.
        string ArtiOsResourceInstancePriority [0..1]  # This attribute has two components that state: that the RESOURCE is used by TASKs only or by TASKs and ISRs, and the priority that will be used when locking the RESOURCE.
        reference ArtiOsResourceInstanceEcuCRef [0..1]: destination=OsResource  # Refers to an EcuC OsResource that is beeing extended.
        reference ArtiOsResourceInstanceGenericComponentInstanceRef [0..1]: destination=ArtiGenericComponentInstance  # Refers to an ArtiGenericComponentInstance that extends the ArtiOsResourceInstance.
        reference ArtiOsResourceInstanceLockerRef [0..1]: destination=ArtiObjectInstanceParameter  # Refers to the ArtiObjectInstanceParameter that contains the evaluation for the "locker" of this ArtiOsResource.
        reference ArtiOsResourceInstanceStateRef [0..1]: destination=ArtiObjectInstanceParameter  # Refers to the ArtiObjectInstanceParameter that contains the evaluation for the "state" of this ArtiOsResource.
        reference ArtiOsResourceInstanceValidRef [0..1]: destination=ArtiObjectInstanceParameter  # Refers to the ArtiObjectInstanceParameter that contains the evaluation for the "validity" of this ArtiOsResourceInstance. Every object declaration may contain a VALID attribute telling the debugger whether the object's attributes are currently valid. It may have an integer type of any size. Its possible values are 0 (invalid) and non zero (object is valid).
      container ArtiOsStackClass [0..1]  # Contains the layout of an ArtiOsStack object. The ArtiOsStack object defines the memory area of any stack in the system.
        reference ArtiOsStackClassGenericComponentClassRef [0..1]: destination=ArtiGenericComponentClass  # Refers to an ArtiGenericComponentClass that extends the ArtiOsStackClass.
      container ArtiOsStackInstance [0..*]  # Represents an instance of an ArtiOsStack object.
        string ArtiOsStackInstanceDirection [0..1]  # This attribute specifies the direction of stack growth and may have either "UP" or "DOWN" as its value. UP means growing from lower to higher addresses. DOWN means growing from higher addresses to lower addresses.
        reference ArtiOsStackInstanceBaseAddressRef [0..1]: destination=ArtiObjectInstanceParameter  # Refers to the ArtiObjectInstanceParameter that contains the evaluation for the "baseaddress" of this ArtiOsStack. This attribute specifies the lowest address of stack memory area, regardless of the stack direction.
        reference ArtiOsStackInstanceFillPatternRef [0..1]: destination=ArtiObjectInstanceParameter  # Refers to the ArtiObjectInstanceParameter that contains the evaluation for the "fillpattern" of this ArtiOsStack. If the operating system fills the stack during initialisation, this attribute specifies with which pattern the stack area is initialised. This allows the debugger to evaluate the maximum stack usage. For "stackdirection" "DOWN" the pattern starts at "baseaddress". For "stackdirection" "UP" the pattern starts at "baseaddress" + "size". If no pattern is used, this attribute must be omitted.
        reference ArtiOsStackInstanceGenericComponentInstanceRef [0..1]: destination=ArtiGenericComponentInstance  # Refers to an ArtiGenericComponentInstance that extends the ArtiOsStackInstance.
        reference ArtiOsStackInstanceSizeRef [0..1]: destination=ArtiObjectInstanceParameter  # Refers to the ArtiObjectInstanceParameter that contains the evaluation for the "size" of this ArtiOsStack. This attribute represents the size (in bytes) of the memory area allocated for stack.
        reference ArtiOsStackInstanceValidRef [0..1]: destination=ArtiObjectInstanceParameter  # Refers to the ArtiObjectInstanceParameter that contains the evaluation for the "validity" of this ArtiOsStackInstance. Every object declaration may contain a VALID attribute telling the debugger whether the object's attributes are currently valid. It may have an integer type of any size. Its possible values are 0 (invalid) and non zero (object is valid).
      container ArtiOsTaskClass [0..1]  # Contains the layout of an ARTI "OsTask" object, extending the EcuC OsTask.
        reference ArtiOsTaskClassClassGenericComponentRef [0..1]: destination=ArtiGenericComponentClass  # Refers to an ArtiGenericComponentClass that extends the OsTask.
        reference ArtiOsTaskClassContextRef [0..1]: destination=ArtiObjectClassParameter  # ArtiOsTaskContextRef in ArtiOsTaskInstances. This attribute contains a reference to the context object that the task is currently using.
        reference ArtiOsTaskClassCurrentTaskStateRef [0..1]: destination=ArtiObjectClassParameter  # Refers to the ArtiObjectClassParameter that defines the ArtiCurrentTaskStateInstance parameter including the task state mapping.
        reference ArtiOsTaskClassPriorityRef [0..1]: destination=ArtiObjectClassParameter  # Refers to the ArtiObjectClassParameter that declares the attribute ArtiOsTaskPriorityRef in ArtiOsTaskInstances. This attribute represents the current priority of the TASK object. The current priority can be different from the static task priority as a result of priority ceiling protocol. The priority displayed is the priority as defined in the OsTask.
        reference ArtiOsTaskClassStackRef [0..1]: destination=ArtiObjectClassParameter  # Refers to the ArtiObjectClassParameter that declares the attribute ArtiOsTaskStackRef in ArtiOsTaskInstances. This attribute contains a reference to the stack object that the task is currently using.
      container ArtiOsTaskInstance [0..*]  # Represents an instance of an ARTI "OsTask" object, extending the EcuC OsTask.
        function name ArtiOsTaskInstanceFunction [0..1]  # This parameter represents the C function name of the task body.
        integer ArtiOsTaskInstanceId: 0..18446744073709551615  # This parameter represents the "TaskID" as given by the OSEK OS, returned by GetTaskID().
        reference ArtiOsTaskInstanceContextRef [0..1]: destination=ArtiObjectInstanceParameter  # Refers to the ArtiObjectInstanceParameter that contains the evaluation for the ArtiOsContext of this ArtiOsTask.
        reference ArtiOsTaskInstanceCurrentActivationsRef [0..1]: destination=ArtiObjectInstanceParameter  # Refers to the ArtiObjectInstanceParameter that contains the evaluation for the "current activations" of this task. This attribute specifies the number of current activations for the task.
        reference ArtiOsTaskInstanceCurrentTaskStateRef [0..1]: destination=ArtiObjectInstanceParameter  # Refers to the ArtiObjectInstanceParameter that contains the evaluation for the "current state" of this task.
        reference ArtiOsTaskInstanceEcucRef: destination=OsTask  # Refers to an ArtiGenericComponentInstance that extends the OsTask.
        reference ArtiOsTaskInstanceGenericComponentRef [0..1]: destination=ArtiGenericComponentInstance  # Refers to an ArtiGenericComponentInstance that extends the OsTask.
        reference ArtiOsTaskInstancePriorityRef [0..1]: destination=ArtiObjectInstanceParameter  # Refers to the ArtiObjectInstanceParameter that contains the evaluation for the "task priority" of this task.
        reference ArtiOsTaskInstanceStackRef [0..1]: destination=ArtiObjectInstanceParameter  # Refers to the ArtiObjectInstanceParameter that contains the evaluation for the ArtiOsStack of this ArtiOsTask.
        reference ArtiOsTaskInstanceValidRef [0..1]: destination=ArtiObjectInstanceParameter  # Refers to the ArtiObjectInstanceParameter that contains the evaluation for the "validity" of this ArtiOsTaskInstance. Every object declaration may contain a VALID attribute telling the debugger whether the object's attributes are currently valid. It may have an integer type of any size. Its possible values are 0 (invalid) and non zero (object is valid).
    container ArtiRte [0..1]  # The ArtiRte Container contains all parameters for ARTI that are filled by the generators RTE. Tags: atp.Status=draft
      reference ArtiRteHookRef [0..*]: destination=ArtiHook  # Refers to an arti hook which is called by the RTE. Tags: atp.Status=draft
      container ArtiRteRunnableClass [0..1]  # Contains the layout of an ArtiRteRunnable object. Tags: atp.Status=draft
        reference ArtiRteRunnableClassGenericComponentClassRef [0..1]: destination=ArtiGenericComponentClass  # Refers to an ArtiGenericComponentClass that extends the ArtiRteRunnableClass. Tags: atp.Status=draft
        reference ArtiRteRunnableIdRef: destination=ArtiObjectClassParameter  # Refers to the ArtiObjectClassParameter that declares the attribute ArtiRteRunnableIdRef in ArtiRteRunnableEntityInstances. This attribute specifies the idOf(reName) mapping. Tags: atp.Status=draft
      container ArtiRteRunnableInstance [0..1]  # Represents an instance of an ArtiRteRunnable object, extending the BswM RunnableEntity. Tags: atp.Status=draft
        string ArtiRteRunnableInstanceSymbol [0..1]  # Specifies the symbol / function name that implements the runnable. Tags: atp.Status=draft
        foreign reference ArtiRteRunnableInstanceBswRef [0..1]: destination-type=RUNNABLE-ENTITY  # Refers to an Rte Runnable that is beeing extended. Tags: atp.Status=draft
        reference ArtiRteRunnableInstanceGenericComponentInstanceRef [0..1]: destination=ArtiGenericComponentInstance  # Refers to an ArtiGenericComponentInstance that extends the ArtiRteRunnableInstance. Tags: atp.Status=draft
      container ArtiRteSchedulableClass [0..1]  # Contains the layout of an ArtiRteSchedulable object. Tags: atp.Status=draft
        reference ArtiRteSchedulableClassGenericComponentClassRef [0..1]: destination=ArtiGenericComponentClass  # Refers to an ArtiGenericComponentClass that extends the ArtiRteSchedulableClass. Tags: atp.Status=draft
        reference ArtiRteSchedulableIdRef: destination=ArtiObjectClassParameter  # Refers to the ArtiObjectClassParameter that declares the attribute ArtiRteSchmEntityIdRef in ArtiRteSchedulableInstances. This attribute specifies the idOf(entityName) mapping. Tags: atp.Status=draft
      container ArtiRteSchedulableInstance [0..1]  # Represents an instance of an ArtiRteSchedulable object, extending the Rte Schedulable Entity. Tags: atp.Status=draft
        string ArtiRteSchedulableInstanceSymbol [0..1]  # Specifies the symbol / function name that implements the schedulable. Tags: atp.Status=draft
        foreign reference ArtiRteSchedulableInstanceBswRef [0..1]: destination-type=BSW-SCHEDULABLE-ENITIY  # Refers to an Rte Schedulable that is beeing extended. Tags: atp.Status=draft
        reference ArtiRteSchedulableInstanceGenericComponentInstanceRef [0..1]: destination=ArtiGenericComponentInstance  # Refers to an ArtiGenericComponentInstance that extends the ArtiRteSchedulableInstance. Tags: atp.Status=draft
    container ArtiValues [0..*]  # The ArtiValues container collects all parameter values for ARTI that are filled by the generators (OS, RTE, ...)
      container ArtiConstant [0..*]  # This container holds a constant value.
        string ArtiConstantString  # This is the constant value for a specific parameter.
      container ArtiExpression [0..*]  # This container holds a C like expression that a debugger can evaluate. This is similar to what is already done in ORTI.
        string ArtiExpressionString  # This string represents a C like expression that a debugger can evaluate.
      container ArtiHook [0..*]  # This container represents an ARTI hook that is present in the module.
        string ArtiHookClass  # Name of the (schedule) class of macros. Classes can be one of the predefined classes or user defined.
        string ArtiHookContext  # Name of the execution context. One of NOSUSP, SPRVSR, or USER. | See also chapter "ARTI Tracing Macro".
        string ArtiHookEventName  # The name of the event as defined for a particular class, or an arbitrary name for generic classes.
        string ArtiHookInstance  # Name of an instance of the (schedule) class.
        reference ArtiHookEventParameterTypeRef [0..1]: destination=ArtiParameterTypeMap  # Refers to a parameter type to interpret the hook event number.
        reference ArtiHookInstanceParameterTypeRef [0..1]: destination=ArtiParameterTypeMap  # Refers to a parameter type to interpret the hook instance number.
      container ArtiObjectClassParameter [0..*]  # This container represents a parameter of an Arti object class definition.
        reference ArtiObjectClassParameterTypeMapRef [0..1]: destination=ArtiParameterTypeMap  # Refers to a parameter type to interpret the instance parameter value.
      container ArtiObjectInstanceParameter [0..*]  # This container represents a parameter of an Arti object instance.
        reference ArtiObjectInstanceParameterConstantRef [0..1]: destination=ArtiConstant  # Refers to a constant representing the value of this parameter.
        reference ArtiObjectInstanceParameterExpressionRef [0..1]: destination=ArtiExpression  # Refers to an expression that evaluates the value of this parameter.
        reference ArtiObjectInstanceParameterHookRef [0..1]: destination=ArtiHook  # Refers to a hook that records this parameter.
      container ArtiParameterTypeMap [0..*]  # A map of key/value pairs to map a parameter value to a display string and/or an Arti or EcuC object.
        container ArtiParameterTypeMapPair [1..*]  # A key/value pair to map a parameter value to a display string and/or an Arti or EcuC object.
          integer ArtiParameterTypeMapPairInput [0..1]: 0..65535  # The numerical value given by a parameter to translate. | When used with Hooks (ArtiHooks), this parameter is mandatory (multiplicity 1) and its value is limited to the range of 0..65535. When used with Hooks, this parameter may be used to map the values given by "instanceParameter" and/or the "eventParameter" of the ARTI_TRACE macro.
          string ArtiParameterTypeMapPairOutput [0..1]  # The string to display for the Input value.
          reference ArtiParameterTypeMapPairInputExpressionRef [0..1]: destination=ArtiExpression  # Refers to an expression that evaluates to a numerical value to translate.
          choice reference ArtiParameterTypeMapPairOutputRef [0..1]: destination=[ArtiOsContextInstance, ArtiOsIsrInstance, ArtiOsStackInstance, ArtiOsTaskInstance, ArtiStatesTaskState, OsAppMode]  # Choice Reference to ArtiOsTaskInstance, ArtiOsIsrInstance, ArtiStatesTaskState, OsAppMode, ArtiOsContextInstance, or ArtiOsStackInstance.
      container ArtiStates [0..*]  # This container contains all states of tasks, isrs... that the EcuC uses.
        container ArtiStatesTaskState [0..*]  # Each state used by the OS has to be listed as ArtiStatesTaskState Parameter with a choice of the states.
          boolean ArtiStatesTaskStateEnhanced  # Set to true, if the OS provides an "enhanced" state model with "READY" split to "Activated", "Preempted", "Released".
          enumeration ArtiStatesTaskStateEnum: {ArtiTaskStateActivated, ArtiTaskStatePreempted, ArtiTaskStateReady, ArtiTaskStateReleased, ArtiTaskStateRunning, ArtiTaskStateSuspended, ArtiTaskStateWaiting}  # ArtiStatesTaskState choice of the states.
