AUTOSAR XML (schema 4-0-3)
package /AUTOSAR/EcucDefs
  module definition IdsM [0..1]: variants pre-compile
    container IdsMConfiguration  # Configuration parameters of the module IdsM. Tags: atp.Status=draft
      container IdsMBlockState [1..16]  # Configuration of an IdsM blocking state used in the IdsMStateBlockFilter to suspend the collection of security events. Tags: atp.Status=draft | The active state is reported by the BswM via IdsM_BswM_StateChanged().
        integer IdsMBlockStateID: 0..15, symbolic-name-value=true  # This value specifies the identifier of this block state. Tags: atp.Status=draft
      container IdsMBufferConfiguration  # Configuration of the event buffers and context data buffers used by IdsM. Tags: atp.Status=draft
        container IdsMContextDataBuffer [0..65535]  # Buffer that is reserved to store the context data of SEvs. Tags: atp.Status=draft | Depending on the type of SEv that is processed, there can be significant differences in sizes of the context data.
          integer IdsMContextDataBufferSize: 1..1500  # Size of the context data buffer in bytes. Tags: atp.Status=draft | It is recommended to configure buffers with an appropriate size depending on the configured SEvs.
          integer IdsMNumberOfContextDataBuffers: 1..65535  # The number of buffers with the configured buffer size specified in IdsMContextDataBufferSize. Tags: atp.Status=draft | It is recommended to configure an appropriate number of buffers depending on the configured SEvs.
        container IdsMEventBuffers  # Buffers used to store the SEvs. Tags: atp.Status=draft
          integer IdsMNumberOfEventBuffers: 1..65535  # The number of event buffers used to store the SEvs. Tags: atp.Status=draft | The suggested number of buffers can be calculated as follows: IdsMNumberOfBuffers = Number of Aggregation Filter Instances + Upper bound of parallel processed SEvs. Number of Aggregation Filter Instances = The number of configured SEvs that use a filter chain that contains an aggregation filter. Upper bound of parallel processed SEvs = 10% of the number of configured SEvs.
      container IdsMEvent [1..65535]  # Configuration of the IdsM Event unit which is reported by a sensor and its parameters. Tags: atp.Status=draft
        integer IdsMExternalEventId: 0..65534  # The external security event ID which is reported to the sink. Tags: atp.Status=draft | There are two different value ranges depending on the referencing module: Standarized SEv ID is defined by the AUTOSAR specification. This ID is usually derived from the SecXT. Standard ID range: 0x0000 - 0x8000 Generic User Event ID is defined by the user. Used when a SW-C / Application references the SEv. Generic ID range: 0x8000 - 0xFFFE. 0xFFFF is considered an invalid ID
        integer IdsMInternalEventId: 0..65535, symbolic-name-value=true, default-value=65535  # Consecutive number used internally as an identifier by the IdsM module. Tags: atp.Status=draft | This number is calculated internally and shall not be configured manually. This parameter is only available to publish the result of this calculation. Applications using IdsM APIs shall not rely on the value of this parameter. Instead, they shall use the symbolic name value.
        enumeration IdsMReportingModeFilter  # The reporting mode filter defines the level of detail of the reporting. Whether SEv should be dropped, forwarded with context data or forwarded without context data. Tags: atp.Status=draft | The parameter determines if the SEv is either: - dropped (OFF) - sent without context data (BRIEF) - sent with context data (DETAILED) - sent without context data, ignoring the rest of the filter chain (BRIEF_BYPASSING_FILTERS) - sent with context data ignoring the rest of the filter chain (DETAILED_BYPASSING_FILTERS)
          BRIEF  # Tags: atp.Status=draft
          BRIEF_BYPASSING_FILTERS  # Tags: atp.Status=draft
          DETAILED  # Tags: atp.Status=draft
          DETAILED_BYPASSING_FILTERS  # Tags: atp.Status=draft
          OFF  # Tags: atp.Status=draft
        integer IdsMSensorInstanceId: 0..65535, default-value=0  # The instance ID of the sensor which reports security events to the IdsM. Tags: atp.Status=draft | If there is only one instance of a sensor, the default ID is 0.
        boolean IdsMSinkDem: default-value=false  # The QSEv will be sent to the Dem Module into a Security Event Memory (Sem) to persist it on the local ECU. Tags: atp.Status=draft
        boolean IdsMSinkIdsR: default-value=false  # The QSEv will be sent to the IDS Reporter. Tags: atp.Status=draft
        reference IdsMFilterChainRef [0..1]: destination=IdsMFilterChain  # Reference to a configured IdsM filter chain. Tags: atp.Status=draft
        container IdsMServiceInterfaceOptions [0..1]  # Adittional configuration parameters of a SEv when the sensor is a SW-C or application. Tags: atp.Status=draft
          enumeration IdsMAdditionalParameterOption: default-value=None  # In addition to the optional context data the Service Port Interface can be extended by the following parameters: Tags: atp.Status=draft | - None: No extensions - Count: Additionally a count can be passed. This value is used as an initialization counter for the corresponding SEv. - Count and Timestamp: Additionally to the count a timestamp can be passed. Note: The timestamp option depends on whether IdsMTimeStampOption is configured to enable timestamps.
            Count  # Tags: atp.Status=draft
            CountTimestamp  # Tags: atp.Status=draft
            None  # Tags: atp.Status=draft
          integer IdsMEventMaxContextDataSize: 0..1500, default-value=0  # Maximum number of bytes used by the IdsM and the RTE when forwarding context data of the corresponding security event. Tags: atp.Status=draft | This parameter is only used for SW-C use cases. This is the maximum amount of bytes defined for transmission of the context data. In case this is a Basic Software Module SEv, the configuration of this parameter is not necessary and will be ignored.
      container IdsMFilterChain [0..*]  # A filter chain is a combination of filters that affects one or more SEvs. Tags: atp.Status=draft | A filter receives a SEv, checks condition(s) and, e.g. - forwards SEv immediately/later - drops SEv - stores SEv - modifies SEv Consider that the filter order is defined as follows: - Reporting Mode Level (per SEv ID) - Block State (per SEv ID) - Forward Every nth (per SEv ID) - Event Aggregation (per SEv ID) - Event Threshold (per SEv ID) - Event Rate Limitation (per IdsM Instance) - Traffic Limitation (per IdsM Instance)
        container IdsMBlockStateFilter [0..1]  # This state filter drops SEvs if the current State reported by the BswM is in this state filter list. Tags: atp.Status=draft
          reference IdsMBlockStateReference [1..16]: destination=IdsMBlockState  # The collection of SEvs during this state will be suspended. Tags: atp.Status=draft
        container IdsMEventAggregationFilter [0..1]  # All received events of a certain event ID that are received by this filter during a single aggregation time interval are not forwarded immediately. Tags: atp.Status=draft | Instead, only the last or the first received SEv is stored in an aggregation buffer, depending on the configuration of "IdsMContextDataSourceSelector". The counter field of the SEv is modified so that it contains the sum of the counter fields of all incoming SEvs during the current aggregation time interval. At the end of the aggregation time interval, the buffered SEv is sent out and the aggregation buffer is cleared. If there was no incoming SEv until the end of the aggregation time interval, no message will be sent.
          enumeration IdsMContextDataSourceSelector  # The resulting SEv from the aggregation filter contains the context data from one of the following two sources: Tags: atp.Status=draft | IDSM_FILTERS_CTX_USE_FIRST = ContextData of first received SEv is used for resulting QSEv. IDSM_FILTERS_CTX_USE_LAST = ContextData of last received SEv is used for resulting QSEv.
            IDSM_FILTERS_CTX_USE_FIRST  # Tags: atp.Status=draft
            IDSM_FILTERS_CTX_USE_LAST  # Tags: atp.Status=draft
          float IdsMEventAggregationTimeInterval: 0..INF  # Length of the aggregation time interval (as float in seconds). Tags: atp.Status=draft | Note: Shall be configured as a multiple of the IdsM main function period.
        container IdsMEventThresholdFilter [0..1]  # During each time interval "IdsMEventThresholdTimeInterval", the filter drops the first "IdsMEventThresholdNumber - 1" SEvs and forwards all other incoming SEvs immediately until the end of the time interval. Tags: atp.Status=draft
          integer IdsMEventThresholdNumber: 2..65535  # This parameter assigns the threshold 'p' for each SEv ID affected by this threshold filter. Tags: atp.Status=draft | All SEvs ' p-1' are dropped, SEvs equal or greater than 'p' are forwarded.
          float IdsMEventThresholdTimeInterval: 0..INF  # Length of the threshold time interval (as float in seconds). Tags: atp.Status=draft | Note: Shall be configured as a multiple of the IdsM main function period.
        container IdsMForwardEveryNthFilter [0..1]  # Out of all incoming SEVs, drop all but every nth. Those will be forwarded without modification. Tags: atp.Status=draft
          integer IdsMNthParameter: 2..65535  # For each SEv ID for which this filter is configured, this parameter assigns the appropriate n. Tags: atp.Status=draft | Only 1 from n SEvs will be forwarded.
      container IdsMPdus [0..1]  # Configuration of the PDU references used to send the events data. Tags: atp.Status=draft
        container IdsMIfTxPdu [0..1]  # IF PDU used to transmit a QSEv via the PduR to the IdsR. Tags: atp.Status=draft | If the total size of the QSEv's data to be transmitted fits in a single frame of the underlying bus, the IF PDU is used.
          integer IdsMIfTxPduHandleId: 0..0, symbolic-name-value=true, default-value=0  # IdsM does not use this parameter, content will be ignored. Tags: atp.Status=draft | The existence of this parameter is needed by PduR.
          reference IdsMIfTxPduRef: destination=Pdu  # Reference to the IF PDU used for transmission of the QSEvs. Tags: atp.Status=draft
        container IdsMTpTxPdu [0..1]  # TP PDU used to transmit a QSEv via the PduR to the IdsR. Tags: atp.Status=draft | If the total size of the QSEv's data to be transmitted is bigger than the size of a single frame of the underlying bus, the TP PDU is used.
          integer IdsMTpTxPduHandleId: 0..0, symbolic-name-value=true, default-value=0  # IdsM does not use this parameter, content will be ignored. Tags: atp.Status=draft | The existence of this parameter is needed by PduR.
          reference IdsMTpTxPduRef: destination=Pdu  # Reference to the TP PDU used for transmission of the QSEvs. Tags: atp.Status=draft
    container IdsMGeneral  # General configuration parameters of IdsM. Tags: atp.Status=draft
      boolean IdsMDevErrorDetect  # This parameter enables/disables the Development Error Detection and Notification. Tags: atp.Status=draft | true: Development error detection is enabled. false: Development error detection is disabled. Note: In general, the development error detection is recommended during pre-test phase. It is not recommended to enable the development error detection in production code due to increased runtime and ROM needs.
      boolean IdsMDiagnosticSupport: default-value=false  # Enables or disables the Dcm APIs which are used to read and write certain values of the IdsM module through the diagnostic communication manager. Tags: atp.Status=draft | true: Dcm APIs are enabled false: Dcm APIs are disabled
      integer IdsMInstanceId: 0..1023  # The unique identifier of the sending IdsM instance. Tags: atp.Status=draft | This ID helps identifying the origin of a SEv, together with the SEv configuration parameters: ExternalEventId and the IdsMSensorInstanceId. Note: There is only one IdsM (from the AUTOSAR Classic Platform) instance per ECU.
      float IdsMMainFunctionPeriod: 0..INF, default-value=0.01  # The period between successive calls to the IdsM main function (as float in seconds). Tags: atp.Status=draft
      integer IdsMSignatureGenerateResultLength [0..1]: 0..4294967295  # This parameter defines the length in bytes of the signature calculated by the crypto services. This parameter should be set when the IdsMSignatureSupport is enabled. Tags: atp.Status=draft
      boolean IdsMSignatureSupport: default-value=false  # This parameter enables/disables the functionality of sending messages to the network with a signature of encryption calculated by the crypto services. Tags: atp.Status=draft
      enumeration IdsMTimestampOption  # This parameter enables/disables the functionality of having a timestamp field as part of a QSEv and if the origin of the timestamp is from the AUTOSAR stack or from the application (custom timestamp). Tags: atp.Status=draft
        AUTOSAR  # Tags: atp.Status=draft
        Custom  # Tags: atp.Status=draft
        None  # Tags: atp.Status=draft
      boolean IdsMVersionInfoApi  # This parameter enables/disables the function IdsM_GetVersionInfo() to get major, minor and patch version information of the module. Tags: atp.Status=draft
      reference IdsMCsmJobReference [0..1]: destination=CsmJob  # This parameter references the Csm job that is used to generate signatures when qualified security events must be signed. Tags: atp.Status=draft
      reference IdsMNvmBlockDescriptor [0..1]: destination=NvMBlockDescriptor  # Choose a NvM block descriptor reference, that is used to load and store the non-volatile data of IdsM module. Tags: atp.Status=draft | The supported NvM block names are: RAM: IdsM_NvMRamBlockData ROM: IdsM_NvMRomBlockData
      reference IdsMStbMSynchronizedTimeBaseReference [0..1]: destination=StbMSynchronizedTimeBase  # This parameter references the time source when the origin of the timestamp is AUTOSAR. Tags: atp.Status=draft
      container IdsMGlobalRateLimitationFilters [0..1]  # Global rate limitation filters for all SEvs. Tags: atp.Status=draft
        container IdsMFilterEventRateLimitation [0..1]  # For configurable time intervals of length "IdsMRateLimitationTimeInterval" this filter forwards all the SEvs until reaching the limit "IdsMRateLimitationMaximumEvents". Tags: atp.Status=draft | The limit is measured in number of incoming SEvs. Until the end of the time interval, all subsequent SEvs are dropped. This is helpful to cap the load that the IdsM generates unto information sinks like the IdsR. This filter is not specific to a single SEv but it applies to all SEvs handled by the current IdsM instance. Note: Each possible SEv counts as a single one, regardless of its counter value.
          integer IdsMRateLimitationMaximumEvents: 1..65535  # The maximum number of SEvs which are passed on by this filter in a single rate limitation time interval. Tags: atp.Status=draft
          float IdsMRateLimitationTimeInterval: 0..INF  # Time interval length of the event rate limitation filter (as float in seconds). Tags: atp.Status=draft | Note: Shall be configured as a multiple of the IdsM main function period.
        container IdsMFilterTrafficLimitation [0..1]  # The traffic limitation filter forwards all the incoming SEvs until reaching the limit "IdsMTrafficLimitationMaximumBytes". Tags: atp.Status=draft | The limit is measured in incoming amount of bytes. This filter forwards SEvs only, if the accumulated sizes of all incoming SEvs in the current traffic limitation time interval up until the current SEv is smaller or equal than a configurable maximum number of bytes "IdsMTrafficLimitationMaximumBytes". The length of the traffic limitation time interval is configurable in "IdsMTrafficLimitationTimeInterval". This filter is not specific to a single SEv but it applies to all SEvs handled by the current IdsM instance.
          integer IdsMTrafficLimitationMaximumBytes: 1..65535  # The maximum number of bytes to be sent out by the IdsM in a single traffic limitation time interval. Tags: atp.Status=draft
          float IdsMTrafficLimitationTimeInterval: 0..INF  # Length of the traffic limitation time interval (as float in seconds). Tags: atp.Status=draft | Note: Shall be configured as a multiple of the IdsM main function period.
