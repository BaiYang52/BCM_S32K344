AUTOSAR XML (schema 00046)
standard types defined: boolean, dtRef_const_VOID, dtRef_VOID, sint8, uint16, uint32, uint8, boolean_CompuMethod, boolean_DataConstr, sint8_DataConstr, uint16_DataConstr, uint32_DataConstr, uint8_DataConstr
package /MICROSAR_Static_ServicePortInterfaces/ComM_swc
  mode declaration group ComMMode: category=ALPHABETIC_ORDER, initial-mode=COMM_NO_COMMUNICATION
    mode COMM_NO_COMMUNICATION
    mode COMM_SILENT_COMMUNICATION
    mode COMM_FULL_COMMUNICATION
package /MICROSAR_Static_ServicePortInterfaces/ComM_swc/DataTypes
  impl type ComM_InhibitionStatusType: range raw 0..255, implementation-data-type=uint8
  impl type ComM_ModeType: compu {0=COMM_NO_COMMUNICATION, 1=COMM_SILENT_COMMUNICATION, 2=COMM_FULL_COMMUNICATION}, range raw 0..3, implementation-data-type=uint8
package /MICROSAR_Static_ServicePortInterfaces/ComM_swc/Interfaces
  4 x client server interface, all with is-service=true, service-kind=COM-MANAGER:
    ComM_ChannelLimitation
      operation GetInhibitionStatus: possible-error=ComM_ChannelLimitation/E_NOT_OK
        arg Status: type=ComM_InhibitionStatusType, direction=OUT, server-argument-impl-policy=USE-ARGUMENT-TYPE
      operation LimitChannelToNoComMode: possible-error=ComM_ChannelLimitation/E_NOT_OK
        arg Status: type=boolean, direction=IN, server-argument-impl-policy=USE-ARGUMENT-TYPE
      error E_NOT_OK: error-code=1
    ComM_ChannelWakeUp
      operation GetInhibitionStatus: possible-error=ComM_ChannelWakeUp/E_NOT_OK
        arg Status: type=ComM_InhibitionStatusType, direction=OUT, server-argument-impl-policy=USE-ARGUMENT-TYPE
      operation PreventWakeUp: possible-error=ComM_ChannelWakeUp/E_NOT_OK
        arg Status: type=boolean, direction=IN, server-argument-impl-policy=USE-ARGUMENT-TYPE
      error E_NOT_OK: error-code=1
    ComM_ECUModeLimitation
      4 x operation, all with possible-error=ComM_ECUModeLimitation/E_NOT_OK:
        LimitECUToNoComMode
          arg Status: type=boolean, direction=IN, server-argument-impl-policy=USE-ARGUMENT-TYPE
        ReadInhibitCounter
          arg CounterValue: type=uint16, direction=OUT, server-argument-impl-policy=USE-ARGUMENT-TYPE
        ResetInhibitCounter
        SetECUGroupClassification
          arg Status: type=ComM_InhibitionStatusType, direction=IN, server-argument-impl-policy=USE-ARGUMENT-TYPE
      error E_NOT_OK: error-code=1
    ComM_UserRequest
      4 x operation:
        GetCurrentComMode: possible-error=ComM_UserRequest/E_NOT_OK
          arg ComMode: type=ComM_ModeType, direction=OUT, server-argument-impl-policy=USE-ARGUMENT-TYPE
        GetMaxComMode: possible-error=ComM_UserRequest/E_NOT_OK
          arg ComMode: type=ComM_ModeType, direction=OUT, server-argument-impl-policy=USE-ARGUMENT-TYPE
        GetRequestedComMode: possible-error=ComM_UserRequest/E_NOT_OK
          arg ComMode: type=ComM_ModeType, direction=OUT, server-argument-impl-policy=USE-ARGUMENT-TYPE
        RequestComMode: possible-error=[E_MODE_LIMITATION, ComM_UserRequest/E_NOT_OK]
          arg ComMode: type=ComM_ModeType, direction=IN, server-argument-impl-policy=USE-ARGUMENT-TYPE
      error E_MODE_LIMITATION: error-code=2
      error E_NOT_OK: error-code=1
  mode switch interface ComM_CurrentMode: is-service=true, service-kind=COM-MANAGER
    mode group currentMode: type=ComMMode
package /MICROSAR_Static_ServicePortInterfaces/Csm_swc/DataTypes
  6 x impl type:
    Crypto_VerifyResultType: compu {0=CRYPTO_E_VER_OK, 1=CRYPTO_E_VER_NOT_OK}, range raw 0..1, implementation-data-type=uint8  # Enumeration of the result type of verification operations.
    Csm_MacGenerateDataType_CsmPrimitivesMACGenerate: category=ARRAY, sw-calibration-access=READ-ONLY  # Used as Buffer for service.
      element Csm_MacGenerateDataType_CsmPrimitivesMACGenerateElement: array-size=1024, array-size-semantics=FIXED-SIZE, implementation-data-type=uint8
    Csm_MacGenerateResultType_CsmPrimitivesMACGenerate: category=ARRAY, sw-calibration-access=READ-ONLY  # Used as Buffer for service.
      element Csm_MacGenerateResultType_CsmPrimitivesMACGenerateElement: array-size=8, array-size-semantics=FIXED-SIZE, implementation-data-type=uint8
    Csm_MacVerifyCompareType_CsmPrimitivesMACVerify: category=ARRAY, sw-calibration-access=READ-ONLY  # Used as Buffer for service.
      element Csm_MacVerifyCompareType_CsmPrimitivesMACVerifyElement: array-size=1, array-size-semantics=FIXED-SIZE, implementation-data-type=uint8
    Csm_MacVerifyDataType_CsmPrimitivesMACVerify: category=ARRAY, sw-calibration-access=READ-ONLY  # Used as Buffer for service.
      element Csm_MacVerifyDataType_CsmPrimitivesMACVerifyElement: array-size=1024, array-size-semantics=FIXED-SIZE, implementation-data-type=uint8
    Csm_ResultType: compu {1=E_NOT_OK, 2=E_SMALL_BUFFER, 3=E_ENTROPY_EXHAUSTION, 4=E_KEY_READ_FAIL, 5=E_KEY_NOT_AVAILABLE, 6=E_KEY_NOT_VALID, 7=E_JOB_CANCELED, 8=E_KEY_EMPTY}, range raw 0..8, implementation-data-type=uint8  # Csm module specific return values for use in Std_ReturnType that could occur during asynchronous job processing.
package /MICROSAR_Static_ServicePortInterfaces/Csm_swc/Interfaces
  client server interface CallbackNotification: is-service=true, service-kind=CRYPTO-SERVICE-MANAGER  # Interface for the callback notification.
    operation CallbackNotification
      arg result: type=Csm_ResultType, direction=IN, server-argument-impl-policy=USE-ARGUMENT-TYPE
  client server interface CsmMacGenerate_CsmPrimitivesMACGenerate: is-service=true, service-kind=CRYPTO-SERVICE-MANAGER  # A message authentication code (MAC) is a short piece of information used to authenticate a message. A MAC algorithm accepts as input a secret key and an arbitrary-length message to be authenticated, and outputs a MAC. The MAC value protects both a message's data integrity as well as its authenticity, by allowing verifiers (who also possess the secret key) to detect any changes to the message content.
    operation CancelJob: possible-error=CsmMacGenerate_CsmPrimitivesMACGenerate/E_NOT_OK  # Cancels the Job.
    operation MacGenerate: possible-error=[CsmMacGenerate_CsmPrimitivesMACGenerate/CSM_E_BUSY, CsmMacGenerate_CsmPrimitivesMACGenerate/CSM_E_SMALL_BUFFER, CsmMacGenerate_CsmPrimitivesMACGenerate/E_NOT_OK]  # This interface shall be used to start the MAC generation service of the CSM module.
      4 x arg:
        dataBuffer: type=Csm_MacGenerateDataType_CsmPrimitivesMACGenerate, direction=IN, server-argument-impl-policy=USE-ARRAY-BASE-TYPE
        dataLength: type=uint32, direction=IN, server-argument-impl-policy=USE-ARGUMENT-TYPE
        resultBuffer: type=Csm_MacGenerateResultType_CsmPrimitivesMACGenerate, direction=OUT, server-argument-impl-policy=USE-ARRAY-BASE-TYPE
        resultLength: type=uint32, direction=INOUT, server-argument-impl-policy=USE-ARGUMENT-TYPE
    error CSM_E_BUSY: error-code=2  # The service request failed because the service is still busy.
    error CSM_E_SMALL_BUFFER: error-code=3  # The service request failed because the provided buffer is too small to store the result.
    error E_NOT_OK: error-code=1  # The service request failed.
  client server interface CsmMacVerify_CsmPrimitivesMACVerify: is-service=true, service-kind=CRYPTO-SERVICE-MANAGER  # A message authentication code (MAC) is a short piece of information used to authenticate a message. A MAC algorithm accepts as input a secret key and an arbitrary-length message to be authenticated, and outputs a MAC. The MAC value protects both a message's data integrity as well as its authenticity, by allowing verifiers (who also possess the secret key) to detect any changes to the message content.
    operation CancelJob: possible-error=CsmMacVerify_CsmPrimitivesMACVerify/E_NOT_OK  # Cancels the Job.
    operation MacVerify: possible-error=[CsmMacVerify_CsmPrimitivesMACVerify/CSM_E_BUSY, CsmMacVerify_CsmPrimitivesMACVerify/CSM_E_SMALL_BUFFER, CsmMacVerify_CsmPrimitivesMACVerify/E_NOT_OK]  # This interface shall be used to start the MAC verification service of the CSM module.
      5 x arg:
        dataBuffer: type=Csm_MacVerifyDataType_CsmPrimitivesMACVerify, direction=IN, server-argument-impl-policy=USE-ARRAY-BASE-TYPE
        dataLength: type=uint32, direction=IN, server-argument-impl-policy=USE-ARGUMENT-TYPE
        compareBuffer: type=Csm_MacVerifyCompareType_CsmPrimitivesMACVerify, direction=IN, server-argument-impl-policy=USE-ARRAY-BASE-TYPE
        compareLength: type=uint32, direction=IN, server-argument-impl-policy=USE-ARGUMENT-TYPE
        verifyResult: type=Crypto_VerifyResultType, direction=OUT, server-argument-impl-policy=USE-ARGUMENT-TYPE
    error CSM_E_BUSY: error-code=2  # The service request failed because the service is still busy.
    error CSM_E_SMALL_BUFFER: error-code=3  # The service request failed because the provided buffer is too small to store the result.
    error E_NOT_OK: error-code=1  # The service request failed.
package /MICROSAR_Static_ServicePortInterfaces/Dcm_swc
  mode declaration group DcmControlDtcSetting: category=EXPLICIT_ORDER, initial-mode=ENABLEDTCSETTING, on-transition-value=2
    mode ENABLEDTCSETTING: value=0
    mode DISABLEDTCSETTING: value=1
  mode declaration group DcmDiagnosticSessionControl: category=EXPLICIT_ORDER, initial-mode=DEFAULT_SESSION, on-transition-value=255
    mode DEFAULT_SESSION: value=1
    mode PROGRAMMING_SESSION: value=2
    mode EXTENDED_SESSION: value=3
  mode declaration group DcmEcuReset: category=EXPLICIT_ORDER, initial-mode=NONE, on-transition-value=7
    7 x mode:
      NONE: value=0
      HARD: value=1
      KEYONOFF: value=2
      SOFT: value=3
      JUMPTOBOOTLOADER: value=4
      JUMPTOSYSSUPPLIERBOOTLOADER: value=5
      EXECUTE: value=6
package /MICROSAR_Static_ServicePortInterfaces/Dcm_swc/DataTypes
  10 x impl type:
    Dcm_ConfirmationStatusType: compu {0=DCM_RES_POS_OK, 1=DCM_RES_POS_NOT_OK, 2=DCM_RES_NEG_OK, 3=DCM_RES_NEG_NOT_OK}, range raw 0..3, implementation-data-type=uint8
    Dcm_Data2ByteType: category=ARRAY, sw-calibration-access=READ-ONLY
      element Dcm_Data2ByteTypeElement: array-size=2, array-size-semantics=FIXED-SIZE, implementation-data-type=uint8
    Dcm_Data4ByteType: category=ARRAY, sw-calibration-access=READ-ONLY
      element Dcm_Data4ByteTypeElement: array-size=4, array-size-semantics=FIXED-SIZE, implementation-data-type=uint8
    Dcm_Data650ByteType: category=ARRAY, sw-calibration-access=READ-ONLY
      element Dcm_Data650ByteTypeElement: array-size=650, array-size-semantics=FIXED-SIZE, implementation-data-type=uint8
    Dcm_NegativeResponseCodeType:
      compu {0=DCM_E_POSITIVERESPONSE, 16=DCM_E_GENERALREJECT, 17=DCM_E_SERVICENOTSUPPORTED, 18=DCM_E_SUBFUNCTIONNOTSUPPORTED, 19=DCM_E_INCORRECTMESSAGELENGTHORINVALIDFORMAT, 20=DCM_E_RESPONSETOOLONG, 33=DCM_E_BUSYREPEATREQUEST, 34=DCM_E_CONDITIONSNOTCORRECT, 36=DCM_E_REQUESTSEQUENCEERROR, 37=DCM_E_NORESPONSEFROMSUBNETCOMPONENT, 38=DCM_E_FAILUREPREVENTSEXECUTIONOFREQUESTEDACTION, 49=DCM_E_REQUESTOUTOFRANGE, 51=DCM_E_SECURITYACCESSDENIED, 52=DCM_E_AUTHENTICATIONREQUIRED, 53=DCM_E_INVALIDKEY, 54=DCM_E_EXCEEDNUMBEROFATTEMPTS, 55=DCM_E_REQUIREDTIMEDELAYNOTEXPIRED, 80=DCM_E_CVF_INVALIDTIMEPERIOD, 81=DCM_E_CVF_INVALIDSIGNATURE, 82=DCM_E_CVF_INVALIDCHAINOFTRUST, 83=DCM_E_CVF_INVALIDTYPE, 84=DCM_E_CVF_INVALIDFORMAT, 85=DCM_E_CVF_INVALIDCONTENT, 86=DCM_E_CVF_INVALIDSCOPE, 87=DCM_E_CVF_INVALIDCERTIFICATEREVOKED, 88=DCM_E_OWNERSHIPVERIFICATIONFAILED, 89=DCM_E_CHALLENGECALCULATIONFAILED, 112=DCM_E_UPLOADDOWNLOADNOTACCEPTED, 113=DCM_E_TRANSFERDATASUSPENDED, 114=DCM_E_GENERALPROGRAMMINGFAILURE, 115=DCM_E_WRONGBLOCKSEQUENCECOUNTER, 120=DCM_E_REQUESTCORRECTLYRECEIVEDRESPONSEPENDING, 126=DCM_E_SUBFUNCTIONNOTSUPPORTEDINACTIVESESSION, 127=DCM_E_SERVICENOTSUPPORTEDINACTIVESESSION, 129=DCM_E_RPMTOOHIGH, 130=DCM_E_RPMTOOLOW, 131=DCM_E_ENGINEISRUNNING, 132=DCM_E_ENGINEISNOTRUNNING, 133=DCM_E_ENGINERUNTIMETOOLOW, 134=DCM_E_TEMPERATURETOOHIGH, 135=DCM_E_TEMPERATURETOOLOW, 136=DCM_E_VEHICLESPEEDTOOHIGH, 137=DCM_E_VEHICLESPEEDTOOLOW, 138=DCM_E_THROTTLE_PEDALTOOHIGH, 139=DCM_E_THROTTLE_PEDALTOOLOW, 140=DCM_E_TRANSMISSIONRANGENOTINNEUTRAL, 141=DCM_E_TRANSMISSIONRANGENOTINGEAR, 143=DCM_E_BRAKESWITCH_NOTCLOSED, 144=DCM_E_SHIFTERLEVERNOTINPARK, 145=DCM_E_TORQUECONVERTERCLUTCHLOCKED, 146=DCM_E_VOLTAGETOOHIGH, 147=DCM_E_VOLTAGETOOLOW, 240..249=DCM_E_VMSCNC_0..DCM_E_VMSCNC_9, 250=DCM_E_VMSCNC_A, 251=DCM_E_VMSCNC_B, 252=DCM_E_VMSCNC_C, 253=DCM_E_VMSCNC_D, 254=DCM_E_VMSCNC_E}
      range raw 0..255
      implementation-data-type=uint8
    Dcm_OpStatusType: compu {0=DCM_INITIAL, 1=DCM_PENDING, 2=DCM_CANCEL, 3=DCM_FORCE_RCRRP_OK, 64=DCM_FORCE_RCRRP_NOT_OK}, range raw 0..64, implementation-data-type=uint8
    Dcm_ProtocolType: compu {0=DCM_OBD_ON_CAN, 1=DCM_OBD_ON_FLEXRAY, 2=DCM_OBD_ON_IP, 3=DCM_UDS_ON_CAN, 4=DCM_UDS_ON_FLEXRAY, 5=DCM_UDS_ON_IP, 12=DCM_NO_ACTIVE_PROTOCOL, 240..254=DCM_SUPPLIER_1..DCM_SUPPLIER_15}, range raw 0..254, implementation-data-type=uint8
    Dcm_RequestKindType: compu {0=DCM_REQ_KIND_NONE, 1=DCM_REQ_KIND_EXTERNAL, 2=DCM_REQ_KIND_ROE}, range raw 0..2, implementation-data-type=uint8
    Dcm_SecLevelType: compu {0=DCM_SEC_LEV_LOCKED, 1=DCM_SEC_LEV_L1, 2=DCM_SEC_LEV_L2}, range raw 0..2, implementation-data-type=uint8
    Dcm_SesCtrlType: compu {1=DCM_DEFAULT_SESSION, 2=DCM_PROGRAMMING_SESSION, 3=DCM_EXTENDED_DIAGNOSTIC_SESSION}, range raw 0..3, implementation-data-type=uint8
package /MICROSAR_Static_ServicePortInterfaces/Dcm_swc/Interfaces
  4 x client server interface, all with is-service=true, service-kind=DIAGNOSTIC-COMMUNICATION-MANAGER:
    DCMServices
      6 x operation:
        GetActiveProtocol: possible-error=DCMServices/E_OK
          arg ActiveProtocol: type=Dcm_ProtocolType, direction=OUT, server-argument-impl-policy=USE-ARGUMENT-TYPE
        GetRequestKind: possible-error=DCMServices/E_NOT_OK
          arg TesterSourceAddress: type=uint16, direction=IN, server-argument-impl-policy=USE-ARGUMENT-TYPE
          arg RequestKind: type=Dcm_RequestKindType, direction=OUT, server-argument-impl-policy=USE-ARGUMENT-TYPE
        GetSecurityLevel: possible-error=DCMServices/E_OK
          arg SecLevel: type=Dcm_SecLevelType, direction=OUT, server-argument-impl-policy=USE-ARGUMENT-TYPE
        GetSesCtrlType: possible-error=DCMServices/E_OK
          arg SesCtrlType: type=Dcm_SesCtrlType, direction=OUT, server-argument-impl-policy=USE-ARGUMENT-TYPE
        ResetToDefaultSession: possible-error=DCMServices/E_OK
        SetActiveDiagnostic: possible-error=DCMServices/E_OK
          arg active: type=boolean, direction=IN, server-argument-impl-policy=USE-ARGUMENT-TYPE
      error E_NOT_OK: error-code=1
      error E_OK: error-code=0
    SecurityAccess_Level_3
      operation CompareKey: possible-error=[SecurityAccess_Level_3/DCM_E_COMPARE_KEY_FAILED, SecurityAccess_Level_3/DCM_E_PENDING, SecurityAccess_Level_3/E_NOT_OK]
        arg Key: type=Dcm_Data2ByteType, direction=IN, server-argument-impl-policy=USE-ARGUMENT-TYPE
        arg OpStatus: type=Dcm_OpStatusType, direction=IN, server-argument-impl-policy=USE-ARGUMENT-TYPE
        arg ErrorCode: type=Dcm_NegativeResponseCodeType, direction=OUT, server-argument-impl-policy=USE-ARGUMENT-TYPE
      operation GetSeed: possible-error=[SecurityAccess_Level_3/DCM_E_PENDING, SecurityAccess_Level_3/E_NOT_OK]
        arg OpStatus: type=Dcm_OpStatusType, direction=IN, server-argument-impl-policy=USE-ARGUMENT-TYPE
        arg Seed: type=Dcm_Data2ByteType, direction=OUT, server-argument-impl-policy=USE-ARGUMENT-TYPE
        arg ErrorCode: type=Dcm_NegativeResponseCodeType, direction=OUT, server-argument-impl-policy=USE-ARGUMENT-TYPE
      error DCM_E_COMPARE_KEY_FAILED: error-code=11
      error DCM_E_PENDING: error-code=10
      error E_NOT_OK: error-code=1
    SecurityAccess_UnlockedL1
      operation CompareKey: possible-error=[SecurityAccess_UnlockedL1/DCM_E_COMPARE_KEY_FAILED, SecurityAccess_UnlockedL1/DCM_E_PENDING, SecurityAccess_UnlockedL1/E_NOT_OK]
        arg Key: type=Dcm_Data4ByteType, direction=IN, server-argument-impl-policy=USE-ARGUMENT-TYPE
        arg OpStatus: type=Dcm_OpStatusType, direction=IN, server-argument-impl-policy=USE-ARGUMENT-TYPE
        arg ErrorCode: type=Dcm_NegativeResponseCodeType, direction=OUT, server-argument-impl-policy=USE-ARGUMENT-TYPE
      operation GetSeed: possible-error=[SecurityAccess_UnlockedL1/DCM_E_PENDING, SecurityAccess_UnlockedL1/E_NOT_OK]
        arg OpStatus: type=Dcm_OpStatusType, direction=IN, server-argument-impl-policy=USE-ARGUMENT-TYPE
        arg Seed: type=Dcm_Data4ByteType, direction=OUT, server-argument-impl-policy=USE-ARGUMENT-TYPE
        arg ErrorCode: type=Dcm_NegativeResponseCodeType, direction=OUT, server-argument-impl-policy=USE-ARGUMENT-TYPE
      error DCM_E_COMPARE_KEY_FAILED: error-code=11
      error DCM_E_PENDING: error-code=10
      error E_NOT_OK: error-code=1
    ServiceRequestNotification
      operation Confirmation: possible-error=ServiceRequestNotification/E_NOT_OK
        4 x arg, all with direction=IN, server-argument-impl-policy=USE-ARGUMENT-TYPE:
          SID: type=uint8
          ReqType: type=uint8
          SourceAddress: type=uint16
          ConfirmationStatus: type=Dcm_ConfirmationStatusType
      operation Indication: possible-error=[ServiceRequestNotification/E_NOT_OK, E_REQUEST_NOT_ACCEPTED]
        6 x arg, all with server-argument-impl-policy=USE-ARGUMENT-TYPE:
          SID: type=uint8, direction=IN
          RequestData: type=Dcm_Data650ByteType, direction=IN
          DataSize: type=uint16, direction=IN
          ReqType: type=uint8, direction=IN
          SourceAddress: type=uint16, direction=IN
          ErrorCode: type=Dcm_NegativeResponseCodeType, direction=OUT
      error E_NOT_OK: error-code=1
      error E_REQUEST_NOT_ACCEPTED: error-code=8
  mode switch interface DcmControlDtcSetting: is-service=true, service-kind=DIAGNOSTIC-COMMUNICATION-MANAGER
    mode group DcmControlDtcSetting: type=DcmControlDtcSetting
  mode switch interface DcmDiagnosticSessionControl: is-service=true, service-kind=DIAGNOSTIC-COMMUNICATION-MANAGER
    mode group DcmDiagnosticSessionControl: type=DcmDiagnosticSessionControl
  mode switch interface DcmEcuReset: is-service=true, service-kind=DIAGNOSTIC-COMMUNICATION-MANAGER
    mode group DcmEcuReset: type=DcmEcuReset
package /MICROSAR_Static_ServicePortInterfaces/Dem_swc/DataTypes
  12 x impl type:
    Dem_DebounceResetStatusType: compu {0=DEM_DEBOUNCE_STATUS_FREEZE, 1=DEM_DEBOUNCE_STATUS_RESET}, range raw 0..255, implementation-data-type=uint8
    Dem_DebouncingStateType:
      compu {mask 1: 1=DEM_TEMPORARILY_DEFECTIVE (Bit 0: Temporarily Defective (corresponds to 0 < FDC < 127)), mask 2: 2=DEM_FINALLY_DEFECTIVE (Bit 1: Finally Defective (corresponds to FDC = 127)), mask 4: 4=DEM_TEMPORARILY_HEALED (Bit 2: Temporarily healed (corresponds to -128 < FDC < 0)), mask 8: 8=DEM_TEST_COMPLETE (Bit 3: Test complete (corresponds to FDC = -128 or FDC = 127)), mask 16: 16=DEM_DTR_UPDATE (Bit 4: DTR Update (= Test complete && Debouncing complete && enable conditions / storage conditions fulfilled))}
      range raw 0..255
      implementation-data-type=uint8
    Dem_DTCFormatType: compu {0=DEM_DTC_FORMAT_OBD, 1=DEM_DTC_FORMAT_UDS, 2=DEM_DTC_FORMAT_J1939}, range raw 0..2, implementation-data-type=uint8
    Dem_DTCOriginType:
      compu {1=DEM_DTC_ORIGIN_PRIMARY_MEMORY, 2=DEM_DTC_ORIGIN_MIRROR_MEMORY, 3=DEM_DTC_ORIGIN_PERMANENT_MEMORY, 4=DEM_DTC_ORIGIN_OBD_RELEVANT_MEMORY, 5=DEM_DTC_ORIGIN_SECONDARY_MEMORY, 5=DEM_DTC_ORIGIN_USERDEFINED_MEMORY_10, 5=DEM_DTC_ORIGIN_USERDEFINED_MEMORY_11, 5=DEM_DTC_ORIGIN_USERDEFINED_MEMORY_12, 5=DEM_DTC_ORIGIN_USERDEFINED_MEMORY_13, 5=DEM_DTC_ORIGIN_USERDEFINED_MEMORY_14, 5=DEM_DTC_ORIGIN_USERDEFINED_MEMORY_15, 5=DEM_DTC_ORIGIN_USERDEFINED_MEMORY_16, 5=DEM_DTC_ORIGIN_USERDEFINED_MEMORY_17, 5=DEM_DTC_ORIGIN_USERDEFINED_MEMORY_18, 5=DEM_DTC_ORIGIN_USERDEFINED_MEMORY_19, 5=DEM_DTC_ORIGIN_USERDEFINED_MEMORY_1A, 5=DEM_DTC_ORIGIN_USERDEFINED_MEMORY_1B, 5=DEM_DTC_ORIGIN_USERDEFINED_MEMORY_1C, 5=DEM_DTC_ORIGIN_USERDEFINED_MEMORY_1D, 5=DEM_DTC_ORIGIN_USERDEFINED_MEMORY_1E, 5=DEM_DTC_ORIGIN_USERDEFINED_MEMORY_1F, 5=DEM_DTC_ORIGIN_USERDEFINED_MEMORY_20, 5=DEM_DTC_ORIGIN_USERDEFINED_MEMORY_21, 5=DEM_DTC_ORIGIN_USERDEFINED_MEMORY_22, 5=DEM_DTC_ORIGIN_USERDEFINED_MEMORY_23, 5=DEM_DTC_ORIGIN_USERDEFINED_MEMORY_24, 5=DEM_DTC_ORIGIN_USERDEFINED_MEMORY_25, 5=DEM_DTC_ORIGIN_USERDEFINED_MEMORY_26, 5=DEM_DTC_ORIGIN_USERDEFINED_MEMORY_27, 5=DEM_DTC_ORIGIN_USERDEFINED_MEMORY_28, 5=DEM_DTC_ORIGIN_USERDEFINED_MEMORY_29, 5=DEM_DTC_ORIGIN_USERDEFINED_MEMORY_2A, 5=DEM_DTC_ORIGIN_USERDEFINED_MEMORY_2B, 5=DEM_DTC_ORIGIN_USERDEFINED_MEMORY_2C, 5=DEM_DTC_ORIGIN_USERDEFINED_MEMORY_2D, 5=DEM_DTC_ORIGIN_USERDEFINED_MEMORY_2E, 5=DEM_DTC_ORIGIN_USERDEFINED_MEMORY_2F, 5=DEM_DTC_ORIGIN_USERDEFINED_MEMORY_30, 5=DEM_DTC_ORIGIN_USERDEFINED_MEMORY_31, 5=DEM_DTC_ORIGIN_USERDEFINED_MEMORY_32, 5=DEM_DTC_ORIGIN_USERDEFINED_MEMORY_33, 5=DEM_DTC_ORIGIN_USERDEFINED_MEMORY_34, 5=DEM_DTC_ORIGIN_USERDEFINED_MEMORY_35, 5=DEM_DTC_ORIGIN_USERDEFINED_MEMORY_36, 5=DEM_DTC_ORIGIN_USERDEFINED_MEMORY_37, 5=DEM_DTC_ORIGIN_USERDEFINED_MEMORY_38, 5=DEM_DTC_ORIGIN_USERDEFINED_MEMORY_39, 5=DEM_DTC_ORIGIN_USERDEFINED_MEMORY_3A, 5=DEM_DTC_ORIGIN_USERDEFINED_MEMORY_3B, 5=DEM_DTC_ORIGIN_USERDEFINED_MEMORY_3C, 5=DEM_DTC_ORIGIN_USERDEFINED_MEMORY_3D, 5=DEM_DTC_ORIGIN_USERDEFINED_MEMORY_3E, 5=DEM_DTC_ORIGIN_USERDEFINED_MEMORY_3F, 5=DEM_DTC_ORIGIN_USERDEFINED_MEMORY_40, 5=DEM_DTC_ORIGIN_USERDEFINED_MEMORY_41, 5=DEM_DTC_ORIGIN_USERDEFINED_MEMORY_42, 5=DEM_DTC_ORIGIN_USERDEFINED_MEMORY_43, 5=DEM_DTC_ORIGIN_USERDEFINED_MEMORY_44, 5=DEM_DTC_ORIGIN_USERDEFINED_MEMORY_45, 5=DEM_DTC_ORIGIN_USERDEFINED_MEMORY_46, 5=DEM_DTC_ORIGIN_USERDEFINED_MEMORY_47, 5=DEM_DTC_ORIGIN_USERDEFINED_MEMORY_48, 5=DEM_DTC_ORIGIN_USERDEFINED_MEMORY_49, 5=DEM_DTC_ORIGIN_USERDEFINED_MEMORY_4A, 5=DEM_DTC_ORIGIN_USERDEFINED_MEMORY_4B, 5=DEM_DTC_ORIGIN_USERDEFINED_MEMORY_4C, 5=DEM_DTC_ORIGIN_USERDEFINED_MEMORY_4D, 5=DEM_DTC_ORIGIN_USERDEFINED_MEMORY_4E, 5=DEM_DTC_ORIGIN_USERDEFINED_MEMORY_4F, 5=DEM_DTC_ORIGIN_USERDEFINED_MEMORY_50, 5=DEM_DTC_ORIGIN_USERDEFINED_MEMORY_51, 5=DEM_DTC_ORIGIN_USERDEFINED_MEMORY_52, 5=DEM_DTC_ORIGIN_USERDEFINED_MEMORY_53, 5=DEM_DTC_ORIGIN_USERDEFINED_MEMORY_54, 5=DEM_DTC_ORIGIN_USERDEFINED_MEMORY_55, 5=DEM_DTC_ORIGIN_USERDEFINED_MEMORY_56, 5=DEM_DTC_ORIGIN_USERDEFINED_MEMORY_57, 5=DEM_DTC_ORIGIN_USERDEFINED_MEMORY_58, 5=DEM_DTC_ORIGIN_USERDEFINED_MEMORY_59, 5=DEM_DTC_ORIGIN_USERDEFINED_MEMORY_5A, 5=DEM_DTC_ORIGIN_USERDEFINED_MEMORY_5B, 5=DEM_DTC_ORIGIN_USERDEFINED_MEMORY_5C, 5=DEM_DTC_ORIGIN_USERDEFINED_MEMORY_5D, 5=DEM_DTC_ORIGIN_USERDEFINED_MEMORY_5E, 5=DEM_DTC_ORIGIN_USERDEFINED_MEMORY_5F, 5=DEM_DTC_ORIGIN_USERDEFINED_MEMORY_60, 5=DEM_DTC_ORIGIN_USERDEFINED_MEMORY_61, 5=DEM_DTC_ORIGIN_USERDEFINED_MEMORY_62, 5=DEM_DTC_ORIGIN_USERDEFINED_MEMORY_63, 5=DEM_DTC_ORIGIN_USERDEFINED_MEMORY_64, 5=DEM_DTC_ORIGIN_USERDEFINED_MEMORY_65, 5=DEM_DTC_ORIGIN_USERDEFINED_MEMORY_66, 5=DEM_DTC_ORIGIN_USERDEFINED_MEMORY_67, 5=DEM_DTC_ORIGIN_USERDEFINED_MEMORY_68, 5=DEM_DTC_ORIGIN_USERDEFINED_MEMORY_69, 5=DEM_DTC_ORIGIN_USERDEFINED_MEMORY_6A, 5=DEM_DTC_ORIGIN_USERDEFINED_MEMORY_6B, 5=DEM_DTC_ORIGIN_USERDEFINED_MEMORY_6C, 5=DEM_DTC_ORIGIN_USERDEFINED_MEMORY_6D, 5=DEM_DTC_ORIGIN_USERDEFINED_MEMORY_6E, 5=DEM_DTC_ORIGIN_USERDEFINED_MEMORY_6F, 5=DEM_DTC_ORIGIN_USERDEFINED_MEMORY_70, 5=DEM_DTC_ORIGIN_USERDEFINED_MEMORY_71, 5=DEM_DTC_ORIGIN_USERDEFINED_MEMORY_72, 5=DEM_DTC_ORIGIN_USERDEFINED_MEMORY_73, 5=DEM_DTC_ORIGIN_USERDEFINED_MEMORY_74, 5=DEM_DTC_ORIGIN_USERDEFINED_MEMORY_75, 5=DEM_DTC_ORIGIN_USERDEFINED_MEMORY_76, 5=DEM_DTC_ORIGIN_USERDEFINED_MEMORY_77, 5=DEM_DTC_ORIGIN_USERDEFINED_MEMORY_78, 5=DEM_DTC_ORIGIN_USERDEFINED_MEMORY_79, 5=DEM_DTC_ORIGIN_USERDEFINED_MEMORY_7A, 5=DEM_DTC_ORIGIN_USERDEFINED_MEMORY_7B, 5=DEM_DTC_ORIGIN_USERDEFINED_MEMORY_7C, 5=DEM_DTC_ORIGIN_USERDEFINED_MEMORY_7D, 5=DEM_DTC_ORIGIN_USERDEFINED_MEMORY_7E, 5=DEM_DTC_ORIGIN_USERDEFINED_MEMORY_7F, 5=DEM_DTC_ORIGIN_USERDEFINED_MEMORY_80, 5=DEM_DTC_ORIGIN_USERDEFINED_MEMORY_81, 5=DEM_DTC_ORIGIN_USERDEFINED_MEMORY_82, 5=DEM_DTC_ORIGIN_USERDEFINED_MEMORY_83, 5=DEM_DTC_ORIGIN_USERDEFINED_MEMORY_84, 5=DEM_DTC_ORIGIN_USERDEFINED_MEMORY_85, 5=DEM_DTC_ORIGIN_USERDEFINED_MEMORY_86, 5=DEM_DTC_ORIGIN_USERDEFINED_MEMORY_87, 5=DEM_DTC_ORIGIN_USERDEFINED_MEMORY_88, 5=DEM_DTC_ORIGIN_USERDEFINED_MEMORY_89, 5=DEM_DTC_ORIGIN_USERDEFINED_MEMORY_8A, 5=DEM_DTC_ORIGIN_USERDEFINED_MEMORY_8B, 5=DEM_DTC_ORIGIN_USERDEFINED_MEMORY_8C, 5=DEM_DTC_ORIGIN_USERDEFINED_MEMORY_8D, 5=DEM_DTC_ORIGIN_USERDEFINED_MEMORY_8E, 5=DEM_DTC_ORIGIN_USERDEFINED_MEMORY_8F, 5=DEM_DTC_ORIGIN_USERDEFINED_MEMORY_90, 5=DEM_DTC_ORIGIN_USERDEFINED_MEMORY_91, 5=DEM_DTC_ORIGIN_USERDEFINED_MEMORY_92, 5=DEM_DTC_ORIGIN_USERDEFINED_MEMORY_93, 5=DEM_DTC_ORIGIN_USERDEFINED_MEMORY_94, 5=DEM_DTC_ORIGIN_USERDEFINED_MEMORY_95, 5=DEM_DTC_ORIGIN_USERDEFINED_MEMORY_96, 5=DEM_DTC_ORIGIN_USERDEFINED_MEMORY_97, 5=DEM_DTC_ORIGIN_USERDEFINED_MEMORY_98, 5=DEM_DTC_ORIGIN_USERDEFINED_MEMORY_99, 5=DEM_DTC_ORIGIN_USERDEFINED_MEMORY_9A, 5=DEM_DTC_ORIGIN_USERDEFINED_MEMORY_9B, 5=DEM_DTC_ORIGIN_USERDEFINED_MEMORY_9C, 5=DEM_DTC_ORIGIN_USERDEFINED_MEMORY_9D, 5=DEM_DTC_ORIGIN_USERDEFINED_MEMORY_9E, 5=DEM_DTC_ORIGIN_USERDEFINED_MEMORY_9F, 5=DEM_DTC_ORIGIN_USERDEFINED_MEMORY_A0, 5=DEM_DTC_ORIGIN_USERDEFINED_MEMORY_A1, 5=DEM_DTC_ORIGIN_USERDEFINED_MEMORY_A2, 5=DEM_DTC_ORIGIN_USERDEFINED_MEMORY_A3, 5=DEM_DTC_ORIGIN_USERDEFINED_MEMORY_A4, 5=DEM_DTC_ORIGIN_USERDEFINED_MEMORY_A5, 5=DEM_DTC_ORIGIN_USERDEFINED_MEMORY_A6, 5=DEM_DTC_ORIGIN_USERDEFINED_MEMORY_A7, 5=DEM_DTC_ORIGIN_USERDEFINED_MEMORY_A8, 5=DEM_DTC_ORIGIN_USERDEFINED_MEMORY_A9, 5=DEM_DTC_ORIGIN_USERDEFINED_MEMORY_AA, 5=DEM_DTC_ORIGIN_USERDEFINED_MEMORY_AB, 5=DEM_DTC_ORIGIN_USERDEFINED_MEMORY_AC, 5=DEM_DTC_ORIGIN_USERDEFINED_MEMORY_AD, 5=DEM_DTC_ORIGIN_USERDEFINED_MEMORY_AE, 5=DEM_DTC_ORIGIN_USERDEFINED_MEMORY_AF, 5=DEM_DTC_ORIGIN_USERDEFINED_MEMORY_B0, 5=DEM_DTC_ORIGIN_USERDEFINED_MEMORY_B1, 5=DEM_DTC_ORIGIN_USERDEFINED_MEMORY_B2, 5=DEM_DTC_ORIGIN_USERDEFINED_MEMORY_B3, 5=DEM_DTC_ORIGIN_USERDEFINED_MEMORY_B4, 5=DEM_DTC_ORIGIN_USERDEFINED_MEMORY_B5, 5=DEM_DTC_ORIGIN_USERDEFINED_MEMORY_B6, 5=DEM_DTC_ORIGIN_USERDEFINED_MEMORY_B7, 5=DEM_DTC_ORIGIN_USERDEFINED_MEMORY_B8, 5=DEM_DTC_ORIGIN_USERDEFINED_MEMORY_B9, 5=DEM_DTC_ORIGIN_USERDEFINED_MEMORY_BA, 5=DEM_DTC_ORIGIN_USERDEFINED_MEMORY_BB, 5=DEM_DTC_ORIGIN_USERDEFINED_MEMORY_BC, 5=DEM_DTC_ORIGIN_USERDEFINED_MEMORY_BD, 5=DEM_DTC_ORIGIN_USERDEFINED_MEMORY_BE, 5=DEM_DTC_ORIGIN_USERDEFINED_MEMORY_BF, 5=DEM_DTC_ORIGIN_USERDEFINED_MEMORY_C0, 5=DEM_DTC_ORIGIN_USERDEFINED_MEMORY_C1, 5=DEM_DTC_ORIGIN_USERDEFINED_MEMORY_C2, 5=DEM_DTC_ORIGIN_USERDEFINED_MEMORY_C3, 5=DEM_DTC_ORIGIN_USERDEFINED_MEMORY_C4, 5=DEM_DTC_ORIGIN_USERDEFINED_MEMORY_C5, 5=DEM_DTC_ORIGIN_USERDEFINED_MEMORY_C6, 5=DEM_DTC_ORIGIN_USERDEFINED_MEMORY_C7, 5=DEM_DTC_ORIGIN_USERDEFINED_MEMORY_C8, 5=DEM_DTC_ORIGIN_USERDEFINED_MEMORY_C9, 5=DEM_DTC_ORIGIN_USERDEFINED_MEMORY_CA, 5=DEM_DTC_ORIGIN_USERDEFINED_MEMORY_CB, 5=DEM_DTC_ORIGIN_USERDEFINED_MEMORY_CC, 5=DEM_DTC_ORIGIN_USERDEFINED_MEMORY_CD, 5=DEM_DTC_ORIGIN_USERDEFINED_MEMORY_CE, 5=DEM_DTC_ORIGIN_USERDEFINED_MEMORY_CF, 5=DEM_DTC_ORIGIN_USERDEFINED_MEMORY_D0, 5=DEM_DTC_ORIGIN_USERDEFINED_MEMORY_D1, 5=DEM_DTC_ORIGIN_USERDEFINED_MEMORY_D2, 5=DEM_DTC_ORIGIN_USERDEFINED_MEMORY_D3, 5=DEM_DTC_ORIGIN_USERDEFINED_MEMORY_D4, 5=DEM_DTC_ORIGIN_USERDEFINED_MEMORY_D5, 5=DEM_DTC_ORIGIN_USERDEFINED_MEMORY_D6, 5=DEM_DTC_ORIGIN_USERDEFINED_MEMORY_D7, 5=DEM_DTC_ORIGIN_USERDEFINED_MEMORY_D8, 5=DEM_DTC_ORIGIN_USERDEFINED_MEMORY_D9, 5=DEM_DTC_ORIGIN_USERDEFINED_MEMORY_DA, 5=DEM_DTC_ORIGIN_USERDEFINED_MEMORY_DB, 5=DEM_DTC_ORIGIN_USERDEFINED_MEMORY_DC, 5=DEM_DTC_ORIGIN_USERDEFINED_MEMORY_DD, 5=DEM_DTC_ORIGIN_USERDEFINED_MEMORY_DE, 5=DEM_DTC_ORIGIN_USERDEFINED_MEMORY_DF, 5=DEM_DTC_ORIGIN_USERDEFINED_MEMORY_E0, 5=DEM_DTC_ORIGIN_USERDEFINED_MEMORY_E1, 5=DEM_DTC_ORIGIN_USERDEFINED_MEMORY_E2, 5=DEM_DTC_ORIGIN_USERDEFINED_MEMORY_E3, 5=DEM_DTC_ORIGIN_USERDEFINED_MEMORY_E4, 5=DEM_DTC_ORIGIN_USERDEFINED_MEMORY_E5, 5=DEM_DTC_ORIGIN_USERDEFINED_MEMORY_E6, 5=DEM_DTC_ORIGIN_USERDEFINED_MEMORY_E7, 5=DEM_DTC_ORIGIN_USERDEFINED_MEMORY_E8, 5=DEM_DTC_ORIGIN_USERDEFINED_MEMORY_E9, 5=DEM_DTC_ORIGIN_USERDEFINED_MEMORY_EA, 5=DEM_DTC_ORIGIN_USERDEFINED_MEMORY_EB, 5=DEM_DTC_ORIGIN_USERDEFINED_MEMORY_EC, 5=DEM_DTC_ORIGIN_USERDEFINED_MEMORY_ED, 5=DEM_DTC_ORIGIN_USERDEFINED_MEMORY_EE, 5=DEM_DTC_ORIGIN_USERDEFINED_MEMORY_EF, 5=DEM_DTC_ORIGIN_USERDEFINED_MEMORY_F0, 5=DEM_DTC_ORIGIN_USERDEFINED_MEMORY_F1, 5=DEM_DTC_ORIGIN_USERDEFINED_MEMORY_F2, 5=DEM_DTC_ORIGIN_USERDEFINED_MEMORY_F3, 5=DEM_DTC_ORIGIN_USERDEFINED_MEMORY_F4, 5=DEM_DTC_ORIGIN_USERDEFINED_MEMORY_F5, 5=DEM_DTC_ORIGIN_USERDEFINED_MEMORY_F6, 5=DEM_DTC_ORIGIN_USERDEFINED_MEMORY_F7, 5=DEM_DTC_ORIGIN_USERDEFINED_MEMORY_F8, 5=DEM_DTC_ORIGIN_USERDEFINED_MEMORY_F9, 5=DEM_DTC_ORIGIN_USERDEFINED_MEMORY_FA, 5=DEM_DTC_ORIGIN_USERDEFINED_MEMORY_FB, 5=DEM_DTC_ORIGIN_USERDEFINED_MEMORY_FC, 5=DEM_DTC_ORIGIN_USERDEFINED_MEMORY_FD, 5=DEM_DTC_ORIGIN_USERDEFINED_MEMORY_FE, 5=DEM_DTC_ORIGIN_USERDEFINED_MEMORY_FF}
      range raw 1..511
      implementation-data-type=uint16
    Dem_EventIdType: range raw 1..65535, implementation-data-type=uint16
    Dem_EventStatusType:
      compu {0=DEM_EVENT_STATUS_PASSED, 1=DEM_EVENT_STATUS_FAILED, 2=DEM_EVENT_STATUS_PREPASSED, 3=DEM_EVENT_STATUS_PREFAILED, 4=DEM_EVENT_STATUS_FDC_THRESHOLD_REACHED, 5=DEM_EVENT_STATUS_PASSED_CONDITIONS_NOT_FULFILLED, 6=DEM_EVENT_STATUS_FAILED_CONDITIONS_NOT_FULFILLED, 7=DEM_EVENT_STATUS_PREPASSED_CONDITIONS_NOT_FULFILLED, 8=DEM_EVENT_STATUS_PREFAILED_CONDITIONS_NOT_FULFILLED}
      range raw 0..255
      implementation-data-type=uint8
    Dem_IndicatorStatusType: compu {0=DEM_INDICATOR_OFF, 1=DEM_INDICATOR_CONTINUOUS, 2=DEM_INDICATOR_BLINKING, 3=DEM_INDICATOR_BLINK_CONT, 4=DEM_INDICATOR_SLOW_FLASH, 5=DEM_INDICATOR_FAST_FLASH, 6=DEM_INDICATOR_ON_DEMAND, 7=DEM_INDICATOR_SHORT}, range raw 0..7, implementation-data-type=uint8
    Dem_InitMonitorReasonType: compu {1=DEM_INIT_MONITOR_CLEAR, 2=DEM_INIT_MONITOR_RESTART, 3=DEM_INIT_MONITOR_REENABLED, 4=DEM_INIT_MONITOR_STORAGE_REENABLED}, range raw 1..4, implementation-data-type=uint8
    Dem_MaxDataValueType: category=ARRAY, sw-calibration-access=READ-ONLY
      element Dem_MaxDataValueTypeElement: array-size=6, array-size-semantics=FIXED-SIZE, implementation-data-type=uint8
    Dem_MonitorStatusType: compu {mask 1: 1=DEM_MONITOR_STATUS_TF (bit 0: TestFailed), mask 2: 2=DEM_MONITOR_STATUS_TNCTOC (bit 1: TestNotCompletedThisOperationCycle)}, range raw 0..255, implementation-data-type=uint8
    Dem_OperationCycleStateType: compu {0=DEM_CYCLE_STATE_START, 1=DEM_CYCLE_STATE_END}, range raw 0..1, implementation-data-type=uint8
    Dem_UdsStatusByteType:
      compu {mask 1: 1=DEM_UDS_STATUS_TF (bit 0: TestFailed), mask 2: 2=DEM_UDS_STATUS_TFTOC (bit 1: TestFailedThisOperationCycle), mask 4: 4=DEM_UDS_STATUS_PDTC (bit 2: PendingDTC), mask 8: 8=DEM_UDS_STATUS_CDTC (bit 3: ConfirmedDTC), mask 16: 16=DEM_UDS_STATUS_TNCSLC (bit 4: TestNotCompletedSinceLastClear), mask 32: 32=DEM_UDS_STATUS_TFSLC (bit 5: TestFailedSinceLastClear), mask 64: 64=DEM_UDS_STATUS_TNCTOC (bit 6: TestNotCompletedThisOperationCycle), mask 128: 128=DEM_UDS_STATUS_WIR (bit 7: WarningIndicatorRequested)}
      range raw 0..255
      implementation-data-type=uint8
package /MICROSAR_Static_ServicePortInterfaces/Dem_swc/Interfaces
  10 x client server interface, all with is-service=true, service-kind=DIAGNOSTIC-EVENT-MANAGER:
    CallbackInitMonitorForEvent
      operation InitMonitorForEvent: possible-error=CallbackInitMonitorForEvent/E_NOT_OK
        arg InitMonitorReason: type=Dem_InitMonitorReasonType, direction=IN, server-argument-impl-policy=USE-ARGUMENT-TYPE
      error E_NOT_OK: error-code=1
    ClearDTC
      operation ClearDTC: possible-error=[DEM_CLEAR_BUSY, DEM_CLEAR_FAILED, DEM_CLEAR_MEMORY_ERROR, DEM_PENDING, DEM_WRONG_DTC, DEM_WRONG_DTCORIGIN, ClearDTC/E_NOT_OK]
      operation SelectDTC: possible-error=[ClearDTC/E_NOT_OK, ClearDTC/E_OK]
        arg DTC: type=uint32, direction=IN, server-argument-impl-policy=USE-ARGUMENT-TYPE
        arg DTCFormat: type=Dem_DTCFormatType, direction=IN, server-argument-impl-policy=USE-ARGUMENT-TYPE
        arg DTCOrigin: type=Dem_DTCOriginType, direction=IN, server-argument-impl-policy=USE-ARGUMENT-TYPE
      8 x error:
        DEM_CLEAR_BUSY: error-code=5
        DEM_CLEAR_FAILED: error-code=7
        DEM_CLEAR_MEMORY_ERROR: error-code=6
        DEM_PENDING: error-code=4
        DEM_WRONG_DTC: error-code=8
        DEM_WRONG_DTCORIGIN: error-code=9
        E_NOT_OK: error-code=1
        E_OK: error-code=0
    DemServices
      operation GetDTCStatusAvailabilityMask: possible-error=DemServices/E_NOT_OK
        arg ClientId: type=uint8, direction=IN, server-argument-impl-policy=USE-ARGUMENT-TYPE
        arg DTCStatusMask: type=uint8, direction=OUT, server-argument-impl-policy=USE-ARGUMENT-TYPE
      operation GetPostRunRequested: possible-error=DemServices/E_NOT_OK
        arg IsRequested: type=boolean, direction=OUT, server-argument-impl-policy=USE-ARGUMENT-TYPE
      error E_NOT_OK: error-code=1
    DiagnosticInfo
      11 x operation:
        GetDebouncingOfEvent: possible-error=DiagnosticInfo/E_NOT_OK
          arg DebouncingState: type=Dem_DebouncingStateType, direction=OUT, server-argument-impl-policy=USE-ARGUMENT-TYPE
        GetDTCOfEvent: possible-error=[DiagnosticInfo/DEM_E_NO_DTC_AVAILABLE, DiagnosticInfo/E_NOT_OK]
          arg DTCFormat: type=Dem_DTCFormatType, direction=IN, server-argument-impl-policy=USE-ARGUMENT-TYPE
          arg DTCOfEvent: type=uint32, direction=OUT, server-argument-impl-policy=USE-ARGUMENT-TYPE
        GetEventEnableCondition: possible-error=DiagnosticInfo/E_NOT_OK
          arg ConditionFullfilled: type=boolean, direction=OUT, server-argument-impl-policy=USE-ARGUMENT-TYPE
        GetEventExtendedDataRecordEx: possible-error=[DiagnosticInfo/DEM_BUFFER_TOO_SMALL, DiagnosticInfo/DEM_NO_SUCH_ELEMENT, DiagnosticInfo/E_NOT_OK]
          arg RecordNumber: type=uint8, direction=IN, server-argument-impl-policy=USE-ARGUMENT-TYPE
          arg DestBuffer: type=Dem_MaxDataValueType, direction=OUT, server-argument-impl-policy=USE-ARGUMENT-TYPE
          arg BufSize: type=uint16, direction=INOUT, server-argument-impl-policy=USE-ARGUMENT-TYPE
        GetEventFailed: possible-error=DiagnosticInfo/E_NOT_OK
          arg EventFailed: type=boolean, direction=OUT, server-argument-impl-policy=USE-ARGUMENT-TYPE
        GetEventFreezeFrameDataEx: possible-error=[DiagnosticInfo/DEM_BUFFER_TOO_SMALL, DiagnosticInfo/DEM_NO_SUCH_ELEMENT, DiagnosticInfo/E_NOT_OK]
          4 x arg, all with server-argument-impl-policy=USE-ARGUMENT-TYPE:
            RecordNumber: type=uint8, direction=IN
            DataId: type=uint16, direction=IN
            DestBuffer: type=Dem_MaxDataValueType, direction=OUT
            BufSize: type=uint16, direction=INOUT
        GetEventStatus: possible-error=DiagnosticInfo/E_NOT_OK
          arg UDSStatusByte: type=Dem_UdsStatusByteType, direction=OUT, server-argument-impl-policy=USE-ARGUMENT-TYPE
        GetEventTested: possible-error=DiagnosticInfo/E_NOT_OK
          arg EventTested: type=boolean, direction=OUT, server-argument-impl-policy=USE-ARGUMENT-TYPE
        GetEventUdsStatus: possible-error=DiagnosticInfo/E_NOT_OK
          arg UDSStatusByte: type=Dem_UdsStatusByteType, direction=OUT, server-argument-impl-policy=USE-ARGUMENT-TYPE
        GetFaultDetectionCounter: possible-error=[DiagnosticInfo/DEM_E_NO_FDC_AVAILABLE, DiagnosticInfo/E_NOT_OK]
          arg FaultDetectionCounter: type=sint8, direction=OUT, server-argument-impl-policy=USE-ARGUMENT-TYPE
        GetMonitorStatus: possible-error=DiagnosticInfo/E_NOT_OK
          arg MonitorStatus: type=Dem_MonitorStatusType, direction=OUT, server-argument-impl-policy=USE-ARGUMENT-TYPE
      5 x error:
        DEM_BUFFER_TOO_SMALL: error-code=21
        DEM_E_NO_DTC_AVAILABLE: error-code=10
        DEM_E_NO_FDC_AVAILABLE: error-code=14
        DEM_NO_SUCH_ELEMENT: error-code=48
        E_NOT_OK: error-code=1
    DiagnosticMonitor
      11 x operation:
        GetDTCOfEvent: possible-error=[DiagnosticMonitor/DEM_E_NO_DTC_AVAILABLE, DiagnosticMonitor/E_NOT_OK]
          arg DTCFormat: type=Dem_DTCFormatType, direction=IN, server-argument-impl-policy=USE-ARGUMENT-TYPE
          arg DTCOfEvent: type=uint32, direction=OUT, server-argument-impl-policy=USE-ARGUMENT-TYPE
        GetEventExtendedDataRecordEx: possible-error=[DiagnosticMonitor/DEM_BUFFER_TOO_SMALL, DiagnosticMonitor/DEM_NO_SUCH_ELEMENT, DiagnosticMonitor/E_NOT_OK]
          arg RecordNumber: type=uint8, direction=IN, server-argument-impl-policy=USE-ARGUMENT-TYPE
          arg DestBuffer: type=Dem_MaxDataValueType, direction=OUT, server-argument-impl-policy=USE-ARGUMENT-TYPE
          arg BufSize: type=uint16, direction=INOUT, server-argument-impl-policy=USE-ARGUMENT-TYPE
        GetEventFailed: possible-error=DiagnosticMonitor/E_NOT_OK
          arg EventFailed: type=boolean, direction=OUT, server-argument-impl-policy=USE-ARGUMENT-TYPE
        GetEventFreezeFrameDataEx: possible-error=[DiagnosticMonitor/DEM_BUFFER_TOO_SMALL, DiagnosticMonitor/DEM_NO_SUCH_ELEMENT, DiagnosticMonitor/E_NOT_OK]
          4 x arg, all with server-argument-impl-policy=USE-ARGUMENT-TYPE:
            RecordNumber: type=uint8, direction=IN
            DataId: type=uint16, direction=IN
            DestBuffer: type=Dem_MaxDataValueType, direction=OUT
            BufSize: type=uint16, direction=INOUT
        GetEventStatus: possible-error=DiagnosticMonitor/E_NOT_OK
          arg UDSStatusByte: type=Dem_UdsStatusByteType, direction=OUT, server-argument-impl-policy=USE-ARGUMENT-TYPE
        GetEventTested: possible-error=DiagnosticMonitor/E_NOT_OK
          arg EventTested: type=boolean, direction=OUT, server-argument-impl-policy=USE-ARGUMENT-TYPE
        GetEventUdsStatus: possible-error=DiagnosticMonitor/E_NOT_OK
          arg UDSStatusByte: type=Dem_UdsStatusByteType, direction=OUT, server-argument-impl-policy=USE-ARGUMENT-TYPE
        GetFaultDetectionCounter: possible-error=[DiagnosticMonitor/DEM_E_NO_FDC_AVAILABLE, DiagnosticMonitor/E_NOT_OK]
          arg FaultDetectionCounter: type=sint8, direction=OUT, server-argument-impl-policy=USE-ARGUMENT-TYPE
        ResetEventDebounceStatus: possible-error=DiagnosticMonitor/E_NOT_OK
          arg DebounceResetStatus: type=Dem_DebounceResetStatusType, direction=IN, server-argument-impl-policy=USE-ARGUMENT-TYPE
        ResetEventStatus: possible-error=DiagnosticMonitor/E_NOT_OK
        SetEventStatus: possible-error=DiagnosticMonitor/E_NOT_OK
          arg EventStatus: type=Dem_EventStatusType, direction=IN, server-argument-impl-policy=USE-ARGUMENT-TYPE
      5 x error:
        DEM_BUFFER_TOO_SMALL: error-code=21
        DEM_E_NO_DTC_AVAILABLE: error-code=10
        DEM_E_NO_FDC_AVAILABLE: error-code=14
        DEM_NO_SUCH_ELEMENT: error-code=48
        E_NOT_OK: error-code=1
    EventAvailable
      operation GetEventAvailable: possible-error=[EventAvailable/E_NOT_OK, EventAvailable/E_OK]
        arg AvailableStatus: type=boolean, direction=OUT, server-argument-impl-policy=USE-ARGUMENT-TYPE
      operation SetEventAvailable: possible-error=[EventAvailable/E_NOT_OK, EventAvailable/E_OK]
        arg AvailableStatus: type=boolean, direction=IN, server-argument-impl-policy=USE-ARGUMENT-TYPE
      error E_NOT_OK: error-code=1
      error E_OK: error-code=0
    EvMemOverflowIndication
      operation GetEventMemoryOverflow: possible-error=EvMemOverflowIndication/E_NOT_OK
        arg OverflowIndication: type=boolean, direction=OUT, server-argument-impl-policy=USE-ARGUMENT-TYPE
      operation GetNumberOfEventMemoryEntries: possible-error=EvMemOverflowIndication/E_NOT_OK
        arg NumberOfEventMemoryEntries: type=uint8, direction=OUT, server-argument-impl-policy=USE-ARGUMENT-TYPE
      error E_NOT_OK: error-code=1
    GeneralDiagnosticInfo
      11 x operation:
        GetDebouncingOfEvent: possible-error=GeneralDiagnosticInfo/E_NOT_OK
          arg EventId: type=Dem_EventIdType, direction=IN, server-argument-impl-policy=USE-ARGUMENT-TYPE
          arg DebouncingState: type=Dem_DebouncingStateType, direction=OUT, server-argument-impl-policy=USE-ARGUMENT-TYPE
        GetDTCOfEvent: possible-error=[GeneralDiagnosticInfo/DEM_E_NO_DTC_AVAILABLE, GeneralDiagnosticInfo/E_NOT_OK]
          arg EventId: type=Dem_EventIdType, direction=IN, server-argument-impl-policy=USE-ARGUMENT-TYPE
          arg DTCFormat: type=Dem_DTCFormatType, direction=IN, server-argument-impl-policy=USE-ARGUMENT-TYPE
          arg DTCOfEvent: type=uint32, direction=OUT, server-argument-impl-policy=USE-ARGUMENT-TYPE
        GetEventEnableCondition: possible-error=GeneralDiagnosticInfo/E_NOT_OK
          arg EventId: type=Dem_EventIdType, direction=IN, server-argument-impl-policy=USE-ARGUMENT-TYPE
          arg ConditionFullfilled: type=boolean, direction=OUT, server-argument-impl-policy=USE-ARGUMENT-TYPE
        GetEventExtendedDataRecordEx: possible-error=[GeneralDiagnosticInfo/DEM_BUFFER_TOO_SMALL, GeneralDiagnosticInfo/DEM_NO_SUCH_ELEMENT, GeneralDiagnosticInfo/E_NOT_OK]
          4 x arg, all with server-argument-impl-policy=USE-ARGUMENT-TYPE:
            EventId: type=Dem_EventIdType, direction=IN
            RecordNumber: type=uint8, direction=IN
            DestBuffer: type=Dem_MaxDataValueType, direction=OUT
            BufSize: type=uint16, direction=INOUT
        GetEventFailed: possible-error=GeneralDiagnosticInfo/E_NOT_OK
          arg EventId: type=Dem_EventIdType, direction=IN, server-argument-impl-policy=USE-ARGUMENT-TYPE
          arg EventFailed: type=boolean, direction=OUT, server-argument-impl-policy=USE-ARGUMENT-TYPE
        GetEventFreezeFrameDataEx: possible-error=[GeneralDiagnosticInfo/DEM_BUFFER_TOO_SMALL, GeneralDiagnosticInfo/DEM_NO_SUCH_ELEMENT, GeneralDiagnosticInfo/E_NOT_OK]
          5 x arg, all with server-argument-impl-policy=USE-ARGUMENT-TYPE:
            EventId: type=Dem_EventIdType, direction=IN
            RecordNumber: type=uint8, direction=IN
            DataId: type=uint16, direction=IN
            DestBuffer: type=Dem_MaxDataValueType, direction=OUT
            BufSize: type=uint16, direction=INOUT
        GetEventStatus: possible-error=GeneralDiagnosticInfo/E_NOT_OK
          arg EventId: type=Dem_EventIdType, direction=IN, server-argument-impl-policy=USE-ARGUMENT-TYPE
          arg UDSStatusByte: type=Dem_UdsStatusByteType, direction=OUT, server-argument-impl-policy=USE-ARGUMENT-TYPE
        GetEventTested: possible-error=GeneralDiagnosticInfo/E_NOT_OK
          arg EventId: type=Dem_EventIdType, direction=IN, server-argument-impl-policy=USE-ARGUMENT-TYPE
          arg EventTested: type=boolean, direction=OUT, server-argument-impl-policy=USE-ARGUMENT-TYPE
        GetEventUdsStatus: possible-error=GeneralDiagnosticInfo/E_NOT_OK
          arg EventId: type=Dem_EventIdType, direction=IN, server-argument-impl-policy=USE-ARGUMENT-TYPE
          arg UDSStatusByte: type=Dem_UdsStatusByteType, direction=OUT, server-argument-impl-policy=USE-ARGUMENT-TYPE
        GetFaultDetectionCounter: possible-error=[GeneralDiagnosticInfo/DEM_E_NO_FDC_AVAILABLE, GeneralDiagnosticInfo/E_NOT_OK]
          arg EventId: type=Dem_EventIdType, direction=IN, server-argument-impl-policy=USE-ARGUMENT-TYPE
          arg FaultDetectionCounter: type=sint8, direction=OUT, server-argument-impl-policy=USE-ARGUMENT-TYPE
        GetMonitorStatus: possible-error=GeneralDiagnosticInfo/E_NOT_OK
          arg EventId: type=Dem_EventIdType, direction=IN, server-argument-impl-policy=USE-ARGUMENT-TYPE
          arg MonitorStatus: type=Dem_MonitorStatusType, direction=OUT, server-argument-impl-policy=USE-ARGUMENT-TYPE
      5 x error:
        DEM_BUFFER_TOO_SMALL: error-code=21
        DEM_E_NO_DTC_AVAILABLE: error-code=10
        DEM_E_NO_FDC_AVAILABLE: error-code=14
        DEM_NO_SUCH_ELEMENT: error-code=48
        E_NOT_OK: error-code=1
    IndicatorStatus
      operation GetIndicatorStatus: possible-error=IndicatorStatus/E_NOT_OK
        arg IndicatorStatus: type=Dem_IndicatorStatusType, direction=OUT, server-argument-impl-policy=USE-ARGUMENT-TYPE
      error E_NOT_OK: error-code=1
    OperationCycle
      operation GetOperationCycleState: possible-error=[OperationCycle/E_NOT_OK, OperationCycle/E_OK]
        arg CycleState: type=Dem_OperationCycleStateType, direction=OUT, server-argument-impl-policy=USE-ARGUMENT-TYPE
      operation SetOperationCycleState: possible-error=[OperationCycle/E_NOT_OK, OperationCycle/E_OK]
        arg CycleState: type=Dem_OperationCycleStateType, direction=IN, server-argument-impl-policy=USE-ARGUMENT-TYPE
      error E_NOT_OK: error-code=1
      error E_OK: error-code=0
package /MICROSAR_Static_ServicePortInterfaces/Det_swc/Interfaces
  client server interface DETService: is-service=true, service-kind=DEVELOPMENT-ERROR-TRACER
    operation ReportError: possible-error=DETService/E_OK
      arg ApiId: type=uint8, direction=IN, server-argument-impl-policy=USE-ARGUMENT-TYPE
      arg ErrorId: type=uint8, direction=IN, server-argument-impl-policy=USE-ARGUMENT-TYPE
    operation ReportRuntimeError: possible-error=DETService/E_OK
      arg ApiId: type=uint8, direction=IN, server-argument-impl-policy=USE-ARGUMENT-TYPE
      arg ErrorId: type=uint8, direction=IN, server-argument-impl-policy=USE-ARGUMENT-TYPE
    error E_OK: error-code=0
  client server interface DETServiceLegacy: is-service=true, service-kind=DEVELOPMENT-ERROR-TRACER
    operation ReportError: possible-error=DETServiceLegacy/E_OK
      arg InstanceId: type=uint8, direction=IN, server-argument-impl-policy=USE-ARGUMENT-TYPE
      arg ApiId: type=uint8, direction=IN, server-argument-impl-policy=USE-ARGUMENT-TYPE
      arg ErrorId: type=uint8, direction=IN, server-argument-impl-policy=USE-ARGUMENT-TYPE
    error E_OK: error-code=0
package /MICROSAR_Static_ServicePortInterfaces/Dlt_swc/DataTypes
  16 x impl type:
    Dlt_ApplicationIdInfoType: category=STRUCTURE  # Information about Applications.
      5 x element:
        appId: implementation-data-type=Dlt_ApplicationIDType  # Application ID
        contextIdCount: implementation-data-type=uint16  # Length of contextInfoList
        contextInfoList: category=ARRAY  # List of Context information
          element contextInfoListElement: array-size=5, array-size-semantics=FIXED-SIZE, sw-calibration-access=READ-ONLY, implementation-data-type=Dlt_ContextIdInfoType
        appDescLen: implementation-data-type=uint16  # Length of Application Description
        appDesc: category=ARRAY  # Application Description
          element appDescElement: array-size=256, array-size-semantics=FIXED-SIZE, sw-calibration-access=READ-ONLY, implementation-data-type=uint8
    Dlt_ApplicationIDType: category=ARRAY, sw-calibration-access=READ-ONLY  # This type describes the Application ID
      element Dlt_ApplicationIDTypeElement: array-size=4, array-size-semantics=FIXED-SIZE, implementation-data-type=uint8
    Dlt_AssignmentOperation: compu {1=DLT_ASSIGN_ADD, 2=DLT_ASSIGN_REMOVE}, range raw 1..2, implementation-data-type=uint8  # Adding or removing a LogChannel assignment for the given tuple of ApplicationId/ContextId.
    Dlt_ContextIdInfoType: category=STRUCTURE  # Context Information
      5 x element:
        contextId: implementation-data-type=Dlt_ContextIDType  # the ContextId
        logLevel: implementation-data-type=Dlt_MessageLogLevelType  # the log message filter level
        traceStatus: implementation-data-type=uint8  # 0: off; 1: on
        lenContextDescription: implementation-data-type=uint16  # Length of Context Description
        contextDesc: category=ARRAY  # Context Description
          element contextDescElement: array-size=256, array-size-semantics=FIXED-SIZE, sw-calibration-access=READ-ONLY, implementation-data-type=uint8
    Dlt_ContextIDType: category=ARRAY, sw-calibration-access=READ-ONLY  # This type describes the Context ID
      element Dlt_ContextIDTypeElement: array-size=4, array-size-semantics=FIXED-SIZE, implementation-data-type=uint8
    Dlt_DataType: category=ARRAY, sw-calibration-access=READ-ONLY  # This type describes the data pointer type used for injection call.
      element Dlt_DataTypeElement: array-size=256, array-size-semantics=FIXED-SIZE, implementation-data-type=uint8
    Dlt_GlobalStateType: compu {1=DLT_GLOBAL_STATE_OFFLINE, 2=DLT_GLOBAL_STATE_ONLINE}, range raw 1..2, implementation-data-type=uint8  # This type describes the global Dlt state
    Dlt_LogChannelNameType: category=ARRAY, sw-calibration-access=READ-ONLY  # This type describes the LogChannel name.
      element Dlt_LogChannelNameTypeElement: array-size=4, array-size-semantics=FIXED-SIZE, implementation-data-type=uint8
    Dlt_LogInfoPtrType: category=ARRAY, sw-calibration-access=READ-ONLY  # This pointer type points to Dlt_LogInfoType
      element Dlt_LogInfoPtrTypeElement: array-size=1, array-size-semantics=FIXED-SIZE, implementation-data-type=Dlt_LogInfoType
    Dlt_LogInfoType: category=STRUCTURE  # Log information
      element appIdCount: implementation-data-type=uint16  # Number of AppIds
      element appIdInfo: category=ARRAY  # Details of Application
        element appIdInfoElement: array-size=13, array-size-semantics=FIXED-SIZE, sw-calibration-access=READ-ONLY, implementation-data-type=Dlt_ApplicationIdInfoType
    Dlt_MessageLogInfoType: category=STRUCTURE  # This type describes the message log level, message options, context ID type and application ID of a verbose or non-verbose message.
      5 x element, all with category=TYPE_REFERENCE:
        argCount: range raw 0..255, implementation-data-type=uint8
        logLevel: implementation-data-type=Dlt_MessageLogLevelType
        options: implementation-data-type=Dlt_MessageOptionsType
        contextId: implementation-data-type=Dlt_ContextIDType
        appId: implementation-data-type=Dlt_ApplicationIDType
    Dlt_MessageLogLevelType: compu {0=DLT_LOG_OFF, 1=DLT_LOG_FATAL, 2=DLT_LOG_ERROR, 3=DLT_LOG_WARN, 4=DLT_LOG_INFO, 5=DLT_LOG_DEBUG, 6=DLT_LOG_VERBOSE}, range raw 0..6, implementation-data-type=uint8  # This type describes the log level for each log message.
    Dlt_MessageOptionsType: range raw 0..255, implementation-data-type=uint8  # Bit 0: If set Verbose mode is used (yet not relevant), Bit 1..3: Dlt_MessageTypeType: determines type of msg (log,trace,...)
    Dlt_MessageTraceInfoType: category=STRUCTURE  # This type describes the message trace status, message options, context ID type and application ID of a verbose or non-verbose message.
      4 x element, all with category=TYPE_REFERENCE:
        traceInfo: implementation-data-type=Dlt_MessageTraceType
        options: implementation-data-type=Dlt_MessageOptionsType
        context: implementation-data-type=Dlt_ContextIDType
        appId: implementation-data-type=Dlt_ApplicationIDType
    Dlt_MessageTraceType: compu {1=DLT_TRACE_VARIABLE, 2=DLT_TRACE_FUNCTION_IN, 3=DLT_TRACE_FUNCTION_OUT, 4=DLT_TRACE_STATE, 5=DLT_TRACE_VFB}, range raw 1..5, implementation-data-type=uint8  # This type describes labels for trace messages.
    Dlt_Uint8BufferType: category=ARRAY, sw-calibration-access=READ-ONLY  # This type describes the message buffer.
      element Dlt_Uint8BufferTypeElement: array-size=256, array-size-semantics=FIXED-SIZE, implementation-data-type=uint8
package /MICROSAR_Static_ServicePortInterfaces/Dlt_swc/Interfaces
  6 x client server interface, all with is-service=true, service-kind=DIAGNOSTIC-LOG-AND-TRACE:
    DltControlService  # Through this port SW-Cs can control log settings and other configuration items of DLT.
      15 x operation:
        GetDefaultLogLevel: possible-error=[DltControlService/DLT_E_ERROR, DltControlService/E_OK]  # Called to return the pass through range for Log Messages for all not explicit set ContextIds.
          arg DefaultLogLevel: type=Dlt_MessageLogLevelType, direction=OUT, server-argument-impl-policy=USE-ARGUMENT-TYPE
        GetDefaultTraceStatus: possible-error=[DltControlService/DLT_E_ERROR, DltControlService/E_OK]  # Called to returns the current default Trace Status.
          arg LogChannelName: type=Dlt_LogChannelNameType, direction=IN, server-argument-impl-policy=USE-ARGUMENT-TYPE
          arg TraceStatus: type=boolean, direction=OUT, server-argument-impl-policy=USE-ARGUMENT-TYPE
        GetLogChannelNames: possible-error=[DltControlService/DLT_E_ERROR, DltControlService/E_OK]  # Called to get names of all configured log channels.
          arg NumberOfLogChannels: type=uint8, direction=OUT, server-argument-impl-policy=USE-ARGUMENT-TYPE
          arg LogChannelNames: type=Dlt_LogChannelNameType, direction=OUT, server-argument-impl-policy=USE-ARGUMENT-TYPE
        GetLogChannelThreshold: possible-error=[DltControlService/DLT_E_ERROR, DltControlService/E_OK]  # Called to set the log channel specific threshold and trace status.
          arg LogChannelName: type=Dlt_LogChannelNameType, direction=IN, server-argument-impl-policy=USE-ARGUMENT-TYPE
          arg Threshold: type=Dlt_MessageLogLevelType, direction=OUT, server-argument-impl-policy=USE-ARGUMENT-TYPE
          arg TraceStatus: type=boolean, direction=OUT, server-argument-impl-policy=USE-ARGUMENT-TYPE
        GetLogInfo: possible-error=[DltControlService/DLT_E_ERROR, DltControlService/E_OK]  # This service is used to get the LogLevel for the given tuple of ApplicationID/ContextID.
          5 x arg, all with server-argument-impl-policy=USE-ARGUMENT-TYPE:
            Options: type=uint8, direction=IN
            AppId: type=Dlt_ApplicationIDType, direction=IN
            ContextId: type=Dlt_ContextIDType, direction=IN
            Status: type=uint8, direction=IN
            LogInfo: type=Dlt_LogInfoPtrType, direction=OUT
        GetTraceStatus: possible-error=[DltControlService/DLT_E_ERROR, DltControlService/E_OK]  # This service is used to get the TraceStatus for the given tuple of ApplicationID/ContextID.
          arg AppId: type=Dlt_ApplicationIDType, direction=IN, server-argument-impl-policy=USE-ARGUMENT-TYPE
          arg ContextId: type=Dlt_ContextIDType, direction=IN, server-argument-impl-policy=USE-ARGUMENT-TYPE
          arg TraceStatus: type=boolean, direction=OUT, server-argument-impl-policy=USE-ARGUMENT-TYPE
        ResetToFactoryDefault: possible-error=[DltControlService/DLT_E_ERROR, DltControlService/E_OK]  # The service Dlt_ResetToFactoryDefault sets the LogLevel and TraceStatus back to the persistently stored default values. If the feature NvMRAM support is enabled, all stored Dlt values in the NvM are deleted.
        SetDefaultLogLevel: possible-error=[DltControlService/DLT_E_ERROR, DltControlService/E_OK]  # Called to modify the pass through range for Log Messages for all not explicit set ContextIds.
          arg NewLogLevel: type=Dlt_MessageLogLevelType, direction=IN, server-argument-impl-policy=USE-ARGUMENT-TYPE
        SetDefaultTraceStatus: possible-error=[DltControlService/DLT_E_ERROR, DltControlService/E_OK]  # Called to enable or disable trace messages for all not explicitly set ContextIds.
          arg NewTraceStatus: type=boolean, direction=IN, server-argument-impl-policy=USE-ARGUMENT-TYPE
          arg LogChannelName: type=Dlt_LogChannelNameType, direction=IN, server-argument-impl-policy=USE-ARGUMENT-TYPE
        SetLogChannelAssignment: possible-error=[DltControlService/DLT_E_ERROR, DltControlService/E_OK]  # Called to add or remove a log channel assignment to a Dlt context.
          4 x arg, all with direction=IN, server-argument-impl-policy=USE-ARGUMENT-TYPE:
            AppId: type=Dlt_ApplicationIDType
            ContextId: type=Dlt_ContextIDType
            LogChannelName: type=Dlt_LogChannelNameType
            AddRemoveOp: type=Dlt_AssignmentOperation
        SetLogChannelThreshold: possible-error=[DltControlService/DLT_E_ERROR, DltControlService/E_OK]  # Called to set the log channel specific threshold and trace status.
          arg LogChannelName: type=Dlt_LogChannelNameType, direction=IN, server-argument-impl-policy=USE-ARGUMENT-TYPE
          arg NewThreshold: type=Dlt_MessageLogLevelType, direction=IN, server-argument-impl-policy=USE-ARGUMENT-TYPE
          arg NewTraceStatus: type=boolean, direction=IN, server-argument-impl-policy=USE-ARGUMENT-TYPE
        SetLogLevel: possible-error=[DltControlService/DLT_E_ERROR, DltControlService/E_OK]  # This service is used to change the LogLevel for the given tuple of ApplicationID/ContextID.
          arg AppId: type=Dlt_ApplicationIDType, direction=IN, server-argument-impl-policy=USE-ARGUMENT-TYPE
          arg ContextId: type=Dlt_ContextIDType, direction=IN, server-argument-impl-policy=USE-ARGUMENT-TYPE
          arg NewLogLevel: type=Dlt_MessageLogLevelType, direction=IN, server-argument-impl-policy=USE-ARGUMENT-TYPE
        SetMessageFiltering: possible-error=[DltControlService/DLT_E_ERROR, DltControlService/E_OK]  # Switches on/off the message filtering functionality of the Dlt module.
          arg Status: type=boolean, direction=IN, server-argument-impl-policy=USE-ARGUMENT-TYPE
        SetTraceStatus: possible-error=[DltControlService/DLT_E_ERROR, DltControlService/E_OK]  # This service is used to change the TraceStatus for the given tuple of ApplicationID/ContextID.
          arg AppId: type=Dlt_ApplicationIDType, direction=IN, server-argument-impl-policy=USE-ARGUMENT-TYPE
          arg ContextId: type=Dlt_ContextIDType, direction=IN, server-argument-impl-policy=USE-ARGUMENT-TYPE
          arg NewTraceStatus: type=boolean, direction=IN, server-argument-impl-policy=USE-ARGUMENT-TYPE
        StoreConfiguration: possible-error=[DltControlService/DLT_E_ERROR, DltControlService/DLT_E_NOT_SUPPORTED, DltControlService/E_OK]  # If the feature NvMRAM support is enabled, the service Dlt_StoreConfiguration persistently stores the current Dlt configuration.
      error DLT_E_ERROR: error-code=9  # An error occured while Dlt service execution
      error DLT_E_NOT_SUPPORTED: error-code=7  # The service is not supported
      error E_OK: error-code=0  # No error occured while Dlt service execution
    DltInjection  # Through this port injection request can be forwarded to the DLT.
      operation InjectCall_4096  # Called to inject a service request to the application.
        5 x arg, all with direction=IN, server-argument-impl-policy=USE-ARGUMENT-TYPE:
          AppId: type=Dlt_ApplicationIDType
          ContextId: type=Dlt_ContextIDType
          ServiceId: type=uint32
          DataLength: type=uint32
          Data: type=Dlt_DataType
    DLTStateHandling  # The service represents the interface to be used by software components to handle the global Dlt state.
      operation GetState: possible-error=[DLTStateHandling/E_NOT_OK, DLTStateHandling/E_OK]  # The service represents the interface to be used by software components to get the global Dlt state.
        arg CurrentStatePtr: type=Dlt_GlobalStateType, direction=OUT, server-argument-impl-policy=USE-ARGUMENT-TYPE
      operation SetState: possible-error=[DLTStateHandling/E_NOT_OK, DLTStateHandling/E_OK]  # The service represents the interface to be used by software components to set the global Dlt state.
        arg NewState: type=Dlt_GlobalStateType, direction=IN, server-argument-impl-policy=USE-ARGUMENT-TYPE
      error E_NOT_OK: error-code=1  # An error occured while Dlt service execution
      error E_OK: error-code=0  # No error occured while Dlt service execution
    DltSwcMessageService  # The service represents the interface to be used by software components to register their Dlt context.
      operation RegisterContext: possible-error=[DLT_E_CONTEXT_ALREADY_REG, DLT_E_UNKNOWN_SESSION_ID]  # The service represents the interface to be used by software components to register their Dlt context.
        6 x arg, all with direction=IN, server-argument-impl-policy=USE-ARGUMENT-TYPE:
          AppId: type=Dlt_ApplicationIDType
          ContextId: type=Dlt_ContextIDType
          AppDescription: type=Dlt_Uint8BufferType
          LenAppDescription: type=uint8
          ContextDescription: type=Dlt_Uint8BufferType
          LenContextDescription: type=uint8
      operation SendLogMessage: possible-error=[DLT_E_MSG_TOO_LARGE, DLT_E_NO_BUFFER, DLT_E_UNKNOWN_SESSION_ID]  # The service represents the interface to be used by basic software modules or by software component to send log messages.
        arg LogInfo: type=Dlt_MessageLogInfoType, direction=IN, server-argument-impl-policy=USE-ARGUMENT-TYPE
        arg LogData: type=Dlt_Uint8BufferType, direction=IN, server-argument-impl-policy=USE-ARGUMENT-TYPE
        arg LogDataLength: type=uint16, direction=IN, server-argument-impl-policy=USE-ARGUMENT-TYPE
      operation SendTraceMessage: possible-error=[DLT_E_MSG_TOO_LARGE, DLT_E_NO_BUFFER, DLT_E_UNKNOWN_SESSION_ID]  # The service represents the interface to be used by basic software modules or by software component to send trace messages.
        arg TraceInfo: type=Dlt_MessageTraceInfoType, direction=IN, server-argument-impl-policy=USE-ARGUMENT-TYPE
        arg TraceData: type=Dlt_Uint8BufferType, direction=IN, server-argument-impl-policy=USE-ARGUMENT-TYPE
        arg TraceDataLength: type=uint16, direction=IN, server-argument-impl-policy=USE-ARGUMENT-TYPE
      7 x error:
        DLT_E_CONTEXT_ALREADY_REG: error-code=3  # The Context of DLT user is already registered
        DLT_E_CONTEXT_NOT_YET_REG: error-code=6  # The software module context has not registered before
        DLT_E_ERROR: error-code=9  # Generic error
        DLT_E_MSG_TOO_LARGE: error-code=2  # The message sent by DLT user is too large
        DLT_E_NO_BUFFER: error-code=5  # Buffer overflow
        DLT_E_NOT_SUPPORTED: error-code=7  # Service is not supported
        DLT_E_UNKNOWN_SESSION_ID: error-code=4  # The session ID is invalid
    InjectionCallback  # Callback Port to registered Application, which processes Injection.
      operation InjectCall: possible-error=[InjectionCallback/E_NOT_OK, InjectionCallback/E_OK]  # Service to be used by Dlt to forward an injection call.
        5 x arg, all with direction=IN, server-argument-impl-policy=USE-ARGUMENT-TYPE:
          AppId: type=Dlt_ApplicationIDType
          ContextId: type=Dlt_ContextIDType
          ServiceId: type=uint32
          DataLength: type=uint32
          Data: type=Dlt_DataType
      error E_NOT_OK: error-code=1  # An error occured while Dlt InjectCall execution
      error E_OK: error-code=0  # No error occured while Dlt InjectCall execution
    LogTraceSessionControl  # Service to be used by Dlt to indicate the SWC to set a new log level.
      operation LogLevelChangedNotification: possible-error=LogTraceSessionControl/E_OK  # Service to be used by Dlt to indicate the SWC to set a new log level.
        arg AppId: type=Dlt_ApplicationIDType, direction=IN, server-argument-impl-policy=USE-ARGUMENT-TYPE
        arg ContextId: type=Dlt_ContextIDType, direction=IN, server-argument-impl-policy=USE-ARGUMENT-TYPE
        arg LogLevel: type=Dlt_MessageLogLevelType, direction=IN, server-argument-impl-policy=USE-ARGUMENT-TYPE
      operation TraceStatusChangedNotification: possible-error=LogTraceSessionControl/E_OK  # Service to be used by Dlt to indicate the SWC to set a new trace status.
        arg AppId: type=Dlt_ApplicationIDType, direction=IN, server-argument-impl-policy=USE-ARGUMENT-TYPE
        arg ContextId: type=Dlt_ContextIDType, direction=IN, server-argument-impl-policy=USE-ARGUMENT-TYPE
        arg NewTraceInfo: type=boolean, direction=IN, server-argument-impl-policy=USE-ARGUMENT-TYPE
      error E_NOT_OK: error-code=1  # An error occured while Dlt service execution
      error E_OK: error-code=0  # No error occured while Dlt service execution
package /MICROSAR_Static_ServicePortInterfaces/EcuM_swc/DataTypes
  4 x impl type, all with category=TYPE_REFERENCE, implementation-data-type=uint8:
    EcuM_BootTargetType: compu {0=ECUM_BOOT_TARGET_APP, 1=ECUM_BOOT_TARGET_OEM_BOOTLOADER, 2=ECUM_BOOT_TARGET_SYS_BOOTLOADER}, range raw 0..2  # This type represents the boot targets the ECU Manager module can be configured with. The default boot target is ECUM_BOOT_TARGET_OEM_BOOTLOADER.
    EcuM_ModeType: compu {3=EcuMConf_EcuMResetMode_ECUM_RESET_WAKEUP, 1=EcuMConf_EcuMResetMode_ECUM_RESET_WDG, 0=EcuMConf_EcuMResetMode_ECUM_RESET_MCU, 2=EcuMConf_EcuMResetMode_ECUM_RESET_IO, 0=EcuMConf_EcuMSleepMode_EcuMSleepMode}, range raw 0..3  # ECU State Manager states.
    EcuM_ShutdownCauseType: compu {1=EcuMConf_EcuMShutdownCause_ECUM_CAUSE_ECU_STATE, 0=EcuMConf_EcuMShutdownCause_ECUM_CAUSE_UNKNOWN, 2=EcuMConf_EcuMShutdownCause_ECUM_CAUSE_WDGM, 3=EcuMConf_EcuMShutdownCause_ECUM_CAUSE_DCM}, range raw 0..3  # This type describes the cause for a shutdown by the ECU State Manager. It can be extended by configuration.
    EcuM_StateType: compu {80=ECUM_STATE_SLEEP, 128=ECUM_STATE_OFF, 144=ECUM_STATE_RESET}, range raw 0..144
package /MICROSAR_Static_ServicePortInterfaces/EcuM_swc/Interfaces
  client server interface EcuM_BootTarget: is-service=true, service-kind=ECU-MANAGER
    operation GetBootTarget: possible-error=EcuM_BootTarget/E_NOT_OK  # Returns the current boot target.
      arg BootTarget: type=EcuM_BootTargetType, direction=OUT, server-argument-impl-policy=USE-ARGUMENT-TYPE
    operation SelectBootTarget: possible-error=EcuM_BootTarget/E_NOT_OK  # The SW-C selects a boot target.
      arg BootTarget: type=EcuM_BootTargetType, direction=IN, server-argument-impl-policy=USE-ARGUMENT-TYPE
    error E_NOT_OK: error-code=1  # The new boot target was not accepted by EcuM
  client server interface EcuM_ShutdownTarget: is-service=true, service-kind=ECU-MANAGER  # A SW-C can select a shutdown target using this interface.
    5 x operation, all with possible-error=EcuM_ShutdownTarget/E_NOT_OK:
      GetLastShutdownTarget  # Returns the shutdown target of the previous shutdown.
        arg target: type=EcuM_StateType, direction=OUT, server-argument-impl-policy=USE-ARGUMENT-TYPE
        arg resetSleepMode: type=EcuM_ModeType, direction=OUT, server-argument-impl-policy=USE-ARGUMENT-TYPE
      GetShutdownCause  # Returns the selected shutdown cause as set by the operation SelectShutdownCause.
        arg shutdownCause: type=EcuM_ShutdownCauseType, direction=OUT, server-argument-impl-policy=USE-ARGUMENT-TYPE
      GetShutdownTarget  # Returns the currently selected shutdown target for the next shutdown as set by the operation SelectShutdownTarget.
        arg target: type=EcuM_StateType, direction=OUT, server-argument-impl-policy=USE-ARGUMENT-TYPE
        arg resetSleepMode: type=EcuM_ModeType, direction=OUT, server-argument-impl-policy=USE-ARGUMENT-TYPE
      SelectShutdownCause  # The SW-C selects the cause corresponding to the next shutdown target.
        arg shutdownCause: type=EcuM_ShutdownCauseType, direction=IN, server-argument-impl-policy=USE-ARGUMENT-TYPE
      SelectShutdownTarget  # The SW-C selects the cause corresponding to the next shutdown target.
        arg targetState: type=EcuM_StateType, direction=IN, server-argument-impl-policy=USE-ARGUMENT-TYPE
        arg resetSleepMode: type=EcuM_ModeType, direction=IN, server-argument-impl-policy=USE-ARGUMENT-TYPE
    error E_NOT_OK: error-code=1  # The new shutdown target was not set
package /MICROSAR_Static_ServicePortInterfaces/FiM_swc/Interfaces
  client server interface FunctionInhibition: is-service=true, service-kind=FUNCTION-INHIBITION-MANAGER
    operation GetFunctionPermission: possible-error=FunctionInhibition/E_NOT_OK
      arg Permission: type=boolean, direction=OUT, server-argument-impl-policy=USE-ARGUMENT-TYPE
    error E_NOT_OK: error-code=1
package /MICROSAR_Static_ServicePortInterfaces/IdsM_swc/DataTypes
  impl type IdsM_SWC_IdsMEventConfig_ContextDataType: category=ARRAY, sw-calibration-access=READ-ONLY
    element IdsM_SWC_IdsMEventConfig_ContextDataTypeElement: array-size=2, array-size-semantics=FIXED-SIZE, implementation-data-type=uint8
package /MICROSAR_Static_ServicePortInterfaces/IdsM_swc/Interfaces
  client server interface IdsMService_SWC_IdsMEventConfig: is-service=true, service-kind=VENDOR-SPECIFIC
    operation SetSecurityEventWithContextData
      arg contextData: type=IdsM_SWC_IdsMEventConfig_ContextDataType, direction=IN, server-argument-impl-policy=USE-ARRAY-BASE-TYPE
      arg contextDataSize: type=uint16, direction=IN, server-argument-impl-policy=USE-ARGUMENT-TYPE
package /MICROSAR_Static_ServicePortInterfaces/J1939Rm_swc/DataTypes
  4 x impl type:
    J1939Rm_AckCode: compu {0=J1939RM_ACK_POSITIVE, 1=J1939RM_ACK_NEGATIVE, 2=J1939RM_ACK_ACCESS_DENIED, 3=J1939RM_ACK_CANNOT_RESPOND}, range raw 0..3, implementation-data-type=uint8  # This type represents the available kinds of acknowledgements.
    J1939Rm_ExtIdInfoType: category=STRUCTURE  # This type represents a set of extended identifiers.
      4 x element, all with category=TYPE_REFERENCE:
        ExtIdType: implementation-data-type=J1939Rm_ExtIdType
        ExtId{1..3}: implementation-data-type=uint8
    J1939Rm_ExtIdType: compu {0=J1939RM_EXTID_NONE, 1=J1939RM_EXTID_ONE, 2=J1939RM_EXTID_TWO, 3=J1939RM_EXTID_THREE, 4=J1939RM_EXTID_GF}, range raw 0..4, implementation-data-type=uint8  # This type represents the available kinds of extended identifier usage.
    NetworkHandleType: range raw 0..255, implementation-data-type=uint8, type-emitter=J1939Rm
package /MICROSAR_Static_ServicePortInterfaces/J1939Rm_swc/Interfaces
  6 x client server interface, all with is-service=true, service-kind=VENDOR-SPECIFIC:
    AppAckIndication
      operation AckIndication: possible-error=[AppAckIndication/E_NOT_OK, AppAckIndication/E_OK]  # Indicates reception of an Acknowledgement PG.
        8 x arg, all with direction=IN, server-argument-impl-policy=USE-ARGUMENT-TYPE:
          node: type=uint8
          channel: type=NetworkHandleType
          ackPgn: type=uint32
          extIdInfo: type=J1939Rm_ExtIdInfoType
          ackCode: type=J1939Rm_AckCode
          ackAddress: type=uint8
          sourceAddress: type=uint8
          priority: type=uint8
      error E_NOT_OK: error-code=1
      error E_OK: error-code=0
    AppCancelRequestTimeout
      operation CancelRequestTimeout: possible-error=[AppCancelRequestTimeout/E_NOT_OK, AppCancelRequestTimeout/E_OK]  # Cancels timeout monitoring of a Request. If the request is not active, or timeout monitoring was not requested, this call has no effect.
        4 x arg, all with direction=IN, server-argument-impl-policy=USE-ARGUMENT-TYPE:
          channel: type=NetworkHandleType
          requestedPgn: type=uint32
          extIdInfo: type=J1939Rm_ExtIdInfoType
          destAddress: type=uint8
      error E_NOT_OK: error-code=1
      error E_OK: error-code=0
    AppRequestIndication
      operation RequestIndication: possible-error=[AppRequestIndication/E_NOT_OK, AppRequestIndication/E_OK]  # Indicates reception of a Request PG.
        7 x arg, all with direction=IN, server-argument-impl-policy=USE-ARGUMENT-TYPE:
          node: type=uint8
          channel: type=NetworkHandleType
          requestedPgn: type=uint32
          extIdInfo: type=J1939Rm_ExtIdInfoType
          sourceAddress: type=uint8
          destAddress: type=uint8
          priority: type=uint8
      error E_NOT_OK: error-code=1
      error E_OK: error-code=0
    AppRequestTimeoutIndication
      operation RequestTimeoutIndication: possible-error=[AppRequestTimeoutIndication/E_NOT_OK, AppRequestTimeoutIndication/E_OK]  # Indicates timeout of a request triggered with the same parameters.
        5 x arg, all with direction=IN, server-argument-impl-policy=USE-ARGUMENT-TYPE:
          node: type=uint8
          channel: type=NetworkHandleType
          requestedPgn: type=uint32
          extIdInfo: type=J1939Rm_ExtIdInfoType
          destAddress: type=uint8
      error E_NOT_OK: error-code=1
      error E_OK: error-code=0
    AppSendAck
      operation SendAck: possible-error=[AppSendAck/E_NOT_OK, AppSendAck/E_OK]  # Requests transmission of an Acknowledgement PG.
        7 x arg, all with direction=IN, server-argument-impl-policy=USE-ARGUMENT-TYPE:
          channel: type=NetworkHandleType
          ackPgn: type=uint32
          extIdInfo: type=J1939Rm_ExtIdInfoType
          ackCode: type=J1939Rm_AckCode
          ackAddress: type=uint8
          priority: type=uint8
          broadcast: type=boolean
      error E_NOT_OK: error-code=1
      error E_OK: error-code=0
    AppSendRequest
      operation SendRequest: possible-error=[AppSendRequest/E_NOT_OK, AppSendRequest/E_OK]  # Requests transmission of a Request PG.
        6 x arg, all with direction=IN, server-argument-impl-policy=USE-ARGUMENT-TYPE:
          channel: type=NetworkHandleType
          requestedPgn: type=uint32
          extIdInfo: type=J1939Rm_ExtIdInfoType
          destAddress: type=uint8
          priority: type=uint8
          checkTimeout: type=boolean
      error E_NOT_OK: error-code=1
      error E_OK: error-code=0
package /MICROSAR_Static_ServicePortInterfaces/KeyM_swc/DataTypes
  impl type KeyM_CertificateStatusType:  # KeyM module specific return values for certificate status.
    compu {0=KEYM_CERTIFICATE_VALID, 1=KEYM_CERTIFICATE_INVALID, 2=KEYM_CERTIFICATE_NOT_PARSED, 3=KEYM_CERTIFICATE_PARSED_NOT_VALIDATED, 4=KEYM_CERTIFICATE_NOT_AVAILABLE, 5=KEYM_E_CERTIFICATE_VALIDITY_PERIOD_FAIL, 6=KEYM_E_CERTIFICATE_SIGNATURE_FAIL, 7=KEYM_E_CERTIFICATE_INVALID_CHAIN_OF_TRUST, 8=KEYM_E_CERTIFICATE_INVALID_TYPE, 9=KEYM_E_CERTIFICATE_INVALID_FORMAT, 10=KEYM_E_CERTIFICATE_INVALID_CONTENT, 11=KEYM_E_CERTIFICATE_REVOKED}
    range raw 0..11
    implementation-data-type=uint8
  impl type KeyM_const_CryptoKeyDataType: category=DATA_REFERENCE, sw-pointer-target-props={target-category=TYPE_REFERENCE, implementation-data-type=uint8, sw-impl-policy=CONST}  # Byte-pointer to the input or output data.
  impl type KeyM_ResultType: compu {0=KEYM_RT_OK, 1=KEYM_RT_NOT_OK, 2=KEYM_RT_KEY_CERT_INVALID, 3=KEYM_RT_KEY_CERT_WRITE_FAIL, 4=KEYM_RT_KEY_CERT_UPDATE_FAIL, 5=KEYM_RT_CERT_INVALID_CHAIN_OF_TRUST}, range raw 0..5, implementation-data-type=uint8  # KeyM module specific return values for certificate status.
package /MICROSAR_Static_ServicePortInterfaces/KeyM_swc/Interfaces
  client server interface KeyMCertificateNotification: is-service=true, service-kind=VENDOR-SPECIFIC  # This service interface provides callbacks for certificate management operations.
    operation CertificateVerifyCallbackNotification  # Notifies the application that a certificate verification has been finished.
      arg Result: type=KeyM_CertificateStatusType, direction=IN, server-argument-impl-policy=USE-ARGUMENT-TYPE
    operation ServiceCertificateCallbackNotification  # Notifies the application that the certificate service operation has been finished. This function is used by the certificate submodule. This callback is only provided if KeyMServiceCertificateFunctionEnabled is set to TRUE.
      arg Result: type=KeyM_ResultType, direction=IN, server-argument-impl-policy=USE-ARGUMENT-TYPE
      arg ResponseDataLength: type=uint16, direction=IN, server-argument-impl-policy=USE-ARGUMENT-TYPE
      arg ResponseData: type=KeyM_const_CryptoKeyDataType, direction=IN, server-argument-impl-policy=USE-ARGUMENT-TYPE
package /MICROSAR_Static_ServicePortInterfaces/SecOC_swc/DataTypes
  impl type SecOC_VerificationResultType: compu {0=SECOC_VERIFICATIONSUCCESS, 1=SECOC_VERIFICATIONFAILURE, 2=SECOC_FRESHNESSFAILURE, 3=SECOC_AUTHENTICATIONBUILDFAILURE, 4=SECOC_NO_VERIFICATION, 5=SECOC_VERIFICATIONFAILURE_OVERWRITTEN}, range raw 0..5, implementation-data-type=uint8
  impl type SecOC_VerificationStatusType: category=STRUCTURE
    element freshnessValueID: range raw 0..65535, implementation-data-type=uint16
    element verificationStatus: implementation-data-type=SecOC_VerificationResultType
    element secOCDataId: range raw 0..65535, implementation-data-type=uint16
package /MICROSAR_Static_ServicePortInterfaces/SecOC_swc/Interfaces
  client server interface SecOC_VerifyStatusConfiguration: is-service=true, service-kind=VENDOR-SPECIFIC
    operation VerifyStatusOverride: possible-error=[SecOC_VerifyStatusConfiguration/E_NOT_OK, SecOC_VerifyStatusConfiguration/E_OK]
      arg freshnessValueID: type=uint16, direction=IN, server-argument-impl-policy=USE-ARGUMENT-TYPE
      arg overrideStatus: type=uint8, direction=IN, server-argument-impl-policy=USE-ARGUMENT-TYPE
      arg numberOfMessagesToOverride: type=uint8, direction=IN, server-argument-impl-policy=USE-ARGUMENT-TYPE
    error E_NOT_OK: error-code=1
    error E_OK: error-code=0
  sender receiver interface SecOC_VerificationStatusService: is-service=true, service-kind=VENDOR-SPECIFIC, invalidation-policy{data-element=verificationStatus, handle-invalid=DONT-INVALIDATE}
    data verificationStatus: type=SecOC_VerificationStatusType
package /MICROSAR_Static_ServicePortInterfaces/WdgM_swc/DataTypes
  5 x impl type, all with category=TYPE_REFERENCE:
    WdgM_CheckpointIdType: range raw 0..65535, implementation-data-type=uint16  # Identifier of a checkpoint
    WdgM_GlobalStatusType: compu {0=WDGM_GLOBAL_STATUS_OK, 1=WDGM_GLOBAL_STATUS_FAILED, 2=WDGM_GLOBAL_STATUS_EXPIRED, 3=WDGM_GLOBAL_STATUS_STOPPED, 4=WDGM_GLOBAL_STATUS_DEACTIVATED}, range raw 0..4, implementation-data-type=uint8  # Global Monitoring Status summarizes all local monitoring statuses of all supervised entities.
    WdgM_LocalStatusType: compu {0=WDGM_LOCAL_STATUS_OK, 1=WDGM_LOCAL_STATUS_FAILED, 2=WDGM_LOCAL_STATUS_EXPIRED, 4=WDGM_LOCAL_STATUS_DEACTIVATED}, range raw 0..4, implementation-data-type=uint8  # Local Monitoring Status of a supervised entity.
    WdgM_ModeType: range raw 0..255, implementation-data-type=uint8  # Identifier of the Watchdog trigger mode
    WdgM_SupervisedEntityIdType: range raw 0..65535, implementation-data-type=uint16  # Identifier of a supervised entity
package /MICROSAR_Static_ServicePortInterfaces/WdgM_swc/Interfaces
  client server interface WdgM_AliveSupervision: is-service=true, service-kind=WATCH-DOG-MANAGER
    operation CheckpointReached: possible-error=WdgM_AliveSupervision/E_NOT_OK  # Indicates to the Watchdog Manager that a Checkpoint within a Supervised Entity has been reached.
      arg CPID: type=WdgM_CheckpointIdType, direction=IN, server-argument-impl-policy=USE-ARGUMENT-TYPE
    error E_NOT_OK: error-code=1
  client server interface WdgM_General: is-service=true, service-kind=WATCH-DOG-MANAGER
    6 x operation, all with possible-error=WdgM_General/E_NOT_OK:
      GetFirstExpiredSEID  # Returns the id of that supervised entity which first reached the status WDGM_LOCAL_STATUS_EXPIRED.
        arg SEID: type=WdgM_SupervisedEntityIdType, direction=OUT, server-argument-impl-policy=USE-ARGUMENT-TYPE
      GetGlobalStatus  # Returns the global supervision status of the Watchdog Manager.
        arg Status: type=WdgM_GlobalStatusType, direction=OUT, server-argument-impl-policy=USE-ARGUMENT-TYPE
      GetLocalStatus  # Returns the supervision status of a supervised entity.
        arg SEID: type=WdgM_SupervisedEntityIdType, direction=IN, server-argument-impl-policy=USE-ARGUMENT-TYPE
        arg Status: type=WdgM_LocalStatusType, direction=OUT, server-argument-impl-policy=USE-ARGUMENT-TYPE
      GetMode  # Returns the current mode of the Watchdog Manager.
        arg Mode: type=WdgM_ModeType, direction=OUT, server-argument-impl-policy=USE-ARGUMENT-TYPE
      PerformReset  # Instructs the Watchdog Manager to cause a watchdog reset.
      SetMode  # Requests a new trigger mode
        arg Mode: type=WdgM_ModeType, direction=IN, server-argument-impl-policy=USE-ARGUMENT-TYPE
        arg CallerID: type=uint16, direction=IN, server-argument-impl-policy=USE-ARGUMENT-TYPE
    error E_NOT_OK: error-code=1
  client server interface WdgM_LocalStatus: is-service=true, service-kind=WATCH-DOG-MANAGER
    operation GetLocalStatus: possible-error=WdgM_LocalStatus/E_NOT_OK  # Returns the supervision status of a supervised entity.
      arg Status: type=WdgM_LocalStatusType, direction=OUT, server-argument-impl-policy=USE-ARGUMENT-TYPE
    error E_NOT_OK: error-code=1
package /MICROSAR_Static_ServicePortInterfaces/NvM_swc/ImplementationDataTypes
  impl type NvM_RequestResultType: compu {0=NVM_REQ_OK, 1=NVM_REQ_NOT_OK, 2=NVM_REQ_PENDING, 3=NVM_REQ_INTEGRITY_FAILED, 4=NVM_REQ_BLOCK_SKIPPED, 5=NVM_REQ_NV_INVALIDATED, 6=NVM_REQ_CANCELED, 7=NVM_REQ_REDUNDANCY_FAILED, 8=NVM_REQ_RESTORED_FROM_ROM}, implementation-data-type=uint8
  impl type NvM_ServiceIdType: compu {6=NVM_READ_BLOCK, 7=NVM_WRITE_BLOCK, 8=NVM_RESTORE_BLOCK_DEFAULTS, 9=NVM_ERASE_BLOCK, 11=NVM_INVALIDATE_NV_BLOCK, 12=NVM_READ_ALL}, implementation-data-type=uint8
package /MICROSAR_Static_ServicePortInterfaces/NvM_swc/Interfaces
  21 x client server interface, all with is-service=true:
    NvMAdministration
      operation SetBlockProtection: possible-error=NvMAdministration/E_NOT_OK
        arg ProtectionEnabled: type=boolean, direction=IN, server-argument-impl-policy=USE-ARGUMENT-TYPE
      error E_NOT_OK: error-code=1
    NvMNotifyInitBlock
      operation InitBlock
    NvMNotifyJobFinished
      operation JobFinished
        arg ServiceId: type=NvM_ServiceIdType, direction=IN, server-argument-impl-policy=USE-ARGUMENT-TYPE
        arg JobResult: type=NvM_RequestResultType, direction=IN, server-argument-impl-policy=USE-ARGUMENT-TYPE
    NvMService
      operation GetErrorStatus: possible-error=NvMService/E_NOT_OK
        arg ErrorStatus: type=NvM_RequestResultType, direction=OUT, server-argument-impl-policy=USE-ARGUMENT-TYPE
      error E_NOT_OK: error-code=1
    NvMService_AC2
      operation GetErrorStatus: possible-error=NvMService_AC2/E_NOT_OK
        arg ErrorStatus: type=NvM_RequestResultType, direction=OUT, server-argument-impl-policy=USE-ARGUMENT-TYPE
      operation ReadBlock: possible-error=NvMService_AC2/E_NOT_OK
        arg DstPtr: type=dtRef_VOID, direction=IN, server-argument-impl-policy=USE-ARGUMENT-TYPE
      operation WriteBlock: possible-error=NvMService_AC2/E_NOT_OK
        arg SrcPtr: type=dtRef_const_VOID, direction=IN, server-argument-impl-policy=USE-ARGUMENT-TYPE
      error E_NOT_OK: error-code=1
    NvMService_AC2_Defs
      4 x operation, all with possible-error=NvMService_AC2_Defs/E_NOT_OK:
        GetErrorStatus
          arg ErrorStatus: type=NvM_RequestResultType, direction=OUT, server-argument-impl-policy=USE-ARGUMENT-TYPE
        ReadBlock
          arg DstPtr: type=dtRef_VOID, direction=IN, server-argument-impl-policy=USE-ARGUMENT-TYPE
        RestoreBlockDefaults
          arg DstPtr: type=dtRef_VOID, direction=IN, server-argument-impl-policy=USE-ARGUMENT-TYPE
        WriteBlock
          arg SrcPtr: type=dtRef_const_VOID, direction=IN, server-argument-impl-policy=USE-ARGUMENT-TYPE
      error E_NOT_OK: error-code=1
    NvMService_AC2_DS
      5 x operation, all with possible-error=NvMService_AC2_DS/E_NOT_OK:
        GetDataIndex
          arg DataIndex: type=uint8, direction=OUT, server-argument-impl-policy=USE-ARGUMENT-TYPE
        GetErrorStatus
          arg ErrorStatus: type=NvM_RequestResultType, direction=OUT, server-argument-impl-policy=USE-ARGUMENT-TYPE
        ReadBlock
          arg DstPtr: type=dtRef_VOID, direction=IN, server-argument-impl-policy=USE-ARGUMENT-TYPE
        SetDataIndex
          arg DataIndex: type=uint8, direction=IN, server-argument-impl-policy=USE-ARGUMENT-TYPE
        WriteBlock
          arg SrcPtr: type=dtRef_const_VOID, direction=IN, server-argument-impl-policy=USE-ARGUMENT-TYPE
      error E_NOT_OK: error-code=1
    NvMService_AC2_DS_Defs
      6 x operation, all with possible-error=NvMService_AC2_DS_Defs/E_NOT_OK:
        GetDataIndex
          arg DataIndex: type=uint8, direction=OUT, server-argument-impl-policy=USE-ARGUMENT-TYPE
        GetErrorStatus
          arg ErrorStatus: type=NvM_RequestResultType, direction=OUT, server-argument-impl-policy=USE-ARGUMENT-TYPE
        ReadBlock
          arg DstPtr: type=dtRef_VOID, direction=IN, server-argument-impl-policy=USE-ARGUMENT-TYPE
        RestoreBlockDefaults
          arg DstPtr: type=dtRef_VOID, direction=IN, server-argument-impl-policy=USE-ARGUMENT-TYPE
        SetDataIndex
          arg DataIndex: type=uint8, direction=IN, server-argument-impl-policy=USE-ARGUMENT-TYPE
        WriteBlock
          arg SrcPtr: type=dtRef_const_VOID, direction=IN, server-argument-impl-policy=USE-ARGUMENT-TYPE
      error E_NOT_OK: error-code=1
    NvMService_AC2_SRBS
      4 x operation, all with possible-error=NvMService_AC2_SRBS/E_NOT_OK:
        GetErrorStatus
          arg ErrorStatus: type=NvM_RequestResultType, direction=OUT, server-argument-impl-policy=USE-ARGUMENT-TYPE
        ReadBlock
          arg DstPtr: type=dtRef_VOID, direction=IN, server-argument-impl-policy=USE-ARGUMENT-TYPE
        SetRamBlockStatus
          arg RamBlockStatus: type=boolean, direction=IN, server-argument-impl-policy=USE-ARGUMENT-TYPE
        WriteBlock
          arg SrcPtr: type=dtRef_const_VOID, direction=IN, server-argument-impl-policy=USE-ARGUMENT-TYPE
      error E_NOT_OK: error-code=1
    NvMService_AC2_SRBS_Defs
      5 x operation, all with possible-error=NvMService_AC2_SRBS_Defs/E_NOT_OK:
        GetErrorStatus
          arg ErrorStatus: type=NvM_RequestResultType, direction=OUT, server-argument-impl-policy=USE-ARGUMENT-TYPE
        ReadBlock
          arg DstPtr: type=dtRef_VOID, direction=IN, server-argument-impl-policy=USE-ARGUMENT-TYPE
        RestoreBlockDefaults
          arg DstPtr: type=dtRef_VOID, direction=IN, server-argument-impl-policy=USE-ARGUMENT-TYPE
        SetRamBlockStatus
          arg RamBlockStatus: type=boolean, direction=IN, server-argument-impl-policy=USE-ARGUMENT-TYPE
        WriteBlock
          arg SrcPtr: type=dtRef_const_VOID, direction=IN, server-argument-impl-policy=USE-ARGUMENT-TYPE
      error E_NOT_OK: error-code=1
    NvMService_AC2_SRBS_DS
      6 x operation, all with possible-error=NvMService_AC2_SRBS_DS/E_NOT_OK:
        GetDataIndex
          arg DataIndex: type=uint8, direction=OUT, server-argument-impl-policy=USE-ARGUMENT-TYPE
        GetErrorStatus
          arg ErrorStatus: type=NvM_RequestResultType, direction=OUT, server-argument-impl-policy=USE-ARGUMENT-TYPE
        ReadBlock
          arg DstPtr: type=dtRef_VOID, direction=IN, server-argument-impl-policy=USE-ARGUMENT-TYPE
        SetDataIndex
          arg DataIndex: type=uint8, direction=IN, server-argument-impl-policy=USE-ARGUMENT-TYPE
        SetRamBlockStatus
          arg RamBlockStatus: type=boolean, direction=IN, server-argument-impl-policy=USE-ARGUMENT-TYPE
        WriteBlock
          arg SrcPtr: type=dtRef_const_VOID, direction=IN, server-argument-impl-policy=USE-ARGUMENT-TYPE
      error E_NOT_OK: error-code=1
    NvMService_AC2_SRBS_DS_Defs
      7 x operation, all with possible-error=NvMService_AC2_SRBS_DS_Defs/E_NOT_OK:
        GetDataIndex
          arg DataIndex: type=uint8, direction=OUT, server-argument-impl-policy=USE-ARGUMENT-TYPE
        GetErrorStatus
          arg ErrorStatus: type=NvM_RequestResultType, direction=OUT, server-argument-impl-policy=USE-ARGUMENT-TYPE
        ReadBlock
          arg DstPtr: type=dtRef_VOID, direction=IN, server-argument-impl-policy=USE-ARGUMENT-TYPE
        RestoreBlockDefaults
          arg DstPtr: type=dtRef_VOID, direction=IN, server-argument-impl-policy=USE-ARGUMENT-TYPE
        SetDataIndex
          arg DataIndex: type=uint8, direction=IN, server-argument-impl-policy=USE-ARGUMENT-TYPE
        SetRamBlockStatus
          arg RamBlockStatus: type=boolean, direction=IN, server-argument-impl-policy=USE-ARGUMENT-TYPE
        WriteBlock
          arg SrcPtr: type=dtRef_const_VOID, direction=IN, server-argument-impl-policy=USE-ARGUMENT-TYPE
      error E_NOT_OK: error-code=1
    NvMService_AC3
      5 x operation, all with possible-error=NvMService_AC3/E_NOT_OK:
        EraseBlock
        GetErrorStatus
          arg ErrorStatus: type=NvM_RequestResultType, direction=OUT, server-argument-impl-policy=USE-ARGUMENT-TYPE
        InvalidateNvBlock
        ReadBlock
          arg DstPtr: type=dtRef_VOID, direction=IN, server-argument-impl-policy=USE-ARGUMENT-TYPE
        WriteBlock
          arg SrcPtr: type=dtRef_const_VOID, direction=IN, server-argument-impl-policy=USE-ARGUMENT-TYPE
      error E_NOT_OK: error-code=1
    NvMService_AC3_Defs
      6 x operation, all with possible-error=NvMService_AC3_Defs/E_NOT_OK:
        EraseBlock
        GetErrorStatus
          arg ErrorStatus: type=NvM_RequestResultType, direction=OUT, server-argument-impl-policy=USE-ARGUMENT-TYPE
        InvalidateNvBlock
        ReadBlock
          arg DstPtr: type=dtRef_VOID, direction=IN, server-argument-impl-policy=USE-ARGUMENT-TYPE
        RestoreBlockDefaults
          arg DstPtr: type=dtRef_VOID, direction=IN, server-argument-impl-policy=USE-ARGUMENT-TYPE
        WriteBlock
          arg SrcPtr: type=dtRef_const_VOID, direction=IN, server-argument-impl-policy=USE-ARGUMENT-TYPE
      error E_NOT_OK: error-code=1
    NvMService_AC3_DS
      7 x operation, all with possible-error=NvMService_AC3_DS/E_NOT_OK:
        EraseBlock
        GetDataIndex
          arg DataIndex: type=uint8, direction=OUT, server-argument-impl-policy=USE-ARGUMENT-TYPE
        GetErrorStatus
          arg ErrorStatus: type=NvM_RequestResultType, direction=OUT, server-argument-impl-policy=USE-ARGUMENT-TYPE
        InvalidateNvBlock
        ReadBlock
          arg DstPtr: type=dtRef_VOID, direction=IN, server-argument-impl-policy=USE-ARGUMENT-TYPE
        SetDataIndex
          arg DataIndex: type=uint8, direction=IN, server-argument-impl-policy=USE-ARGUMENT-TYPE
        WriteBlock
          arg SrcPtr: type=dtRef_const_VOID, direction=IN, server-argument-impl-policy=USE-ARGUMENT-TYPE
      error E_NOT_OK: error-code=1
    NvMService_AC3_DS_Defs
      8 x operation, all with possible-error=NvMService_AC3_DS_Defs/E_NOT_OK:
        EraseBlock
        GetDataIndex
          arg DataIndex: type=uint8, direction=OUT, server-argument-impl-policy=USE-ARGUMENT-TYPE
        GetErrorStatus
          arg ErrorStatus: type=NvM_RequestResultType, direction=OUT, server-argument-impl-policy=USE-ARGUMENT-TYPE
        InvalidateNvBlock
        ReadBlock
          arg DstPtr: type=dtRef_VOID, direction=IN, server-argument-impl-policy=USE-ARGUMENT-TYPE
        RestoreBlockDefaults
          arg DstPtr: type=dtRef_VOID, direction=IN, server-argument-impl-policy=USE-ARGUMENT-TYPE
        SetDataIndex
          arg DataIndex: type=uint8, direction=IN, server-argument-impl-policy=USE-ARGUMENT-TYPE
        WriteBlock
          arg SrcPtr: type=dtRef_const_VOID, direction=IN, server-argument-impl-policy=USE-ARGUMENT-TYPE
      error E_NOT_OK: error-code=1
    NvMService_AC3_SRBS
      6 x operation, all with possible-error=NvMService_AC3_SRBS/E_NOT_OK:
        EraseBlock
        GetErrorStatus
          arg ErrorStatus: type=NvM_RequestResultType, direction=OUT, server-argument-impl-policy=USE-ARGUMENT-TYPE
        InvalidateNvBlock
        ReadBlock
          arg DstPtr: type=dtRef_VOID, direction=IN, server-argument-impl-policy=USE-ARGUMENT-TYPE
        SetRamBlockStatus
          arg RamBlockStatus: type=boolean, direction=IN, server-argument-impl-policy=USE-ARGUMENT-TYPE
        WriteBlock
          arg SrcPtr: type=dtRef_const_VOID, direction=IN, server-argument-impl-policy=USE-ARGUMENT-TYPE
      error E_NOT_OK: error-code=1
    NvMService_AC3_SRBS_Defs
      7 x operation, all with possible-error=NvMService_AC3_SRBS_Defs/E_NOT_OK:
        EraseBlock
        GetErrorStatus
          arg ErrorStatus: type=NvM_RequestResultType, direction=OUT, server-argument-impl-policy=USE-ARGUMENT-TYPE
        InvalidateNvBlock
        ReadBlock
          arg DstPtr: type=dtRef_VOID, direction=IN, server-argument-impl-policy=USE-ARGUMENT-TYPE
        RestoreBlockDefaults
          arg DstPtr: type=dtRef_VOID, direction=IN, server-argument-impl-policy=USE-ARGUMENT-TYPE
        SetRamBlockStatus
          arg RamBlockStatus: type=boolean, direction=IN, server-argument-impl-policy=USE-ARGUMENT-TYPE
        WriteBlock
          arg SrcPtr: type=dtRef_const_VOID, direction=IN, server-argument-impl-policy=USE-ARGUMENT-TYPE
      error E_NOT_OK: error-code=1
    NvMService_AC3_SRBS_DS
      8 x operation, all with possible-error=NvMService_AC3_SRBS_DS/E_NOT_OK:
        EraseBlock
        GetDataIndex
          arg DataIndex: type=uint8, direction=OUT, server-argument-impl-policy=USE-ARGUMENT-TYPE
        GetErrorStatus
          arg ErrorStatus: type=NvM_RequestResultType, direction=OUT, server-argument-impl-policy=USE-ARGUMENT-TYPE
        InvalidateNvBlock
        ReadBlock
          arg DstPtr: type=dtRef_VOID, direction=IN, server-argument-impl-policy=USE-ARGUMENT-TYPE
        SetDataIndex
          arg DataIndex: type=uint8, direction=IN, server-argument-impl-policy=USE-ARGUMENT-TYPE
        SetRamBlockStatus
          arg RamBlockStatus: type=boolean, direction=IN, server-argument-impl-policy=USE-ARGUMENT-TYPE
        WriteBlock
          arg SrcPtr: type=dtRef_const_VOID, direction=IN, server-argument-impl-policy=USE-ARGUMENT-TYPE
      error E_NOT_OK: error-code=1
    NvMService_AC3_SRBS_DS_Defs
      9 x operation, all with possible-error=NvMService_AC3_SRBS_DS_Defs/E_NOT_OK:
        EraseBlock
        GetDataIndex
          arg DataIndex: type=uint8, direction=OUT, server-argument-impl-policy=USE-ARGUMENT-TYPE
        GetErrorStatus
          arg ErrorStatus: type=NvM_RequestResultType, direction=OUT, server-argument-impl-policy=USE-ARGUMENT-TYPE
        InvalidateNvBlock
        ReadBlock
          arg DstPtr: type=dtRef_VOID, direction=IN, server-argument-impl-policy=USE-ARGUMENT-TYPE
        RestoreBlockDefaults
          arg DstPtr: type=dtRef_VOID, direction=IN, server-argument-impl-policy=USE-ARGUMENT-TYPE
        SetDataIndex
          arg DataIndex: type=uint8, direction=IN, server-argument-impl-policy=USE-ARGUMENT-TYPE
        SetRamBlockStatus
          arg RamBlockStatus: type=boolean, direction=IN, server-argument-impl-policy=USE-ARGUMENT-TYPE
        WriteBlock
          arg SrcPtr: type=dtRef_const_VOID, direction=IN, server-argument-impl-policy=USE-ARGUMENT-TYPE
      error E_NOT_OK: error-code=1
    NvMService_SRBS
      operation GetErrorStatus: possible-error=NvMService_SRBS/E_NOT_OK
        arg ErrorStatus: type=NvM_RequestResultType, direction=OUT, server-argument-impl-policy=USE-ARGUMENT-TYPE
      operation SetRamBlockStatus: possible-error=NvMService_SRBS/E_NOT_OK
        arg RamBlockStatus: type=boolean, direction=IN, server-argument-impl-policy=USE-ARGUMENT-TYPE
      error E_NOT_OK: error-code=1
